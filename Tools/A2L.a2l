ASAP2_VERSION 1 51
/begin PROJECT Project_VCU ""
/begin MODULE Module_1 ""
/begin IF_DATA XCP
 /begin PROTOCOL_LAYER 0x0100 0x07D0 0x2710 0 0 0 0 0 0x08 0x0008 BYTE_ORDER_MSB_LAST ADDRESS_GRANULARITY_BYTE SEED_AND_KEY_EXTERNAL_FUNCTION "" /end PROTOCOL_LAYER
 /begin DAQ DYNAMIC 0x0000 0x0002 0x00 OPTIMISATION_TYPE_DEFAULT ADDRESS_EXTENSION_FREE IDENTIFICATION_FIELD_TYPE_ABSOLUTE GRANULARITY_ODT_ENTRY_SIZE_DAQ_BYTE 0x07 OVERLOAD_INDICATION_PID /begin TIMESTAMP_SUPPORTED 0x0010 SIZE_WORD UNIT_100NS /end TIMESTAMP_SUPPORTED
  /begin EVENT "XcpEventChannel_10MS" "XcpEventChannel_10MS" 0x0000 DAQ 0xFF 0x01 0x06 0x00 /end EVENT
  /begin EVENT "XcpEventChannel_20MS" "XcpEventChannel_10MS" 0x0001 DAQ 0xFF 0x02 0x06 0x00 /end EVENT
 /end DAQ
 /begin XCP_ON_CAN 0x00000000 0x00000606 0x00000607 500000 50 SINGLE 0 0 SINGLE 0 /end XCP_ON_CAN
/end IF_DATA
/begin MOD_COMMON "" BYTE_ORDER MSB_LAST /end MOD_COMMON
/begin CHARACTERISTIC SensorMng.c_SensorMngCtrlVal_Bts7xx_HS1_En "" VALUE 0x802F0008 __UBYTE_S 0 DEFAULT_CM 0 255 BIT_MASK 0x000000FF FORMAT "%0.15" /end CHARACTERISTIC
/begin CHARACTERISTIC SensorMng.c_SensorMngCtrlVal_Bts7xx_HS2_En "" VALUE 0x802F0009 __UBYTE_S 0 DEFAULT_CM 0 255 BIT_MASK 0x000000FF FORMAT "%0.15" /end CHARACTERISTIC
/begin CHARACTERISTIC SensorMng.c_SensorMngCtrlVal_Bts7xx_HS3_En "" VALUE 0x802F000A __UBYTE_S 0 DEFAULT_CM 0 255 BIT_MASK 0x000000FF FORMAT "%0.15" /end CHARACTERISTIC
/begin CHARACTERISTIC SensorMng.c_SensorMngCtrlVal_Bts7xx_HS4_En "" VALUE 0x802F000B __UBYTE_S 0 DEFAULT_CM 0 255 BIT_MASK 0x000000FF FORMAT "%0.15" /end CHARACTERISTIC
/begin CHARACTERISTIC SensorMng.c_SensorMngCtrlVal_Tle4252d_en "" VALUE 0x802F000F __UBYTE_S 0 DEFAULT_CM 0 255 BIT_MASK 0x000000FF FORMAT "%0.15" /end CHARACTERISTIC
/begin CHARACTERISTIC SensorMng.c_SensorMngCtrlVal_Tle888qk_Lout01_En "" VALUE 0x802F0004 __UBYTE_S 0 DEFAULT_CM 0 255 BIT_MASK 0x000000FF FORMAT "%0.15" /end CHARACTERISTIC
/begin CHARACTERISTIC SensorMng.c_SensorMngCtrlVal_Tle888qk_Lout08_En "" VALUE 0x802F0005 __UBYTE_S 0 DEFAULT_CM 0 255 BIT_MASK 0x000000FF FORMAT "%0.15" /end CHARACTERISTIC
/begin CHARACTERISTIC SensorMng.c_SensorMngCtrlVal_Tle888qk_Lout14_En "" VALUE 0x802F0006 __UBYTE_S 0 DEFAULT_CM 0 255 BIT_MASK 0x000000FF FORMAT "%0.15" /end CHARACTERISTIC
/begin CHARACTERISTIC SensorMng.c_SensorMngCtrlVal_Tle888qk_Lout16_En "" VALUE 0x802F0007 __UBYTE_S 0 DEFAULT_CM 0 255 BIT_MASK 0x000000FF FORMAT "%0.15" /end CHARACTERISTIC
/begin CHARACTERISTIC SensorMng.c_SensorMngCtrlVal_Tle888qk_Out21_En "" VALUE 0x802F0000 __UBYTE_S 0 DEFAULT_CM 0 255 BIT_MASK 0x000000FF FORMAT "%0.15" /end CHARACTERISTIC
/begin CHARACTERISTIC SensorMng.c_SensorMngCtrlVal_Tle888qk_Out22_En "" VALUE 0x802F0001 __UBYTE_S 0 DEFAULT_CM 0 255 BIT_MASK 0x000000FF FORMAT "%0.15" /end CHARACTERISTIC
/begin CHARACTERISTIC SensorMng.c_SensorMngCtrlVal_Tle888qk_Out23_En "" VALUE 0x802F0002 __UBYTE_S 0 DEFAULT_CM 0 255 BIT_MASK 0x000000FF FORMAT "%0.15" /end CHARACTERISTIC
/begin CHARACTERISTIC SensorMng.c_SensorMngCtrlVal_Tle888qk_Out24_En "" VALUE 0x802F0003 __UBYTE_S 0 DEFAULT_CM 0 255 BIT_MASK 0x000000FF FORMAT "%0.15" /end CHARACTERISTIC
/begin CHARACTERISTIC SensorMng.c_SensorMngCtrlVal_Tle9201_Dir "" VALUE 0x802F000C __UBYTE_S 0 DEFAULT_CM 0 255 BIT_MASK 0x000000FF FORMAT "%0.15" /end CHARACTERISTIC
/begin CHARACTERISTIC SensorMng.c_SensorMngCtrlVal_Tle9201_Dis "" VALUE 0x802F000E __UBYTE_S 0 DEFAULT_CM 0 255 BIT_MASK 0x000000FF FORMAT "%0.15" /end CHARACTERISTIC
/begin CHARACTERISTIC SensorMng.c_SensorMngCtrlVal_Tle9201_Pwm "" VALUE 0x802F000D __UBYTE_S 0 DEFAULT_CM 0 255 BIT_MASK 0x000000FF FORMAT "%0.15" /end CHARACTERISTIC
/begin CHARACTERISTIC CtAp_BMSMgmt_Cal.c_HvMgmt_BMSHVPowerOff_CFG "" VALUE 0x802F0032 __UWORD_S 0 DEFAULT_CM 0 65535 BIT_MASK 0x0000FFFF FORMAT "%0.15" /end CHARACTERISTIC
/begin CHARACTERISTIC CtAp_BMSMgmt_Cal.c_HvMgmt_BMSHVPowerOn_CFG "" VALUE 0x802F0136 __UWORD_S 0 DEFAULT_CM 0 65535 BIT_MASK 0x0000FFFF FORMAT "%0.15" /end CHARACTERISTIC
/begin CHARACTERISTIC CtAp_ChrgComM_Cal.c_DCChrMgmt_DcPortErrRelsTempLv2_CFG "" VALUE 0x802F008C __SWORD_S 0 DEFAULT_CM -32768 32767 BIT_MASK 0x0000FFFF FORMAT "%0.15" /end CHARACTERISTIC
/begin CHARACTERISTIC CtAp_SpdLmt_Cal.c_TorqPahMgmt_DftFwdMaxSpd3GearD_CFG "" VALUE 0x802F8E02 __UBYTE_S 0 DEFAULT_CM 0 255 BIT_MASK 0x000000FF FORMAT "%0.15" /end CHARACTERISTIC
/begin COMPU_METHOD DEFAULT_CM "" RAT_FUNC "%6.2" "" COEFFS 0 1 0 0 0 1 /end COMPU_METHOD
/begin RECORD_LAYOUT __UBYTE_S FNC_VALUES 1 UBYTE ROW_DIR DIRECT /end RECORD_LAYOUT
/begin RECORD_LAYOUT __SBYTE_S FNC_VALUES 1 SBYTE ROW_DIR DIRECT /end RECORD_LAYOUT
/begin RECORD_LAYOUT __UWORD_S FNC_VALUES 1 UWORD ROW_DIR DIRECT /end RECORD_LAYOUT
/begin RECORD_LAYOUT __SWORD_S FNC_VALUES 1 SWORD ROW_DIR DIRECT /end RECORD_LAYOUT
/begin RECORD_LAYOUT __ULONG_S FNC_VALUES 1 ULONG ROW_DIR DIRECT /end RECORD_LAYOUT
/begin RECORD_LAYOUT __SLONG_S FNC_VALUES 1 SLONG ROW_DIR DIRECT /end RECORD_LAYOUT
/begin RECORD_LAYOUT __FLOAT32_IEEE_S FNC_VALUES 1 FLOAT32_IEEE ROW_DIR DIRECT /end RECORD_LAYOUT
/begin RECORD_LAYOUT __FLOAT64_IEEE_S FNC_VALUES 1 FLOAT64_IEEE ROW_DIR DIRECT /end RECORD_LAYOUT
/end MODULE
/end PROJECT
