ASAP2_VERSION 1 51
/begin PROJECT Project_VCU ""
/begin MODULE Module_1 ""
/begin IF_DATA XCP
 /begin PROTOCOL_LAYER 0x0100 0x07D0 0x2710 0 0 0 0 0 0x08 0x0008 BYTE_ORDER_MSB_LAST ADDRESS_GRANULARITY_BYTE SEED_AND_KEY_EXTERNAL_FUNCTION "" /end PROTOCOL_LAYER
 /begin DAQ DYNAMIC 0x0000 0x0002 0x00 OPTIMISATION_TYPE_DEFAULT ADDRESS_EXTENSION_FREE IDENTIFICATION_FIELD_TYPE_ABSOLUTE GRANULARITY_ODT_ENTRY_SIZE_DAQ_BYTE 0x07 OVERLOAD_INDICATION_PID /begin TIMESTAMP_SUPPORTED 0x0010 SIZE_WORD UNIT_100NS /end TIMESTAMP_SUPPORTED
  /begin EVENT "XcpEventChannel_10MS" "XcpEventChannel_10MS" 0x0000 DAQ 0xFF 0x01 0x06 0x00 /end EVENT
  /begin EVENT "XcpEventChannel_20MS" "XcpEventChannel_10MS" 0x0001 DAQ 0xFF 0x02 0x06 0x00 /end EVENT
 /end DAQ
 /begin XCP_ON_CAN 0x00000000 0x00000606 0x00000607 500000 50 SINGLE 0 0 SINGLE 0 /end XCP_ON_CAN
/end IF_DATA
/begin MOD_COMMON "" BYTE_ORDER MSB_LAST /end MOD_COMMON
/begin MEASUREMENT SensorMng.c_Ext_D_In2 "" UBYTE DEFAULT_CM 0 0 0 255 BIT_MASK 0x000000FF ECU_ADDRESS 0x7000AA36 FORMAT "%0.15" /end MEASUREMENT
/begin CHARACTERISTIC CDD_MyApp.c_Calib_Sig0_Calib_Sig0._0 "" VALUE 0x80101C27 __UBYTE_S 0 DEFAULT_CM 0 255 BIT_MASK 0x000000FF FORMAT "%0.15" /end CHARACTERISTIC
/begin CHARACTERISTIC CDD_MyApp.c_Calib_Sig1_Calib_Sig1._0 "" VALUE 0x7000B7E4 __UBYTE_S 0 DEFAULT_CM 0 255 BIT_MASK 0x000000FF FORMAT "%0.15" /end CHARACTERISTIC
/begin CHARACTERISTIC PwmIf.c_PwmOutPeriod_Set_Flash1_PwmOutPeriod_Set_Flash1._0 "" VALUE 0x80100620 __ULONG_S 0 DEFAULT_CM 0 4294967295 FORMAT "%0.15" /end CHARACTERISTIC
/begin CHARACTERISTIC PwmIf.c_PwmOutPeriod_Set_Flash1_PwmOutPeriod_Set_Flash1._1 "" VALUE 0x80100624 __ULONG_S 0 DEFAULT_CM 0 4294967295 FORMAT "%0.15" /end CHARACTERISTIC
/begin CHARACTERISTIC SensorMng.c_SensorMngCtrlVal_Bts7xx_HS1_En "" VALUE 0x7000A96C __UBYTE_S 0 DEFAULT_CM 0 255 BIT_MASK 0x000000FF FORMAT "%0.15" /end CHARACTERISTIC
/begin CHARACTERISTIC SensorMng.c_SensorMngCtrlVal_Bts7xx_HS2_En "" VALUE 0x7000A96D __UBYTE_S 0 DEFAULT_CM 0 255 BIT_MASK 0x000000FF FORMAT "%0.15" /end CHARACTERISTIC
/begin CHARACTERISTIC SensorMng.c_SensorMngCtrlVal_Bts7xx_HS3_En "" VALUE 0x7000A96E __UBYTE_S 0 DEFAULT_CM 0 255 BIT_MASK 0x000000FF FORMAT "%0.15" /end CHARACTERISTIC
/begin CHARACTERISTIC SensorMng.c_SensorMngCtrlVal_Bts7xx_HS4_En "" VALUE 0x7000A96F __UBYTE_S 0 DEFAULT_CM 0 255 BIT_MASK 0x000000FF FORMAT "%0.15" /end CHARACTERISTIC
/begin CHARACTERISTIC SensorMng.c_SensorMngCtrlVal_Tle4252d_en "" VALUE 0x7000A973 __UBYTE_S 0 DEFAULT_CM 0 255 BIT_MASK 0x000000FF FORMAT "%0.15" /end CHARACTERISTIC
/begin CHARACTERISTIC SensorMng.c_SensorMngCtrlVal_Tle888qk_Lout01_En "" VALUE 0x7000A968 __UBYTE_S 0 DEFAULT_CM 0 255 BIT_MASK 0x000000FF FORMAT "%0.15" /end CHARACTERISTIC
/begin CHARACTERISTIC SensorMng.c_SensorMngCtrlVal_Tle888qk_Lout08_En "" VALUE 0x7000A969 __UBYTE_S 0 DEFAULT_CM 0 255 BIT_MASK 0x000000FF FORMAT "%0.15" /end CHARACTERISTIC
/begin CHARACTERISTIC SensorMng.c_SensorMngCtrlVal_Tle888qk_Lout14_En "" VALUE 0x7000A96A __UBYTE_S 0 DEFAULT_CM 0 255 BIT_MASK 0x000000FF FORMAT "%0.15" /end CHARACTERISTIC
/begin CHARACTERISTIC SensorMng.c_SensorMngCtrlVal_Tle888qk_Lout16_En "" VALUE 0x7000A96B __UBYTE_S 0 DEFAULT_CM 0 255 BIT_MASK 0x000000FF FORMAT "%0.15" /end CHARACTERISTIC
/begin CHARACTERISTIC SensorMng.c_SensorMngCtrlVal_Tle888qk_Out21_En "" VALUE 0x7000A964 __UBYTE_S 0 DEFAULT_CM 0 255 BIT_MASK 0x000000FF FORMAT "%0.15" /end CHARACTERISTIC
/begin CHARACTERISTIC SensorMng.c_SensorMngCtrlVal_Tle888qk_Out22_En "" VALUE 0x7000A965 __UBYTE_S 0 DEFAULT_CM 0 255 BIT_MASK 0x000000FF FORMAT "%0.15" /end CHARACTERISTIC
/begin CHARACTERISTIC SensorMng.c_SensorMngCtrlVal_Tle888qk_Out23_En "" VALUE 0x7000A966 __UBYTE_S 0 DEFAULT_CM 0 255 BIT_MASK 0x000000FF FORMAT "%0.15" /end CHARACTERISTIC
/begin CHARACTERISTIC SensorMng.c_SensorMngCtrlVal_Tle888qk_Out24_En "" VALUE 0x7000A967 __UBYTE_S 0 DEFAULT_CM 0 255 BIT_MASK 0x000000FF FORMAT "%0.15" /end CHARACTERISTIC
/begin CHARACTERISTIC SensorMng.c_SensorMngCtrlVal_Tle9201_Dir "" VALUE 0x7000A970 __UBYTE_S 0 DEFAULT_CM 0 255 BIT_MASK 0x000000FF FORMAT "%0.15" /end CHARACTERISTIC
/begin CHARACTERISTIC SensorMng.c_SensorMngCtrlVal_Tle9201_Dis "" VALUE 0x7000A972 __UBYTE_S 0 DEFAULT_CM 0 255 BIT_MASK 0x000000FF FORMAT "%0.15" /end CHARACTERISTIC
/begin CHARACTERISTIC SensorMng.c_SensorMngCtrlVal_Tle9201_Pwm "" VALUE 0x7000A971 __UBYTE_S 0 DEFAULT_CM 0 255 BIT_MASK 0x000000FF FORMAT "%0.15" /end CHARACTERISTIC
/begin COMPU_METHOD DEFAULT_CM "" RAT_FUNC "%6.2" "" COEFFS 0 1 0 0 0 1 /end COMPU_METHOD
/begin RECORD_LAYOUT __UBYTE_S FNC_VALUES 1 UBYTE ROW_DIR DIRECT /end RECORD_LAYOUT
/begin RECORD_LAYOUT __SBYTE_S FNC_VALUES 1 SBYTE ROW_DIR DIRECT /end RECORD_LAYOUT
/begin RECORD_LAYOUT __UWORD_S FNC_VALUES 1 UWORD ROW_DIR DIRECT /end RECORD_LAYOUT
/begin RECORD_LAYOUT __SWORD_S FNC_VALUES 1 SWORD ROW_DIR DIRECT /end RECORD_LAYOUT
/begin RECORD_LAYOUT __ULONG_S FNC_VALUES 1 ULONG ROW_DIR DIRECT /end RECORD_LAYOUT
/begin RECORD_LAYOUT __SLONG_S FNC_VALUES 1 SLONG ROW_DIR DIRECT /end RECORD_LAYOUT
/begin RECORD_LAYOUT __FLOAT32_IEEE_S FNC_VALUES 1 FLOAT32_IEEE ROW_DIR DIRECT /end RECORD_LAYOUT
/begin RECORD_LAYOUT __FLOAT64_IEEE_S FNC_VALUES 1 FLOAT64_IEEE ROW_DIR DIRECT /end RECORD_LAYOUT
/end MODULE
/end PROJECT
