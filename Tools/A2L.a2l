/* @@@@ File written by CANAPE_VERSION 17 0 31 @@@@ */ ASAP2_VERSION 1 51
/begin PROJECT Project_VCU ""
/begin MODULE Module_1 ""
/begin MOD_COMMON "" BYTE_ORDER MSB_LAST ALIGNMENT_BYTE 1 ALIGNMENT_WORD 1 ALIGNMENT_LONG 1 ALIGNMENT_FLOAT32_IEEE 1 ALIGNMENT_FLOAT64_IEEE 1 /end MOD_COMMON
/begin IF_DATA XCP
 /begin PROTOCOL_LAYER 0x0104 0x07D0 0x2710 0x00 0x00 0x00 0x00 0x00 0x08 0x08 BYTE_ORDER_MSB_LAST ADDRESS_GRANULARITY_BYTE OPTIONAL_CMD ALLOC_ODT_ENTRY OPTIONAL_CMD ALLOC_ODT OPTIONAL_CMD ALLOC_DAQ OPTIONAL_CMD FREE_DAQ OPTIONAL_CMD GET_DAQ_EVENT_INFO OPTIONAL_CMD GET_DAQ_RESOLUTION_INFO OPTIONAL_CMD GET_DAQ_PROCESSOR_INFO OPTIONAL_CMD START_STOP_SYNCH OPTIONAL_CMD START_STOP_DAQ_LIST OPTIONAL_CMD GET_DAQ_LIST_MODE OPTIONAL_CMD SET_DAQ_LIST_MODE OPTIONAL_CMD WRITE_DAQ OPTIONAL_CMD SET_DAQ_PTR OPTIONAL_CMD CLEAR_DAQ_LIST OPTIONAL_CMD GET_CAL_PAGE OPTIONAL_CMD SET_CAL_PAGE OPTIONAL_CMD DOWNLOAD OPTIONAL_CMD UPLOAD OPTIONAL_CMD SET_MTA OPTIONAL_CMD GET_COMM_MODE_INFO COMMUNICATION_MODE_SUPPORTED BLOCK MASTER 0x2B 0x01 /end PROTOCOL_LAYER
 /begin XCP_ON_CAN 0x0100 CAN_ID_MASTER 0x0606 CAN_ID_SLAVE 0x0607 BAUDRATE 0x07A120 SAMPLE_POINT 0x4B SAMPLE_RATE SINGLE BTL_CYCLES 0x08 SJW 0x02 SYNC_EDGE SINGLE MAX_DLC_REQUIRED /end XCP_ON_CAN
/end IF_DATA
/begin IF_DATA XCP
 /begin PROTOCOL_LAYER 0x0100 0x07D0 0x2710 0 0 0 0 0 0x08 0x0008 BYTE_ORDER_MSB_LAST ADDRESS_GRANULARITY_BYTE SEED_AND_KEY_EXTERNAL_FUNCTION "" /end PROTOCOL_LAYER
 /begin DAQ DYNAMIC 0x0000 0x0002 0x00 OPTIMISATION_TYPE_DEFAULT ADDRESS_EXTENSION_FREE IDENTIFICATION_FIELD_TYPE_ABSOLUTE GRANULARITY_ODT_ENTRY_SIZE_DAQ_BYTE 0x07 OVERLOAD_INDICATION_PID /begin TIMESTAMP_SUPPORTED 0x0010 SIZE_WORD UNIT_100NS /end TIMESTAMP_SUPPORTED
  /begin EVENT "XcpEventChannel_10MS" "XcpEventChannel_10MS" 0x0000 DAQ 0xFF 0x01 0x06 0x00 /end EVENT
  /begin EVENT "XcpEventChannel_20MS" "XcpEventChannel_10MS" 0x0001 DAQ 0xFF 0x02 0x06 0x00 /end EVENT
 /end DAQ
 /begin XCP_ON_CAN 0x00000000 0x00000606 0x00000607 500000 50 SINGLE 0 0 SINGLE 0 /end XCP_ON_CAN
/end IF_DATA
/begin MOD_PAR ""
 /begin MEMORY_SEGMENT CALRAM "" DATA RAM INTERN 0x7000000 0x1000000 -1 -1 -1 -1 -1
  /begin IF_DATA XCP
   /begin SEGMENT 0x00 0x02 0x00 0x00 0x00
    /begin PAGE 0x00 ECU_ACCESS_ALLOWED_WITH_XCP_ONLY XCP_READ_ACCESS_ALLOWED_WITH_ECU_ONLY XCP_WRITE_ACCESS_NOT_ALLOWED /end PAGE
    /begin PAGE 0x01 ECU_ACCESS_ALLOWED_WITH_XCP_ONLY XCP_READ_ACCESS_ALLOWED_WITH_ECU_ONLY XCP_WRITE_ACCESS_ALLOWED_WITH_ECU_ONLY /end PAGE
   /end SEGMENT
  /end IF_DATA
 /end MEMORY_SEGMENT
/end MOD_PAR
/begin COMPU_METHOD DEFAULT_CM "" RAT_FUNC "%6.2" "" COEFFS 0 1 0 0 0 1 /end COMPU_METHOD
/begin CHARACTERISTIC CDD_MyApp.c_Calib_Sig0_Calib_Sig0._0 "" VALUE 0x80101C27 __UBYTE_S 0 DEFAULT_CM 0 255 FORMAT "%.15" /end CHARACTERISTIC
/begin CHARACTERISTIC CDD_MyApp.c_Calib_Sig1_Calib_Sig1._0 "" VALUE 0x7000B6F0 __UBYTE_S 0 DEFAULT_CM 0 255 FORMAT "%.15" /end CHARACTERISTIC
/begin CHARACTERISTIC PwmIf.c_PwmOutPeriod_Set_Flash1_PwmOutPeriod_Set_Flash1._0 "" VALUE 0x80100620 __ULONG_S 0 DEFAULT_CM 0 4294967295 FORMAT "%.15" /end CHARACTERISTIC
/begin CHARACTERISTIC PwmIf.c_PwmOutPeriod_Set_Flash1_PwmOutPeriod_Set_Flash1._1 "" VALUE 0x80100624 __ULONG_S 0 DEFAULT_CM 0 4294967295 FORMAT "%.15" /end CHARACTERISTIC
/begin MEASUREMENT SensorMng.c_Ext_D_In2 "" UBYTE DEFAULT_CM 0 0 0 255 ECU_ADDRESS 0x7000A964 FORMAT "%.15" /end MEASUREMENT
/begin CHARACTERISTIC SensorMng.c_SensorMngCtrlVal_Bts7xx_HS1_En "" VALUE 0x7000A89C __UBYTE_S 0 DEFAULT_CM 0 255 FORMAT "%.15" /end CHARACTERISTIC
/begin CHARACTERISTIC SensorMng.c_SensorMngCtrlVal_Bts7xx_HS2_En "" VALUE 0x7000A89D __UBYTE_S 0 DEFAULT_CM 0 255 FORMAT "%.15" /end CHARACTERISTIC
/begin CHARACTERISTIC SensorMng.c_SensorMngCtrlVal_Bts7xx_HS3_En "" VALUE 0x7000A89E __UBYTE_S 0 DEFAULT_CM 0 255 FORMAT "%.15" /end CHARACTERISTIC
/begin CHARACTERISTIC SensorMng.c_SensorMngCtrlVal_Bts7xx_HS4_En "" VALUE 0x7000A89F __UBYTE_S 0 DEFAULT_CM 0 255 FORMAT "%.15" /end CHARACTERISTIC
/begin CHARACTERISTIC SensorMng.c_SensorMngCtrlVal_Tle4252d_en "" VALUE 0x7000A8A3 __UBYTE_S 0 DEFAULT_CM 0 255 FORMAT "%.15" /end CHARACTERISTIC
/begin CHARACTERISTIC SensorMng.c_SensorMngCtrlVal_Tle888qk_Lout01_En "" VALUE 0x7000A898 __UBYTE_S 0 DEFAULT_CM 0 255 FORMAT "%.15" /end CHARACTERISTIC
/begin CHARACTERISTIC SensorMng.c_SensorMngCtrlVal_Tle888qk_Lout08_En "" VALUE 0x7000A899 __UBYTE_S 0 DEFAULT_CM 0 255 FORMAT "%.15" /end CHARACTERISTIC
/begin CHARACTERISTIC SensorMng.c_SensorMngCtrlVal_Tle888qk_Lout14_En "" VALUE 0x7000A89A __UBYTE_S 0 DEFAULT_CM 0 255 FORMAT "%.15" /end CHARACTERISTIC
/begin CHARACTERISTIC SensorMng.c_SensorMngCtrlVal_Tle888qk_Lout16_En "" VALUE 0x7000A89B __UBYTE_S 0 DEFAULT_CM 0 255 FORMAT "%.15" /end CHARACTERISTIC
/begin CHARACTERISTIC SensorMng.c_SensorMngCtrlVal_Tle888qk_Out21_En "" VALUE 0x7000A894 __UBYTE_S 0 DEFAULT_CM 0 255 FORMAT "%.15" /end CHARACTERISTIC
/begin CHARACTERISTIC SensorMng.c_SensorMngCtrlVal_Tle888qk_Out22_En "" VALUE 0x7000A895 __UBYTE_S 0 DEFAULT_CM 0 255 FORMAT "%.15" /end CHARACTERISTIC
/begin CHARACTERISTIC SensorMng.c_SensorMngCtrlVal_Tle888qk_Out23_En "" VALUE 0x7000A896 __UBYTE_S 0 DEFAULT_CM 0 255 FORMAT "%.15" /end CHARACTERISTIC
/begin CHARACTERISTIC SensorMng.c_SensorMngCtrlVal_Tle888qk_Out24_En "" VALUE 0x7000A897 __UBYTE_S 0 DEFAULT_CM 0 255 FORMAT "%.15" /end CHARACTERISTIC
/begin CHARACTERISTIC SensorMng.c_SensorMngCtrlVal_Tle9201_Dir "" VALUE 0x7000A8A0 __UBYTE_S 0 DEFAULT_CM 0 255 FORMAT "%.15" /end CHARACTERISTIC
/begin CHARACTERISTIC SensorMng.c_SensorMngCtrlVal_Tle9201_Dis "" VALUE 0x7000A8A2 __UBYTE_S 0 DEFAULT_CM 0 255 FORMAT "%.15" /end CHARACTERISTIC
/begin CHARACTERISTIC SensorMng.c_SensorMngCtrlVal_Tle9201_Pwm "" VALUE 0x7000A8A1 __UBYTE_S 0 DEFAULT_CM 0 255 FORMAT "%.15" /end CHARACTERISTIC
/begin RECORD_LAYOUT __FLOAT32_IEEE_S FNC_VALUES 1 FLOAT32_IEEE ROW_DIR DIRECT /end RECORD_LAYOUT
/begin RECORD_LAYOUT __FLOAT64_IEEE_S FNC_VALUES 1 FLOAT64_IEEE ROW_DIR DIRECT /end RECORD_LAYOUT
/begin RECORD_LAYOUT __SBYTE_S FNC_VALUES 1 SBYTE ROW_DIR DIRECT /end RECORD_LAYOUT
/begin RECORD_LAYOUT __SLONG_S FNC_VALUES 1 SLONG ROW_DIR DIRECT /end RECORD_LAYOUT
/begin RECORD_LAYOUT __SWORD_S FNC_VALUES 1 SWORD ROW_DIR DIRECT /end RECORD_LAYOUT
/begin RECORD_LAYOUT __UBYTE_S FNC_VALUES 1 UBYTE ROW_DIR DIRECT /end RECORD_LAYOUT
/begin RECORD_LAYOUT __ULONG_S FNC_VALUES 1 ULONG ROW_DIR DIRECT /end RECORD_LAYOUT
/begin RECORD_LAYOUT __UWORD_S FNC_VALUES 1 UWORD ROW_DIR DIRECT /end RECORD_LAYOUT
/begin RECORD_LAYOUT __UBYTE_Z FNC_VALUES 1 UBYTE ROW_DIR DIRECT /end RECORD_LAYOUT
/begin RECORD_LAYOUT __UWORD_Z FNC_VALUES 1 UWORD ROW_DIR DIRECT /end RECORD_LAYOUT
/begin RECORD_LAYOUT __ULONG_Z FNC_VALUES 1 ULONG ROW_DIR DIRECT /end RECORD_LAYOUT
/begin RECORD_LAYOUT __SBYTE_Z FNC_VALUES 1 SBYTE ROW_DIR DIRECT /end RECORD_LAYOUT
/begin RECORD_LAYOUT __SWORD_Z FNC_VALUES 1 SWORD ROW_DIR DIRECT /end RECORD_LAYOUT
/begin RECORD_LAYOUT __SLONG_Z FNC_VALUES 1 SLONG ROW_DIR DIRECT /end RECORD_LAYOUT
/begin RECORD_LAYOUT __FLOAT32_IEEE_Z FNC_VALUES 1 FLOAT32_IEEE ROW_DIR DIRECT /end RECORD_LAYOUT
/begin RECORD_LAYOUT __FLOAT64_IEEE_Z FNC_VALUES 1 FLOAT64_IEEE ROW_DIR DIRECT /end RECORD_LAYOUT
/begin RECORD_LAYOUT SSV__UBYTE_S AXIS_PTS_X 1 UBYTE INDEX_INCR DIRECT /end RECORD_LAYOUT
/begin RECORD_LAYOUT SSV__UWORD_S AXIS_PTS_X 1 UWORD INDEX_INCR DIRECT /end RECORD_LAYOUT
/begin RECORD_LAYOUT SSV__ULONG_S AXIS_PTS_X 1 ULONG INDEX_INCR DIRECT /end RECORD_LAYOUT
/begin RECORD_LAYOUT SSV__SBYTE_S AXIS_PTS_X 1 SBYTE INDEX_INCR DIRECT /end RECORD_LAYOUT
/begin RECORD_LAYOUT SSV__SWORD_S AXIS_PTS_X 1 SWORD INDEX_INCR DIRECT /end RECORD_LAYOUT
/begin RECORD_LAYOUT SSV__SLONG_S AXIS_PTS_X 1 SLONG INDEX_INCR DIRECT /end RECORD_LAYOUT
/begin RECORD_LAYOUT SSV__FLOAT32_IEEE_S AXIS_PTS_X 1 FLOAT32_IEEE INDEX_INCR DIRECT /end RECORD_LAYOUT
/begin RECORD_LAYOUT SSV__FLOAT64_IEEE_S AXIS_PTS_X 1 FLOAT64_IEEE INDEX_INCR DIRECT /end RECORD_LAYOUT
/end MODULE
/end PROJECT
