ASAP2_VERSION 1 51
/begin PROJECT Project_VCU ""
/begin MODULE Module_1 ""
/begin IF_DATA XCP
 /begin PROTOCOL_LAYER 0x0100 0x07D0 0x2710 0 0 0 0 0 0x08 0x0008 BYTE_ORDER_MSB_LAST ADDRESS_GRANULARITY_BYTE SEED_AND_KEY_EXTERNAL_FUNCTION "" /end PROTOCOL_LAYER
 /begin DAQ DYNAMIC 0x0000 0x0002 0x00 OPTIMISATION_TYPE_DEFAULT ADDRESS_EXTENSION_FREE IDENTIFICATION_FIELD_TYPE_ABSOLUTE GRANULARITY_ODT_ENTRY_SIZE_DAQ_BYTE 0x07 OVERLOAD_INDICATION_PID /begin TIMESTAMP_SUPPORTED 0x0010 SIZE_WORD UNIT_100NS /end TIMESTAMP_SUPPORTED
  /begin EVENT "XcpEventChannel_10MS" "XcpEventChannel_10MS" 0x0000 DAQ 0xFF 0x01 0x06 0x00 /end EVENT
  /begin EVENT "XcpEventChannel_20MS" "XcpEventChannel_10MS" 0x0001 DAQ 0xFF 0x02 0x06 0x00 /end EVENT
 /end DAQ
 /begin XCP_ON_CAN 0x00000000 0x00000606 0x00000607 500000 50 SINGLE 0 0 SINGLE 0 /end XCP_ON_CAN
/end IF_DATA
/begin MOD_COMMON "" BYTE_ORDER MSB_LAST /end MOD_COMMON
/begin MEASUREMENT Rte.c_Rte_DIAG_SWC_NvBlockNeed_DiagDID_00_MirrorBlock_Rte_DIAG_SWC_NvBlockNeed_DiagDID_00_MirrorBlock._0 "" UBYTE DEFAULT_CM 0 0 0 255 BIT_MASK 0x000000FF ECU_ADDRESS 0x7000BCE2 FORMAT "%0.15" /end MEASUREMENT
/begin MEASUREMENT Rte.c_Rte_DIAG_SWC_NvBlockNeed_DiagDID_00_MirrorBlock_Rte_DIAG_SWC_NvBlockNeed_DiagDID_00_MirrorBlock._1 "" UBYTE DEFAULT_CM 0 0 0 255 BIT_MASK 0x000000FF ECU_ADDRESS 0x7000BCE3 FORMAT "%0.15" /end MEASUREMENT
/begin MEASUREMENT Rte.c_Rte_DIAG_SWC_NvBlockNeed_DiagDID_00_MirrorBlock_Rte_DIAG_SWC_NvBlockNeed_DiagDID_00_MirrorBlock._2 "" UBYTE DEFAULT_CM 0 0 0 255 BIT_MASK 0x000000FF ECU_ADDRESS 0x7000BCE4 FORMAT "%0.15" /end MEASUREMENT
/begin MEASUREMENT Rte.c_Rte_DIAG_SWC_NvBlockNeed_DiagDID_00_MirrorBlock_Rte_DIAG_SWC_NvBlockNeed_DiagDID_00_MirrorBlock._3 "" UBYTE DEFAULT_CM 0 0 0 255 BIT_MASK 0x000000FF ECU_ADDRESS 0x7000BCE5 FORMAT "%0.15" /end MEASUREMENT
/begin MEASUREMENT SWC1.c_XcpCnt "" UBYTE DEFAULT_CM 0 0 0 255 BIT_MASK 0x000000FF ECU_ADDRESS 0x7000A1F8 FORMAT "%0.15" /end MEASUREMENT
/begin MEASUREMENT DIAG_SWC.c_DTC_Status_0002 "" UBYTE DEFAULT_CM 0 0 0 255 BIT_MASK 0x000000FF ECU_ADDRESS 0x7000A1F1 FORMAT "%0.15" /end MEASUREMENT
/begin MEASUREMENT DIAG_SWC.c_DTC_Status_0003 "" UBYTE DEFAULT_CM 0 0 0 255 BIT_MASK 0x000000FF ECU_ADDRESS 0x7000A1F2 FORMAT "%0.15" /end MEASUREMENT
/begin MEASUREMENT DIAG_SWC.c_DTC_FailCnt "" UBYTE DEFAULT_CM 0 0 0 255 BIT_MASK 0x000000FF ECU_ADDRESS 0x7000A1F0 FORMAT "%0.15" /end MEASUREMENT
/begin CHARACTERISTIC CDD_MyApp.c_Calib_Sig0_Calib_Sig0._0 "" VALUE 0x800015E9 __UBYTE_S 0 DEFAULT_CM 0 255 BIT_MASK 0x000000FF FORMAT "%0.15" /end CHARACTERISTIC
/begin CHARACTERISTIC CDD_MyApp.c_Calib_Sig1_Calib_Sig1._0 "" VALUE 0x7000A1AE __UBYTE_S 0 DEFAULT_CM 0 255 BIT_MASK 0x000000FF FORMAT "%0.15" /end CHARACTERISTIC
/begin CHARACTERISTIC PwmIf.c_PwmOutPeriod_Set_Flash1_PwmOutPeriod_Set_Flash1._0 "" VALUE 0x8000153C __ULONG_S 0 DEFAULT_CM 0 4294967295 FORMAT "%0.15" /end CHARACTERISTIC
/begin CHARACTERISTIC PwmIf.c_PwmOutPeriod_Set_Flash2_PwmOutPeriod_Set_Flash2._0 "" VALUE 0x8000155C __ULONG_S 0 DEFAULT_CM 0 4294967295 FORMAT "%0.15" /end CHARACTERISTIC
/begin COMPU_METHOD DEFAULT_CM "" RAT_FUNC "%6.2" "" COEFFS 0 1 0 0 0 1 /end COMPU_METHOD
/begin RECORD_LAYOUT __UBYTE_S FNC_VALUES 1 UBYTE ROW_DIR DIRECT /end RECORD_LAYOUT
/begin RECORD_LAYOUT __SBYTE_S FNC_VALUES 1 SBYTE ROW_DIR DIRECT /end RECORD_LAYOUT
/begin RECORD_LAYOUT __UWORD_S FNC_VALUES 1 UWORD ROW_DIR DIRECT /end RECORD_LAYOUT
/begin RECORD_LAYOUT __SWORD_S FNC_VALUES 1 SWORD ROW_DIR DIRECT /end RECORD_LAYOUT
/begin RECORD_LAYOUT __ULONG_S FNC_VALUES 1 ULONG ROW_DIR DIRECT /end RECORD_LAYOUT
/begin RECORD_LAYOUT __SLONG_S FNC_VALUES 1 SLONG ROW_DIR DIRECT /end RECORD_LAYOUT
/begin RECORD_LAYOUT __FLOAT32_IEEE_S FNC_VALUES 1 FLOAT32_IEEE ROW_DIR DIRECT /end RECORD_LAYOUT
/begin RECORD_LAYOUT __FLOAT64_IEEE_S FNC_VALUES 1 FLOAT64_IEEE ROW_DIR DIRECT /end RECORD_LAYOUT
/end MODULE
/end PROJECT
