ASAP2_VERSION 1 51
/begin PROJECT TC37X_VCU_V2L_Proj ""
/begin MODULE Module_1 ""
/begin IF_DATA ASAP1B_CCP
 /begin RASTER "Event10ms" "" 0 1 1 /end RASTER
 /begin RASTER "Event20ms" "" 1 2 1 /end RASTER
 /begin SEED_KEY "" "" "" /end SEED_KEY
 /begin TP_BLOB 0x201 0x206 0x00000606 0x00000607 0x00000000 0x02 BAUDRATE 0x3D090 SAMPLE_POINT 0x4B SAMPLE_RATE 0x1 BTL_CYCLES 0x8 SJW 0x2 SYNC_EDGE SINGLE DAQ_MODE BURST BYTES_ONLY CONSISTENCY ODT ADDRESS_EXTENSION DAQ /begin CHECKSUM_PARAM 0x3 0x0 /end CHECKSUM_PARAM OPTIONAL_CMD 0xF OPTIONAL_CMD 0x23 OPTIONAL_CMD 0xE /end TP_BLOB
/end IF_DATA
/begin MOD_COMMON "" BYTE_ORDER MSB_FIRST /end MOD_COMMON
/begin MEASUREMENT SWC1.c_ComMReqFlg "" UBYTE DEFAULT_CM 0 0 0 255 BIT_MASK 0x000000FF ECU_ADDRESS 0x70008DB9 FORMAT "%0.15" /end MEASUREMENT
/begin MEASUREMENT SWC1.c_XcpCnt "" UBYTE DEFAULT_CM 0 0 0 255 BIT_MASK 0x000000FF ECU_ADDRESS 0x70008DBD FORMAT "%0.15" /end MEASUREMENT
/begin COMPU_METHOD DEFAULT_CM "" RAT_FUNC "%6.2" "" COEFFS 0 1 0 0 0 1 /end COMPU_METHOD
/end MODULE
/end PROJECT
