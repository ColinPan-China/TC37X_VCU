AUTOSAR XML (schema 00048)
package /MICROSAR/CanTrcv_Tja1040
  bsw implementation CanTrcv_Impl: programming-language=C, sw-version=4.03.00, used-code-generator=DaVinci Configurator5, vendor-id=30, ar-release-version=4.00.03, vendor-api-infix=Tja1040
package /MICROSAR/CanTrcv_Tja1040_ib_bswmd/BswModuleDescriptions
  bsw module description CanTrcv: provided-entrys=CanTrcv_30_Tja1040_MainFunction
    bsw internal behavior CanTrcv_Tja1040_Behavior
      exclusive area CANTRCV_30_TJA1040_EXCLUSIVE_AREA_0
      bsw schedulable entity CanTrcv_30_Tja1040_MainFunction: implemented-entry=CanTrcv_30_Tja1040_MainFunction
      bsw timing event CanTrcv_30_Tja1040_MainFunctionTimingEvent0: starts-on-event=CanTrcv_30_Tja1040_MainFunction, period=0.01
  bsw module entry CanTrcv_30_Tja1040_MainFunction: call-type=SCHEDULED, execution-context=TASK
