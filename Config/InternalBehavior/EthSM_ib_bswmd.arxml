AUTOSAR XML (schema 00048)
package /MICROSAR/EthSM_ib_bswmd/BswModuleDescriptions
  bsw module description EthSM: provided-entrys=EthSM_MainFunction
    bsw internal behavior EthSMBehavior
      bsw schedulable entity EthSM_MainFunction: implemented-entry=EthSM_MainFunction
      bsw timing event EthSM_MainFunctionTimingEvent0: starts-on-event=EthSM_MainFunction, period=0.02
  bsw module entry EthSM_MainFunction: call-type=SCHEDULED, execution-context=TASK
