AUTOSAR XML (schema 00048)
package /MICROSAR
  bsw implementation Rte_Impl: programming-language=C, sw-version=4.26.00, used-code-generator=DaVinci Configurator, vendor-id=30, ar-release-version=4.03.01
    resource consumption ResourceConsumption
      25 x memory section:
        CODE: sw-addrmethod=CODE
        VAR_NOINIT_UNSPECIFIED: sw-addrmethod=VAR_NO_INIT
        VAR_ZERO_INIT_UNSPECIFIED: sw-addrmethod=VAR_ZERO_INIT
        VAR_ZERO_INIT_8BIT: sw-addrmethod=VAR_ZERO_INIT
        VAR_INIT_UNSPECIFIED: sw-addrmethod=VAR_INIT
        CONST_UNSPECIFIED: sw-addrmethod=CONST
        APPL_CODE: sw-addrmethod=CODE
        BSWM_APPL_CODE: sw-addrmethod=CODE
        ECUM_APPL_CODE: sw-addrmethod=CODE
        OS_OSCORE0_SWC_APPL_CODE: sw-addrmethod=CODE
        SWC1_APPL_CODE: sw-addrmethod=CODE
        COMM_APPL_CODE: sw-addrmethod=CODE
        DET_APPL_CODE: sw-addrmethod=CODE
        POWERMNG_SWC_APPL_CODE: sw-addrmethod=CODE
        COM_SWC_APPL_CODE: sw-addrmethod=CODE
        NVM_APPL_CODE: sw-addrmethod=CODE
        NVM_SWC_APPL_CODE: sw-addrmethod=CODE
        CONST_DEFAULT_RTE_CDATA_GROUP_UNSPECIFIED: sw-addrmethod=CONST
        VAR_DEFAULT_RTE_PIM_GROUP_UNSPECIFIED: sw-addrmethod=VAR_NO_INIT
        DCM_APPL_CODE: sw-addrmethod=CODE
        DEMMASTER_0_APPL_CODE: sw-addrmethod=CODE
        DEMSATELLITE_0_APPL_CODE: sw-addrmethod=CODE
        DIAG_SWC_APPL_CODE: sw-addrmethod=CODE
        IOHWAB_SWC_APPL_CODE: sw-addrmethod=CODE
        IOHWAB_APPL_CODE: sw-addrmethod=CODE
package /MICROSAR/Rte_ib_bswmd/BswModuleDescriptions
  bsw module description Rte: provided-entrys=Rte_ComSendSignalProxyPeriodic
    bsw internal behavior RteBehavior
      bsw schedulable entity Rte_ComSendSignalProxyPeriodic: implemented-entry=Rte_ComSendSignalProxyPeriodic
      bsw timing event Rte_ComSendSignalProxyPeriodicTimingEvent0: starts-on-event=Rte_ComSendSignalProxyPeriodic, period=0.01
  bsw module entry Rte_ComSendSignalProxyPeriodic: call-type=SCHEDULED, execution-context=TASK
