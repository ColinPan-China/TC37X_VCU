AUTOSAR XML (schema 00048)
package /MICROSAR
  bsw implementation Rte_Impl: programming-language=C, sw-version=4.26.00, used-code-generator=DaVinci Configurator, vendor-id=30, ar-release-version=4.03.01
    resource consumption ResourceConsumption
      104 x memory section:
        CODE: sw-addrmethod=CODE
        VAR_NOINIT_UNSPECIFIED: sw-addrmethod=SystemApplication_OsCore0_VAR_NO_INIT
        VAR_ZERO_INIT_UNSPECIFIED: sw-addrmethod=SystemApplication_OsCore0_VAR_INIT
        VAR_ZERO_INIT_8BIT: sw-addrmethod=SystemApplication_OsCore0_VAR_INIT
        VAR_INIT_UNSPECIFIED: sw-addrmethod=SystemApplication_OsCore0_VAR_INIT
        CONST_UNSPECIFIED: sw-addrmethod=CONST
        APPL_CODE: sw-addrmethod=CODE
        BSWM_APPL_CODE: sw-addrmethod=CODE
        ECUM_APPL_CODE: sw-addrmethod=CODE
        OS_OSCORE0_SWC_APPL_CODE: sw-addrmethod=CODE
        COMM_APPL_CODE: sw-addrmethod=CODE
        DET_APPL_CODE: sw-addrmethod=CODE
        NVM_APPL_CODE: sw-addrmethod=CODE
        DCM_APPL_CODE: sw-addrmethod=CODE
        DEMMASTER_0_APPL_CODE: sw-addrmethod=CODE
        DEMSATELLITE_0_APPL_CODE: sw-addrmethod=CODE
        VAR_NOCACHE_NOINIT_UNSPECIFIED: sw-addrmethod=SystemApplication_OsCore0_VAR_NOCACHE_NO_INIT
        VAR_NOCACHE_ZERO_INIT_UNSPECIFIED: sw-addrmethod=SystemApplication_OsCore0_VAR_NOCACHE_INIT
        VAR_NOCACHE_ZERO_INIT_8BIT: sw-addrmethod=SystemApplication_OsCore0_VAR_NOCACHE_INIT
        VAR_GLOBALSHARED_NOCACHE_ZERO_INIT_8BIT: sw-addrmethod=GLOBALSHARED_VAR_NOCACHE_INIT
        VAR_NOCACHE_INIT_UNSPECIFIED: sw-addrmethod=SystemApplication_OsCore0_VAR_NOCACHE_INIT
        OS_OSCORE1_SWC_APPL_CODE: sw-addrmethod=CODE
        OS_OSCORE2_SWC_APPL_CODE: sw-addrmethod=CODE
        VAR_SystemApplication_OsCore0_NOINIT_UNSPECIFIED: sw-addrmethod=SystemApplication_OsCore0_VAR_NO_INIT
        VAR_SystemApplication_OsCore0_NOCACHE_NOINIT_UNSPECIFIED: sw-addrmethod=SystemApplication_OsCore0_VAR_NOCACHE_NO_INIT
        VAR_SystemApplication_OsCore0_ZERO_INIT_UNSPECIFIED: sw-addrmethod=SystemApplication_OsCore0_VAR_INIT
        VAR_SystemApplication_OsCore0_NOCACHE_ZERO_INIT_UNSPECIFIED: sw-addrmethod=SystemApplication_OsCore0_VAR_NOCACHE_INIT
        VAR_SystemApplication_OsCore0_NOCACHE_ZERO_INIT_8BIT: sw-addrmethod=SystemApplication_OsCore0_VAR_NOCACHE_INIT
        VAR_SystemApplication_OsCore0_INIT_UNSPECIFIED: sw-addrmethod=SystemApplication_OsCore0_VAR_INIT
        VAR_SystemApplication_OsCore0_NOCACHE_INIT_UNSPECIFIED: sw-addrmethod=SystemApplication_OsCore0_VAR_NOCACHE_INIT
        VAR_SystemApplication_OsCore1_NOINIT_UNSPECIFIED: sw-addrmethod=SystemApplication_OsCore1_VAR_NO_INIT
        VAR_SystemApplication_OsCore1_NOCACHE_NOINIT_UNSPECIFIED: sw-addrmethod=SystemApplication_OsCore1_VAR_NOCACHE_NO_INIT
        VAR_SystemApplication_OsCore1_ZERO_INIT_UNSPECIFIED: sw-addrmethod=SystemApplication_OsCore1_VAR_INIT
        VAR_SystemApplication_OsCore1_NOCACHE_ZERO_INIT_UNSPECIFIED: sw-addrmethod=SystemApplication_OsCore1_VAR_NOCACHE_INIT
        VAR_SystemApplication_OsCore1_NOCACHE_ZERO_INIT_8BIT: sw-addrmethod=SystemApplication_OsCore1_VAR_NOCACHE_INIT
        VAR_SystemApplication_OsCore1_INIT_UNSPECIFIED: sw-addrmethod=SystemApplication_OsCore1_VAR_INIT
        VAR_SystemApplication_OsCore1_NOCACHE_INIT_UNSPECIFIED: sw-addrmethod=SystemApplication_OsCore1_VAR_NOCACHE_INIT
        VAR_SystemApplication_OsCore2_NOINIT_UNSPECIFIED: sw-addrmethod=SystemApplication_OsCore2_VAR_NO_INIT
        VAR_SystemApplication_OsCore2_NOCACHE_NOINIT_UNSPECIFIED: sw-addrmethod=SystemApplication_OsCore2_VAR_NOCACHE_NO_INIT
        VAR_SystemApplication_OsCore2_ZERO_INIT_UNSPECIFIED: sw-addrmethod=SystemApplication_OsCore2_VAR_INIT
        VAR_SystemApplication_OsCore2_NOCACHE_ZERO_INIT_UNSPECIFIED: sw-addrmethod=SystemApplication_OsCore2_VAR_NOCACHE_INIT
        VAR_SystemApplication_OsCore2_NOCACHE_ZERO_INIT_8BIT: sw-addrmethod=SystemApplication_OsCore2_VAR_NOCACHE_INIT
        VAR_SystemApplication_OsCore2_INIT_UNSPECIFIED: sw-addrmethod=SystemApplication_OsCore2_VAR_INIT
        VAR_SystemApplication_OsCore2_NOCACHE_INIT_UNSPECIFIED: sw-addrmethod=SystemApplication_OsCore2_VAR_NOCACHE_INIT
        CORE1APP_SWC_APPL_CODE: sw-addrmethod=CODE
        CORE2APP_SWC_APPL_CODE: sw-addrmethod=CODE
        IOHWAB_APPL_CODE: sw-addrmethod=CODE
        CTAP_ACCCAL_APPL_CODE: sw-addrmethod=CODE
        CTAP_ACCRPEDLDRV_APPL_CODE: sw-addrmethod=CODE
        CTAP_ACPARMGMT_APPL_CODE: sw-addrmethod=CODE
        CTAP_BMSMGMT_APPL_CODE: sw-addrmethod=CODE
        CTAP_BRKMGMT_APPL_CODE: sw-addrmethod=CODE
        CTAP_CANHANDLER_APPL_CODE: sw-addrmethod=CODE
        CTAP_CHRGCOMM_APPL_CODE: sw-addrmethod=CODE
        CTAP_CHRGEGYCAL_APPL_CODE: sw-addrmethod=CODE
        CTAP_CHRGMOD_APPL_CODE: sw-addrmethod=CODE
        CTAP_CHRGPREHEAT_APPL_CODE: sw-addrmethod=CODE
        CTAP_CHRGSDL_APPL_CODE: sw-addrmethod=CODE
        CTAP_CHRGSEQCTRL_APPL_CODE: sw-addrmethod=CODE
        CTAP_CHRGSTAT_APPL_CODE: sw-addrmethod=CODE
        CTAP_CNSCALCN_APPL_CODE: sw-addrmethod=CODE
        CTAP_COASTCTRL_APPL_CODE: sw-addrmethod=CODE
        CTAP_COMMERR_APPL_CODE: sw-addrmethod=CODE
        CTAP_CRPCTRL_APPL_CODE: sw-addrmethod=CODE
        CTAP_DCCOMM_APPL_CODE: sw-addrmethod=CODE
        CTAP_DCDCMGMT_APPL_CODE: sw-addrmethod=CODE
        CTAP_DCFCMGMT_APPL_CODE: sw-addrmethod=CODE
        CTAP_DCPARMGMT_APPL_CODE: sw-addrmethod=CODE
        CTAP_DRVASSCCTRL_APPL_CODE: sw-addrmethod=CODE
        CTAP_DRVMOD_APPL_CODE: sw-addrmethod=CODE
        CTAP_DRVTORQCOOR_APPL_CODE: sw-addrmethod=CODE
        CTAP_ELSSDIAG_APPL_CODE: sw-addrmethod=CODE
        CTAP_EMMGMT_APPL_CODE: sw-addrmethod=CODE
        CTAP_FCTSFTYGEAR_APPL_CODE: sw-addrmethod=CODE
        CTAP_FCTSFTYTORQ_APPL_CODE: sw-addrmethod=CODE
        CTAP_FLTREACTN_APPL_CODE: sw-addrmethod=CODE
        CTAP_GEARCAL_APPL_CODE: sw-addrmethod=CODE
        CTAP_HVSFTY_APPL_CODE: sw-addrmethod=CODE
        CTAP_HWHANDLER_APPL_CODE: sw-addrmethod=CODE
        CTAP_LINHANDLER_APPL_CODE: sw-addrmethod=CODE
        CTAP_LVBATTMGMT_APPL_CODE: sw-addrmethod=CODE
        CTAP_MCUMGMT_APPL_CODE: sw-addrmethod=CODE
        CTAP_OBCSTSMGMT_APPL_CODE: sw-addrmethod=CODE
        CTAP_ONEPEDCTRL_APPL_CODE: sw-addrmethod=CODE
        CTAP_PDLALYS_APPL_CODE: sw-addrmethod=CODE
        CTAP_PWRLIM_APPL_CODE: sw-addrmethod=CODE
        CTAP_RESEST_APPL_CODE: sw-addrmethod=CODE
        CTAP_RNGESTIMN_APPL_CODE: sw-addrmethod=CODE
        CTAP_S2MGMT_APPL_CODE: sw-addrmethod=CODE
        CTAP_SLOPEST_APPL_CODE: sw-addrmethod=CODE
        CTAP_SPDLMT_APPL_CODE: sw-addrmethod=CODE
        CTAP_TCUMGMT_APPL_CODE: sw-addrmethod=CODE
        CTAP_TORQCOOR_APPL_CODE: sw-addrmethod=CODE
        CTAP_TORQCROSSZR_APPL_CODE: sw-addrmethod=CODE
        CTAP_TORQDAMP_APPL_CODE: sw-addrmethod=CODE
        CTAP_TORQFIL_APPL_CODE: sw-addrmethod=CODE
        CTAP_TORQLMT_APPL_CODE: sw-addrmethod=CODE
        CTAP_TORQMODMAP_APPL_CODE: sw-addrmethod=CODE
        CTAP_TRSMPROTD_APPL_CODE: sw-addrmethod=CODE
        CTAP_VEHSPD_APPL_CODE: sw-addrmethod=CODE
        CTAP_VEHSTABYCTRL_APPL_CODE: sw-addrmethod=CODE
        CTAP_VEHSTAT_APPL_CODE: sw-addrmethod=CODE
        CTAP_WAKEUPRSN_APPL_CODE: sw-addrmethod=CODE
        HOOKCALLOUT_APPL_CODE: sw-addrmethod=CODE
package /MICROSAR/Rte_ib_bswmd/BswModuleDescriptions
  bsw module description Rte: provided-entrys=Rte_ComSendSignalProxyPeriodic
    bsw internal behavior RteBehavior
      bsw schedulable entity Rte_ComSendSignalProxyPeriodic: implemented-entry=Rte_ComSendSignalProxyPeriodic
      bsw timing event Rte_ComSendSignalProxyPeriodicTimingEvent0: starts-on-event=Rte_ComSendSignalProxyPeriodic, period=0.01
  bsw module entry Rte_ComSendSignalProxyPeriodic: call-type=SCHEDULED, execution-context=TASK
