AUTOSAR XML (schema 00048)
package /AURIX2G/EcucDefs/Adc_ib_bswmd/BswModuleDescriptions
  bsw module description Adc
    bsw internal behavior AdcBehavior
      exclusive area KernelData
      exclusive area SrcRegAccess
