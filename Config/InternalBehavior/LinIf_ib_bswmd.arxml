AUTOSAR XML (schema 00048)
package /MICROSAR
  bsw implementation LinIf_Impl: programming-language=C, sw-version=9.00.00, used-code-generator=DaVinci Configurator, vendor-id=30, ar-release-version=4.00.03
package /MICROSAR/LinIf_ib_bswmd/BswModuleDescriptions
  bsw module description LinIf: provided-entrys=LinIf_MainFunction
    bsw internal behavior LinIfBehavior
      exclusive area LINIF_EXCLUSIVE_AREA_0  # Exclusive area for LinIf channel main function
      exclusive area LINIF_EXCLUSIVE_AREA_1  # Exclusive area for asynchronous API functions
      exclusive area LINIF_EXCLUSIVE_AREA_2  # Exclusive area for callback functions from LIN driver in interrupt context
      bsw schedulable entity LinIf_MainFunction: implemented-entry=LinIf_MainFunction
      bsw timing event LinIf_MainFunctionTimingEvent0: starts-on-event=LinIf_MainFunction, period=0.005
  bsw module entry LinIf_MainFunction: call-type=SCHEDULED, execution-context=TASK
