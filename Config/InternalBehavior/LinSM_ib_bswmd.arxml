AUTOSAR XML (schema 00048)
package /MICROSAR
  bsw implementation LinSM_Impl: programming-language=C, sw-version=7.00.02, used-code-generator=DaVinci Configurator, vendor-id=30, ar-release-version=4.00.03
package /MICROSAR/LinSM_ib_bswmd/BswModuleDescriptions
  bsw module description LinSM: provided-entrys=LinSM_MainFunction
    bsw internal behavior LinSMBehavior
      5 x exclusive area:
        LINSM_EXCLUSIVE_AREA_0  # Must lock task interrupts, if LinIf_MainFunction(), LinSM_MainFunction() or BswM action BswMLinScheduleSwitch priority level is higher than the level of ComM_MainFunction().
        LINSM_EXCLUSIVE_AREA_1  # Must lock task interrupts, if ComM_MainFunction(), LinSM_MainFunction() or BswM action BswMLinScheduleSwitch priority level is higher than the level of LinIf_MainFunction().
        LINSM_EXCLUSIVE_AREA_2  # Must lock task interrupts, if ComM_MainFunction(), LinIf_MainFunction() or BswM action BswMLinScheduleSwitch priority level is higher than the level of LinSM_MainFunction().
        LINSM_EXCLUSIVE_AREA_3  # Must lock task interrupts, if ComM_MainFunction(), LinIf_MainFunction() or LinSM_MainFunction() interrupt priority level is higher than the level of the BswM action BswMLinScheduleSwitch.
        LINSM_EXCLUSIVE_AREA_4  # Must lock task interrupts if the function LinSM_GotoSleepIndication() may be interrupted by any of the functions LinSM_MainFunction(), LinSM_RequestComMode(), LinSM_WakeupConfirmation() or LinSM_GotoSleepConfirmation().
      bsw schedulable entity LinSM_MainFunction: implemented-entry=LinSM_MainFunction
      bsw timing event LinSM_MainFunctionTimingEvent0: starts-on-event=LinSM_MainFunction, period=0.01
  bsw module entry LinSM_MainFunction: call-type=SCHEDULED, execution-context=TASK
