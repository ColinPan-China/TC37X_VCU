AUTOSAR XML (schema 00048)
package /MICROSAR/J1939Tp_ib_bswmd/BswModuleDescriptions
  bsw module description J1939Tp: provided-entrys=J1939Tp_MainFunction
    bsw internal behavior J1939TpBehavior
      exclusive area J1939TP_EXCLUSIVE_AREA_TXNPDULOCK  # Protect N-PDU transmission lock against concurrent access from interrupt and task level.
      exclusive area J1939TP_EXCLUSIVE_AREA_RXNSDULOCK  # Protect N-SDU reception lock against concurrent access from interrupt and task level.
      exclusive area J1939TP_EXCLUSIVE_AREA_TXNSDULOCK  # Protect N-SDU transmission lock against concurrent access from interrupt and task level.
      bsw schedulable entity J1939Tp_MainFunction: implemented-entry=J1939Tp_MainFunction
      bsw timing event J1939Tp_MainFunctionTimingEvent0: starts-on-event=J1939Tp_MainFunction, period=0.01
  bsw module entry J1939Tp_MainFunction: call-type=SCHEDULED, execution-context=TASK
