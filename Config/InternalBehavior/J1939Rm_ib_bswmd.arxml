AUTOSAR XML (schema 00048)
package /MICROSAR
  bsw implementation J1939Rm_Impl: programming-language=C, sw-version=5.00.02, used-code-generator=DaVinci Configurator, vendor-id=30, ar-release-version=4.02.02
