AUTOSAR XML (schema 00048)
package /AURIX2G/EcucDefs/Icu_ib_bswmd/BswModuleDescriptions
  bsw module description Icu
    bsw internal behavior IcuBehavior
      8 x exclusive area:
        EnableWakeup
        EnableNotification
        ResetEdgeCount
        CcuInterruptHandle
        CcuVariableupdate
        GtmEnableEdgeCount
        SetActivationCondition
        GtmGetDutyCycle
