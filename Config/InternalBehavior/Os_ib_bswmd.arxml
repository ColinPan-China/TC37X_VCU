AUTOSAR XML (schema 00048)
package /MICROSAR/Os_ib_bswmd/SwAddrMethods
  55 x sw addr method:
    SystemApplication_OsCore0_CONST: section-type=CONST
    SystemApplication_OsCore0_CONST_FAST: section-type=CONST
    SystemApplication_OsCore0_VAR_INIT: section-initialization-policy=INIT, section-type=VAR
    SystemApplication_OsCore0_VAR_FAST_INIT: section-initialization-policy=INIT, section-type=VAR-FAST
    SystemApplication_OsCore0_VAR_NOCACHE_INIT: section-initialization-policy=INIT, section-type=VAR
    SystemApplication_OsCore0_VAR_NO_INIT: section-initialization-policy=NO_INIT, section-type=VAR
    SystemApplication_OsCore0_VAR_FAST_NO_INIT: section-initialization-policy=NO_INIT, section-type=VAR-FAST
    SystemApplication_OsCore0_VAR_NOCACHE_NO_INIT: section-initialization-policy=NO_INIT, section-type=VAR
    SystemApplication_OsCore0_VAR_CLEARED: section-initialization-policy=CLEARED, section-type=VAR
    SystemApplication_OsCore0_VAR_FAST_CLEARED: section-initialization-policy=CLEARED, section-type=VAR-FAST
    SystemApplication_OsCore0_VAR_NOCACHE_CLEARED: section-initialization-policy=CLEARED, section-type=VAR
    OsApplication_CONST: section-type=CONST
    OsApplication_CONST_FAST: section-type=CONST
    OsApplication_VAR_INIT: section-initialization-policy=INIT, section-type=VAR
    OsApplication_VAR_FAST_INIT: section-initialization-policy=INIT, section-type=VAR-FAST
    OsApplication_VAR_NOCACHE_INIT: section-initialization-policy=INIT, section-type=VAR
    OsApplication_VAR_NO_INIT: section-initialization-policy=NO_INIT, section-type=VAR
    OsApplication_VAR_FAST_NO_INIT: section-initialization-policy=NO_INIT, section-type=VAR-FAST
    OsApplication_VAR_NOCACHE_NO_INIT: section-initialization-policy=NO_INIT, section-type=VAR
    OsApplication_VAR_CLEARED: section-initialization-policy=CLEARED, section-type=VAR
    OsApplication_VAR_FAST_CLEARED: section-initialization-policy=CLEARED, section-type=VAR-FAST
    OsApplication_VAR_NOCACHE_CLEARED: section-initialization-policy=CLEARED, section-type=VAR
    GLOBALSHARED_CONST: section-type=CONST
    GLOBALSHARED_CONST_FAST: section-type=CONST
    GLOBALSHARED_VAR_INIT: section-initialization-policy=INIT, section-type=VAR
    GLOBALSHARED_VAR_FAST_INIT: section-initialization-policy=INIT, section-type=VAR-FAST
    GLOBALSHARED_VAR_NOCACHE_INIT: section-initialization-policy=INIT, section-type=VAR
    GLOBALSHARED_VAR_NO_INIT: section-initialization-policy=NO_INIT, section-type=VAR
    GLOBALSHARED_VAR_FAST_NO_INIT: section-initialization-policy=NO_INIT, section-type=VAR-FAST
    GLOBALSHARED_VAR_NOCACHE_NO_INIT: section-initialization-policy=NO_INIT, section-type=VAR
    GLOBALSHARED_VAR_CLEARED: section-initialization-policy=CLEARED, section-type=VAR
    GLOBALSHARED_VAR_FAST_CLEARED: section-initialization-policy=CLEARED, section-type=VAR-FAST
    GLOBALSHARED_VAR_NOCACHE_CLEARED: section-initialization-policy=CLEARED, section-type=VAR
    SystemApplication_OsCore1_CONST: section-type=CONST
    SystemApplication_OsCore1_CONST_FAST: section-type=CONST
    SystemApplication_OsCore1_VAR_INIT: section-initialization-policy=INIT, section-type=VAR
    SystemApplication_OsCore1_VAR_FAST_INIT: section-initialization-policy=INIT, section-type=VAR-FAST
    SystemApplication_OsCore1_VAR_NOCACHE_INIT: section-initialization-policy=INIT, section-type=VAR
    SystemApplication_OsCore1_VAR_NO_INIT: section-initialization-policy=NO_INIT, section-type=VAR
    SystemApplication_OsCore1_VAR_FAST_NO_INIT: section-initialization-policy=NO_INIT, section-type=VAR-FAST
    SystemApplication_OsCore1_VAR_NOCACHE_NO_INIT: section-initialization-policy=NO_INIT, section-type=VAR
    SystemApplication_OsCore1_VAR_CLEARED: section-initialization-policy=CLEARED, section-type=VAR
    SystemApplication_OsCore1_VAR_FAST_CLEARED: section-initialization-policy=CLEARED, section-type=VAR-FAST
    SystemApplication_OsCore1_VAR_NOCACHE_CLEARED: section-initialization-policy=CLEARED, section-type=VAR
    SystemApplication_OsCore2_CONST: section-type=CONST
    SystemApplication_OsCore2_CONST_FAST: section-type=CONST
    SystemApplication_OsCore2_VAR_INIT: section-initialization-policy=INIT, section-type=VAR
    SystemApplication_OsCore2_VAR_FAST_INIT: section-initialization-policy=INIT, section-type=VAR-FAST
    SystemApplication_OsCore2_VAR_NOCACHE_INIT: section-initialization-policy=INIT, section-type=VAR
    SystemApplication_OsCore2_VAR_NO_INIT: section-initialization-policy=NO_INIT, section-type=VAR
    SystemApplication_OsCore2_VAR_FAST_NO_INIT: section-initialization-policy=NO_INIT, section-type=VAR-FAST
    SystemApplication_OsCore2_VAR_NOCACHE_NO_INIT: section-initialization-policy=NO_INIT, section-type=VAR
    SystemApplication_OsCore2_VAR_CLEARED: section-initialization-policy=CLEARED, section-type=VAR
    SystemApplication_OsCore2_VAR_FAST_CLEARED: section-initialization-policy=CLEARED, section-type=VAR-FAST
    SystemApplication_OsCore2_VAR_NOCACHE_CLEARED: section-initialization-policy=CLEARED, section-type=VAR
