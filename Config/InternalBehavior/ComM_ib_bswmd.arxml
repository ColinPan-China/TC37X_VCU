AUTOSAR XML (schema 00048)
package /MICROSAR
  bsw implementation ComM_Impl: programming-language=C, sw-version=14.01.01, used-code-generator=DaVinci Configurator, vendor-id=30, ar-release-version=4.00.03
package /MICROSAR/ComM_ib_bswmd/BswModuleDescriptions
  bsw module description ComM: provided-entrys=[ComM_MainFunction_0, ComM_MainFunction_1, ComM_MainFunction_2]
    bsw internal behavior ComMBehavior
      8 x exclusive area:
        COMM_EXCLUSIVE_AREA_0
        COMM_EXCLUSIVE_AREA_1
        COMM_EXCLUSIVE_AREA_{2..7}  # This exclusive area is only used in case of multi-partition. It must be configured as a spinlock to allow access to some variables simultaneously from multiple cores.
      bsw schedulable entity ComM_MainFunction_{0..2}: implemented-entry=ComM_MainFunction_{0..2}
      bsw timing event ComM_MainFunction_{0..2}TimingEvent0: starts-on-event=ComM_MainFunction_{0..2}, period=0.02
  bsw module entry ComM_MainFunction_{0..2}: call-type=SCHEDULED, execution-context=TASK
