AUTOSAR XML (schema 00048)
package /MICROSAR/EthTrcv_30_Generic_ib_bswmd/BswModuleDescriptions
  bsw module description EthTrcv
    bsw internal behavior EthTrcv_30_GenericBehavior
