AUTOSAR XML (schema 00048)
package /MICROSAR
  bsw implementation Com_Impl: programming-language=C, sw-version=22.02.01, used-code-generator=DaVinci Configurator, vendor-id=30, ar-release-version=4.00.03
package /MICROSAR/Com_ib_bswmd/BswModuleDescriptions
  bsw module description Com
    provided-entrys:
      Com_MainFunctionRx_ComMainFunctionRx
      Com_MainFunctionTx_ComMainFunctionTx
      Com_MainFunctionTx_ComMainFunctionTx_{001..004}
      Com_MainFunctionTx_ComMainFunctionTx_10ms
      Com_MainFunctionTx_ComMainFunctionTx_20ms
      Com_MainFunctionTx_ComMainFunctionTx_50ms
      Com_MainFunctionTx_ComMainFunctionTx_100ms
      Com_MainFunctionTx_ComMainFunctionTx_200ms
    bsw internal behavior ComBehavior
      exclusive area COM_EXCLUSIVE_AREA_TX  # This critical section protects Tx ressources that can be accessed from various contexts. Therefore the critical section enclosed with COM_EXCLUSIVE_AREA_TX should never be interrupted by any Com API which accesses Tx ressources. For more details, see DocTechRef.
      exclusive area COM_EXCLUSIVE_AREA_RX  # This critical section protects Rx ressources that can be accessed from various contexts.Therefore the critical section enclosed with COM_EXCLUSIVE_AREA_RX should never be interrupted by any Com API which accesses Rx ressources. For more details, see DocTechRef.
      exclusive area COM_EXCLUSIVE_AREA_BOTH  # This critical section protects Rx and Tx ressources that are being accessed in context of Com_MainFunctionRouteSignals for signal gateway routings or description routings with configured deferred description source. For more details, see DocTechRef.
      bsw schedulable entity Com_MainFunctionRx_ComMainFunctionRx: implemented-entry=Com_MainFunctionRx_ComMainFunctionRx
      bsw schedulable entity Com_MainFunctionTx_ComMainFunctionTx: implemented-entry=Com_MainFunctionTx_ComMainFunctionTx
      bsw timing event Com_MainFunctionRx_ComMainFunctionRxTimingEvent0: starts-on-event=Com_MainFunctionRx_ComMainFunctionRx, period=0.01
      bsw timing event Com_MainFunctionTx_ComMainFunctionTxTimingEvent0: starts-on-event=Com_MainFunctionTx_ComMainFunctionTx, period=0.01
  11 x bsw module entry, all with call-type=SCHEDULED, execution-context=TASK:
    Com_MainFunctionRx_ComMainFunctionRx
    Com_MainFunctionTx_ComMainFunctionTx
    Com_MainFunctionTx_ComMainFunctionTx_{001..004}
    Com_MainFunctionTx_ComMainFunctionTx_10ms
    Com_MainFunctionTx_ComMainFunctionTx_20ms
    Com_MainFunctionTx_ComMainFunctionTx_50ms
    Com_MainFunctionTx_ComMainFunctionTx_100ms
    Com_MainFunctionTx_ComMainFunctionTx_200ms
