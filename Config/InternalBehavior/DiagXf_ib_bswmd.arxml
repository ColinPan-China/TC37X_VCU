AUTOSAR XML (schema 4-2-1)
package /MICROSAR
  bsw implementation DiagXf_Impl: programming-language=C, sw-version=1.14.00, used-code-generator=DaVinci Configurator, vendor-id=30, ar-release-version=4.03.01
    resource consumption ResourceConsumption
      memory section CODE: sw-addrmethod=CODE
