[part 2 of 2: package /ActiveEcuC]
AUTOSAR XML (schema 00048)
package /ActiveEcuC  (continued)
  module config Dem: implementation-config-variant=VARIANT-PRE-COMPILE, module-description=Dem_Impl  (continued)
    DemConfigSet  (continued)
      DTC_0xc19b87 (DemEventParameter):
        DemEventKind = DEM_EVENT_KIND_SWC
        DemEventTimeSeries = DEM_TIMESERIES_SNAPSHOT_NONE
        DemEventAvailable = true
        DemEventId = 82
        DemEventAvailableInVariant = true
        DemEventLatchTestFailed = false
        DemEventCreateInfoPort = true
        DemDTCClassRef = DTCClass_DTC_0xc19b87
        DemExtendedDataClassRef = ExtendedDataClass_83dcefb7
        DemFreezeFrameClassRef = FreezeFrameClass_5f5b5001
        DemFreezeFrameRecNumClassRef = FreezeFrameRecNumClass_f98c8aa7
        DemEventClass:
          DemAgingAllowed = true
          DemAgingCycleCounterThreshold = 40
          DemEventDestination = DEM_DTC_ORIGIN_PRIMARY_MEMORY
          DemEventPriority = 1
          DemEventSignificance = DEM_EVENT_SIGNIFICANCE_FAULT
          DemEventFailureCycleCounterThreshold = 0
          DemConsiderPtoStatus = false
          DemFFPrestorageSupported = false
          DemAgingCycleRef = PowerCycle
          DemEnableConditionGroupRef = EnableConditionGroup_f3616881
          DemOperationCycleRef = PowerCycle
          DemDebounceAlgorithmClass
            DemDebounceCounterBased:
              DemDebounceCounterDecrementStepSize = 1
              DemDebounceCounterIncrementStepSize = 1
              DemDebounceCounterJumpDown = false
              DemDebounceCounterJumpUp = true
              DemDebounceBehavior = DEM_DEBOUNCE_FREEZE
              DemDebounceCounterFailedThreshold = 127
              DemDebounceCounterJumpDownValue = 0
              DemDebounceCounterJumpUpValue = 0
              DemDebounceCounterPassedThreshold = -128
              DemDebounceCounterStorage = false
              DemDebounceContinuous = false
          IndicatorAttribute_WarningIndicator (DemIndicatorAttribute):
            DemIndicatorFailureCycleSource = DEM_FAILURE_CYCLE_EVENT
            DemIndicatorBehaviour = DEM_INDICATOR_CONTINUOUS
            DemIndicatorHealingCycleCounterThreshold = 3
            DemIndicatorHealingCycleRef = PowerCycle
            DemIndicatorRef = WarningIndicator
      DTCClass_DTC_0x908255 (DemDTCClass): DemDTCSeverity=DEM_DTC_SEV_NO_SEVERITY, DemUdsDTC=9470549, DemImmediateNvStorage=false
      DTC_0x113297 (DemEventParameter):
        DemEventKind = DEM_EVENT_KIND_SWC
        DemEventTimeSeries = DEM_TIMESERIES_SNAPSHOT_NONE
        DemEventAvailable = true
        DemEventId = 32
        DemEventAvailableInVariant = true
        DemEventLatchTestFailed = false
        DemEventCreateInfoPort = true
        DemDTCClassRef = DTCClass_DTC_0x113297
        DemExtendedDataClassRef = ExtendedDataClass_83dcefb7
        DemFreezeFrameClassRef = FreezeFrameClass_5f5b5001
        DemFreezeFrameRecNumClassRef = FreezeFrameRecNumClass_f98c8aa7
        DemEventClass:
          DemAgingAllowed = true
          DemAgingCycleCounterThreshold = 40
          DemEventDestination = DEM_DTC_ORIGIN_PRIMARY_MEMORY
          DemEventPriority = 1
          DemEventSignificance = DEM_EVENT_SIGNIFICANCE_FAULT
          DemEventFailureCycleCounterThreshold = 0
          DemConsiderPtoStatus = false
          DemFFPrestorageSupported = false
          DemAgingCycleRef = PowerCycle
          DemEnableConditionGroupRef = EnableConditionGroup_58c4940f
          DemOperationCycleRef = PowerCycle
          DemDebounceAlgorithmClass
            DemDebounceCounterBased:
              DemDebounceCounterDecrementStepSize = 1
              DemDebounceCounterIncrementStepSize = 1
              DemDebounceCounterJumpDown = false
              DemDebounceCounterJumpUp = true
              DemDebounceBehavior = DEM_DEBOUNCE_FREEZE
              DemDebounceCounterFailedThreshold = 127
              DemDebounceCounterJumpDownValue = 0
              DemDebounceCounterJumpUpValue = 0
              DemDebounceCounterPassedThreshold = -128
              DemDebounceCounterStorage = false
              DemDebounceContinuous = false
          IndicatorAttribute_WarningIndicator (DemIndicatorAttribute):
            DemIndicatorFailureCycleSource = DEM_FAILURE_CYCLE_EVENT
            DemIndicatorBehaviour = DEM_INDICATOR_CONTINUOUS
            DemIndicatorHealingCycleCounterThreshold = 3
            DemIndicatorHealingCycleRef = PowerCycle
            DemIndicatorRef = WarningIndicator
      DTCClass_DTC_0x116494 (DemDTCClass): DemDTCSeverity=DEM_DTC_SEV_NO_SEVERITY, DemUdsDTC=1139860, DemImmediateNvStorage=false
      3 x DemEventParameter, all with DemEventKind=DEM_EVENT_KIND_SWC, DemEventTimeSeries=DEM_TIMESERIES_SNAPSHOT_NONE, DemEventAvailable=true, DemEventAvailableInVariant=true, DemEventLatchTestFailed=false, DemEventCreateInfoPort=true, DemExtendedDataClassRef=ExtendedDataClass_83dcefb7, DemFreezeFrameClassRef=FreezeFrameClass_5f5b5001, DemFreezeFrameRecNumClassRef=FreezeFrameRecNumClass_f98c8aa7:
        DTC_0x115d4b: DemEventId=5, DemDTCClassRef=DTCClass_DTC_0x115d4b
          DemEventClass:
            DemAgingAllowed = true
            DemAgingCycleCounterThreshold = 40
            DemEventDestination = DEM_DTC_ORIGIN_PRIMARY_MEMORY
            DemEventPriority = 1
            DemEventSignificance = DEM_EVENT_SIGNIFICANCE_FAULT
            DemEventFailureCycleCounterThreshold = 0
            DemConsiderPtoStatus = false
            DemFFPrestorageSupported = false
            DemAgingCycleRef = PowerCycle
            DemEnableConditionGroupRef = EnableConditionGroup_fdfec498
            DemOperationCycleRef = PowerCycle
            DemDebounceAlgorithmClass
              DemDebounceCounterBased:
                DemDebounceCounterDecrementStepSize = 1
                DemDebounceCounterIncrementStepSize = 1
                DemDebounceCounterJumpDown = false
                DemDebounceCounterJumpUp = true
                DemDebounceBehavior = DEM_DEBOUNCE_FREEZE
                DemDebounceCounterFailedThreshold = 127
                DemDebounceCounterJumpDownValue = 0
                DemDebounceCounterJumpUpValue = 0
                DemDebounceCounterPassedThreshold = -128
                DemDebounceCounterStorage = false
                DemDebounceContinuous = false
            IndicatorAttribute_WarningIndicator (DemIndicatorAttribute):
              DemIndicatorFailureCycleSource = DEM_FAILURE_CYCLE_EVENT
              DemIndicatorBehaviour = DEM_INDICATOR_CONTINUOUS
              DemIndicatorHealingCycleCounterThreshold = 3
              DemIndicatorHealingCycleRef = PowerCycle
              DemIndicatorRef = WarningIndicator
        DTC_0xc19987: DemEventId=97, DemDTCClassRef=DTCClass_DTC_0xc19987
          DemEventClass:
            DemAgingAllowed = true
            DemAgingCycleCounterThreshold = 40
            DemEventDestination = DEM_DTC_ORIGIN_PRIMARY_MEMORY
            DemEventPriority = 2
            DemEventSignificance = DEM_EVENT_SIGNIFICANCE_FAULT
            DemEventFailureCycleCounterThreshold = 0
            DemConsiderPtoStatus = false
            DemFFPrestorageSupported = false
            DemAgingCycleRef = PowerCycle
            DemEnableConditionGroupRef = EnableConditionGroup_f3616881
            DemOperationCycleRef = PowerCycle
            DemDebounceAlgorithmClass
              DemDebounceCounterBased:
                DemDebounceCounterDecrementStepSize = 1
                DemDebounceCounterIncrementStepSize = 1
                DemDebounceCounterJumpDown = false
                DemDebounceCounterJumpUp = true
                DemDebounceBehavior = DEM_DEBOUNCE_FREEZE
                DemDebounceCounterFailedThreshold = 127
                DemDebounceCounterJumpDownValue = 0
                DemDebounceCounterJumpUpValue = 0
                DemDebounceCounterPassedThreshold = -128
                DemDebounceCounterStorage = false
                DemDebounceContinuous = false
            IndicatorAttribute_WarningIndicator (DemIndicatorAttribute):
              DemIndicatorFailureCycleSource = DEM_FAILURE_CYCLE_EVENT
              DemIndicatorBehaviour = DEM_INDICATOR_CONTINUOUS
              DemIndicatorHealingCycleCounterThreshold = 3
              DemIndicatorHealingCycleRef = PowerCycle
              DemIndicatorRef = WarningIndicator
        DTC_0x117097: DemEventId=67, DemDTCClassRef=DTCClass_DTC_0x117097
          DemEventClass:
            DemAgingAllowed = true
            DemAgingCycleCounterThreshold = 40
            DemEventDestination = DEM_DTC_ORIGIN_PRIMARY_MEMORY
            DemEventPriority = 1
            DemEventSignificance = DEM_EVENT_SIGNIFICANCE_FAULT
            DemEventFailureCycleCounterThreshold = 0
            DemConsiderPtoStatus = false
            DemFFPrestorageSupported = false
            DemAgingCycleRef = PowerCycle
            DemEnableConditionGroupRef = EnableConditionGroup_fdfec498
            DemOperationCycleRef = PowerCycle
            DemDebounceAlgorithmClass
              DemDebounceCounterBased:
                DemDebounceCounterDecrementStepSize = 1
                DemDebounceCounterIncrementStepSize = 1
                DemDebounceCounterJumpDown = false
                DemDebounceCounterJumpUp = true
                DemDebounceBehavior = DEM_DEBOUNCE_FREEZE
                DemDebounceCounterFailedThreshold = 127
                DemDebounceCounterJumpDownValue = 0
                DemDebounceCounterJumpUpValue = 0
                DemDebounceCounterPassedThreshold = -128
                DemDebounceCounterStorage = false
                DemDebounceContinuous = false
            IndicatorAttribute_WarningIndicator (DemIndicatorAttribute):
              DemIndicatorFailureCycleSource = DEM_FAILURE_CYCLE_EVENT
              DemIndicatorBehaviour = DEM_INDICATOR_CONTINUOUS
              DemIndicatorHealingCycleCounterThreshold = 3
              DemIndicatorHealingCycleRef = PowerCycle
              DemIndicatorRef = WarningIndicator
      DTCClass_DTC_0xc14787 (DemDTCClass): DemDTCSeverity=DEM_DTC_SEV_NO_SEVERITY, DemUdsDTC=12666759, DemImmediateNvStorage=false
      DTCClass_DTC_0x114197 (DemDTCClass): DemDTCSeverity=DEM_DTC_SEV_NO_SEVERITY, DemUdsDTC=1130903, DemImmediateNvStorage=false
      DTC_0x115592 (DemEventParameter):
        DemEventKind = DEM_EVENT_KIND_SWC
        DemEventTimeSeries = DEM_TIMESERIES_SNAPSHOT_NONE
        DemEventAvailable = true
        DemEventId = 55
        DemEventAvailableInVariant = true
        DemEventLatchTestFailed = false
        DemEventCreateInfoPort = true
        DemDTCClassRef = DTCClass_DTC_0x115592
        DemExtendedDataClassRef = ExtendedDataClass_83dcefb7
        DemFreezeFrameClassRef = FreezeFrameClass_5f5b5001
        DemFreezeFrameRecNumClassRef = FreezeFrameRecNumClass_f98c8aa7
        DemEventClass:
          DemAgingAllowed = true
          DemAgingCycleCounterThreshold = 40
          DemEventDestination = DEM_DTC_ORIGIN_PRIMARY_MEMORY
          DemEventPriority = 2
          DemEventSignificance = DEM_EVENT_SIGNIFICANCE_FAULT
          DemEventFailureCycleCounterThreshold = 0
          DemConsiderPtoStatus = false
          DemFFPrestorageSupported = false
          DemAgingCycleRef = PowerCycle
          DemEnableConditionGroupRef = EnableConditionGroup_fdfec498
          DemOperationCycleRef = PowerCycle
          DemDebounceAlgorithmClass
            DemDebounceCounterBased:
              DemDebounceCounterDecrementStepSize = 1
              DemDebounceCounterIncrementStepSize = 1
              DemDebounceCounterJumpDown = false
              DemDebounceCounterJumpUp = true
              DemDebounceBehavior = DEM_DEBOUNCE_FREEZE
              DemDebounceCounterFailedThreshold = 127
              DemDebounceCounterJumpDownValue = 0
              DemDebounceCounterJumpUpValue = 0
              DemDebounceCounterPassedThreshold = -128
              DemDebounceCounterStorage = false
              DemDebounceContinuous = false
          IndicatorAttribute_WarningIndicator (DemIndicatorAttribute):
            DemIndicatorFailureCycleSource = DEM_FAILURE_CYCLE_EVENT
            DemIndicatorBehaviour = DEM_INDICATOR_CONTINUOUS
            DemIndicatorHealingCycleCounterThreshold = 3
            DemIndicatorHealingCycleRef = PowerCycle
            DemIndicatorRef = WarningIndicator
      DTCClass_DTC_0x114992 (DemDTCClass): DemDTCSeverity=DEM_DTC_SEV_NO_SEVERITY, DemUdsDTC=1132946, DemImmediateNvStorage=false
      DTC_0xc20187 (DemEventParameter):
        DemEventKind = DEM_EVENT_KIND_SWC
        DemEventTimeSeries = DEM_TIMESERIES_SNAPSHOT_NONE
        DemEventAvailable = true
        DemEventId = 99
        DemEventAvailableInVariant = true
        DemEventLatchTestFailed = false
        DemEventCreateInfoPort = true
        DemDTCClassRef = DTCClass_DTC_0xc20187
        DemExtendedDataClassRef = ExtendedDataClass_83dcefb7
        DemFreezeFrameClassRef = FreezeFrameClass_5f5b5001
        DemFreezeFrameRecNumClassRef = FreezeFrameRecNumClass_f98c8aa7
        DemEventClass:
          DemAgingAllowed = true
          DemAgingCycleCounterThreshold = 40
          DemEventDestination = DEM_DTC_ORIGIN_PRIMARY_MEMORY
          DemEventPriority = 2
          DemEventSignificance = DEM_EVENT_SIGNIFICANCE_FAULT
          DemEventFailureCycleCounterThreshold = 0
          DemConsiderPtoStatus = false
          DemFFPrestorageSupported = false
          DemAgingCycleRef = PowerCycle
          DemEnableConditionGroupRef = EnableConditionGroup_f3616881
          DemOperationCycleRef = PowerCycle
          DemDebounceAlgorithmClass
            DemDebounceCounterBased:
              DemDebounceCounterDecrementStepSize = 1
              DemDebounceCounterIncrementStepSize = 1
              DemDebounceCounterJumpDown = false
              DemDebounceCounterJumpUp = true
              DemDebounceBehavior = DEM_DEBOUNCE_FREEZE
              DemDebounceCounterFailedThreshold = 127
              DemDebounceCounterJumpDownValue = 0
              DemDebounceCounterJumpUpValue = 0
              DemDebounceCounterPassedThreshold = -128
              DemDebounceCounterStorage = false
              DemDebounceContinuous = false
          IndicatorAttribute_WarningIndicator (DemIndicatorAttribute):
            DemIndicatorFailureCycleSource = DEM_FAILURE_CYCLE_EVENT
            DemIndicatorBehaviour = DEM_INDICATOR_CONTINUOUS
            DemIndicatorHealingCycleCounterThreshold = 3
            DemIndicatorHealingCycleRef = PowerCycle
            DemIndicatorRef = WarningIndicator
      DTCClass_DTC_0x113897 (DemDTCClass): DemDTCSeverity=DEM_DTC_SEV_NO_SEVERITY, DemUdsDTC=1128599, DemImmediateNvStorage=false
      DTC_0x116c05 (DemEventParameter):
        DemEventKind = DEM_EVENT_KIND_SWC
        DemEventTimeSeries = DEM_TIMESERIES_SNAPSHOT_NONE
        DemEventAvailable = true
        DemEventId = 8
        DemEventAvailableInVariant = true
        DemEventLatchTestFailed = false
        DemEventCreateInfoPort = true
        DemDTCClassRef = DTCClass_DTC_0x116c05
        DemExtendedDataClassRef = ExtendedDataClass_83dcefb7
        DemFreezeFrameClassRef = FreezeFrameClass_5f5b5001
        DemFreezeFrameRecNumClassRef = FreezeFrameRecNumClass_f98c8aa7
        DemEventClass:
          DemAgingAllowed = true
          DemAgingCycleCounterThreshold = 40
          DemEventDestination = DEM_DTC_ORIGIN_PRIMARY_MEMORY
          DemEventPriority = 1
          DemEventSignificance = DEM_EVENT_SIGNIFICANCE_FAULT
          DemEventFailureCycleCounterThreshold = 0
          DemConsiderPtoStatus = false
          DemFFPrestorageSupported = false
          DemAgingCycleRef = PowerCycle
          DemOperationCycleRef = PowerCycle
          DemDebounceAlgorithmClass
            DemDebounceCounterBased:
              DemDebounceCounterDecrementStepSize = 1
              DemDebounceCounterIncrementStepSize = 1
              DemDebounceCounterJumpDown = false
              DemDebounceCounterJumpUp = true
              DemDebounceBehavior = DEM_DEBOUNCE_FREEZE
              DemDebounceCounterFailedThreshold = 127
              DemDebounceCounterJumpDownValue = 0
              DemDebounceCounterJumpUpValue = 0
              DemDebounceCounterPassedThreshold = -128
              DemDebounceCounterStorage = false
              DemDebounceContinuous = false
          IndicatorAttribute_WarningIndicator (DemIndicatorAttribute):
            DemIndicatorFailureCycleSource = DEM_FAILURE_CYCLE_EVENT
            DemIndicatorBehaviour = DEM_INDICATOR_CONTINUOUS
            DemIndicatorHealingCycleCounterThreshold = 3
            DemIndicatorHealingCycleRef = PowerCycle
            DemIndicatorRef = WarningIndicator
      DTC_0xc07388 (DemEventParameter):
        DemEventKind = DEM_EVENT_KIND_SWC
        DemEventTimeSeries = DEM_TIMESERIES_SNAPSHOT_NONE
        DemEventAvailable = true
        DemEventId = 85
        DemEventAvailableInVariant = true
        DemEventLatchTestFailed = false
        DemEventCreateInfoPort = true
        DemDTCClassRef = DTCClass_DTC_0xc07388
        DemExtendedDataClassRef = ExtendedDataClass_83dcefb7
        DemFreezeFrameClassRef = FreezeFrameClass_5f5b5001
        DemFreezeFrameRecNumClassRef = FreezeFrameRecNumClass_f98c8aa7
        DemEventClass:
          DemAgingAllowed = true
          DemAgingCycleCounterThreshold = 40
          DemEventDestination = DEM_DTC_ORIGIN_PRIMARY_MEMORY
          DemEventPriority = 1
          DemEventSignificance = DEM_EVENT_SIGNIFICANCE_FAULT
          DemEventFailureCycleCounterThreshold = 0
          DemConsiderPtoStatus = false
          DemFFPrestorageSupported = false
          DemAgingCycleRef = PowerCycle
          DemEnableConditionGroupRef = EnableConditionGroup_c81fc67e
          DemOperationCycleRef = PowerCycle
          DemDebounceAlgorithmClass
            DemDebounceCounterBased:
              DemDebounceCounterDecrementStepSize = 1
              DemDebounceCounterIncrementStepSize = 1
              DemDebounceCounterJumpDown = false
              DemDebounceCounterJumpUp = true
              DemDebounceBehavior = DEM_DEBOUNCE_FREEZE
              DemDebounceCounterFailedThreshold = 127
              DemDebounceCounterJumpDownValue = 0
              DemDebounceCounterJumpUpValue = 0
              DemDebounceCounterPassedThreshold = -128
              DemDebounceCounterStorage = false
              DemDebounceContinuous = false
          IndicatorAttribute_WarningIndicator (DemIndicatorAttribute):
            DemIndicatorFailureCycleSource = DEM_FAILURE_CYCLE_EVENT
            DemIndicatorBehaviour = DEM_INDICATOR_CONTINUOUS
            DemIndicatorHealingCycleCounterThreshold = 3
            DemIndicatorHealingCycleRef = PowerCycle
            DemIndicatorRef = WarningIndicator
      3 x DemDTCClass, all with DemDTCSeverity=DEM_DTC_SEV_NO_SEVERITY, DemImmediateNvStorage=false:
        DTCClass_DTC_0x908017: DemUdsDTC=9469975
        DTCClass_DTC_0x11611c: DemUdsDTC=1138972
        DTCClass_DTC_0xc20787: DemUdsDTC=12715911
      DTC_0xc10387 (DemEventParameter):
        DemEventKind = DEM_EVENT_KIND_SWC
        DemEventTimeSeries = DEM_TIMESERIES_SNAPSHOT_NONE
        DemEventAvailable = true
        DemEventId = 87
        DemEventAvailableInVariant = true
        DemEventLatchTestFailed = false
        DemEventCreateInfoPort = true
        DemDTCClassRef = DTCClass_DTC_0xc10387
        DemExtendedDataClassRef = ExtendedDataClass_83dcefb7
        DemFreezeFrameClassRef = FreezeFrameClass_5f5b5001
        DemFreezeFrameRecNumClassRef = FreezeFrameRecNumClass_f98c8aa7
        DemEventClass:
          DemAgingAllowed = true
          DemAgingCycleCounterThreshold = 40
          DemEventDestination = DEM_DTC_ORIGIN_PRIMARY_MEMORY
          DemEventPriority = 1
          DemEventSignificance = DEM_EVENT_SIGNIFICANCE_FAULT
          DemEventFailureCycleCounterThreshold = 0
          DemConsiderPtoStatus = false
          DemFFPrestorageSupported = false
          DemAgingCycleRef = PowerCycle
          DemEnableConditionGroupRef = EnableConditionGroup_f3616881
          DemOperationCycleRef = PowerCycle
          DemDebounceAlgorithmClass
            DemDebounceCounterBased:
              DemDebounceCounterDecrementStepSize = 1
              DemDebounceCounterIncrementStepSize = 1
              DemDebounceCounterJumpDown = false
              DemDebounceCounterJumpUp = true
              DemDebounceBehavior = DEM_DEBOUNCE_FREEZE
              DemDebounceCounterFailedThreshold = 127
              DemDebounceCounterJumpDownValue = 0
              DemDebounceCounterJumpUpValue = 0
              DemDebounceCounterPassedThreshold = -128
              DemDebounceCounterStorage = false
              DemDebounceContinuous = false
          IndicatorAttribute_WarningIndicator (DemIndicatorAttribute):
            DemIndicatorFailureCycleSource = DEM_FAILURE_CYCLE_EVENT
            DemIndicatorBehaviour = DEM_INDICATOR_CONTINUOUS
            DemIndicatorHealingCycleCounterThreshold = 3
            DemIndicatorHealingCycleRef = PowerCycle
            DemIndicatorRef = WarningIndicator
      DTCClass_DTC_0x115392 (DemDTCClass): DemDTCSeverity=DEM_DTC_SEV_NO_SEVERITY, DemUdsDTC=1135506, DemImmediateNvStorage=false
      3 x DemEventParameter, all with DemEventKind=DEM_EVENT_KIND_SWC, DemEventTimeSeries=DEM_TIMESERIES_SNAPSHOT_NONE, DemEventAvailable=true, DemEventAvailableInVariant=true, DemEventLatchTestFailed=false, DemEventCreateInfoPort=true, DemExtendedDataClassRef=ExtendedDataClass_83dcefb7, DemFreezeFrameClassRef=FreezeFrameClass_5f5b5001, DemFreezeFrameRecNumClassRef=FreezeFrameRecNumClass_f98c8aa7:
        DTC_0x114497: DemEventId=44, DemDTCClassRef=DTCClass_DTC_0x114497
          DemEventClass:
            DemAgingAllowed = true
            DemAgingCycleCounterThreshold = 40
            DemEventDestination = DEM_DTC_ORIGIN_PRIMARY_MEMORY
            DemEventPriority = 1
            DemEventSignificance = DEM_EVENT_SIGNIFICANCE_FAULT
            DemEventFailureCycleCounterThreshold = 0
            DemConsiderPtoStatus = false
            DemFFPrestorageSupported = false
            DemAgingCycleRef = PowerCycle
            DemEnableConditionGroupRef = EnableConditionGroup_983000c1
            DemOperationCycleRef = PowerCycle
            DemDebounceAlgorithmClass
              DemDebounceCounterBased:
                DemDebounceCounterDecrementStepSize = 1
                DemDebounceCounterIncrementStepSize = 1
                DemDebounceCounterJumpDown = false
                DemDebounceCounterJumpUp = true
                DemDebounceBehavior = DEM_DEBOUNCE_FREEZE
                DemDebounceCounterFailedThreshold = 127
                DemDebounceCounterJumpDownValue = 0
                DemDebounceCounterJumpUpValue = 0
                DemDebounceCounterPassedThreshold = -128
                DemDebounceCounterStorage = false
                DemDebounceContinuous = false
            IndicatorAttribute_WarningIndicator (DemIndicatorAttribute):
              DemIndicatorFailureCycleSource = DEM_FAILURE_CYCLE_EVENT
              DemIndicatorBehaviour = DEM_INDICATOR_CONTINUOUS
              DemIndicatorHealingCycleCounterThreshold = 3
              DemIndicatorHealingCycleRef = PowerCycle
              DemIndicatorRef = WarningIndicator
        DTC_0x110211: DemEventId=26, DemDTCClassRef=DTCClass_DTC_0x110211
          DemEventClass:
            DemAgingAllowed = true
            DemAgingCycleCounterThreshold = 40
            DemEventDestination = DEM_DTC_ORIGIN_PRIMARY_MEMORY
            DemEventPriority = 1
            DemEventSignificance = DEM_EVENT_SIGNIFICANCE_FAULT
            DemEventFailureCycleCounterThreshold = 0
            DemConsiderPtoStatus = false
            DemFFPrestorageSupported = false
            DemAgingCycleRef = PowerCycle
            DemEnableConditionGroupRef = EnableConditionGroup_bbe52cb7
            DemOperationCycleRef = PowerCycle
            DemDebounceAlgorithmClass
              DemDebounceCounterBased:
                DemDebounceCounterDecrementStepSize = 1
                DemDebounceCounterIncrementStepSize = 1
                DemDebounceCounterJumpDown = false
                DemDebounceCounterJumpUp = true
                DemDebounceBehavior = DEM_DEBOUNCE_FREEZE
                DemDebounceCounterFailedThreshold = 127
                DemDebounceCounterJumpDownValue = 0
                DemDebounceCounterJumpUpValue = 0
                DemDebounceCounterPassedThreshold = -128
                DemDebounceCounterStorage = false
                DemDebounceContinuous = false
            IndicatorAttribute_WarningIndicator (DemIndicatorAttribute):
              DemIndicatorFailureCycleSource = DEM_FAILURE_CYCLE_EVENT
              DemIndicatorBehaviour = DEM_INDICATOR_CONTINUOUS
              DemIndicatorHealingCycleCounterThreshold = 3
              DemIndicatorHealingCycleRef = PowerCycle
              DemIndicatorRef = WarningIndicator
        DTC_0x117405: DemEventId=71, DemDTCClassRef=DTCClass_DTC_0x117405
          DemEventClass:
            DemAgingAllowed = true
            DemAgingCycleCounterThreshold = 40
            DemEventDestination = DEM_DTC_ORIGIN_PRIMARY_MEMORY
            DemEventPriority = 1
            DemEventSignificance = DEM_EVENT_SIGNIFICANCE_FAULT
            DemEventFailureCycleCounterThreshold = 0
            DemConsiderPtoStatus = false
            DemFFPrestorageSupported = false
            DemAgingCycleRef = PowerCycle
            DemOperationCycleRef = PowerCycle
            DemDebounceAlgorithmClass
              DemDebounceCounterBased:
                DemDebounceCounterDecrementStepSize = 1
                DemDebounceCounterIncrementStepSize = 1
                DemDebounceCounterJumpDown = false
                DemDebounceCounterJumpUp = true
                DemDebounceBehavior = DEM_DEBOUNCE_FREEZE
                DemDebounceCounterFailedThreshold = 127
                DemDebounceCounterJumpDownValue = 0
                DemDebounceCounterJumpUpValue = 0
                DemDebounceCounterPassedThreshold = -128
                DemDebounceCounterStorage = false
                DemDebounceContinuous = false
            IndicatorAttribute_WarningIndicator (DemIndicatorAttribute):
              DemIndicatorFailureCycleSource = DEM_FAILURE_CYCLE_EVENT
              DemIndicatorBehaviour = DEM_INDICATOR_CONTINUOUS
              DemIndicatorHealingCycleCounterThreshold = 3
              DemIndicatorHealingCycleRef = PowerCycle
              DemIndicatorRef = WarningIndicator
      3 x DemDTCClass, all with DemDTCSeverity=DEM_DTC_SEV_NO_SEVERITY, DemImmediateNvStorage=false:
        DTCClass_DTC_0xc29a00: DemUdsDTC=12753408
        DTCClass_DTC_0xc19687: DemUdsDTC=12686983
        DTCClass_DTC_0x111352: DemUdsDTC=1119058
      3 x DemEventParameter, all with DemEventKind=DEM_EVENT_KIND_SWC, DemEventTimeSeries=DEM_TIMESERIES_SNAPSHOT_NONE, DemEventAvailable=true, DemEventAvailableInVariant=true, DemEventLatchTestFailed=false, DemEventCreateInfoPort=true, DemExtendedDataClassRef=ExtendedDataClass_83dcefb7, DemFreezeFrameRecNumClassRef=FreezeFrameRecNumClass_f98c8aa7:
        DTC_0x11621c: DemEventId=22, DemDTCClassRef=DTCClass_DTC_0x11621c, DemFreezeFrameClassRef=FreezeFrameClass_5f5b5001
          DemEventClass:
            DemAgingAllowed = true
            DemAgingCycleCounterThreshold = 40
            DemEventDestination = DEM_DTC_ORIGIN_PRIMARY_MEMORY
            DemEventPriority = 2
            DemEventSignificance = DEM_EVENT_SIGNIFICANCE_FAULT
            DemEventFailureCycleCounterThreshold = 0
            DemConsiderPtoStatus = false
            DemFFPrestorageSupported = false
            DemAgingCycleRef = PowerCycle
            DemEnableConditionGroupRef = EnableConditionGroup_fdfec498
            DemOperationCycleRef = PowerCycle
            DemDebounceAlgorithmClass
              DemDebounceCounterBased:
                DemDebounceCounterDecrementStepSize = 1
                DemDebounceCounterIncrementStepSize = 1
                DemDebounceCounterJumpDown = false
                DemDebounceCounterJumpUp = true
                DemDebounceBehavior = DEM_DEBOUNCE_FREEZE
                DemDebounceCounterFailedThreshold = 127
                DemDebounceCounterJumpDownValue = 0
                DemDebounceCounterJumpUpValue = 0
                DemDebounceCounterPassedThreshold = -128
                DemDebounceCounterStorage = false
                DemDebounceContinuous = false
            IndicatorAttribute_WarningIndicator (DemIndicatorAttribute):
              DemIndicatorFailureCycleSource = DEM_FAILURE_CYCLE_EVENT
              DemIndicatorBehaviour = DEM_INDICATOR_CONTINUOUS
              DemIndicatorHealingCycleCounterThreshold = 3
              DemIndicatorHealingCycleRef = PowerCycle
              DemIndicatorRef = WarningIndicator
        DTC_0x117c08: DemEventId=14, DemDTCClassRef=DTCClass_DTC_0x117c08, DemFreezeFrameClassRef=FreezeFrameClass_5f5b5001
          DemEventClass:
            DemAgingAllowed = true
            DemAgingCycleCounterThreshold = 40
            DemEventDestination = DEM_DTC_ORIGIN_PRIMARY_MEMORY
            DemEventPriority = 2
            DemEventSignificance = DEM_EVENT_SIGNIFICANCE_FAULT
            DemEventFailureCycleCounterThreshold = 0
            DemConsiderPtoStatus = false
            DemFFPrestorageSupported = false
            DemAgingCycleRef = PowerCycle
            DemEnableConditionGroupRef = EnableConditionGroup_4ffb066f
            DemOperationCycleRef = PowerCycle
            DemDebounceAlgorithmClass
              DemDebounceCounterBased:
                DemDebounceCounterDecrementStepSize = 1
                DemDebounceCounterIncrementStepSize = 1
                DemDebounceCounterJumpDown = false
                DemDebounceCounterJumpUp = true
                DemDebounceBehavior = DEM_DEBOUNCE_FREEZE
                DemDebounceCounterFailedThreshold = 127
                DemDebounceCounterJumpDownValue = 0
                DemDebounceCounterJumpUpValue = 0
                DemDebounceCounterPassedThreshold = -128
                DemDebounceCounterStorage = false
                DemDebounceContinuous = false
            IndicatorAttribute_WarningIndicator (DemIndicatorAttribute):
              DemIndicatorFailureCycleSource = DEM_FAILURE_CYCLE_EVENT
              DemIndicatorBehaviour = DEM_INDICATOR_CONTINUOUS
              DemIndicatorHealingCycleCounterThreshold = 3
              DemIndicatorHealingCycleRef = PowerCycle
              DemIndicatorRef = WarningIndicator
        DTC_0x115816: DemEventId=57, DemDTCClassRef=DTCClass_DTC_0x115816, DemFreezeFrameClassRef=FreezeFrameClass_d96350db
          DemEventClass:
            DemAgingAllowed = true
            DemAgingCycleCounterThreshold = 40
            DemEventDestination = DEM_DTC_ORIGIN_PRIMARY_MEMORY
            DemEventPriority = 1
            DemEventSignificance = DEM_EVENT_SIGNIFICANCE_FAULT
            DemEventFailureCycleCounterThreshold = 0
            DemConsiderPtoStatus = false
            DemFFPrestorageSupported = false
            DemAgingCycleRef = PowerCycle
            DemEnableConditionGroupRef = EnableConditionGroup_bbe52cb7
            DemOperationCycleRef = PowerCycle
            DemDebounceAlgorithmClass
              DemDebounceCounterBased:
                DemDebounceCounterDecrementStepSize = 1
                DemDebounceCounterIncrementStepSize = 1
                DemDebounceCounterJumpDown = false
                DemDebounceCounterJumpUp = true
                DemDebounceBehavior = DEM_DEBOUNCE_FREEZE
                DemDebounceCounterFailedThreshold = 127
                DemDebounceCounterJumpDownValue = 0
                DemDebounceCounterJumpUpValue = 0
                DemDebounceCounterPassedThreshold = -128
                DemDebounceCounterStorage = false
                DemDebounceContinuous = false
            IndicatorAttribute_WarningIndicator (DemIndicatorAttribute):
              DemIndicatorFailureCycleSource = DEM_FAILURE_CYCLE_EVENT
              DemIndicatorBehaviour = DEM_INDICATOR_CONTINUOUS
              DemIndicatorHealingCycleCounterThreshold = 3
              DemIndicatorHealingCycleRef = PowerCycle
              DemIndicatorRef = WarningIndicator
      4 x DemDTCClass, all with DemDTCSeverity=DEM_DTC_SEV_NO_SEVERITY, DemImmediateNvStorage=false:
        DTCClass_DTC_0xc07388: DemUdsDTC=12612488
        DTCClass_DTC_0x117e52: DemUdsDTC=1146450
        DTCClass_DTC_0x111e71: DemUdsDTC=1121905
        DTCClass_DTC_0x116594: DemUdsDTC=1140116
      DTC_0x908017 (DemEventParameter):
        DemEventKind = DEM_EVENT_KIND_SWC
        DemEventTimeSeries = DEM_TIMESERIES_SNAPSHOT_NONE
        DemEventAvailable = true
        DemEventId = 76
        DemEventAvailableInVariant = true
        DemEventLatchTestFailed = false
        DemEventCreateInfoPort = true
        DemDTCClassRef = DTCClass_DTC_0x908017
        DemExtendedDataClassRef = ExtendedDataClass_83dcefb7
        DemFreezeFrameClassRef = FreezeFrameClass_5f5b5001
        DemFreezeFrameRecNumClassRef = FreezeFrameRecNumClass_f98c8aa7
        DemEventClass:
          DemAgingAllowed = true
          DemAgingCycleCounterThreshold = 40
          DemEventDestination = DEM_DTC_ORIGIN_PRIMARY_MEMORY
          DemEventPriority = 1
          DemEventSignificance = DEM_EVENT_SIGNIFICANCE_FAULT
          DemEventFailureCycleCounterThreshold = 0
          DemConsiderPtoStatus = false
          DemFFPrestorageSupported = false
          DemAgingCycleRef = PowerCycle
          DemEnableConditionGroupRef = EnableConditionGroup_93df7d19
          DemOperationCycleRef = PowerCycle
          DemDebounceAlgorithmClass
            DemDebounceCounterBased:
              DemDebounceCounterDecrementStepSize = 1
              DemDebounceCounterIncrementStepSize = 1
              DemDebounceCounterJumpDown = false
              DemDebounceCounterJumpUp = true
              DemDebounceBehavior = DEM_DEBOUNCE_FREEZE
              DemDebounceCounterFailedThreshold = 127
              DemDebounceCounterJumpDownValue = 0
              DemDebounceCounterJumpUpValue = 0
              DemDebounceCounterPassedThreshold = -128
              DemDebounceCounterStorage = false
              DemDebounceContinuous = false
          IndicatorAttribute_WarningIndicator (DemIndicatorAttribute):
            DemIndicatorFailureCycleSource = DEM_FAILURE_CYCLE_EVENT
            DemIndicatorBehaviour = DEM_INDICATOR_CONTINUOUS
            DemIndicatorHealingCycleCounterThreshold = 3
            DemIndicatorHealingCycleRef = PowerCycle
            DemIndicatorRef = WarningIndicator
      DTCClass_DTC_0x117c08 (DemDTCClass): DemDTCSeverity=DEM_DTC_SEV_NO_SEVERITY, DemUdsDTC=1145864, DemImmediateNvStorage=false
      DTC_0x113997 (DemEventParameter):
        DemEventKind = DEM_EVENT_KIND_SWC
        DemEventTimeSeries = DEM_TIMESERIES_SNAPSHOT_NONE
        DemEventAvailable = true
        DemEventId = 39
        DemEventAvailableInVariant = true
        DemEventLatchTestFailed = false
        DemEventCreateInfoPort = true
        DemDTCClassRef = DTCClass_DTC_0x113997
        DemExtendedDataClassRef = ExtendedDataClass_83dcefb7
        DemFreezeFrameClassRef = FreezeFrameClass_5f5b5001
        DemFreezeFrameRecNumClassRef = FreezeFrameRecNumClass_f98c8aa7
        DemEventClass:
          DemAgingAllowed = true
          DemAgingCycleCounterThreshold = 40
          DemEventDestination = DEM_DTC_ORIGIN_PRIMARY_MEMORY
          DemEventPriority = 1
          DemEventSignificance = DEM_EVENT_SIGNIFICANCE_FAULT
          DemEventFailureCycleCounterThreshold = 0
          DemConsiderPtoStatus = false
          DemFFPrestorageSupported = false
          DemAgingCycleRef = PowerCycle
          DemEnableConditionGroupRef = EnableConditionGroup_983000c1
          DemOperationCycleRef = PowerCycle
          DemDebounceAlgorithmClass
            DemDebounceCounterBased:
              DemDebounceCounterDecrementStepSize = 1
              DemDebounceCounterIncrementStepSize = 1
              DemDebounceCounterJumpDown = false
              DemDebounceCounterJumpUp = true
              DemDebounceBehavior = DEM_DEBOUNCE_FREEZE
              DemDebounceCounterFailedThreshold = 127
              DemDebounceCounterJumpDownValue = 0
              DemDebounceCounterJumpUpValue = 0
              DemDebounceCounterPassedThreshold = -128
              DemDebounceCounterStorage = false
              DemDebounceContinuous = false
          IndicatorAttribute_WarningIndicator (DemIndicatorAttribute):
            DemIndicatorFailureCycleSource = DEM_FAILURE_CYCLE_EVENT
            DemIndicatorBehaviour = DEM_INDICATOR_CONTINUOUS
            DemIndicatorHealingCycleCounterThreshold = 3
            DemIndicatorHealingCycleRef = PowerCycle
            DemIndicatorRef = WarningIndicator
      DTC_0x115492 (DemEventParameter):
        DemEventKind = DEM_EVENT_KIND_SWC
        DemEventTimeSeries = DEM_TIMESERIES_SNAPSHOT_NONE
        DemEventAvailable = true
        DemEventId = 54
        DemEventAvailableInVariant = true
        DemEventLatchTestFailed = false
        DemEventCreateInfoPort = true
        DemDTCClassRef = DTCClass_DTC_0x115492
        DemExtendedDataClassRef = ExtendedDataClass_83dcefb7
        DemFreezeFrameClassRef = FreezeFrameClass_5f5b5001
        DemFreezeFrameRecNumClassRef = FreezeFrameRecNumClass_f98c8aa7
        DemEventClass:
          DemAgingAllowed = true
          DemAgingCycleCounterThreshold = 40
          DemEventDestination = DEM_DTC_ORIGIN_PRIMARY_MEMORY
          DemEventPriority = 2
          DemEventSignificance = DEM_EVENT_SIGNIFICANCE_FAULT
          DemEventFailureCycleCounterThreshold = 0
          DemConsiderPtoStatus = false
          DemFFPrestorageSupported = false
          DemAgingCycleRef = PowerCycle
          DemEnableConditionGroupRef = EnableConditionGroup_fdfec498
          DemOperationCycleRef = PowerCycle
          DemDebounceAlgorithmClass
            DemDebounceCounterBased:
              DemDebounceCounterDecrementStepSize = 1
              DemDebounceCounterIncrementStepSize = 1
              DemDebounceCounterJumpDown = false
              DemDebounceCounterJumpUp = true
              DemDebounceBehavior = DEM_DEBOUNCE_FREEZE
              DemDebounceCounterFailedThreshold = 127
              DemDebounceCounterJumpDownValue = 0
              DemDebounceCounterJumpUpValue = 0
              DemDebounceCounterPassedThreshold = -128
              DemDebounceCounterStorage = false
              DemDebounceContinuous = false
          IndicatorAttribute_WarningIndicator (DemIndicatorAttribute):
            DemIndicatorFailureCycleSource = DEM_FAILURE_CYCLE_EVENT
            DemIndicatorBehaviour = DEM_INDICATOR_CONTINUOUS
            DemIndicatorHealingCycleCounterThreshold = 3
            DemIndicatorHealingCycleRef = PowerCycle
            DemIndicatorRef = WarningIndicator
      DTCClass_DTC_0x117205 (DemDTCClass): DemDTCSeverity=DEM_DTC_SEV_NO_SEVERITY, DemUdsDTC=1143301, DemImmediateNvStorage=false
      DTC_0xc11087 (DemEventParameter):
        DemEventKind = DEM_EVENT_KIND_SWC
        DemEventTimeSeries = DEM_TIMESERIES_SNAPSHOT_NONE
        DemEventAvailable = true
        DemEventId = 88
        DemEventAvailableInVariant = true
        DemEventLatchTestFailed = false
        DemEventCreateInfoPort = true
        DemDTCClassRef = DTCClass_DTC_0xc11087
        DemExtendedDataClassRef = ExtendedDataClass_83dcefb7
        DemFreezeFrameClassRef = FreezeFrameClass_5f5b5001
        DemFreezeFrameRecNumClassRef = FreezeFrameRecNumClass_f98c8aa7
        DemEventClass:
          DemAgingAllowed = true
          DemAgingCycleCounterThreshold = 40
          DemEventDestination = DEM_DTC_ORIGIN_PRIMARY_MEMORY
          DemEventPriority = 1
          DemEventSignificance = DEM_EVENT_SIGNIFICANCE_FAULT
          DemEventFailureCycleCounterThreshold = 0
          DemConsiderPtoStatus = false
          DemFFPrestorageSupported = false
          DemAgingCycleRef = PowerCycle
          DemEnableConditionGroupRef = EnableConditionGroup_f3616881
          DemOperationCycleRef = PowerCycle
          DemDebounceAlgorithmClass
            DemDebounceCounterBased:
              DemDebounceCounterDecrementStepSize = 1
              DemDebounceCounterIncrementStepSize = 1
              DemDebounceCounterJumpDown = false
              DemDebounceCounterJumpUp = true
              DemDebounceBehavior = DEM_DEBOUNCE_FREEZE
              DemDebounceCounterFailedThreshold = 127
              DemDebounceCounterJumpDownValue = 0
              DemDebounceCounterJumpUpValue = 0
              DemDebounceCounterPassedThreshold = -128
              DemDebounceCounterStorage = false
              DemDebounceContinuous = false
          IndicatorAttribute_WarningIndicator (DemIndicatorAttribute):
            DemIndicatorFailureCycleSource = DEM_FAILURE_CYCLE_EVENT
            DemIndicatorBehaviour = DEM_INDICATOR_CONTINUOUS
            DemIndicatorHealingCycleCounterThreshold = 3
            DemIndicatorHealingCycleRef = PowerCycle
            DemIndicatorRef = WarningIndicator
      DTC_0x115c4b (DemEventParameter):
        DemEventKind = DEM_EVENT_KIND_SWC
        DemEventTimeSeries = DEM_TIMESERIES_SNAPSHOT_NONE
        DemEventAvailable = true
        DemEventId = 4
        DemEventAvailableInVariant = true
        DemEventLatchTestFailed = false
        DemEventCreateInfoPort = true
        DemDTCClassRef = DTCClass_DTC_0x115c4b
        DemExtendedDataClassRef = ExtendedDataClass_83dcefb7
        DemFreezeFrameClassRef = FreezeFrameClass_5f5b5001
        DemFreezeFrameRecNumClassRef = FreezeFrameRecNumClass_f98c8aa7
        DemEventClass:
          DemAgingAllowed = true
          DemAgingCycleCounterThreshold = 40
          DemEventDestination = DEM_DTC_ORIGIN_PRIMARY_MEMORY
          DemEventPriority = 2
          DemEventSignificance = DEM_EVENT_SIGNIFICANCE_FAULT
          DemEventFailureCycleCounterThreshold = 0
          DemConsiderPtoStatus = false
          DemFFPrestorageSupported = false
          DemAgingCycleRef = PowerCycle
          DemEnableConditionGroupRef = EnableConditionGroup_fdfec498
          DemOperationCycleRef = PowerCycle
          DemDebounceAlgorithmClass
            DemDebounceCounterBased:
              DemDebounceCounterDecrementStepSize = 1
              DemDebounceCounterIncrementStepSize = 1
              DemDebounceCounterJumpDown = false
              DemDebounceCounterJumpUp = true
              DemDebounceBehavior = DEM_DEBOUNCE_FREEZE
              DemDebounceCounterFailedThreshold = 127
              DemDebounceCounterJumpDownValue = 0
              DemDebounceCounterJumpUpValue = 0
              DemDebounceCounterPassedThreshold = -128
              DemDebounceCounterStorage = false
              DemDebounceContinuous = false
          IndicatorAttribute_WarningIndicator (DemIndicatorAttribute):
            DemIndicatorFailureCycleSource = DEM_FAILURE_CYCLE_EVENT
            DemIndicatorBehaviour = DEM_INDICATOR_CONTINUOUS
            DemIndicatorHealingCycleCounterThreshold = 3
            DemIndicatorHealingCycleRef = PowerCycle
            DemIndicatorRef = WarningIndicator
      DTCClass_DTC_0x114297 (DemDTCClass): DemDTCSeverity=DEM_DTC_SEV_NO_SEVERITY, DemUdsDTC=1131159, DemImmediateNvStorage=false
      DTCClass_DTC_0x110012 (DemDTCClass): DemDTCSeverity=DEM_DTC_SEV_NO_SEVERITY, DemUdsDTC=1114130, DemImmediateNvStorage=false
      DTC_0x113197 (DemEventParameter):
        DemEventKind = DEM_EVENT_KIND_SWC
        DemEventTimeSeries = DEM_TIMESERIES_SNAPSHOT_NONE
        DemEventAvailable = true
        DemEventId = 31
        DemEventAvailableInVariant = true
        DemEventLatchTestFailed = false
        DemEventCreateInfoPort = true
        DemDTCClassRef = DTCClass_DTC_0x113197
        DemExtendedDataClassRef = ExtendedDataClass_83dcefb7
        DemFreezeFrameClassRef = FreezeFrameClass_d0d51cf0
        DemFreezeFrameRecNumClassRef = FreezeFrameRecNumClass_f98c8aa7
        DemEventClass:
          DemAgingAllowed = true
          DemAgingCycleCounterThreshold = 40
          DemEventDestination = DEM_DTC_ORIGIN_PRIMARY_MEMORY
          DemEventPriority = 1
          DemEventSignificance = DEM_EVENT_SIGNIFICANCE_FAULT
          DemEventFailureCycleCounterThreshold = 0
          DemConsiderPtoStatus = false
          DemFFPrestorageSupported = false
          DemAgingCycleRef = PowerCycle
          DemEnableConditionGroupRef = EnableConditionGroup_fdfec498
          DemOperationCycleRef = PowerCycle
          DemDebounceAlgorithmClass
            DemDebounceCounterBased:
              DemDebounceCounterDecrementStepSize = 1
              DemDebounceCounterIncrementStepSize = 1
              DemDebounceCounterJumpDown = false
              DemDebounceCounterJumpUp = true
              DemDebounceBehavior = DEM_DEBOUNCE_FREEZE
              DemDebounceCounterFailedThreshold = 127
              DemDebounceCounterJumpDownValue = 0
              DemDebounceCounterJumpUpValue = 0
              DemDebounceCounterPassedThreshold = -128
              DemDebounceCounterStorage = false
              DemDebounceContinuous = false
          IndicatorAttribute_WarningIndicator (DemIndicatorAttribute):
            DemIndicatorFailureCycleSource = DEM_FAILURE_CYCLE_EVENT
            DemIndicatorBehaviour = DEM_INDICATOR_CONTINUOUS
            DemIndicatorHealingCycleCounterThreshold = 3
            DemIndicatorHealingCycleRef = PowerCycle
            DemIndicatorRef = WarningIndicator
      5 x DemDTCClass, all with DemDTCSeverity=DEM_DTC_SEV_NO_SEVERITY, DemImmediateNvStorage=false:
        DTCClass_DTC_0x115816: DemUdsDTC=1136662
        DTCClass_DTC_0x113997: DemUdsDTC=1128855
        DTCClass_DTC_0xc12987: DemUdsDTC=12659079
        DTCClass_DTC_0x11621c: DemUdsDTC=1139228
        DTCClass_DTC_0x115492: DemUdsDTC=1135762
      5 x DemEventParameter, all with DemEventKind=DEM_EVENT_KIND_SWC, DemEventTimeSeries=DEM_TIMESERIES_SNAPSHOT_NONE, DemEventAvailable=true, DemEventAvailableInVariant=true, DemEventLatchTestFailed=false, DemEventCreateInfoPort=true, DemExtendedDataClassRef=ExtendedDataClass_83dcefb7, DemFreezeFrameClassRef=FreezeFrameClass_5f5b5001, DemFreezeFrameRecNumClassRef=FreezeFrameRecNumClass_f98c8aa7:
        DTC_0x114397: DemEventId=43, DemDTCClassRef=DTCClass_DTC_0x114397
          DemEventClass:
            DemAgingAllowed = true
            DemAgingCycleCounterThreshold = 40
            DemEventDestination = DEM_DTC_ORIGIN_PRIMARY_MEMORY
            DemEventPriority = 1
            DemEventSignificance = DEM_EVENT_SIGNIFICANCE_FAULT
            DemEventFailureCycleCounterThreshold = 0
            DemConsiderPtoStatus = false
            DemFFPrestorageSupported = false
            DemAgingCycleRef = PowerCycle
            DemEnableConditionGroupRef = EnableConditionGroup_983000c1
            DemOperationCycleRef = PowerCycle
            DemDebounceAlgorithmClass
              DemDebounceCounterBased:
                DemDebounceCounterDecrementStepSize = 1
                DemDebounceCounterIncrementStepSize = 1
                DemDebounceCounterJumpDown = false
                DemDebounceCounterJumpUp = true
                DemDebounceBehavior = DEM_DEBOUNCE_FREEZE
                DemDebounceCounterFailedThreshold = 127
                DemDebounceCounterJumpDownValue = 0
                DemDebounceCounterJumpUpValue = 0
                DemDebounceCounterPassedThreshold = -128
                DemDebounceCounterStorage = false
                DemDebounceContinuous = false
            IndicatorAttribute_WarningIndicator (DemIndicatorAttribute):
              DemIndicatorFailureCycleSource = DEM_FAILURE_CYCLE_EVENT
              DemIndicatorBehaviour = DEM_INDICATOR_CONTINUOUS
              DemIndicatorHealingCycleCounterThreshold = 3
              DemIndicatorHealingCycleRef = PowerCycle
              DemIndicatorRef = WarningIndicator
        DTC_0xc12987: DemEventId=90, DemDTCClassRef=DTCClass_DTC_0xc12987
          DemEventClass:
            DemAgingAllowed = true
            DemAgingCycleCounterThreshold = 40
            DemEventDestination = DEM_DTC_ORIGIN_PRIMARY_MEMORY
            DemEventPriority = 1
            DemEventSignificance = DEM_EVENT_SIGNIFICANCE_FAULT
            DemEventFailureCycleCounterThreshold = 0
            DemConsiderPtoStatus = false
            DemFFPrestorageSupported = false
            DemAgingCycleRef = PowerCycle
            DemEnableConditionGroupRef = EnableConditionGroup_35324f44
            DemOperationCycleRef = PowerCycle
            DemDebounceAlgorithmClass
              DemDebounceCounterBased:
                DemDebounceCounterDecrementStepSize = 1
                DemDebounceCounterIncrementStepSize = 1
                DemDebounceCounterJumpDown = false
                DemDebounceCounterJumpUp = true
                DemDebounceBehavior = DEM_DEBOUNCE_FREEZE
                DemDebounceCounterFailedThreshold = 127
                DemDebounceCounterJumpDownValue = 0
                DemDebounceCounterJumpUpValue = 0
                DemDebounceCounterPassedThreshold = -128
                DemDebounceCounterStorage = false
                DemDebounceContinuous = false
            IndicatorAttribute_WarningIndicator (DemIndicatorAttribute):
              DemIndicatorFailureCycleSource = DEM_FAILURE_CYCLE_EVENT
              DemIndicatorBehaviour = DEM_INDICATOR_CONTINUOUS
              DemIndicatorHealingCycleCounterThreshold = 3
              DemIndicatorHealingCycleRef = PowerCycle
              DemIndicatorRef = WarningIndicator
        DTC_0x110112: DemEventId=25, DemDTCClassRef=DTCClass_DTC_0x110112
          DemEventClass:
            DemAgingAllowed = true
            DemAgingCycleCounterThreshold = 40
            DemEventDestination = DEM_DTC_ORIGIN_PRIMARY_MEMORY
            DemEventPriority = 1
            DemEventSignificance = DEM_EVENT_SIGNIFICANCE_FAULT
            DemEventFailureCycleCounterThreshold = 0
            DemConsiderPtoStatus = false
            DemFFPrestorageSupported = false
            DemAgingCycleRef = PowerCycle
            DemEnableConditionGroupRef = EnableConditionGroup_bbe52cb7
            DemOperationCycleRef = PowerCycle
            DemDebounceAlgorithmClass
              DemDebounceCounterBased:
                DemDebounceCounterDecrementStepSize = 1
                DemDebounceCounterIncrementStepSize = 1
                DemDebounceCounterJumpDown = false
                DemDebounceCounterJumpUp = true
                DemDebounceBehavior = DEM_DEBOUNCE_FREEZE
                DemDebounceCounterFailedThreshold = 127
                DemDebounceCounterJumpDownValue = 0
                DemDebounceCounterJumpUpValue = 0
                DemDebounceCounterPassedThreshold = -128
                DemDebounceCounterStorage = false
                DemDebounceContinuous = false
            IndicatorAttribute_WarningIndicator (DemIndicatorAttribute):
              DemIndicatorFailureCycleSource = DEM_FAILURE_CYCLE_EVENT
              DemIndicatorBehaviour = DEM_INDICATOR_CONTINUOUS
              DemIndicatorHealingCycleCounterThreshold = 3
              DemIndicatorHealingCycleRef = PowerCycle
              DemIndicatorRef = WarningIndicator
        DTC_0x117305: DemEventId=70, DemDTCClassRef=DTCClass_DTC_0x117305
          DemEventClass:
            DemAgingAllowed = true
            DemAgingCycleCounterThreshold = 40
            DemEventDestination = DEM_DTC_ORIGIN_PRIMARY_MEMORY
            DemEventPriority = 1
            DemEventSignificance = DEM_EVENT_SIGNIFICANCE_FAULT
            DemEventFailureCycleCounterThreshold = 0
            DemConsiderPtoStatus = false
            DemFFPrestorageSupported = false
            DemAgingCycleRef = PowerCycle
            DemOperationCycleRef = PowerCycle
            DemDebounceAlgorithmClass
              DemDebounceCounterBased:
                DemDebounceCounterDecrementStepSize = 1
                DemDebounceCounterIncrementStepSize = 1
                DemDebounceCounterJumpDown = false
                DemDebounceCounterJumpUp = true
                DemDebounceBehavior = DEM_DEBOUNCE_FREEZE
                DemDebounceCounterFailedThreshold = 127
                DemDebounceCounterJumpDownValue = 0
                DemDebounceCounterJumpUpValue = 0
                DemDebounceCounterPassedThreshold = -128
                DemDebounceCounterStorage = false
                DemDebounceContinuous = false
            IndicatorAttribute_WarningIndicator (DemIndicatorAttribute):
              DemIndicatorFailureCycleSource = DEM_FAILURE_CYCLE_EVENT
              DemIndicatorBehaviour = DEM_INDICATOR_CONTINUOUS
              DemIndicatorHealingCycleCounterThreshold = 3
              DemIndicatorHealingCycleRef = PowerCycle
              DemIndicatorRef = WarningIndicator
        DTC_0x117d08: DemEventId=15, DemDTCClassRef=DTCClass_DTC_0x117d08
          DemEventClass:
            DemAgingAllowed = true
            DemAgingCycleCounterThreshold = 40
            DemEventDestination = DEM_DTC_ORIGIN_PRIMARY_MEMORY
            DemEventPriority = 2
            DemEventSignificance = DEM_EVENT_SIGNIFICANCE_FAULT
            DemEventFailureCycleCounterThreshold = 0
            DemConsiderPtoStatus = false
            DemFFPrestorageSupported = false
            DemAgingCycleRef = PowerCycle
            DemEnableConditionGroupRef = EnableConditionGroup_4ffb066f
            DemOperationCycleRef = PowerCycle
            DemDebounceAlgorithmClass
              DemDebounceCounterBased:
                DemDebounceCounterDecrementStepSize = 1
                DemDebounceCounterIncrementStepSize = 1
                DemDebounceCounterJumpDown = false
                DemDebounceCounterJumpUp = true
                DemDebounceBehavior = DEM_DEBOUNCE_FREEZE
                DemDebounceCounterFailedThreshold = 127
                DemDebounceCounterJumpDownValue = 0
                DemDebounceCounterJumpUpValue = 0
                DemDebounceCounterPassedThreshold = -128
                DemDebounceCounterStorage = false
                DemDebounceContinuous = false
            IndicatorAttribute_WarningIndicator (DemIndicatorAttribute):
              DemIndicatorFailureCycleSource = DEM_FAILURE_CYCLE_EVENT
              DemIndicatorBehaviour = DEM_INDICATOR_CONTINUOUS
              DemIndicatorHealingCycleCounterThreshold = 3
              DemIndicatorHealingCycleRef = PowerCycle
              DemIndicatorRef = WarningIndicator
      DTCClass_DTC_0x113197 (DemDTCClass): DemDTCSeverity=DEM_DTC_SEV_NO_SEVERITY, DemUdsDTC=1126807, DemImmediateNvStorage=false
      DTCClass_DTC_0x115c4b (DemDTCClass): DemDTCSeverity=DEM_DTC_SEV_NO_SEVERITY, DemUdsDTC=1137739, DemImmediateNvStorage=false
      3 x DemEventParameter, all with DemEventKind=DEM_EVENT_KIND_SWC, DemEventTimeSeries=DEM_TIMESERIES_SNAPSHOT_NONE, DemEventAvailable=true, DemEventAvailableInVariant=true, DemEventLatchTestFailed=false, DemEventCreateInfoPort=true, DemExtendedDataClassRef=ExtendedDataClass_83dcefb7, DemFreezeFrameClassRef=FreezeFrameClass_5f5b5001, DemFreezeFrameRecNumClassRef=FreezeFrameRecNumClass_f98c8aa7:
        DTC_0x11611c: DemEventId=21, DemDTCClassRef=DTCClass_DTC_0x11611c
          DemEventClass:
            DemAgingAllowed = true
            DemAgingCycleCounterThreshold = 40
            DemEventDestination = DEM_DTC_ORIGIN_PRIMARY_MEMORY
            DemEventPriority = 2
            DemEventSignificance = DEM_EVENT_SIGNIFICANCE_FAULT
            DemEventFailureCycleCounterThreshold = 0
            DemConsiderPtoStatus = false
            DemFFPrestorageSupported = false
            DemAgingCycleRef = PowerCycle
            DemEnableConditionGroupRef = EnableConditionGroup_fdfec498
            DemOperationCycleRef = PowerCycle
            DemDebounceAlgorithmClass
              DemDebounceCounterBased:
                DemDebounceCounterDecrementStepSize = 1
                DemDebounceCounterIncrementStepSize = 1
                DemDebounceCounterJumpDown = false
                DemDebounceCounterJumpUp = true
                DemDebounceBehavior = DEM_DEBOUNCE_FREEZE
                DemDebounceCounterFailedThreshold = 127
                DemDebounceCounterJumpDownValue = 0
                DemDebounceCounterJumpUpValue = 0
                DemDebounceCounterPassedThreshold = -128
                DemDebounceCounterStorage = false
                DemDebounceContinuous = false
            IndicatorAttribute_WarningIndicator (DemIndicatorAttribute):
              DemIndicatorFailureCycleSource = DEM_FAILURE_CYCLE_EVENT
              DemIndicatorBehaviour = DEM_INDICATOR_CONTINUOUS
              DemIndicatorHealingCycleCounterThreshold = 3
              DemIndicatorHealingCycleRef = PowerCycle
              DemIndicatorRef = WarningIndicator
        DTC_0x111352: DemEventId=30, DemDTCClassRef=DTCClass_DTC_0x111352
          DemEventClass:
            DemAgingAllowed = true
            DemAgingCycleCounterThreshold = 40
            DemEventDestination = DEM_DTC_ORIGIN_PRIMARY_MEMORY
            DemEventPriority = 1
            DemEventSignificance = DEM_EVENT_SIGNIFICANCE_FAULT
            DemEventFailureCycleCounterThreshold = 0
            DemConsiderPtoStatus = false
            DemFFPrestorageSupported = false
            DemAgingCycleRef = PowerCycle
            DemEnableConditionGroupRef = EnableConditionGroup_bbe52cb7
            DemOperationCycleRef = PowerCycle
            DemDebounceAlgorithmClass
              DemDebounceCounterBased:
                DemDebounceCounterDecrementStepSize = 1
                DemDebounceCounterIncrementStepSize = 1
                DemDebounceCounterJumpDown = false
                DemDebounceCounterJumpUp = true
                DemDebounceBehavior = DEM_DEBOUNCE_FREEZE
                DemDebounceCounterFailedThreshold = 127
                DemDebounceCounterJumpDownValue = 0
                DemDebounceCounterJumpUpValue = 0
                DemDebounceCounterPassedThreshold = -128
                DemDebounceCounterStorage = false
                DemDebounceContinuous = false
            IndicatorAttribute_WarningIndicator (DemIndicatorAttribute):
              DemIndicatorFailureCycleSource = DEM_FAILURE_CYCLE_EVENT
              DemIndicatorBehaviour = DEM_INDICATOR_CONTINUOUS
              DemIndicatorHealingCycleCounterThreshold = 3
              DemIndicatorHealingCycleRef = PowerCycle
              DemIndicatorRef = WarningIndicator
        DTC_0x908116: DemEventId=77, DemDTCClassRef=DTCClass_DTC_0x908116
          DemEventClass:
            DemAgingAllowed = true
            DemAgingCycleCounterThreshold = 40
            DemEventDestination = DEM_DTC_ORIGIN_PRIMARY_MEMORY
            DemEventPriority = 1
            DemEventSignificance = DEM_EVENT_SIGNIFICANCE_FAULT
            DemEventFailureCycleCounterThreshold = 0
            DemConsiderPtoStatus = false
            DemFFPrestorageSupported = false
            DemAgingCycleRef = PowerCycle
            DemEnableConditionGroupRef = EnableConditionGroup_93df7d19
            DemOperationCycleRef = PowerCycle
            DemDebounceAlgorithmClass
              DemDebounceCounterBased:
                DemDebounceCounterDecrementStepSize = 1
                DemDebounceCounterIncrementStepSize = 1
                DemDebounceCounterJumpDown = false
                DemDebounceCounterJumpUp = true
                DemDebounceBehavior = DEM_DEBOUNCE_FREEZE
                DemDebounceCounterFailedThreshold = 127
                DemDebounceCounterJumpDownValue = 0
                DemDebounceCounterJumpUpValue = 0
                DemDebounceCounterPassedThreshold = -128
                DemDebounceCounterStorage = false
                DemDebounceContinuous = false
            IndicatorAttribute_WarningIndicator (DemIndicatorAttribute):
              DemIndicatorFailureCycleSource = DEM_FAILURE_CYCLE_EVENT
              DemIndicatorBehaviour = DEM_INDICATOR_CONTINUOUS
              DemIndicatorHealingCycleCounterThreshold = 3
              DemIndicatorHealingCycleRef = PowerCycle
              DemIndicatorRef = WarningIndicator
      DTCClass_DTC_0x117d08 (DemDTCClass): DemDTCSeverity=DEM_DTC_SEV_NO_SEVERITY, DemUdsDTC=1146120, DemImmediateNvStorage=false
      DTC_0x113897 (DemEventParameter):
        DemEventKind = DEM_EVENT_KIND_SWC
        DemEventTimeSeries = DEM_TIMESERIES_SNAPSHOT_NONE
        DemEventAvailable = true
        DemEventId = 38
        DemEventAvailableInVariant = true
        DemEventLatchTestFailed = false
        DemEventCreateInfoPort = true
        DemDTCClassRef = DTCClass_DTC_0x113897
        DemExtendedDataClassRef = ExtendedDataClass_83dcefb7
        DemFreezeFrameClassRef = FreezeFrameClass_5f5b5001
        DemFreezeFrameRecNumClassRef = FreezeFrameRecNumClass_f98c8aa7
        DemEventClass:
          DemAgingAllowed = true
          DemAgingCycleCounterThreshold = 40
          DemEventDestination = DEM_DTC_ORIGIN_PRIMARY_MEMORY
          DemEventPriority = 1
          DemEventSignificance = DEM_EVENT_SIGNIFICANCE_FAULT
          DemEventFailureCycleCounterThreshold = 0
          DemConsiderPtoStatus = false
          DemFFPrestorageSupported = false
          DemAgingCycleRef = PowerCycle
          DemEnableConditionGroupRef = EnableConditionGroup_983000c1
          DemOperationCycleRef = PowerCycle
          DemDebounceAlgorithmClass
            DemDebounceCounterBased:
              DemDebounceCounterDecrementStepSize = 1
              DemDebounceCounterIncrementStepSize = 1
              DemDebounceCounterJumpDown = false
              DemDebounceCounterJumpUp = true
              DemDebounceBehavior = DEM_DEBOUNCE_FREEZE
              DemDebounceCounterFailedThreshold = 127
              DemDebounceCounterJumpDownValue = 0
              DemDebounceCounterJumpUpValue = 0
              DemDebounceCounterPassedThreshold = -128
              DemDebounceCounterStorage = false
              DemDebounceContinuous = false
          IndicatorAttribute_WarningIndicator (DemIndicatorAttribute):
            DemIndicatorFailureCycleSource = DEM_FAILURE_CYCLE_EVENT
            DemIndicatorBehaviour = DEM_INDICATOR_CONTINUOUS
            DemIndicatorHealingCycleCounterThreshold = 3
            DemIndicatorHealingCycleRef = PowerCycle
            DemIndicatorRef = WarningIndicator
      DTCClass_DTC_0x117305 (DemDTCClass): DemDTCSeverity=DEM_DTC_SEV_NO_SEVERITY, DemUdsDTC=1143557, DemImmediateNvStorage=false
      DTC_0x115392 (DemEventParameter):
        DemEventKind = DEM_EVENT_KIND_SWC
        DemEventTimeSeries = DEM_TIMESERIES_SNAPSHOT_NONE
        DemEventAvailable = true
        DemEventId = 53
        DemEventAvailableInVariant = true
        DemEventLatchTestFailed = false
        DemEventCreateInfoPort = true
        DemDTCClassRef = DTCClass_DTC_0x115392
        DemExtendedDataClassRef = ExtendedDataClass_83dcefb7
        DemFreezeFrameClassRef = FreezeFrameClass_5f5b5001
        DemFreezeFrameRecNumClassRef = FreezeFrameRecNumClass_f98c8aa7
        DemEventClass:
          DemAgingAllowed = true
          DemAgingCycleCounterThreshold = 40
          DemEventDestination = DEM_DTC_ORIGIN_PRIMARY_MEMORY
          DemEventPriority = 2
          DemEventSignificance = DEM_EVENT_SIGNIFICANCE_FAULT
          DemEventFailureCycleCounterThreshold = 0
          DemConsiderPtoStatus = false
          DemFFPrestorageSupported = false
          DemAgingCycleRef = PowerCycle
          DemEnableConditionGroupRef = EnableConditionGroup_fdfec498
          DemOperationCycleRef = PowerCycle
          DemDebounceAlgorithmClass
            DemDebounceCounterBased:
              DemDebounceCounterDecrementStepSize = 1
              DemDebounceCounterIncrementStepSize = 1
              DemDebounceCounterJumpDown = false
              DemDebounceCounterJumpUp = true
              DemDebounceBehavior = DEM_DEBOUNCE_FREEZE
              DemDebounceCounterFailedThreshold = 127
              DemDebounceCounterJumpDownValue = 0
              DemDebounceCounterJumpUpValue = 0
              DemDebounceCounterPassedThreshold = -128
              DemDebounceCounterStorage = false
              DemDebounceContinuous = false
          IndicatorAttribute_WarningIndicator (DemIndicatorAttribute):
            DemIndicatorFailureCycleSource = DEM_FAILURE_CYCLE_EVENT
            DemIndicatorBehaviour = DEM_INDICATOR_CONTINUOUS
            DemIndicatorHealingCycleCounterThreshold = 3
            DemIndicatorHealingCycleRef = PowerCycle
            DemIndicatorRef = WarningIndicator
      DTCClass_DTC_0x110112 (DemDTCClass): DemDTCSeverity=DEM_DTC_SEV_NO_SEVERITY, DemUdsDTC=1114386, DemImmediateNvStorage=false
      DTCClass_DTC_0x114397 (DemDTCClass): DemDTCSeverity=DEM_DTC_SEV_NO_SEVERITY, DemUdsDTC=1131415, DemImmediateNvStorage=false
      5 x DemEventParameter, all with DemEventKind=DEM_EVENT_KIND_SWC, DemEventTimeSeries=DEM_TIMESERIES_SNAPSHOT_NONE, DemEventAvailable=true, DemEventAvailableInVariant=true, DemEventLatchTestFailed=false, DemEventCreateInfoPort=true, DemExtendedDataClassRef=ExtendedDataClass_83dcefb7, DemFreezeFrameRecNumClassRef=FreezeFrameRecNumClass_f98c8aa7:
        DTC_0x111e71: DemEventId=1, DemDTCClassRef=DTCClass_DTC_0x111e71, DemFreezeFrameClassRef=FreezeFrameClass_376d31f7
          DemEventClass:
            DemAgingAllowed = true
            DemAgingCycleCounterThreshold = 40
            DemEventDestination = DEM_DTC_ORIGIN_PRIMARY_MEMORY
            DemEventPriority = 2
            DemEventSignificance = DEM_EVENT_SIGNIFICANCE_FAULT
            DemEventFailureCycleCounterThreshold = 0
            DemConsiderPtoStatus = false
            DemFFPrestorageSupported = false
            DemAgingCycleRef = PowerCycle
            DemEnableConditionGroupRef = EnableConditionGroup_fdfec498
            DemOperationCycleRef = PowerCycle
            DemDebounceAlgorithmClass
              DemDebounceCounterBased:
                DemDebounceCounterDecrementStepSize = 1
                DemDebounceCounterIncrementStepSize = 1
                DemDebounceCounterJumpDown = false
                DemDebounceCounterJumpUp = true
                DemDebounceBehavior = DEM_DEBOUNCE_FREEZE
                DemDebounceCounterFailedThreshold = 127
                DemDebounceCounterJumpDownValue = 0
                DemDebounceCounterJumpUpValue = 0
                DemDebounceCounterPassedThreshold = -128
                DemDebounceCounterStorage = false
                DemDebounceContinuous = false
            IndicatorAttribute_WarningIndicator (DemIndicatorAttribute):
              DemIndicatorFailureCycleSource = DEM_FAILURE_CYCLE_EVENT
              DemIndicatorBehaviour = DEM_INDICATOR_CONTINUOUS
              DemIndicatorHealingCycleCounterThreshold = 3
              DemIndicatorHealingCycleRef = PowerCycle
              DemIndicatorRef = WarningIndicator
        DTC_0xc10f87: DemEventId=80, DemDTCClassRef=DTCClass_DTC_0xc10f87, DemFreezeFrameClassRef=FreezeFrameClass_5f5b5001
          DemEventClass:
            DemAgingAllowed = true
            DemAgingCycleCounterThreshold = 40
            DemEventDestination = DEM_DTC_ORIGIN_PRIMARY_MEMORY
            DemEventPriority = 2
            DemEventSignificance = DEM_EVENT_SIGNIFICANCE_FAULT
            DemEventFailureCycleCounterThreshold = 0
            DemConsiderPtoStatus = false
            DemFFPrestorageSupported = false
            DemAgingCycleRef = PowerCycle
            DemEnableConditionGroupRef = EnableConditionGroup_f3616881
            DemOperationCycleRef = PowerCycle
            DemDebounceAlgorithmClass
              DemDebounceCounterBased:
                DemDebounceCounterDecrementStepSize = 1
                DemDebounceCounterIncrementStepSize = 1
                DemDebounceCounterJumpDown = false
                DemDebounceCounterJumpUp = true
                DemDebounceBehavior = DEM_DEBOUNCE_FREEZE
                DemDebounceCounterFailedThreshold = 127
                DemDebounceCounterJumpDownValue = 0
                DemDebounceCounterJumpUpValue = 0
                DemDebounceCounterPassedThreshold = -128
                DemDebounceCounterStorage = false
                DemDebounceContinuous = false
            IndicatorAttribute_WarningIndicator (DemIndicatorAttribute):
              DemIndicatorFailureCycleSource = DEM_FAILURE_CYCLE_EVENT
              DemIndicatorBehaviour = DEM_INDICATOR_CONTINUOUS
              DemIndicatorHealingCycleCounterThreshold = 3
              DemIndicatorHealingCycleRef = PowerCycle
              DemIndicatorRef = WarningIndicator
        DTC_0x908255: DemEventId=78, DemDTCClassRef=DTCClass_DTC_0x908255, DemFreezeFrameClassRef=FreezeFrameClass_5f5b5001
          DemEventClass:
            DemAgingAllowed = true
            DemAgingCycleCounterThreshold = 40
            DemEventDestination = DEM_DTC_ORIGIN_PRIMARY_MEMORY
            DemEventPriority = 2
            DemEventSignificance = DEM_EVENT_SIGNIFICANCE_FAULT
            DemEventFailureCycleCounterThreshold = 0
            DemConsiderPtoStatus = false
            DemFFPrestorageSupported = false
            DemAgingCycleRef = PowerCycle
            DemEnableConditionGroupRef = EnableConditionGroup_fb7bc2c5
            DemOperationCycleRef = PowerCycle
            DemDebounceAlgorithmClass
              DemDebounceCounterBased:
                DemDebounceCounterDecrementStepSize = 1
                DemDebounceCounterIncrementStepSize = 1
                DemDebounceCounterJumpDown = false
                DemDebounceCounterJumpUp = true
                DemDebounceBehavior = DEM_DEBOUNCE_FREEZE
                DemDebounceCounterFailedThreshold = 127
                DemDebounceCounterJumpDownValue = 0
                DemDebounceCounterJumpUpValue = 0
                DemDebounceCounterPassedThreshold = -128
                DemDebounceCounterStorage = false
                DemDebounceContinuous = false
            IndicatorAttribute_WarningIndicator (DemIndicatorAttribute):
              DemIndicatorFailureCycleSource = DEM_FAILURE_CYCLE_EVENT
              DemIndicatorBehaviour = DEM_INDICATOR_CONTINUOUS
              DemIndicatorHealingCycleCounterThreshold = 3
              DemIndicatorHealingCycleRef = PowerCycle
              DemIndicatorRef = WarningIndicator
        DTC_0x117e52: DemEventId=16, DemDTCClassRef=DTCClass_DTC_0x117e52, DemFreezeFrameClassRef=FreezeFrameClass_5f5b5001
          DemEventClass:
            DemAgingAllowed = true
            DemAgingCycleCounterThreshold = 40
            DemEventDestination = DEM_DTC_ORIGIN_PRIMARY_MEMORY
            DemEventPriority = 2
            DemEventSignificance = DEM_EVENT_SIGNIFICANCE_FAULT
            DemEventFailureCycleCounterThreshold = 0
            DemConsiderPtoStatus = false
            DemFFPrestorageSupported = false
            DemAgingCycleRef = PowerCycle
            DemEnableConditionGroupRef = EnableConditionGroup_fd8a9b69
            DemOperationCycleRef = PowerCycle
            DemDebounceAlgorithmClass
              DemDebounceCounterBased:
                DemDebounceCounterDecrementStepSize = 1
                DemDebounceCounterIncrementStepSize = 1
                DemDebounceCounterJumpDown = false
                DemDebounceCounterJumpUp = true
                DemDebounceBehavior = DEM_DEBOUNCE_FREEZE
                DemDebounceCounterFailedThreshold = 127
                DemDebounceCounterJumpDownValue = 0
                DemDebounceCounterJumpUpValue = 0
                DemDebounceCounterPassedThreshold = -128
                DemDebounceCounterStorage = false
                DemDebounceContinuous = false
            IndicatorAttribute_WarningIndicator (DemIndicatorAttribute):
              DemIndicatorFailureCycleSource = DEM_FAILURE_CYCLE_EVENT
              DemIndicatorBehaviour = DEM_INDICATOR_CONTINUOUS
              DemIndicatorHealingCycleCounterThreshold = 3
              DemIndicatorHealingCycleRef = PowerCycle
              DemIndicatorRef = WarningIndicator
        DTC_0x117205: DemEventId=69, DemDTCClassRef=DTCClass_DTC_0x117205, DemFreezeFrameClassRef=FreezeFrameClass_5f5b5001
          DemEventClass:
            DemAgingAllowed = true
            DemAgingCycleCounterThreshold = 40
            DemEventDestination = DEM_DTC_ORIGIN_PRIMARY_MEMORY
            DemEventPriority = 1
            DemEventSignificance = DEM_EVENT_SIGNIFICANCE_FAULT
            DemEventFailureCycleCounterThreshold = 0
            DemConsiderPtoStatus = false
            DemFFPrestorageSupported = false
            DemAgingCycleRef = PowerCycle
            DemOperationCycleRef = PowerCycle
            DemDebounceAlgorithmClass
              DemDebounceCounterBased:
                DemDebounceCounterDecrementStepSize = 1
                DemDebounceCounterIncrementStepSize = 1
                DemDebounceCounterJumpDown = false
                DemDebounceCounterJumpUp = true
                DemDebounceBehavior = DEM_DEBOUNCE_FREEZE
                DemDebounceCounterFailedThreshold = 127
                DemDebounceCounterJumpDownValue = 0
                DemDebounceCounterJumpUpValue = 0
                DemDebounceCounterPassedThreshold = -128
                DemDebounceCounterStorage = false
                DemDebounceContinuous = false
            IndicatorAttribute_WarningIndicator (DemIndicatorAttribute):
              DemIndicatorFailureCycleSource = DEM_FAILURE_CYCLE_EVENT
              DemIndicatorBehaviour = DEM_INDICATOR_CONTINUOUS
              DemIndicatorHealingCycleCounterThreshold = 3
              DemIndicatorHealingCycleRef = PowerCycle
              DemIndicatorRef = WarningIndicator
      3 x DemDTCClass, all with DemDTCSeverity=DEM_DTC_SEV_NO_SEVERITY, DemImmediateNvStorage=false:
        DTCClass_DTC_0xd11b87: DemUdsDTC=13704071
        DTCClass_DTC_0x117097: DemUdsDTC=1142935
        DTCClass_DTC_0x115592: DemUdsDTC=1136018
      DTC_0x110012 (DemEventParameter):
        DemEventKind = DEM_EVENT_KIND_SWC
        DemEventTimeSeries = DEM_TIMESERIES_SNAPSHOT_NONE
        DemEventAvailable = true
        DemEventId = 24
        DemEventAvailableInVariant = true
        DemEventLatchTestFailed = false
        DemEventCreateInfoPort = true
        DemDTCClassRef = DTCClass_DTC_0x110012
        DemExtendedDataClassRef = ExtendedDataClass_83dcefb7
        DemFreezeFrameClassRef = FreezeFrameClass_5f5b5001
        DemFreezeFrameRecNumClassRef = FreezeFrameRecNumClass_f98c8aa7
        DemEventClass:
          DemAgingAllowed = true
          DemAgingCycleCounterThreshold = 40
          DemEventDestination = DEM_DTC_ORIGIN_PRIMARY_MEMORY
          DemEventPriority = 1
          DemEventSignificance = DEM_EVENT_SIGNIFICANCE_FAULT
          DemEventFailureCycleCounterThreshold = 0
          DemConsiderPtoStatus = false
          DemFFPrestorageSupported = false
          DemAgingCycleRef = PowerCycle
          DemEnableConditionGroupRef = EnableConditionGroup_bbe52cb7
          DemOperationCycleRef = PowerCycle
          DemDebounceAlgorithmClass
            DemDebounceCounterBased:
              DemDebounceCounterDecrementStepSize = 1
              DemDebounceCounterIncrementStepSize = 1
              DemDebounceCounterJumpDown = false
              DemDebounceCounterJumpUp = true
              DemDebounceBehavior = DEM_DEBOUNCE_FREEZE
              DemDebounceCounterFailedThreshold = 127
              DemDebounceCounterJumpDownValue = 0
              DemDebounceCounterJumpUpValue = 0
              DemDebounceCounterPassedThreshold = -128
              DemDebounceCounterStorage = false
              DemDebounceContinuous = false
          IndicatorAttribute_WarningIndicator (DemIndicatorAttribute):
            DemIndicatorFailureCycleSource = DEM_FAILURE_CYCLE_EVENT
            DemIndicatorBehaviour = DEM_INDICATOR_CONTINUOUS
            DemIndicatorHealingCycleCounterThreshold = 3
            DemIndicatorHealingCycleRef = PowerCycle
            DemIndicatorRef = WarningIndicator
      DTC_0xc16687 (DemEventParameter):
        DemEventKind = DEM_EVENT_KIND_SWC
        DemEventTimeSeries = DEM_TIMESERIES_SNAPSHOT_NONE
        DemEventAvailable = true
        DemEventId = 95
        DemEventAvailableInVariant = true
        DemEventLatchTestFailed = false
        DemEventCreateInfoPort = true
        DemDTCClassRef = DTCClass_DTC_0xc16687
        DemExtendedDataClassRef = ExtendedDataClass_83dcefb7
        DemFreezeFrameClassRef = FreezeFrameClass_5f5b5001
        DemFreezeFrameRecNumClassRef = FreezeFrameRecNumClass_f98c8aa7
        DemEventClass:
          DemAgingAllowed = true
          DemAgingCycleCounterThreshold = 40
          DemEventDestination = DEM_DTC_ORIGIN_PRIMARY_MEMORY
          DemEventPriority = 1
          DemEventSignificance = DEM_EVENT_SIGNIFICANCE_FAULT
          DemEventFailureCycleCounterThreshold = 0
          DemConsiderPtoStatus = false
          DemFFPrestorageSupported = false
          DemAgingCycleRef = PowerCycle
          DemEnableConditionGroupRef = EnableConditionGroup_f3616881
          DemOperationCycleRef = PowerCycle
          DemDebounceAlgorithmClass
            DemDebounceCounterBased:
              DemDebounceCounterDecrementStepSize = 1
              DemDebounceCounterIncrementStepSize = 1
              DemDebounceCounterJumpDown = false
              DemDebounceCounterJumpUp = true
              DemDebounceBehavior = DEM_DEBOUNCE_FREEZE
              DemDebounceCounterFailedThreshold = 127
              DemDebounceCounterJumpDownValue = 0
              DemDebounceCounterJumpUpValue = 0
              DemDebounceCounterPassedThreshold = -128
              DemDebounceCounterStorage = false
              DemDebounceContinuous = false
          IndicatorAttribute_WarningIndicator (DemIndicatorAttribute):
            DemIndicatorFailureCycleSource = DEM_FAILURE_CYCLE_EVENT
            DemIndicatorBehaviour = DEM_INDICATOR_CONTINUOUS
            DemIndicatorHealingCycleCounterThreshold = 3
            DemIndicatorHealingCycleRef = PowerCycle
            DemIndicatorRef = WarningIndicator
      DTCClass_DTC_0xc11087 (DemDTCClass): DemDTCSeverity=DEM_DTC_SEV_NO_SEVERITY, DemUdsDTC=12652679, DemImmediateNvStorage=false
      DTCClass_DTC_0x115d4b (DemDTCClass): DemDTCSeverity=DEM_DTC_SEV_NO_SEVERITY, DemUdsDTC=1137995, DemImmediateNvStorage=false
      DTC_0x114297 (DemEventParameter):
        DemEventKind = DEM_EVENT_KIND_SWC
        DemEventTimeSeries = DEM_TIMESERIES_SNAPSHOT_NONE
        DemEventAvailable = true
        DemEventId = 42
        DemEventAvailableInVariant = true
        DemEventLatchTestFailed = false
        DemEventCreateInfoPort = true
        DemDTCClassRef = DTCClass_DTC_0x114297
        DemExtendedDataClassRef = ExtendedDataClass_83dcefb7
        DemFreezeFrameClassRef = FreezeFrameClass_5f5b5001
        DemFreezeFrameRecNumClassRef = FreezeFrameRecNumClass_f98c8aa7
        DemEventClass:
          DemAgingAllowed = true
          DemAgingCycleCounterThreshold = 40
          DemEventDestination = DEM_DTC_ORIGIN_PRIMARY_MEMORY
          DemEventPriority = 1
          DemEventSignificance = DEM_EVENT_SIGNIFICANCE_FAULT
          DemEventFailureCycleCounterThreshold = 0
          DemConsiderPtoStatus = false
          DemFFPrestorageSupported = false
          DemAgingCycleRef = PowerCycle
          DemEnableConditionGroupRef = EnableConditionGroup_983000c1
          DemOperationCycleRef = PowerCycle
          DemDebounceAlgorithmClass
            DemDebounceCounterBased:
              DemDebounceCounterDecrementStepSize = 1
              DemDebounceCounterIncrementStepSize = 1
              DemDebounceCounterJumpDown = false
              DemDebounceCounterJumpUp = true
              DemDebounceBehavior = DEM_DEBOUNCE_FREEZE
              DemDebounceCounterFailedThreshold = 127
              DemDebounceCounterJumpDownValue = 0
              DemDebounceCounterJumpUpValue = 0
              DemDebounceCounterPassedThreshold = -128
              DemDebounceCounterStorage = false
              DemDebounceContinuous = false
          IndicatorAttribute_WarningIndicator (DemIndicatorAttribute):
            DemIndicatorFailureCycleSource = DEM_FAILURE_CYCLE_EVENT
            DemIndicatorBehaviour = DEM_INDICATOR_CONTINUOUS
            DemIndicatorHealingCycleCounterThreshold = 3
            DemIndicatorHealingCycleRef = PowerCycle
            DemIndicatorRef = WarningIndicator
      DTC_0x116594 (DemEventParameter):
        DemEventKind = DEM_EVENT_KIND_SWC
        DemEventTimeSeries = DEM_TIMESERIES_SNAPSHOT_NONE
        DemEventAvailable = true
        DemEventId = 62
        DemEventAvailableInVariant = true
        DemEventLatchTestFailed = false
        DemEventCreateInfoPort = true
        DemDTCClassRef = DTCClass_DTC_0x116594
        DemExtendedDataClassRef = ExtendedDataClass_83dcefb7
        DemFreezeFrameClassRef = FreezeFrameClass_5f5b5001
        DemFreezeFrameRecNumClassRef = FreezeFrameRecNumClass_f98c8aa7
        DemEventClass:
          DemAgingAllowed = true
          DemAgingCycleCounterThreshold = 40
          DemEventDestination = DEM_DTC_ORIGIN_PRIMARY_MEMORY
          DemEventPriority = 2
          DemEventSignificance = DEM_EVENT_SIGNIFICANCE_FAULT
          DemEventFailureCycleCounterThreshold = 0
          DemConsiderPtoStatus = false
          DemFFPrestorageSupported = false
          DemAgingCycleRef = PowerCycle
          DemEnableConditionGroupRef = EnableConditionGroup_fdfec498
          DemOperationCycleRef = PowerCycle
          DemDebounceAlgorithmClass
            DemDebounceCounterBased:
              DemDebounceCounterDecrementStepSize = 1
              DemDebounceCounterIncrementStepSize = 1
              DemDebounceCounterJumpDown = false
              DemDebounceCounterJumpUp = true
              DemDebounceBehavior = DEM_DEBOUNCE_FREEZE
              DemDebounceCounterFailedThreshold = 127
              DemDebounceCounterJumpDownValue = 0
              DemDebounceCounterJumpUpValue = 0
              DemDebounceCounterPassedThreshold = -128
              DemDebounceCounterStorage = false
              DemDebounceContinuous = false
          IndicatorAttribute_WarningIndicator (DemIndicatorAttribute):
            DemIndicatorFailureCycleSource = DEM_FAILURE_CYCLE_EVENT
            DemIndicatorBehaviour = DEM_INDICATOR_CONTINUOUS
            DemIndicatorHealingCycleCounterThreshold = 3
            DemIndicatorHealingCycleRef = PowerCycle
            DemIndicatorRef = WarningIndicator
      DTCClass_DTC_0x113297 (DemDTCClass): DemDTCSeverity=DEM_DTC_SEV_NO_SEVERITY, DemUdsDTC=1127063, DemImmediateNvStorage=false
    DemGeneral:
      DemAgingCycleCounterProcessing = DEM_PROCESS_AGINGCTR_INTERN
      DemDebounceCounterBasedSupport = true
      DemEnableConditionSupport = true
      DemPTOSupport = false
      DemDtcStatusAvailabilityMask = 9
      DemTypeOfFreezeFrameRecordNumeration = DEM_FF_RECNUM_CONFIGURED
      DemGeneralInterfaceSupport = false
      DemDataElementDefaultEndianness = LITTLE_ENDIAN
      DemAgingRequieresTestedCycle = false
      DemMaxNumberEventEntryMirror = 0
      DemTriggerMonitorInitBeforeClearOk = true
      DemExtendedDataCapture = DEM_TRIGGER_EVENT_MEMORY_STORAGE
      DemFreezeFrameCapture = DEM_TRIGGER_EVENT_MEMORY_STORAGE
      DemOperationCycleProcessing = DEM_PROCESS_OPCYC_STATE
      DemMaxNumberTimeSeriesSnapshots = 0
      DemAvailabilitySupport = DEM_NO_AVAILABILITY
      DemAvailabilityStorage = false
      DemBswErrorBufferSize = 0
      DemClearDTCBehavior = DEM_CLRRESP_VOLATILE
      DemClearDTCLimitation = DEM_ALL_SUPPORTED_DTCS
      DemDebounceTimeBasedSupport = false
      DemDevErrorDetect = true
      DemEventCombinationSupport = DEM_EVCOMB_DISABLED
      DemEventDisplacementStrategy = DEM_DISPLACEMENT_LEGACY_403
      DemEventMemoryEntryStorageTrigger = DEM_STORAGE_ON_TEST_FAILED
      DemMaxNumberEventEntryOBDFreezeFrame = 0
      DemMaxNumberEventEntryPermanent = 0
      DemMaxNumberEventEntryPrimary = 4
      DemMaxNumberEventEntrySecondary = 0
      DemMaxNumberPrestoredFF = 0
      DemOBDSupport = DEM_OBD_NO_OBD_SUPPORT
      DemOccurrenceCounterProcessing = DEM_PROCESS_OCCCTR_TF
      DemOperationCycleStatusStorage = false
      DemResetConfirmedBitOnOverflow = false
      DemStatusBitHandlingTestFailedSinceLastClear = DEM_STATUS_BIT_NORMAL
      DemStatusBitStorageTestFailed = false
      DemStorageConditionSupport = false
      DemSuppressionSupport = DEM_NO_SUPPRESSION
      DemTaskTime = 0.01
      DemTriggerDcmReports = false
      DemTriggerDltReports = false
      DemTriggerFiMReports = false
      DemTriggerFiMReportsExtended = false
      DemTriggerMonitorInitForEnableConditions = false
      DemTypeOfDTCSupported = DEM_DTC_TRANSLATION_ISO14229_1
      DemVersionInfoApi = false
      DemBswApiVersion = DEM_BSW_API_4_XX_XX
      DemBswApiVersionNvM = DEM_BSW_API_4_XX_XX
      DemBswApiVersionFiM = DEM_BSW_API_4_XX_XX
      DemAgingAfterHealing = DEM_AGING_WHILE_HEALING
      DemAgingBehavior = DEM_AGING_TYPE_1
      DemAgingCounterBehavior = DEM_AGING_COUNT_ALWAYS
      DemAgingCounterReporting = DEM_AGING_NORMAL_REPORTING
      DemAgingRetainEnvironmentalData = false
      DemCompiledPostbuildCrc = 2475946348
      DemCompiledPostbuildCrcMode = DEM_POSTBUILD_CRC_AUTOMATIC
      DemEventDisplacementFallbackStrategy = DEM_FALLBACK_DISCARD_NEW_EVENT
      DemGeneralDiagnosticInfoSupport = true
      DemJ1939Support = false
      DemNvSynchronizeSupport = false
      DemPendingDtcProcessing = DEM_PROCESS_PDTC_ALL_DTC
      DemResetDebounceBehavior = DEM_RESET_DEBOUNCE_ON_DISABLE_ENABLE_CONDITIONS
      DemResetTestFailedOnOperationCycleStart = true
      DemRetryStorageSupport = false
      DemSafeBswChecks = false
      DemUseMemcopyMacros = false
      DemUseRte = true
      DemUserControlledWirBehavior = DEM_ENABLED_DURING_CONTROLDTCSETTING
      DemUserDefinedCompareAndSwap = false
      DemWarningIndicatorRequestedProcessing = DEM_PROCESS_WIR_STOREDONLY
      DemUseMultiPartitionFiM = false
      DemReportSuppressedDTCsInService19x0A = false
      DemSupportAgingForAllDTCs = false
      DemLatchTestFailedBehavior = DEM_LATCH_TF_CONFIRMED_AND_THIS_CYCLE
      DemUseNvm = true
      DemImmediateNvStorageSupport = true
      DemImmediateNvStorageLimit = 255
      WarningIndicator (DemIndicator): DemIndicatorID=0
      DemPostbuild: DemEventAvailableDefaultSupport=true, DemMaxSizeFreezeFrame=26, DemMaxNumberDtr=0, DemMaxSizeGlobalFreezeFrame=0, DemMaxSizeOBDonUDSFreezeFrame=0
      PowerCycle (DemOperationCycle): DemOperationCycleType=DEM_OPCYC_POWER, DemOperationCycleAutomaticEnd=false, DemOperationCycleAutostart=false
      DemEventMemorySet
      DemClient: DemClientId=0
      6 x DemNvRamBlockId:
        DemNvRamBlockId_AdminData: DemNvRamBlockIdType=DEM_NVBLOCK_ADMIN, DemNvRamBlockIdRef=NvM_DEM_AdminData
        DemNvRamBlockId_DEM_PrimaryEntry_0: DemNvRamBlockIdType=DEM_NVBLOCK_PRIMARY, DemNvRamBlockIdIndex=0, DemNvRamBlockIdRef=NvM_DEM_PrimaryEntry_0
        DemNvRamBlockId_DEM_PrimaryEntry_1: DemNvRamBlockIdType=DEM_NVBLOCK_PRIMARY, DemNvRamBlockIdIndex=1, DemNvRamBlockIdRef=NvM_DEM_PrimaryEntry_1
        DemNvRamBlockId_DEM_StatusData: DemNvRamBlockIdType=DEM_NVBLOCK_STATUS, DemNvRamBlockIdRef=NvM_DEM_StatusData
        DemNvRamBlockId_DEM_PrimaryEntry_2: DemNvRamBlockIdType=DEM_NVBLOCK_PRIMARY, DemNvRamBlockIdIndex=2, DemNvRamBlockIdRef=NvM_DEM_PrimaryEntry_2
        DemNvRamBlockId_DEM_PrimaryEntry_3: DemNvRamBlockIdType=DEM_NVBLOCK_PRIMARY, DemNvRamBlockIdIndex=3, DemNvRamBlockIdRef=NvM_DEM_PrimaryEntry_3
      4 x DemEnableCondition, all with DemEnableConditionStatus=true:
        Being_001: DemEnableConditionId=2
        being: DemEnableConditionId=31
        performed: DemEnableConditionId=58
        Reset_001: DemEnableConditionId=16
      DID_0xf1a5_VCU_HVStatus (DemDataClass): DemDataElementDataSize=1, DemDataElementDataType=UINT8, DemDataElementUsePort=USE_DATA_CLIENT_SERVER_PORT, DemDataElementStoreNonVolatile=true
      of (DemEnableCondition): DemEnableConditionId=56, DemEnableConditionStatus=true
      Note (DemEnableCondition): DemEnableConditionId=14, DemEnableConditionStatus=true
      VCU_control_main_relay (DemDidClass): DemDidIdentifier=7441, DemDidDataClassRef=DID_0x1d11_Mainrealy1, DemDidDataClassRef=DID_0x1d11_Mainrelay2
      FreezeFrameClass_a7d22c66 (DemFreezeFrameClass):
        DemDidClassRef = Vehicle_State
        DemDidClassRef = Battery_Voltage
        DemDidClassRef = Total_Odometer
        DemDidClassRef = Vehicle_speed
        DemDidClassRef = Date_And_Time
        DemDidClassRef = VCU_HVStatus
        DemDidClassRef = SOC
        DemDidClassRef = Gear
        DemDidClassRef = VCU_HV_InterLock_PWM_pfrequency
      DID_0xf1a7_Gear (DemDataClass): DemDataElementDataSize=1, DemDataElementDataType=UINT8, DemDataElementUsePort=USE_DATA_CLIENT_SERVER_PORT, DemDataElementStoreNonVolatile=true
      ExtendedData_Fault_Aging_Counter (DemDataClass): DemDataElementDataSize=1, DemDataElementDataType=UINT8, DemDataElementUsePort=USE_DATA_CLIENT_SERVER_PORT, DemDataElementStoreNonVolatile=true
      No (DemEnableCondition): DemEnableConditionId=13, DemEnableConditionStatus=true
      DID_0xf1a1_Battery_Voltage (DemDataClass):
        DemDataElementDataSize = 2
        DemDataElementDataType = UINT16
        DemDataElementEndianness = BIG_ENDIAN
        DemDataElementUsePort = USE_DATA_CLIENT_SERVER_PORT
        DemDataElementStoreNonVolatile = true
      Battery_Voltage (DemDidClass): DemDidIdentifier=61857, DemDidDataClassRef=DID_0xf1a1_Battery_Voltage
      Vehicle_State (DemDidClass): DemDidIdentifier=61856, DemDidDataClassRef=DID_0xf1a0_Ignition_Switch_Signal
      DID_0xf1a4_Date_And_Time_Hour (DemDataClass): DemDataElementDataSize=1, DemDataElementDataType=UINT8, DemDataElementUsePort=USE_DATA_CLIENT_SERVER_PORT, DemDataElementStoreNonVolatile=true
      FreezeFrameRecNumClass_f98c8aa7 (DemFreezeFrameRecNumClass):
        DemFreezeFrameRecordNumber = 1
        DemFreezeFrameRecordTrigger = DEM_RECORD_TRIGGER_TESTFAILED
        DemFreezeFrameRecordUpdate = DEM_UPDATE_RECORD_YES
        DemFreezeFrameRecordNumber = 2
        DemFreezeFrameRecordTrigger = DEM_RECORD_TRIGGER_TESTFAILED
        DemFreezeFrameRecordUpdate = DEM_UPDATE_RECORD_YES
      3 x DemEnableCondition, all with DemEnableConditionStatus=true:
        service: DemEnableConditionId=63
        conditions: DemEnableConditionId=36
        or: DemEnableConditionId=57
      Vehicle_speed (DemDidClass): DemDidIdentifier=61859, DemDidDataClassRef=DID_0xf1a3_Vehicle_speed
      Enable_001 (DemEnableCondition): DemEnableConditionId=10, DemEnableConditionStatus=true
      completed (DemEnableCondition): DemEnableConditionId=34, DemEnableConditionStatus=true
      No_known_corrective_action (DemOperationCycle): DemOperationCycleType=DEM_OPCYC_OTHER, DemOperationCycleAutomaticEnd=false, DemOperationCycleAutostart=false
      DID_0xf1a4_Date_And_Time_Day (DemDataClass): DemDataElementDataSize=1, DemDataElementDataType=UINT8, DemDataElementUsePort=USE_DATA_CLIENT_SERVER_PORT, DemDataElementStoreNonVolatile=true
      3 x DemEnableCondition, all with DemEnableConditionStatus=true:
        if_001: DemEnableConditionId=47
        bussoff: DemEnableConditionId=33
        In_001: DemEnableConditionId=12
      EnableConditionGroup_4ffb066f (DemEnableConditionGroup):
        DemEnableConditionRef = All_001
        DemEnableConditionRef = Conditions_001
        DemEnableConditionRef = Conditions_001
        DemEnableConditionRef = Confirmed
        DemEnableConditionRef = Confirmed
        DemEnableConditionRef = DTC
        DemEnableConditionRef = DTC
        DemEnableConditionRef = Enable_001
        DemEnableConditionRef = Enable_001
        DemEnableConditionRef = If
        DemEnableConditionRef = In_001
        DemEnableConditionRef = No
        DemEnableConditionRef = Note
        DemEnableConditionRef = Reset_001
        DemEnableConditionRef = T_Delay
        DemEnableConditionRef = T_Delay
        DemEnableConditionRef = T_Delay
        DemEnableConditionRef = The
        DemEnableConditionRef = V
        DemEnableConditionRef = V
        DemEnableConditionRef = VCU
        DemEnableConditionRef = active
        DemEnableConditionRef = again
        DemEnableConditionRef = again
        DemEnableConditionRef = and
        DemEnableConditionRef = and
        DemEnableConditionRef = and
        DemEnableConditionRef = any
        DemEnableConditionRef = any
        DemEnableConditionRef = are
        DemEnableConditionRef = battery
        DemEnableConditionRef = condition
        DemEnableConditionRef = conditions
        DemEnableConditionRef = criteria
        DemEnableConditionRef = criteria
        DemEnableConditionRef = do
        DemEnableConditionRef = does
        DemEnableConditionRef = fault
        DemEnableConditionRef = following
        DemEnableConditionRef = for
        DemEnableConditionRef = if_001
        DemEnableConditionRef = in
        DemEnableConditionRef = in
        DemEnableConditionRef = in
        DemEnableConditionRef = is
        DemEnableConditionRef = is
        DemEnableConditionRef = last
        DemEnableConditionRef = meet
        DemEnableConditionRef = meet
        DemEnableConditionRef = met
        DemEnableConditionRef = ms
        DemEnableConditionRef = normal
        DemEnableConditionRef = not
        DemEnableConditionRef = not
        DemEnableConditionRef = of
        DemEnableConditionRef = of
        DemEnableConditionRef = or
        DemEnableConditionRef = process
        DemEnableConditionRef = recovered
        DemEnableConditionRef = requirements
        DemEnableConditionRef = requirements
        DemEnableConditionRef = reset
        DemEnableConditionRef = service
        DemEnableConditionRef = simultaneously
        DemEnableConditionRef = start
        DemEnableConditionRef = start
        DemEnableConditionRef = status
        DemEnableConditionRef = the_001
        DemEnableConditionRef = the_001
        DemEnableConditionRef = the_001
        DemEnableConditionRef = the_001
        DemEnableConditionRef = the_001
        DemEnableConditionRef = the_001
        DemEnableConditionRef = the_001
        DemEnableConditionRef = the_001
        DemEnableConditionRef = timer
        DemEnableConditionRef = timing
        DemEnableConditionRef = timing
        DemEnableConditionRef = to
        DemEnableConditionRef = to
        DemEnableConditionRef = to
        DemEnableConditionRef = up
        DemEnableConditionRef = voltage
        DemEnableConditionRef = wake
      Conditions_001 (DemEnableCondition): DemEnableConditionId=6, DemEnableConditionStatus=true
      DID_0xf1a4_Date_And_Time_Minute (DemDataClass): DemDataElementDataSize=1, DemDataElementDataType=UINT8, DemDataElementUsePort=USE_DATA_CLIENT_SERVER_PORT, DemDataElementStoreNonVolatile=true
      EnableConditionGroup_fdfec498 (DemEnableConditionGroup):
        DemEnableConditionRef = Busoff
        DemEnableConditionRef = CAN
        DemEnableConditionRef = If
        DemEnableConditionRef = No
        DemEnableConditionRef = No
        DemEnableConditionRef = Note
        DemEnableConditionRef = PT
        DemEnableConditionRef = The
        DemEnableConditionRef = V
        DemEnableConditionRef = V
        DemEnableConditionRef = When
        DemEnableConditionRef = active
        DemEnableConditionRef = after
        DemEnableConditionRef = again
        DemEnableConditionRef = all
        DemEnableConditionRef = any
        DemEnableConditionRef = are
        DemEnableConditionRef = battery
        DemEnableConditionRef = be
        DemEnableConditionRef = being
        DemEnableConditionRef = completed
        DemEnableConditionRef = conditions
        DemEnableConditionRef = conditions
        DemEnableConditionRef = conditions
        DemEnableConditionRef = confirmation
        DemEnableConditionRef = diagnosis
        DemEnableConditionRef = diagnosis
        DemEnableConditionRef = during
        DemEnableConditionRef = enable
        DemEnableConditionRef = fault
        DemEnableConditionRef = fault
        DemEnableConditionRef = fault
        DemEnableConditionRef = is
        DemEnableConditionRef = is
        DemEnableConditionRef = is
        DemEnableConditionRef = met
        DemEnableConditionRef = met
        DemEnableConditionRef = ms
        DemEnableConditionRef = normal
        DemEnableConditionRef = not
        DemEnableConditionRef = of
        DemEnableConditionRef = or
        DemEnableConditionRef = performed
        DemEnableConditionRef = process
        DemEnableConditionRef = service
        DemEnableConditionRef = shall
        DemEnableConditionRef = status
        DemEnableConditionRef = the_001
        DemEnableConditionRef = the_001
        DemEnableConditionRef = the_001
        DemEnableConditionRef = the_001
        DemEnableConditionRef = the_001
        DemEnableConditionRef = to
        DemEnableConditionRef = trigger
        DemEnableConditionRef = up
        DemEnableConditionRef = voltage
        DemEnableConditionRef = waked
      EnableConditionGroup_fb7bc2c5 (DemEnableConditionGroup):
        DemEnableConditionRef = If
        DemEnableConditionRef = No
        DemEnableConditionRef = Note
        DemEnableConditionRef = The
        DemEnableConditionRef = V
        DemEnableConditionRef = V
        DemEnableConditionRef = When
        DemEnableConditionRef = active
        DemEnableConditionRef = after
        DemEnableConditionRef = again
        DemEnableConditionRef = all
        DemEnableConditionRef = any
        DemEnableConditionRef = are
        DemEnableConditionRef = battery
        DemEnableConditionRef = be
        DemEnableConditionRef = being
        DemEnableConditionRef = completed
        DemEnableConditionRef = conditions
        DemEnableConditionRef = conditions
        DemEnableConditionRef = conditions
        DemEnableConditionRef = confirmation
        DemEnableConditionRef = diagnosis
        DemEnableConditionRef = diagnosis
        DemEnableConditionRef = during
        DemEnableConditionRef = enable
        DemEnableConditionRef = fault
        DemEnableConditionRef = fault
        DemEnableConditionRef = fault
        DemEnableConditionRef = for
        DemEnableConditionRef = is
        DemEnableConditionRef = is
        DemEnableConditionRef = is
        DemEnableConditionRef = met
        DemEnableConditionRef = met
        DemEnableConditionRef = ms
        DemEnableConditionRef = ms
        DemEnableConditionRef = normal
        DemEnableConditionRef = not
        DemEnableConditionRef = of
        DemEnableConditionRef = or
        DemEnableConditionRef = performed
        DemEnableConditionRef = process
        DemEnableConditionRef = service
        DemEnableConditionRef = shall
        DemEnableConditionRef = the_001
        DemEnableConditionRef = the_001
        DemEnableConditionRef = the_001
        DemEnableConditionRef = the_001
        DemEnableConditionRef = the_001
        DemEnableConditionRef = to
        DemEnableConditionRef = trigger
        DemEnableConditionRef = up
        DemEnableConditionRef = voltage
        DemEnableConditionRef = waked
      DID_0x1d01_VCU_AccelerationPedal (DemDataClass):
        DemDataElementDataSize = 2
        DemDataElementDataType = UINT16
        DemDataElementEndianness = BIG_ENDIAN
        DemDataElementUsePort = USE_DATA_CLIENT_SERVER_PORT
        DemDataElementStoreNonVolatile = true
      3 x DemEnableCondition, all with DemEnableConditionStatus=true:
        do: DemEnableConditionId=40
        any: DemEnableConditionId=27
        meet: DemEnableConditionId=51
      Gear (DemDidClass): DemDidIdentifier=61863, DemDidDataClassRef=DID_0xf1a7_Gear
      10 x DemEnableCondition, all with DemEnableConditionStatus=true:
        again: DemEnableConditionId=24
        enable: DemEnableConditionId=43
        condition: DemEnableConditionId=35
        start: DemEnableConditionId=67
        fault: DemEnableConditionId=44
        Confirmed: DemEnableConditionId=7
        When: DemEnableConditionId=21
        up: DemEnableConditionId=74
        met: DemEnableConditionId=52
        ms: DemEnableConditionId=53
      DID_0x1d05_POD_OBC_OutputDCChargeVoltage (DemDataClass):
        DemDataElementDataSize = 2
        DemDataElementDataType = UINT16
        DemDataElementEndianness = BIG_ENDIAN
        DemDataElementUsePort = USE_DATA_CLIENT_SERVER_PORT
        DemDataElementStoreNonVolatile = true
      DID_0xf1a0_Ignition_Switch_Signal (DemDataClass): DemDataElementDataSize=1, DemDataElementDataType=UINT8, DemDataElementUsePort=USE_DATA_CLIENT_SERVER_PORT, DemDataElementStoreNonVolatile=true
      and (DemEnableCondition): DemEnableConditionId=26, DemEnableConditionStatus=true
      SOC (DemDidClass): DemDidIdentifier=61862, DemDidDataClassRef=DID_0xf1a6_SOC
      timing (DemEnableCondition): DemEnableConditionId=71, DemEnableConditionStatus=true
      ExtendedDataClass_83dcefb7 (DemExtendedDataClass): DemExtendedDataRecordClassRef=ExtendedData
      not (DemEnableCondition): DemEnableConditionId=55, DemEnableConditionStatus=true
      VCU_HVStatus (DemDidClass): DemDidIdentifier=61861, DemDidDataClassRef=DID_0xf1a5_VCU_HVStatus
      EnableConditionGroup_983000c1 (DemEnableConditionGroup):
        DemEnableConditionRef = CAN
        DemEnableConditionRef = DC
        DemEnableConditionRef = If
        DemEnableConditionRef = No
        DemEnableConditionRef = No
        DemEnableConditionRef = Note
        DemEnableConditionRef = The
        DemEnableConditionRef = V
        DemEnableConditionRef = V
        DemEnableConditionRef = When
        DemEnableConditionRef = active
        DemEnableConditionRef = after
        DemEnableConditionRef = again
        DemEnableConditionRef = all
        DemEnableConditionRef = any
        DemEnableConditionRef = are
        DemEnableConditionRef = battery
        DemEnableConditionRef = be
        DemEnableConditionRef = being
        DemEnableConditionRef = busoff_001
        DemEnableConditionRef = completed
        DemEnableConditionRef = conditions
        DemEnableConditionRef = conditions
        DemEnableConditionRef = conditions
        DemEnableConditionRef = confirmation
        DemEnableConditionRef = diagnosis
        DemEnableConditionRef = diagnosis
        DemEnableConditionRef = during
        DemEnableConditionRef = enable
        DemEnableConditionRef = fault
        DemEnableConditionRef = fault
        DemEnableConditionRef = fault
        DemEnableConditionRef = is
        DemEnableConditionRef = is
        DemEnableConditionRef = is
        DemEnableConditionRef = met
        DemEnableConditionRef = met
        DemEnableConditionRef = ms
        DemEnableConditionRef = normal
        DemEnableConditionRef = not
        DemEnableConditionRef = of
        DemEnableConditionRef = or
        DemEnableConditionRef = performed
        DemEnableConditionRef = process
        DemEnableConditionRef = service
        DemEnableConditionRef = shall
        DemEnableConditionRef = status
        DemEnableConditionRef = the_001
        DemEnableConditionRef = the_001
        DemEnableConditionRef = the_001
        DemEnableConditionRef = the_001
        DemEnableConditionRef = the_001
        DemEnableConditionRef = to
        DemEnableConditionRef = trigger
        DemEnableConditionRef = up
        DemEnableConditionRef = voltage
        DemEnableConditionRef = waked
      ExtendedData_Fault_Ocurrence_Counter (DemDataClass): DemDataElementDataSize=1, DemDataElementDataType=UINT8, DemDataElementUsePort=USE_DATA_CLIENT_SERVER_PORT, DemDataElementStoreNonVolatile=true
      reset (DemEnableCondition): DemEnableConditionId=62, DemEnableConditionStatus=true
      DID_0x1d01_Accelerator_pedal_sensor_2_voltage (DemDataClass):
        DemDataElementDataSize = 2
        DemDataElementDataType = UINT16
        DemDataElementEndianness = BIG_ENDIAN
        DemDataElementUsePort = USE_DATA_CLIENT_SERVER_PORT
        DemDataElementStoreNonVolatile = true
      4 x DemEnableCondition, all with DemEnableConditionStatus=true:
        active: DemEnableConditionId=22
        requirements: DemEnableConditionId=61
        for: DemEnableConditionId=46
        does: DemEnableConditionId=41
      FreezeFrameClass_376d31f7 (DemFreezeFrameClass):
        DemDidClassRef = Vehicle_State
        DemDidClassRef = Battery_Voltage
        DemDidClassRef = Total_Odometer
        DemDidClassRef = Vehicle_speed
        DemDidClassRef = Date_And_Time
        DemDidClassRef = VCU_HVStatus
        DemDidClassRef = SOC
        DemDidClassRef = Gear
        DemDidClassRef = Electronic_lock_state
      diagnosis (DemEnableCondition): DemEnableConditionId=39, DemEnableConditionStatus=true
      FreezeFrameClass_d96350db (DemFreezeFrameClass):
        DemDidClassRef = Vehicle_State
        DemDidClassRef = Battery_Voltage
        DemDidClassRef = Total_Odometer
        DemDidClassRef = Vehicle_speed
        DemDidClassRef = Date_And_Time
        DemDidClassRef = VCU_HVStatus
        DemDidClassRef = SOC
        DemDidClassRef = Gear
        DemDidClassRef = AC_charging_parameter
      DID_0x1d11_Mainrealy1 (DemDataClass): DemDataElementDataSize=1, DemDataElementDataType=UINT8, DemDataElementUsePort=USE_DATA_CLIENT_SERVER_PORT, DemDataElementStoreNonVolatile=true
      7 x DemEnableCondition, all with DemEnableConditionStatus=true:
        last: DemEnableConditionId=50
        Busoff: DemEnableConditionId=3
        timer: DemEnableConditionId=70
        be: DemEnableConditionId=30
        recovered: DemEnableConditionId=60
        criteria: DemEnableConditionId=38
        CAN: DemEnableConditionId=4
      FreezeFrameClass_5f5b5001 (DemFreezeFrameClass):
        DemDidClassRef = Vehicle_State
        DemDidClassRef = Battery_Voltage
        DemDidClassRef = Total_Odometer
        DemDidClassRef = Vehicle_speed
        DemDidClassRef = Date_And_Time
        DemDidClassRef = VCU_HVStatus
        DemDidClassRef = SOC
        DemDidClassRef = Gear
      3 x DemDataClass, all with DemDataElementUsePort=USE_DATA_CLIENT_SERVER_PORT, DemDataElementStoreNonVolatile=true:
        DID_0x1d05_POD_OBC_OutputDCChargeCurrent: DemDataElementDataSize=2, DemDataElementDataType=UINT16, DemDataElementEndianness=BIG_ENDIAN
        DID_0x1d01_Accelerator_pedal_sensor_1_voltage: DemDataElementDataSize=2, DemDataElementDataType=UINT16, DemDataElementEndianness=BIG_ENDIAN
        DID_0x1d08_VCU_HVIL: DemDataElementDataSize=1, DemDataElementDataType=UINT8
      DTC (DemEnableCondition): DemEnableConditionId=9, DemEnableConditionStatus=true
      VCU_HV_InterLock_PWM_pfrequency (DemDidClass): DemDidIdentifier=7432, DemDidDataClassRef=DID_0x1d08_VCU_HVIL
      DID_0xf1a4_Date_And_Time_Year (DemDataClass): DemDataElementDataSize=1, DemDataElementDataType=UINT8, DemDataElementUsePort=USE_DATA_CLIENT_SERVER_PORT, DemDataElementStoreNonVolatile=true
      Date_And_Time (DemDidClass):
        DemDidIdentifier = 61860
        DemDidDataClassRef = DID_0xf1a4_Date_And_Time_Second
        DemDidDataClassRef = DID_0xf1a4_Date_And_Time_Minute
        DemDidDataClassRef = DID_0xf1a4_Date_And_Time_Hour
        DemDidDataClassRef = DID_0xf1a4_Date_And_Time_Day
        DemDidDataClassRef = DID_0xf1a4_Date_And_Time_Month
        DemDidDataClassRef = DID_0xf1a4_Date_And_Time_Year
      confirmation (DemEnableCondition): DemEnableConditionId=37, DemEnableConditionStatus=true
      AC_charging_parameter (DemDidClass):
        DemDidIdentifier = 7429
        DemDidDataClassRef = DID_0x1d05_POD_OBC_InputACVoltage
        DemDidDataClassRef = DID_0x1d05_VCU_OBC_ChargeCurrentCommand
        DemDidDataClassRef = DID_0x1d05_POD_OBC_OutputDCChargeCurrent
        DemDidDataClassRef = DID_0x1d05_POD_OBC_OutputDCChargeVoltage
      3 x DemEnableCondition, all with DemEnableConditionStatus=true:
        trigger: DemEnableConditionId=73
        simultaneously: DemEnableConditionId=66
        busoff_001: DemEnableConditionId=32
      VCU_control_S2_status (DemDidClass): DemDidIdentifier=7433, DemDidDataClassRef=DID_0x1d09_New_Bit_Field
      shall (DemEnableCondition): DemEnableConditionId=65, DemEnableConditionStatus=true
      EnableConditionGroup_58c4940f (DemEnableConditionGroup):
        DemEnableConditionRef = CAN
        DemEnableConditionRef = If
        DemEnableConditionRef = No
        DemEnableConditionRef = Note
        DemEnableConditionRef = PT
        DemEnableConditionRef = The
        DemEnableConditionRef = V
        DemEnableConditionRef = V
        DemEnableConditionRef = When
        DemEnableConditionRef = active
        DemEnableConditionRef = after
        DemEnableConditionRef = again
        DemEnableConditionRef = all
        DemEnableConditionRef = any
        DemEnableConditionRef = are
        DemEnableConditionRef = battery
        DemEnableConditionRef = be
        DemEnableConditionRef = being
        DemEnableConditionRef = bussoff
        DemEnableConditionRef = completed
        DemEnableConditionRef = conditions
        DemEnableConditionRef = conditions
        DemEnableConditionRef = conditions
        DemEnableConditionRef = confirmation
        DemEnableConditionRef = diagnosis
        DemEnableConditionRef = diagnosis
        DemEnableConditionRef = during
        DemEnableConditionRef = enable
        DemEnableConditionRef = fault
        DemEnableConditionRef = fault
        DemEnableConditionRef = fault
        DemEnableConditionRef = is
        DemEnableConditionRef = is
        DemEnableConditionRef = is
        DemEnableConditionRef = met
        DemEnableConditionRef = met
        DemEnableConditionRef = ms
        DemEnableConditionRef = normal
        DemEnableConditionRef = not
        DemEnableConditionRef = of
        DemEnableConditionRef = or
        DemEnableConditionRef = performed
        DemEnableConditionRef = process
        DemEnableConditionRef = service
        DemEnableConditionRef = shall
        DemEnableConditionRef = the_001
        DemEnableConditionRef = the_001
        DemEnableConditionRef = the_001
        DemEnableConditionRef = the_001
        DemEnableConditionRef = the_001
        DemEnableConditionRef = to
        DemEnableConditionRef = trigger
        DemEnableConditionRef = up
        DemEnableConditionRef = voltage
        DemEnableConditionRef = waked
      battery (DemEnableCondition): DemEnableConditionId=29, DemEnableConditionStatus=true
      all (DemEnableCondition): DemEnableConditionId=25, DemEnableConditionStatus=true
      DID_0xf1a4_Date_And_Time_Month (DemDataClass): DemDataElementDataSize=1, DemDataElementDataType=UINT8, DemDataElementUsePort=USE_DATA_CLIENT_SERVER_PORT, DemDataElementStoreNonVolatile=true
      FreezeFrameClass_c715a583 (DemFreezeFrameClass):
        DemDidClassRef = Vehicle_State
        DemDidClassRef = Battery_Voltage
        DemDidClassRef = Total_Odometer
        DemDidClassRef = Vehicle_speed
        DemDidClassRef = Date_And_Time
        DemDidClassRef = VCU_HVStatus
        DemDidClassRef = SOC
        DemDidClassRef = Gear
        DemDidClassRef = VCU_control_main_relay
      DID_0xf1a4_Date_And_Time_Second (DemDataClass): DemDataElementDataSize=1, DemDataElementDataType=UINT8, DemDataElementUsePort=USE_DATA_CLIENT_SERVER_PORT, DemDataElementStoreNonVolatile=true
      EnableConditionGroup_93df7d19 (DemEnableConditionGroup):
        DemEnableConditionRef = If
        DemEnableConditionRef = No
        DemEnableConditionRef = Note
        DemEnableConditionRef = When
        DemEnableConditionRef = active
        DemEnableConditionRef = after
        DemEnableConditionRef = again
        DemEnableConditionRef = all
        DemEnableConditionRef = any
        DemEnableConditionRef = are
        DemEnableConditionRef = be
        DemEnableConditionRef = being
        DemEnableConditionRef = completed
        DemEnableConditionRef = conditions
        DemEnableConditionRef = conditions
        DemEnableConditionRef = conditions
        DemEnableConditionRef = confirmation
        DemEnableConditionRef = diagnosis
        DemEnableConditionRef = diagnosis
        DemEnableConditionRef = during
        DemEnableConditionRef = enable
        DemEnableConditionRef = fault
        DemEnableConditionRef = fault
        DemEnableConditionRef = fault
        DemEnableConditionRef = is
        DemEnableConditionRef = is
        DemEnableConditionRef = met
        DemEnableConditionRef = met
        DemEnableConditionRef = ms
        DemEnableConditionRef = not
        DemEnableConditionRef = of
        DemEnableConditionRef = or
        DemEnableConditionRef = performed
        DemEnableConditionRef = process
        DemEnableConditionRef = service
        DemEnableConditionRef = shall
        DemEnableConditionRef = the_001
        DemEnableConditionRef = the_001
        DemEnableConditionRef = the_001
        DemEnableConditionRef = the_001
        DemEnableConditionRef = the_001
        DemEnableConditionRef = trigger
        DemEnableConditionRef = up
        DemEnableConditionRef = waked
      EnableConditionGroup_f3616881 (DemEnableConditionGroup):
        DemEnableConditionRef = All_001
        DemEnableConditionRef = Busoff
        DemEnableConditionRef = CAN
        DemEnableConditionRef = Conditions_001
        DemEnableConditionRef = Conditions_001
        DemEnableConditionRef = Confirmed
        DemEnableConditionRef = Confirmed
        DemEnableConditionRef = DTC
        DemEnableConditionRef = DTC
        DemEnableConditionRef = Enable_001
        DemEnableConditionRef = Enable_001
        DemEnableConditionRef = If
        DemEnableConditionRef = In_001
        DemEnableConditionRef = No
        DemEnableConditionRef = No
        DemEnableConditionRef = Note
        DemEnableConditionRef = PT
        DemEnableConditionRef = Reset_001
        DemEnableConditionRef = T_Delay
        DemEnableConditionRef = T_Delay
        DemEnableConditionRef = T_Delay
        DemEnableConditionRef = The
        DemEnableConditionRef = V
        DemEnableConditionRef = V
        DemEnableConditionRef = VCU
        DemEnableConditionRef = active
        DemEnableConditionRef = again
        DemEnableConditionRef = again
        DemEnableConditionRef = and
        DemEnableConditionRef = and
        DemEnableConditionRef = and
        DemEnableConditionRef = any
        DemEnableConditionRef = any
        DemEnableConditionRef = are
        DemEnableConditionRef = battery
        DemEnableConditionRef = condition
        DemEnableConditionRef = conditions
        DemEnableConditionRef = criteria
        DemEnableConditionRef = criteria
        DemEnableConditionRef = do
        DemEnableConditionRef = does
        DemEnableConditionRef = fault
        DemEnableConditionRef = following
        DemEnableConditionRef = for
        DemEnableConditionRef = if_001
        DemEnableConditionRef = in
        DemEnableConditionRef = in
        DemEnableConditionRef = in
        DemEnableConditionRef = is
        DemEnableConditionRef = is
        DemEnableConditionRef = last
        DemEnableConditionRef = meet
        DemEnableConditionRef = meet
        DemEnableConditionRef = met
        DemEnableConditionRef = ms
        DemEnableConditionRef = normal
        DemEnableConditionRef = not
        DemEnableConditionRef = not
        DemEnableConditionRef = of
        DemEnableConditionRef = of
        DemEnableConditionRef = or
        DemEnableConditionRef = process
        DemEnableConditionRef = recovered
        DemEnableConditionRef = requirements
        DemEnableConditionRef = requirements
        DemEnableConditionRef = reset
        DemEnableConditionRef = service
        DemEnableConditionRef = simultaneously
        DemEnableConditionRef = start
        DemEnableConditionRef = start
        DemEnableConditionRef = status
        DemEnableConditionRef = status
        DemEnableConditionRef = the_001
        DemEnableConditionRef = the_001
        DemEnableConditionRef = the_001
        DemEnableConditionRef = the_001
        DemEnableConditionRef = the_001
        DemEnableConditionRef = the_001
        DemEnableConditionRef = the_001
        DemEnableConditionRef = the_001
        DemEnableConditionRef = timer
        DemEnableConditionRef = timing
        DemEnableConditionRef = timing
        DemEnableConditionRef = to
        DemEnableConditionRef = to
        DemEnableConditionRef = to
        DemEnableConditionRef = up
        DemEnableConditionRef = voltage
        DemEnableConditionRef = wake
      6 x DemEnableCondition, all with DemEnableConditionStatus=true:
        CH: DemEnableConditionId=5
        waked: DemEnableConditionId=77
        process: DemEnableConditionId=59
        normal: DemEnableConditionId=54
        during: DemEnableConditionId=42
        the_001: DemEnableConditionId=69
      DID_0x1d07_Electronic_lock_state (DemDataClass): DemDataElementDataSize=1, DemDataElementDataType=UINT8, DemDataElementUsePort=USE_DATA_CLIENT_SERVER_PORT, DemDataElementStoreNonVolatile=true
      EnableConditionGroup_35324f44 (DemEnableConditionGroup):
        DemEnableConditionRef = All_001
        DemEnableConditionRef = Busoff
        DemEnableConditionRef = CAN
        DemEnableConditionRef = CH
        DemEnableConditionRef = Conditions_001
        DemEnableConditionRef = Conditions_001
        DemEnableConditionRef = Confirmed
        DemEnableConditionRef = Confirmed
        DemEnableConditionRef = DTC
        DemEnableConditionRef = DTC
        DemEnableConditionRef = Enable_001
        DemEnableConditionRef = Enable_001
        DemEnableConditionRef = If
        DemEnableConditionRef = In_001
        DemEnableConditionRef = No
        DemEnableConditionRef = No
        DemEnableConditionRef = Note
        DemEnableConditionRef = Reset_001
        DemEnableConditionRef = T_Delay
        DemEnableConditionRef = T_Delay
        DemEnableConditionRef = T_Delay
        DemEnableConditionRef = The
        DemEnableConditionRef = V
        DemEnableConditionRef = V
        DemEnableConditionRef = VCU
        DemEnableConditionRef = active
        DemEnableConditionRef = again
        DemEnableConditionRef = again
        DemEnableConditionRef = and
        DemEnableConditionRef = and
        DemEnableConditionRef = and
        DemEnableConditionRef = any
        DemEnableConditionRef = any
        DemEnableConditionRef = are
        DemEnableConditionRef = battery
        DemEnableConditionRef = condition
        DemEnableConditionRef = conditions
        DemEnableConditionRef = criteria
        DemEnableConditionRef = criteria
        DemEnableConditionRef = do
        DemEnableConditionRef = does
        DemEnableConditionRef = fault
        DemEnableConditionRef = following
        DemEnableConditionRef = for
        DemEnableConditionRef = if_001
        DemEnableConditionRef = in
        DemEnableConditionRef = in
        DemEnableConditionRef = in
        DemEnableConditionRef = is
        DemEnableConditionRef = is
        DemEnableConditionRef = last
        DemEnableConditionRef = meet
        DemEnableConditionRef = meet
        DemEnableConditionRef = met
        DemEnableConditionRef = ms
        DemEnableConditionRef = normal
        DemEnableConditionRef = not
        DemEnableConditionRef = not
        DemEnableConditionRef = of
        DemEnableConditionRef = of
        DemEnableConditionRef = or
        DemEnableConditionRef = process
        DemEnableConditionRef = recovered
        DemEnableConditionRef = requirements
        DemEnableConditionRef = requirements
        DemEnableConditionRef = reset
        DemEnableConditionRef = service
        DemEnableConditionRef = simultaneously
        DemEnableConditionRef = start
        DemEnableConditionRef = start
        DemEnableConditionRef = status
        DemEnableConditionRef = status
        DemEnableConditionRef = the_001
        DemEnableConditionRef = the_001
        DemEnableConditionRef = the_001
        DemEnableConditionRef = the_001
        DemEnableConditionRef = the_001
        DemEnableConditionRef = the_001
        DemEnableConditionRef = the_001
        DemEnableConditionRef = the_001
        DemEnableConditionRef = timer
        DemEnableConditionRef = timing
        DemEnableConditionRef = timing
        DemEnableConditionRef = to
        DemEnableConditionRef = to
        DemEnableConditionRef = to
        DemEnableConditionRef = up
        DemEnableConditionRef = voltage
        DemEnableConditionRef = wake
      EnableConditionGroup_fd8a9b69 (DemEnableConditionGroup):
        DemEnableConditionRef = If
        DemEnableConditionRef = No
        DemEnableConditionRef = Note
        DemEnableConditionRef = The
        DemEnableConditionRef = V
        DemEnableConditionRef = V
        DemEnableConditionRef = When
        DemEnableConditionRef = active
        DemEnableConditionRef = again
        DemEnableConditionRef = all
        DemEnableConditionRef = any
        DemEnableConditionRef = are
        DemEnableConditionRef = battery
        DemEnableConditionRef = be
        DemEnableConditionRef = completed
        DemEnableConditionRef = conditions
        DemEnableConditionRef = conditions
        DemEnableConditionRef = conditions
        DemEnableConditionRef = confirmation
        DemEnableConditionRef = diagnosis
        DemEnableConditionRef = diagnosis
        DemEnableConditionRef = during
        DemEnableConditionRef = enable
        DemEnableConditionRef = fault
        DemEnableConditionRef = fault
        DemEnableConditionRef = fault
        DemEnableConditionRef = is
        DemEnableConditionRef = is
        DemEnableConditionRef = is
        DemEnableConditionRef = met
        DemEnableConditionRef = met
        DemEnableConditionRef = normal
        DemEnableConditionRef = not
        DemEnableConditionRef = of
        DemEnableConditionRef = or
        DemEnableConditionRef = performed
        DemEnableConditionRef = process
        DemEnableConditionRef = service
        DemEnableConditionRef = shall
        DemEnableConditionRef = the_001
        DemEnableConditionRef = the_001
        DemEnableConditionRef = the_001
        DemEnableConditionRef = the_001
        DemEnableConditionRef = the_001
        DemEnableConditionRef = to
        DemEnableConditionRef = trigger
        DemEnableConditionRef = voltage
      Electronic_lock_state (DemDidClass): DemDidIdentifier=7431, DemDidDataClassRef=DID_0x1d07_Electronic_lock_state
      DID_0x1d09_New_Bit_Field (DemDataClass): DemDataElementDataSize=1, DemDataElementDataType=UINT8, DemDataElementUsePort=USE_DATA_CLIENT_SERVER_PORT, DemDataElementStoreNonVolatile=true
      wake (DemEnableCondition): DemEnableConditionId=76, DemEnableConditionStatus=true
      DC (DemEnableCondition): DemEnableConditionId=8, DemEnableConditionStatus=true
      DID_0x1d01_VCU_VehicleSpeed (DemDataClass):
        DemDataElementDataSize = 2
        DemDataElementDataType = UINT16
        DemDataElementEndianness = BIG_ENDIAN
        DemDataElementUsePort = USE_DATA_CLIENT_SERVER_PORT
        DemDataElementStoreNonVolatile = true
      to (DemEnableCondition): DemEnableConditionId=72, DemEnableConditionStatus=true
      Total_Odometer (DemDidClass): DemDidIdentifier=61858, DemDidDataClassRef=DID_0xf1a2_Total_Odometer
      FreezeFrameClass_de0e94c2 (DemFreezeFrameClass):
        DemDidClassRef = Vehicle_State
        DemDidClassRef = Battery_Voltage
        DemDidClassRef = Total_Odometer
        DemDidClassRef = Vehicle_speed
        DemDidClassRef = Date_And_Time
        DemDidClassRef = VCU_HVStatus
        DemDidClassRef = SOC
        DemDidClassRef = Gear
        DemDidClassRef = VCU_AccPealparameter
      PT (DemEnableCondition): DemEnableConditionId=15, DemEnableConditionStatus=true
      FreezeFrameClass_d0d51cf0 (DemFreezeFrameClass):
        DemDidClassRef = Vehicle_State
        DemDidClassRef = Battery_Voltage
        DemDidClassRef = Total_Odometer
        DemDidClassRef = Vehicle_speed
        DemDidClassRef = Date_And_Time
        DemDidClassRef = VCU_HVStatus
        DemDidClassRef = SOC
        DemDidClassRef = Gear
        DemDidClassRef = VCU_control_S2_status
      DID_0xf1a3_Vehicle_speed (DemDataClass):
        DemDataElementDataSize = 2
        DemDataElementDataType = UINT16
        DemDataElementEndianness = BIG_ENDIAN
        DemDataElementUsePort = USE_DATA_CLIENT_SERVER_PORT
        DemDataElementStoreNonVolatile = true
      following (DemEnableCondition): DemEnableConditionId=45, DemEnableConditionStatus=true
      V (DemEnableCondition): DemEnableConditionId=19, DemEnableConditionStatus=true
      DID_0x1d11_Mainrelay2 (DemDataClass): DemDataElementDataSize=1, DemDataElementDataType=UINT8, DemDataElementUsePort=USE_DATA_CLIENT_SERVER_PORT, DemDataElementStoreNonVolatile=true
      All_001 (DemEnableCondition): DemEnableConditionId=1, DemEnableConditionStatus=true
      serviceNote (DemEnableCondition): DemEnableConditionId=64, DemEnableConditionStatus=true
      ExtendedData_Fault_Aged_Counter (DemDataClass): DemDataElementDataSize=1, DemDataElementDataType=UINT8, DemDataElementUsePort=USE_DATA_CLIENT_SERVER_PORT, DemDataElementStoreNonVolatile=true
      T_Delay (DemEnableCondition): DemEnableConditionId=17, DemEnableConditionStatus=true
      status (DemEnableCondition): DemEnableConditionId=68, DemEnableConditionStatus=true
      DID_0x1d05_POD_OBC_InputACVoltage (DemDataClass):
        DemDataElementDataSize = 2
        DemDataElementDataType = UINT16
        DemDataElementEndianness = BIG_ENDIAN
        DemDataElementUsePort = USE_DATA_CLIENT_SERVER_PORT
        DemDataElementStoreNonVolatile = true
      voltage (DemEnableCondition): DemEnableConditionId=75, DemEnableConditionStatus=true
      in (DemEnableCondition): DemEnableConditionId=48, DemEnableConditionStatus=true
      DID_0x1d05_VCU_OBC_ChargeCurrentCommand (DemDataClass):
        DemDataElementDataSize = 2
        DemDataElementDataType = UINT16
        DemDataElementEndianness = BIG_ENDIAN
        DemDataElementUsePort = USE_DATA_CLIENT_SERVER_PORT
        DemDataElementStoreNonVolatile = true
      VCU_AccPealparameter (DemDidClass):
        DemDidIdentifier = 7425
        DemDidDataClassRef = DID_0x1d01_VCU_VehicleSpeed
        DemDidDataClassRef = DID_0x1d01_Accelerator_pedal_sensor_1_voltage
        DemDidDataClassRef = DID_0x1d01_Accelerator_pedal_sensor_2_voltage
        DemDidDataClassRef = DID_0x1d01_VCU_AccelerationPedal
      ExtendedData (DemExtendedDataRecordClass):
        DemExtendedDataRecordNumber = 1
        DemExtendedDataRecordTrigger = DEM_RECORD_TRIGGER_TESTFAILED
        DemExtendedDataRecordUpdate = DEM_UPDATE_RECORD_YES
        DemDataClassRef = ExtendedData_Fault_Ocurrence_Counter
        DemDataClassRef = ExtendedData_Fault_Aged_Counter
        DemDataClassRef = ExtendedData_Fault_Aging_Counter
      are (DemEnableCondition): DemEnableConditionId=28, DemEnableConditionStatus=true
      after (DemEnableCondition): DemEnableConditionId=23, DemEnableConditionStatus=true
      DID_0xf1a6_SOC (DemDataClass):
        DemDataElementDataSize = 2
        DemDataElementDataType = UINT16
        DemDataElementEndianness = BIG_ENDIAN
        DemDataElementUsePort = USE_DATA_CLIENT_SERVER_PORT
        DemDataElementStoreNonVolatile = true
      3 x DemEnableCondition, all with DemEnableConditionStatus=true:
        is: DemEnableConditionId=49
        The: DemEnableConditionId=18
        VCU: DemEnableConditionId=20
      DID_0xf1a2_Total_Odometer (DemDataClass):
        DemDataElementDataSize = 3
        DemDataElementDataType = UINT8_N
        DemDataElementEndianness = opaque
        DemDataElementUsePort = USE_DATA_CLIENT_SERVER_PORT
        DemDataElementStoreNonVolatile = true
      EnableConditionGroup_bbe52cb7 (DemEnableConditionGroup):
        DemEnableConditionRef = If
        DemEnableConditionRef = No
        DemEnableConditionRef = Note
        DemEnableConditionRef = The
        DemEnableConditionRef = V
        DemEnableConditionRef = V
        DemEnableConditionRef = When
        DemEnableConditionRef = active
        DemEnableConditionRef = after
        DemEnableConditionRef = again
        DemEnableConditionRef = all
        DemEnableConditionRef = any
        DemEnableConditionRef = are
        DemEnableConditionRef = battery
        DemEnableConditionRef = be
        DemEnableConditionRef = being
        DemEnableConditionRef = completed
        DemEnableConditionRef = conditions
        DemEnableConditionRef = conditions
        DemEnableConditionRef = conditions
        DemEnableConditionRef = confirmation
        DemEnableConditionRef = diagnosis
        DemEnableConditionRef = diagnosis
        DemEnableConditionRef = during
        DemEnableConditionRef = enable
        DemEnableConditionRef = fault
        DemEnableConditionRef = fault
        DemEnableConditionRef = fault
        DemEnableConditionRef = is
        DemEnableConditionRef = is
        DemEnableConditionRef = is
        DemEnableConditionRef = met
        DemEnableConditionRef = met
        DemEnableConditionRef = ms
        DemEnableConditionRef = normal
        DemEnableConditionRef = not
        DemEnableConditionRef = of
        DemEnableConditionRef = or
        DemEnableConditionRef = performed
        DemEnableConditionRef = process
        DemEnableConditionRef = service
        DemEnableConditionRef = shall
        DemEnableConditionRef = the_001
        DemEnableConditionRef = the_001
        DemEnableConditionRef = the_001
        DemEnableConditionRef = the_001
        DemEnableConditionRef = the_001
        DemEnableConditionRef = to
        DemEnableConditionRef = trigger
        DemEnableConditionRef = up
        DemEnableConditionRef = voltage
        DemEnableConditionRef = waked
      If (DemEnableCondition): DemEnableConditionId=11, DemEnableConditionStatus=true
      EnableConditionGroup_c81fc67e (DemEnableConditionGroup):
        DemEnableConditionRef = All_001
        DemEnableConditionRef = Being_001
        DemEnableConditionRef = Conditions_001
        DemEnableConditionRef = Conditions_001
        DemEnableConditionRef = Confirmed
        DemEnableConditionRef = Confirmed
        DemEnableConditionRef = DTC
        DemEnableConditionRef = DTC
        DemEnableConditionRef = Enable_001
        DemEnableConditionRef = Enable_001
        DemEnableConditionRef = If
        DemEnableConditionRef = In_001
        DemEnableConditionRef = No
        DemEnableConditionRef = Note
        DemEnableConditionRef = Reset_001
        DemEnableConditionRef = T_Delay
        DemEnableConditionRef = T_Delay
        DemEnableConditionRef = T_Delay
        DemEnableConditionRef = The
        DemEnableConditionRef = V
        DemEnableConditionRef = V
        DemEnableConditionRef = active
        DemEnableConditionRef = again
        DemEnableConditionRef = again
        DemEnableConditionRef = and
        DemEnableConditionRef = and
        DemEnableConditionRef = and
        DemEnableConditionRef = any
        DemEnableConditionRef = any
        DemEnableConditionRef = are
        DemEnableConditionRef = battery
        DemEnableConditionRef = condition
        DemEnableConditionRef = conditions
        DemEnableConditionRef = criteria
        DemEnableConditionRef = criteria
        DemEnableConditionRef = do
        DemEnableConditionRef = does
        DemEnableConditionRef = fault
        DemEnableConditionRef = following
        DemEnableConditionRef = for
        DemEnableConditionRef = if_001
        DemEnableConditionRef = in
        DemEnableConditionRef = in
        DemEnableConditionRef = is
        DemEnableConditionRef = last
        DemEnableConditionRef = meet
        DemEnableConditionRef = meet
        DemEnableConditionRef = met
        DemEnableConditionRef = ms
        DemEnableConditionRef = normal
        DemEnableConditionRef = not
        DemEnableConditionRef = not
        DemEnableConditionRef = of
        DemEnableConditionRef = of
        DemEnableConditionRef = or
        DemEnableConditionRef = process
        DemEnableConditionRef = recovered
        DemEnableConditionRef = requirements
        DemEnableConditionRef = requirements
        DemEnableConditionRef = reset
        DemEnableConditionRef = service
        DemEnableConditionRef = simultaneously
        DemEnableConditionRef = start
        DemEnableConditionRef = start
        DemEnableConditionRef = the_001
        DemEnableConditionRef = the_001
        DemEnableConditionRef = the_001
        DemEnableConditionRef = the_001
        DemEnableConditionRef = the_001
        DemEnableConditionRef = the_001
        DemEnableConditionRef = the_001
        DemEnableConditionRef = timer
        DemEnableConditionRef = timing
        DemEnableConditionRef = timing
        DemEnableConditionRef = to
        DemEnableConditionRef = to
        DemEnableConditionRef = to
        DemEnableConditionRef = up
        DemEnableConditionRef = voltage
        DemEnableConditionRef = waked
