AUTOSAR XML (schema 00048)
package /ActiveEcuC
  module config Dem: implementation-config-variant=VARIANT-PRE-COMPILE, module-description=Dem_Impl
    DemConfigSet
      3 x DemEventParameter, all with DemEventKind=DEM_EVENT_KIND_SWC, DemMaxNumberFreezeFrameRecords=2, DemEventTimeSeries=DEM_TIMESERIES_SNAPSHOT_NONE, DemEventAvailable=true, DemEventAvailableInVariant=true, DemEventLatchTestFailed=false, DemEventCreateInfoPort=true, DemExtendedDataClassRef=ExtendedDataClass_4f5344cd:
        DTC_0X000002: DemEventId=1, DemDTCClassRef=DTCClass_DTC_0X000002, DemFreezeFrameClassRef=FreezeFrameClass_34739cdf
          DemEventClass:
            DemAgingAllowed = true
            DemAgingCycleCounterThreshold = 40
            DemEventDestination = DEM_DTC_ORIGIN_PRIMARY_MEMORY
            DemEventPriority = 1
            DemEventSignificance = DEM_EVENT_SIGNIFICANCE_FAULT
            DemEventFailureCycleCounterThreshold = 3
            DemConsiderPtoStatus = false
            DemFFPrestorageSupported = false
            DemAgingCycleRef = PowerCycle
            DemEnableConditionGroupRef = EnableConditionGroup_2f9cc720
            DemOperationCycleRef = PowerCycle
            DemDebounceAlgorithmClass
              DemDebounceCounterBased:
                DemDebounceCounterDecrementStepSize = 1
                DemDebounceCounterIncrementStepSize = 1
                DemDebounceCounterJumpDown = false
                DemDebounceCounterJumpUp = true
                DemDebounceCounterFailedThreshold = 40
                DemDebounceCounterPassedThreshold = -40
                DemDebounceBehavior = DEM_DEBOUNCE_FREEZE
                DemDebounceCounterJumpDownValue = 0
                DemDebounceCounterJumpUpValue = 0
                DemDebounceCounterStorage = false
                DemDebounceContinuous = false
            IndicatorAttribute_WarningIndicator (DemIndicatorAttribute):
              DemIndicatorFailureCycleSource = DEM_FAILURE_CYCLE_EVENT
              DemIndicatorBehaviour = DEM_INDICATOR_CONTINUOUS
              DemIndicatorHealingCycleCounterThreshold = 3
              DemIndicatorHealingCycleRef = PowerCycle
              DemIndicatorRef = WarningIndicator
        DTC_0X000004: DemEventId=3, DemDTCClassRef=DTCClass_DTC_0X000004, DemFreezeFrameClassRef=FreezeFrameClass_8de652ca
          DemEventClass:
            DemAgingAllowed = true
            DemAgingCycleCounterThreshold = 40
            DemEventDestination = DEM_DTC_ORIGIN_PRIMARY_MEMORY
            DemEventPriority = 4
            DemEventSignificance = DEM_EVENT_SIGNIFICANCE_FAULT
            DemEventFailureCycleCounterThreshold = 3
            DemConsiderPtoStatus = false
            DemFFPrestorageSupported = false
            DemAgingCycleRef = PowerCycle
            DemOperationCycleRef = PowerCycle
            DemDebounceAlgorithmClass
              DemDebounceCounterBased:
                DemDebounceCounterDecrementStepSize = 1
                DemDebounceCounterIncrementStepSize = 1
                DemDebounceCounterJumpDown = false
                DemDebounceCounterJumpUp = true
                DemDebounceCounterFailedThreshold = 40
                DemDebounceCounterPassedThreshold = -40
                DemDebounceBehavior = DEM_DEBOUNCE_FREEZE
                DemDebounceCounterJumpDownValue = 0
                DemDebounceCounterJumpUpValue = 0
                DemDebounceCounterStorage = false
                DemDebounceContinuous = false
            IndicatorAttribute_WarningIndicator (DemIndicatorAttribute):
              DemIndicatorFailureCycleSource = DEM_FAILURE_CYCLE_EVENT
              DemIndicatorBehaviour = DEM_INDICATOR_CONTINUOUS
              DemIndicatorHealingCycleCounterThreshold = 3
              DemIndicatorHealingCycleRef = PowerCycle
              DemIndicatorRef = WarningIndicator
        DTC_0X000003: DemEventId=2, DemDTCClassRef=DTCClass_DTC_0X000003, DemFreezeFrameClassRef=FreezeFrameClass_8de652ca
          DemEventClass:
            DemAgingAllowed = true
            DemAgingCycleCounterThreshold = 40
            DemEventDestination = DEM_DTC_ORIGIN_PRIMARY_MEMORY
            DemEventPriority = 2
            DemEventSignificance = DEM_EVENT_SIGNIFICANCE_FAULT
            DemEventFailureCycleCounterThreshold = 3
            DemConsiderPtoStatus = false
            DemFFPrestorageSupported = false
            DemAgingCycleRef = PowerCycle
            DemEnableConditionGroupRef = EnableConditionGroup_Example_EnableCondition1
            DemOperationCycleRef = PowerCycle
            DemDebounceAlgorithmClass
              DemDebounceCounterBased:
                DemDebounceCounterDecrementStepSize = 32
                DemDebounceCounterIncrementStepSize = 32
                DemDebounceCounterJumpDown = false
                DemDebounceCounterJumpUp = false
                DemDebounceCounterFailedThreshold = 40
                DemDebounceCounterPassedThreshold = -40
                DemDebounceBehavior = DEM_DEBOUNCE_FREEZE
                DemDebounceCounterJumpDownValue = 0
                DemDebounceCounterJumpUpValue = 0
                DemDebounceCounterStorage = false
                DemDebounceContinuous = false
            IndicatorAttribute_WarningIndicator (DemIndicatorAttribute):
              DemIndicatorFailureCycleSource = DEM_FAILURE_CYCLE_EVENT
              DemIndicatorBehaviour = DEM_INDICATOR_CONTINUOUS
              DemIndicatorHealingCycleCounterThreshold = 3
              DemIndicatorHealingCycleRef = PowerCycle
              DemIndicatorRef = WarningIndicator
      3 x DemDTCClass, all with DemDTCSeverity=DEM_DTC_SEV_NO_SEVERITY, DemImmediateNvStorage=true:
        DTCClass_DTC_0X000002: DemUdsDTC=514
        DTCClass_DTC_0X000003: DemUdsDTC=771
        DTCClass_DTC_0X000004: DemUdsDTC=4
      CAN00_BUSOFF (DemEventParameter):
        DemEventKind = DEM_EVENT_KIND_BSW
        DemMaxNumberFreezeFrameRecords = 2
        DemEventTimeSeries = DEM_TIMESERIES_SNAPSHOT_NONE
        DemEventAvailable = true
        DemEventId = 4
        DemEventAvailableInVariant = true
        DemEventLatchTestFailed = false
        DemEventCreateInfoPort = true
        DemDTCClassRef = DTCClass_CAN00_BUSOFF
        DemExtendedDataClassRef = ExtendedDataClass_4f5344cd
        DemFreezeFrameClassRef = FreezeFrameClass_8de652ca
        DemEventClass:
          DemAgingAllowed = true
          DemAgingCycleCounterThreshold = 40
          DemEventDestination = DEM_DTC_ORIGIN_PRIMARY_MEMORY
          DemEventPriority = 3
          DemEventSignificance = DEM_EVENT_SIGNIFICANCE_FAULT
          DemEventFailureCycleCounterThreshold = 3
          DemConsiderPtoStatus = false
          DemFFPrestorageSupported = false
          DemAgingCycleRef = PowerCycle
          DemOperationCycleRef = PowerCycle
          DemDebounceAlgorithmClass
            DemDebounceCounterBased:
              DemDebounceCounterDecrementStepSize = 1
              DemDebounceCounterIncrementStepSize = 1
              DemDebounceCounterJumpDown = false
              DemDebounceCounterJumpUp = true
              DemDebounceCounterFailedThreshold = 40
              DemDebounceCounterPassedThreshold = -40
              DemDebounceBehavior = DEM_DEBOUNCE_FREEZE
              DemDebounceCounterJumpDownValue = 0
              DemDebounceCounterJumpUpValue = 0
              DemDebounceCounterStorage = false
              DemDebounceContinuous = false
          IndicatorAttribute_WarningIndicator (DemIndicatorAttribute):
            DemIndicatorFailureCycleSource = DEM_FAILURE_CYCLE_EVENT
            DemIndicatorBehaviour = DEM_INDICATOR_CONTINUOUS
            DemIndicatorHealingCycleCounterThreshold = 3
            DemIndicatorHealingCycleRef = PowerCycle
            DemIndicatorRef = WarningIndicator
      DTCClass_CAN00_BUSOFF (DemDTCClass): DemDTCSeverity=DEM_DTC_SEV_NO_SEVERITY, DemUdsDTC=13631748, DemImmediateNvStorage=true
      CAN01_ComLost (DemEventParameter):
        DemEventKind = DEM_EVENT_KIND_SWC
        DemMaxNumberFreezeFrameRecords = 2
        DemEventTimeSeries = DEM_TIMESERIES_SNAPSHOT_NONE
        DemEventAvailable = true
        DemEventId = 5
        DemEventAvailableInVariant = true
        DemEventLatchTestFailed = false
        DemEventCreateInfoPort = true
        DemDTCClassRef = DTCClass_CAN01_ComLost
        DemExtendedDataClassRef = ExtendedDataClass_4f5344cd
        DemFreezeFrameClassRef = FreezeFrameClass_8de652ca
        DemEventClass:
          DemAgingAllowed = true
          DemAgingCycleCounterThreshold = 40
          DemEventDestination = DEM_DTC_ORIGIN_PRIMARY_MEMORY
          DemEventPriority = 3
          DemEventSignificance = DEM_EVENT_SIGNIFICANCE_FAULT
          DemEventFailureCycleCounterThreshold = 3
          DemConsiderPtoStatus = false
          DemFFPrestorageSupported = false
          DemAgingCycleRef = IgnitionCycle
          DemEnableConditionGroupRef = EnableConditionGroup_KL15_High
          DemOperationCycleRef = IgnitionCycle
          DemDebounceAlgorithmClass
            DemDebounceCounterBased:
              DemDebounceCounterDecrementStepSize = 1
              DemDebounceCounterIncrementStepSize = 1
              DemDebounceCounterJumpDown = false
              DemDebounceCounterJumpUp = true
              DemDebounceCounterFailedThreshold = 40
              DemDebounceCounterPassedThreshold = -40
              DemDebounceBehavior = DEM_DEBOUNCE_FREEZE
              DemDebounceCounterJumpDownValue = 0
              DemDebounceCounterJumpUpValue = 0
              DemDebounceCounterStorage = false
              DemDebounceContinuous = false
          IndicatorAttribute_WarningIndicator (DemIndicatorAttribute):
            DemIndicatorFailureCycleSource = DEM_FAILURE_CYCLE_EVENT
            DemIndicatorBehaviour = DEM_INDICATOR_CONTINUOUS
            DemIndicatorHealingCycleCounterThreshold = 3
            DemIndicatorHealingCycleRef = IgnitionCycle
            DemIndicatorRef = WarningIndicator
      DTCClass_CAN01_ComLost (DemDTCClass): DemDTCSeverity=DEM_DTC_SEV_NO_SEVERITY, DemUdsDTC=13632005, DemImmediateNvStorage=true
    DemGeneral:
      DemAgingCycleCounterProcessing = DEM_PROCESS_AGINGCTR_INTERN
      DemDebounceCounterBasedSupport = true
      DemEnableConditionSupport = true
      DemPTOSupport = false
      DemDtcStatusAvailabilityMask = 127
      DemTypeOfFreezeFrameRecordNumeration = DEM_FF_RECNUM_CALCULATED
      DemGeneralInterfaceSupport = false
      DemDataElementDefaultEndianness = LITTLE_ENDIAN
      DemAgingRequieresTestedCycle = false
      DemMaxNumberEventEntryMirror = 0
      DemTriggerMonitorInitBeforeClearOk = true
      DemExtendedDataCapture = DEM_TRIGGER_EVENT_MEMORY_STORAGE
      DemFreezeFrameCapture = DEM_TRIGGER_EVENT_MEMORY_STORAGE
      DemOperationCycleProcessing = DEM_PROCESS_OPCYC_STATE
      DemMaxNumberTimeSeriesSnapshots = 0
      DemAvailabilitySupport = DEM_NO_AVAILABILITY
      DemAvailabilityStorage = false
      DemBswErrorBufferSize = 0
      DemClearDTCBehavior = DEM_CLRRESP_VOLATILE
      DemClearDTCLimitation = DEM_ALL_SUPPORTED_DTCS
      DemDebounceTimeBasedSupport = false
      DemDevErrorDetect = true
      DemEventCombinationSupport = DEM_EVCOMB_DISABLED
      DemEventDisplacementStrategy = DEM_DISPLACEMENT_LEGACY_403
      DemEventMemoryEntryStorageTrigger = DEM_STORAGE_ON_TEST_FAILED
      DemMaxNumberEventEntryOBDFreezeFrame = 0
      DemMaxNumberEventEntryPermanent = 0
      DemMaxNumberEventEntryPrimary = 5
      DemMaxNumberEventEntrySecondary = 0
      DemMaxNumberPrestoredFF = 0
      DemOBDSupport = DEM_OBD_NO_OBD_SUPPORT
      DemOccurrenceCounterProcessing = DEM_PROCESS_OCCCTR_TF
      DemOperationCycleStatusStorage = false
      DemResetConfirmedBitOnOverflow = false
      DemStatusBitHandlingTestFailedSinceLastClear = DEM_STATUS_BIT_NORMAL
      DemStatusBitStorageTestFailed = false
      DemStorageConditionSupport = false
      DemSuppressionSupport = DEM_NO_SUPPRESSION
      DemTaskTime = 0.01
      DemTriggerDcmReports = false
      DemTriggerDltReports = false
      DemTriggerFiMReports = false
      DemTriggerFiMReportsExtended = false
      DemTriggerMonitorInitForEnableConditions = false
      DemTypeOfDTCSupported = DEM_DTC_TRANSLATION_ISO14229_1
      DemVersionInfoApi = false
      DemBswApiVersion = DEM_BSW_API_4_XX_XX
      DemBswApiVersionNvM = DEM_BSW_API_4_XX_XX
      DemBswApiVersionFiM = DEM_BSW_API_4_XX_XX
      DemAgingAfterHealing = DEM_AGING_WHILE_HEALING
      DemAgingBehavior = DEM_AGING_TYPE_1
      DemAgingCounterBehavior = DEM_AGING_COUNT_ALWAYS
      DemAgingCounterReporting = DEM_AGING_NORMAL_REPORTING
      DemAgingRetainEnvironmentalData = false
      DemCompiledPostbuildCrc = 1331237508
      DemCompiledPostbuildCrcMode = DEM_POSTBUILD_CRC_AUTOMATIC
      DemEventDisplacementFallbackStrategy = DEM_FALLBACK_DISCARD_NEW_EVENT
      DemGeneralDiagnosticInfoSupport = true
      DemJ1939Support = false
      DemNvSynchronizeSupport = false
      DemPendingDtcProcessing = DEM_PROCESS_PDTC_ALL_DTC
      DemResetDebounceBehavior = DEM_RESET_DEBOUNCE_ON_DISABLE_ENABLE_CONDITIONS
      DemResetTestFailedOnOperationCycleStart = true
      DemRetryStorageSupport = false
      DemSafeBswChecks = false
      DemUseMemcopyMacros = false
      DemUseRte = true
      DemUserControlledWirBehavior = DEM_ENABLED_DURING_CONTROLDTCSETTING
      DemUserDefinedCompareAndSwap = false
      DemWarningIndicatorRequestedProcessing = DEM_PROCESS_WIR_STOREDONLY
      DemUseMultiPartitionFiM = false
      DemReportSuppressedDTCsInService19x0A = false
      DemSupportAgingForAllDTCs = false
      DemLatchTestFailedBehavior = DEM_LATCH_TF_CONFIRMED_AND_THIS_CYCLE
      DemUseNvm = true
      DemImmediateNvStorageSupport = true
      DemImmediateNvStorageLimit = 255
      WarningIndicator (DemIndicator): DemIndicatorID=0
      DemPostbuild: DemEventAvailableDefaultSupport=true, DemMaxSizeFreezeFrame=8, DemMaxNumberDtr=0, DemMaxSizeGlobalFreezeFrame=6, DemMaxSizeOBDonUDSFreezeFrame=0
      PowerCycle (DemOperationCycle): DemOperationCycleType=DEM_OPCYC_POWER, DemOperationCycleAutomaticEnd=false, DemOperationCycleAutostart=false
      DemEventMemorySet
      DemClient: DemClientId=0
      3 x DemNvRamBlockId:
        DemNvRamBlockId_DEM_PrimaryEntry_0: DemNvRamBlockIdType=DEM_NVBLOCK_PRIMARY, DemNvRamBlockIdIndex=0, DemNvRamBlockIdRef=NvM_DEM_PrimaryEntry_0
        DemNvRamBlockId_DEM_PrimaryEntry_1: DemNvRamBlockIdType=DEM_NVBLOCK_PRIMARY, DemNvRamBlockIdIndex=1, DemNvRamBlockIdRef=NvM_DEM_PrimaryEntry_1
        DemNvRamBlockId_DEM_StatusData: DemNvRamBlockIdType=DEM_NVBLOCK_STATUS, DemNvRamBlockIdRef=NvM_DEM_StatusData
      ExtendedDataRecord0x02_Fault_Aging_Counte_Up (DemDataClass):
        DemDataElementDataSize = 1
        DemDataElementInternalData = DEM_AGINGCTR_UPCNT
        DemDataElementUsePort = USE_DATA_INTERNAL
        DemDataElementStoreNonVolatile = true
      ExtendedDataRecord0x02 (DemExtendedDataRecordClass):
        DemExtendedDataRecordNumber = 2
        DemExtendedDataRecordTrigger = DEM_RECORD_TRIGGER_TESTFAILED
        DemExtendedDataRecordUpdate = DEM_UPDATE_RECORD_YES
        DemDataClassRef = ExtendedDataRecord0x02_Fault_Aging_Counte_Up
      ExtendedDataClass_4f5344cd (DemExtendedDataClass): DemExtendedDataRecordClassRef=ExtendedDataRecord0x01, DemExtendedDataRecordClassRef=ExtendedDataRecord0x02
      EnableConditionGroup_2f9cc720 (DemEnableConditionGroup): DemEnableConditionRef=Example_EnableCondition1, DemEnableConditionRef=Example_EnableCondition2
      EnableConditionGroup_Example_EnableCondition1 (DemEnableConditionGroup): DemEnableConditionRef=Example_EnableCondition1
      ExtendedDataRecord0x01_Fault_Aging_Counter (DemDataClass):
        DemDataElementDataSize = 1
        DemDataElementInternalData = DEM_AGINGCTR_DOWNCNT
        DemDataElementUsePort = USE_DATA_INTERNAL
        DemDataElementStoreNonVolatile = true
      ExtendedDataRecord0x01_Occurence_Counter (DemDataClass): DemDataElementDataSize=1, DemDataElementInternalData=DEM_OCCCTR, DemDataElementUsePort=USE_DATA_INTERNAL, DemDataElementStoreNonVolatile=true
      Example_EnableCondition2 (DemEnableCondition): DemEnableConditionId=2, DemEnableConditionStatus=true
      Example_EnableCondition1 (DemEnableCondition): DemEnableConditionId=1, DemEnableConditionStatus=true
      ExtendedDataRecord0x01 (DemExtendedDataRecordClass):
        DemExtendedDataRecordNumber = 1
        DemExtendedDataRecordTrigger = DEM_RECORD_TRIGGER_TESTFAILED
        DemExtendedDataRecordUpdate = DEM_UPDATE_RECORD_YES
        DemDataClassRef = ExtendedDataRecord0x01_Occurence_Counter
        DemDataClassRef = ExtendedDataRecord0x01_Fault_Aging_Counter
      DID_0xf1a2_F1A2_Data (DemDataClass):
        DemDataElementDataSize = 2
        DemDataElementDataType = UINT16
        DemDataElementEndianness = BIG_ENDIAN
        DemDataElementUsePort = USE_DATA_CLIENT_SERVER_PORT
        DemDataElementStoreNonVolatile = true
      DID_0xf1a1_F1A1_Data (DemDataClass):
        DemDataElementDataSize = 2
        DemDataElementDataType = UINT16
        DemDataElementEndianness = BIG_ENDIAN
        DemDataElementUsePort = USE_DATA_CLIENT_SERVER_PORT
        DemDataElementStoreNonVolatile = true
      DID_0xF1A0 (DemDidClass): DemDidIdentifier=61856, DemDidDataClassRef=DID_0xf1a0_F1A0_Data
      DID_0xf1a0_F1A0_Data (DemDataClass):
        DemDataElementDataSize = 2
        DemDataElementDataType = UINT16
        DemDataElementEndianness = BIG_ENDIAN
        DemDataElementUsePort = USE_DATA_CLIENT_SERVER_PORT
        DemDataElementStoreNonVolatile = true
      FreezeFrameClass_8de652ca (DemFreezeFrameClass): DemDidClassRef=DID_0xF1A0, DemDidClassRef=DID_0xF1A1, DemDidClassRef=DID_0xF1A2
      DID_0xF1A1 (DemDidClass): DemDidIdentifier=61857, DemDidDataClassRef=DID_0xf1a1_F1A1_Data
      DID_0xF1A2 (DemDidClass): DemDidIdentifier=61858, DemDidDataClassRef=DID_0xf1a2_F1A2_Data
      DemNvRamBlockId_DEM_PrimaryEntry_2 (DemNvRamBlockId): DemNvRamBlockIdType=DEM_NVBLOCK_PRIMARY, DemNvRamBlockIdIndex=2, DemNvRamBlockIdRef=NvM_DEM_PrimaryEntry_2
      DemGlobalFreezeFrame:
        DemGlobalFreezeFrameRecordNumber = 3
        DemGlobalFreezeFrameRecordUpdate = DEM_UPDATE_RECORD_NO
        DemGlobalFreezeFrameRecordTrigger = DEM_RECORD_TRIGGER_CONFIRMED
        DemGlobalFreezeFrameClassRef = FreezeFrameClass_8de652ca
      FreezeFrameClass_34739cdf (DemFreezeFrameClass): DemDidClassRef=DID_0xF1A0, DemDidClassRef=DID_0xF1A1, DemDidClassRef=DID_0xF1A2, DemDidClassRef=DID_0xF1A3
      DID_0xf1a3_F1A3_Data (DemDataClass):
        DemDataElementDataSize = 2
        DemDataElementDataType = UINT16
        DemDataElementEndianness = BIG_ENDIAN
        DemDataElementUsePort = USE_DATA_CLIENT_SERVER_PORT
        DemDataElementStoreNonVolatile = true
      DID_0xF1A3 (DemDidClass): DemDidIdentifier=61859, DemDidDataClassRef=DID_0xf1a3_F1A3_Data
      DemNvRamBlockId_DEM_PrimaryEntry_3 (DemNvRamBlockId): DemNvRamBlockIdType=DEM_NVBLOCK_PRIMARY, DemNvRamBlockIdIndex=3, DemNvRamBlockIdRef=NvM_DEM_PrimaryEntry_3
      IgnitionCycle (DemOperationCycle): DemOperationCycleType=DEM_OPCYC_IGNITION, DemOperationCycleAutomaticEnd=false, DemOperationCycleAutostart=false
      EnableConditionGroup_KL15_High (DemEnableConditionGroup): DemEnableConditionRef=KL15_High
      KL15_High (DemEnableCondition): DemEnableConditionId=3, DemEnableConditionStatus=false
      DemNvRamBlockId_DEM_AdminData (DemNvRamBlockId): DemNvRamBlockIdType=DEM_NVBLOCK_ADMIN, DemNvRamBlockIdRef=NvM_DEM_AdminData
      DemNvRamBlockId_DEM_PrimaryEntry_4 (DemNvRamBlockId): DemNvRamBlockIdType=DEM_NVBLOCK_PRIMARY, DemNvRamBlockIdIndex=4, DemNvRamBlockIdRef=NvM_DEM_PrimaryEntry_4
