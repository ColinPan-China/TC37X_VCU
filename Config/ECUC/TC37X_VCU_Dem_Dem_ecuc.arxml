[part 1 of 2: package /ActiveEcuC]
AUTOSAR XML (schema 00048)
package /ActiveEcuC
  module config Dem: implementation-config-variant=VARIANT-PRE-COMPILE, module-description=Dem_Impl
    DemConfigSet
      DTCClass_DTC_0x116c05 (DemDTCClass): DemDTCSeverity=DEM_DTC_SEV_NO_SEVERITY, DemUdsDTC=1141765, DemImmediateNvStorage=false
      DTCClass_DTC_0xc20287 (DemDTCClass): DemDTCSeverity=DEM_DTC_SEV_NO_SEVERITY, DemUdsDTC=12714631, DemImmediateNvStorage=false
      3 x DemEventParameter, all with DemEventKind=DEM_EVENT_KIND_SWC, DemEventTimeSeries=DEM_TIMESERIES_SNAPSHOT_NONE, DemEventAvailable=true, DemEventAvailableInVariant=true, DemEventLatchTestFailed=false, DemEventCreateInfoPort=true, DemExtendedDataClassRef=ExtendedDataClass_83dcefb7, DemFreezeFrameClassRef=FreezeFrameClass_5f5b5001, DemFreezeFrameRecNumClassRef=FreezeFrameRecNumClass_f98c8aa7:
        DTC_0x111252: DemEventId=29, DemDTCClassRef=DTCClass_DTC_0x111252
          DemEventClass:
            DemAgingAllowed = true
            DemAgingCycleCounterThreshold = 40
            DemEventDestination = DEM_DTC_ORIGIN_PRIMARY_MEMORY
            DemEventPriority = 1
            DemEventSignificance = DEM_EVENT_SIGNIFICANCE_FAULT
            DemEventFailureCycleCounterThreshold = 0
            DemConsiderPtoStatus = false
            DemFFPrestorageSupported = false
            DemAgingCycleRef = PowerCycle
            DemEnableConditionGroupRef = EnableConditionGroup_bbe52cb7
            DemOperationCycleRef = PowerCycle
            DemDebounceAlgorithmClass
              DemDebounceCounterBased:
                DemDebounceCounterDecrementStepSize = 1
                DemDebounceCounterIncrementStepSize = 1
                DemDebounceCounterJumpDown = false
                DemDebounceCounterJumpUp = true
                DemDebounceBehavior = DEM_DEBOUNCE_FREEZE
                DemDebounceCounterFailedThreshold = 127
                DemDebounceCounterJumpDownValue = 0
                DemDebounceCounterJumpUpValue = 0
                DemDebounceCounterPassedThreshold = -128
                DemDebounceCounterStorage = false
                DemDebounceContinuous = false
            IndicatorAttribute_WarningIndicator (DemIndicatorAttribute):
              DemIndicatorFailureCycleSource = DEM_FAILURE_CYCLE_EVENT
              DemIndicatorBehaviour = DEM_INDICATOR_CONTINUOUS
              DemIndicatorHealingCycleCounterThreshold = 3
              DemIndicatorHealingCycleRef = PowerCycle
              DemIndicatorRef = WarningIndicator
        DTC_0x113797: DemEventId=37, DemDTCClassRef=DTCClass_DTC_0x113797
          DemEventClass:
            DemAgingAllowed = true
            DemAgingCycleCounterThreshold = 40
            DemEventDestination = DEM_DTC_ORIGIN_PRIMARY_MEMORY
            DemEventPriority = 1
            DemEventSignificance = DEM_EVENT_SIGNIFICANCE_FAULT
            DemEventFailureCycleCounterThreshold = 0
            DemConsiderPtoStatus = false
            DemFFPrestorageSupported = false
            DemAgingCycleRef = PowerCycle
            DemEnableConditionGroupRef = EnableConditionGroup_fdfec498
            DemOperationCycleRef = PowerCycle
            DemDebounceAlgorithmClass
              DemDebounceCounterBased:
                DemDebounceCounterDecrementStepSize = 1
                DemDebounceCounterIncrementStepSize = 1
                DemDebounceCounterJumpDown = false
                DemDebounceCounterJumpUp = true
                DemDebounceBehavior = DEM_DEBOUNCE_FREEZE
                DemDebounceCounterFailedThreshold = 127
                DemDebounceCounterJumpDownValue = 0
                DemDebounceCounterJumpUpValue = 0
                DemDebounceCounterPassedThreshold = -128
                DemDebounceCounterStorage = false
                DemDebounceContinuous = false
            IndicatorAttribute_WarningIndicator (DemIndicatorAttribute):
              DemIndicatorFailureCycleSource = DEM_FAILURE_CYCLE_EVENT
              DemIndicatorBehaviour = DEM_INDICATOR_CONTINUOUS
              DemIndicatorHealingCycleCounterThreshold = 3
              DemIndicatorHealingCycleRef = PowerCycle
              DemIndicatorRef = WarningIndicator
        DTC_0xc20787: DemEventId=102, DemDTCClassRef=DTCClass_DTC_0xc20787
          DemEventClass:
            DemAgingAllowed = true
            DemAgingCycleCounterThreshold = 40
            DemEventDestination = DEM_DTC_ORIGIN_PRIMARY_MEMORY
            DemEventPriority = 2
            DemEventSignificance = DEM_EVENT_SIGNIFICANCE_FAULT
            DemEventFailureCycleCounterThreshold = 0
            DemConsiderPtoStatus = false
            DemFFPrestorageSupported = false
            DemAgingCycleRef = PowerCycle
            DemEnableConditionGroupRef = EnableConditionGroup_4ffb066f
            DemOperationCycleRef = PowerCycle
            DemDebounceAlgorithmClass
              DemDebounceCounterBased:
                DemDebounceCounterDecrementStepSize = 1
                DemDebounceCounterIncrementStepSize = 1
                DemDebounceCounterJumpDown = false
                DemDebounceCounterJumpUp = true
                DemDebounceBehavior = DEM_DEBOUNCE_FREEZE
                DemDebounceCounterFailedThreshold = 127
                DemDebounceCounterJumpDownValue = 0
                DemDebounceCounterJumpUpValue = 0
                DemDebounceCounterPassedThreshold = -128
                DemDebounceCounterStorage = false
                DemDebounceContinuous = false
            IndicatorAttribute_WarningIndicator (DemIndicatorAttribute):
              DemIndicatorFailureCycleSource = DEM_FAILURE_CYCLE_EVENT
              DemIndicatorBehaviour = DEM_INDICATOR_CONTINUOUS
              DemIndicatorHealingCycleCounterThreshold = 3
              DemIndicatorHealingCycleRef = PowerCycle
              DemIndicatorRef = WarningIndicator
      DTCClass_DTC_0x117405 (DemDTCClass): DemDTCSeverity=DEM_DTC_SEV_NO_SEVERITY, DemUdsDTC=1143813, DemImmediateNvStorage=false
      3 x DemEventParameter, all with DemEventKind=DEM_EVENT_KIND_SWC, DemEventTimeSeries=DEM_TIMESERIES_SNAPSHOT_NONE, DemEventAvailable=true, DemEventAvailableInVariant=true, DemEventLatchTestFailed=false, DemEventCreateInfoPort=true, DemExtendedDataClassRef=ExtendedDataClass_83dcefb7, DemFreezeFrameRecNumClassRef=FreezeFrameRecNumClass_f98c8aa7:
        DTC_0xc19687: DemEventId=96, DemDTCClassRef=DTCClass_DTC_0xc19687, DemFreezeFrameClassRef=FreezeFrameClass_5f5b5001
          DemEventClass:
            DemAgingAllowed = true
            DemAgingCycleCounterThreshold = 40
            DemEventDestination = DEM_DTC_ORIGIN_PRIMARY_MEMORY
            DemEventPriority = 2
            DemEventSignificance = DEM_EVENT_SIGNIFICANCE_FAULT
            DemEventFailureCycleCounterThreshold = 0
            DemConsiderPtoStatus = false
            DemFFPrestorageSupported = false
            DemAgingCycleRef = PowerCycle
            DemEnableConditionGroupRef = EnableConditionGroup_f3616881
            DemOperationCycleRef = PowerCycle
            DemDebounceAlgorithmClass
              DemDebounceCounterBased:
                DemDebounceCounterDecrementStepSize = 1
                DemDebounceCounterIncrementStepSize = 1
                DemDebounceCounterJumpDown = false
                DemDebounceCounterJumpUp = true
                DemDebounceBehavior = DEM_DEBOUNCE_FREEZE
                DemDebounceCounterFailedThreshold = 127
                DemDebounceCounterJumpDownValue = 0
                DemDebounceCounterJumpUpValue = 0
                DemDebounceCounterPassedThreshold = -128
                DemDebounceCounterStorage = false
                DemDebounceContinuous = false
            IndicatorAttribute_WarningIndicator (DemIndicatorAttribute):
              DemIndicatorFailureCycleSource = DEM_FAILURE_CYCLE_EVENT
              DemIndicatorBehaviour = DEM_INDICATOR_CONTINUOUS
              DemIndicatorHealingCycleCounterThreshold = 3
              DemIndicatorHealingCycleRef = PowerCycle
              DemIndicatorRef = WarningIndicator
        DTC_0x11571e: DemEventId=20, DemDTCClassRef=DTCClass_DTC_0x11571e, DemFreezeFrameClassRef=FreezeFrameClass_de0e94c2
          DemEventClass:
            DemAgingAllowed = true
            DemAgingCycleCounterThreshold = 40
            DemEventDestination = DEM_DTC_ORIGIN_PRIMARY_MEMORY
            DemEventPriority = 1
            DemEventSignificance = DEM_EVENT_SIGNIFICANCE_FAULT
            DemEventFailureCycleCounterThreshold = 0
            DemConsiderPtoStatus = false
            DemFFPrestorageSupported = false
            DemAgingCycleRef = PowerCycle
            DemEnableConditionGroupRef = EnableConditionGroup_bbe52cb7
            DemOperationCycleRef = PowerCycle
            DemDebounceAlgorithmClass
              DemDebounceCounterBased:
                DemDebounceCounterDecrementStepSize = 1
                DemDebounceCounterIncrementStepSize = 1
                DemDebounceCounterJumpDown = false
                DemDebounceCounterJumpUp = true
                DemDebounceBehavior = DEM_DEBOUNCE_FREEZE
                DemDebounceCounterFailedThreshold = 127
                DemDebounceCounterJumpDownValue = 0
                DemDebounceCounterJumpUpValue = 0
                DemDebounceCounterPassedThreshold = -128
                DemDebounceCounterStorage = false
                DemDebounceContinuous = false
            IndicatorAttribute_WarningIndicator (DemIndicatorAttribute):
              DemIndicatorFailureCycleSource = DEM_FAILURE_CYCLE_EVENT
              DemIndicatorBehaviour = DEM_INDICATOR_CONTINUOUS
              DemIndicatorHealingCycleCounterThreshold = 3
              DemIndicatorHealingCycleRef = PowerCycle
              DemIndicatorRef = WarningIndicator
        DTC_0x115292: DemEventId=52, DemDTCClassRef=DTCClass_DTC_0x115292, DemFreezeFrameClassRef=FreezeFrameClass_c715a583
          DemEventClass:
            DemAgingAllowed = true
            DemAgingCycleCounterThreshold = 40
            DemEventDestination = DEM_DTC_ORIGIN_PRIMARY_MEMORY
            DemEventPriority = 1
            DemEventSignificance = DEM_EVENT_SIGNIFICANCE_FAULT
            DemEventFailureCycleCounterThreshold = 0
            DemConsiderPtoStatus = false
            DemFFPrestorageSupported = false
            DemAgingCycleRef = PowerCycle
            DemEnableConditionGroupRef = EnableConditionGroup_fdfec498
            DemOperationCycleRef = PowerCycle
            DemDebounceAlgorithmClass
              DemDebounceCounterBased:
                DemDebounceCounterDecrementStepSize = 1
                DemDebounceCounterIncrementStepSize = 1
                DemDebounceCounterJumpDown = false
                DemDebounceCounterJumpUp = true
                DemDebounceBehavior = DEM_DEBOUNCE_FREEZE
                DemDebounceCounterFailedThreshold = 127
                DemDebounceCounterJumpDownValue = 0
                DemDebounceCounterJumpUpValue = 0
                DemDebounceCounterPassedThreshold = -128
                DemDebounceCounterStorage = false
                DemDebounceContinuous = false
            IndicatorAttribute_WarningIndicator (DemIndicatorAttribute):
              DemIndicatorFailureCycleSource = DEM_FAILURE_CYCLE_EVENT
              DemIndicatorBehaviour = DEM_INDICATOR_CONTINUOUS
              DemIndicatorHealingCycleCounterThreshold = 3
              DemIndicatorHealingCycleRef = PowerCycle
              DemIndicatorRef = WarningIndicator
      DTCClass_DTC_0x110211 (DemDTCClass): DemDTCSeverity=DEM_DTC_SEV_NO_SEVERITY, DemUdsDTC=1114641, DemImmediateNvStorage=false
      DTC_0xc29a00 (DemEventParameter):
        DemEventKind = DEM_EVENT_KIND_SWC
        DemEventTimeSeries = DEM_TIMESERIES_SNAPSHOT_NONE
        DemEventAvailable = true
        DemEventId = 83
        DemEventAvailableInVariant = true
        DemEventLatchTestFailed = false
        DemEventCreateInfoPort = true
        DemDTCClassRef = DTCClass_DTC_0xc29a00
        DemExtendedDataClassRef = ExtendedDataClass_83dcefb7
        DemFreezeFrameClassRef = FreezeFrameClass_5f5b5001
        DemFreezeFrameRecNumClassRef = FreezeFrameRecNumClass_f98c8aa7
        DemEventClass:
          DemAgingAllowed = true
          DemAgingCycleCounterThreshold = 40
          DemEventDestination = DEM_DTC_ORIGIN_PRIMARY_MEMORY
          DemEventPriority = 2
          DemEventSignificance = DEM_EVENT_SIGNIFICANCE_FAULT
          DemEventFailureCycleCounterThreshold = 0
          DemConsiderPtoStatus = false
          DemFFPrestorageSupported = false
          DemAgingCycleRef = PowerCycle
          DemEnableConditionGroupRef = EnableConditionGroup_4ffb066f
          DemOperationCycleRef = PowerCycle
          DemDebounceAlgorithmClass
            DemDebounceCounterBased:
              DemDebounceCounterDecrementStepSize = 1
              DemDebounceCounterIncrementStepSize = 1
              DemDebounceCounterJumpDown = false
              DemDebounceCounterJumpUp = true
              DemDebounceBehavior = DEM_DEBOUNCE_FREEZE
              DemDebounceCounterFailedThreshold = 127
              DemDebounceCounterJumpDownValue = 0
              DemDebounceCounterJumpUpValue = 0
              DemDebounceCounterPassedThreshold = -128
              DemDebounceCounterStorage = false
              DemDebounceContinuous = false
          IndicatorAttribute_WarningIndicator (DemIndicatorAttribute):
            DemIndicatorFailureCycleSource = DEM_FAILURE_CYCLE_EVENT
            DemIndicatorBehaviour = DEM_INDICATOR_CONTINUOUS
            DemIndicatorHealingCycleCounterThreshold = 3
            DemIndicatorHealingCycleRef = PowerCycle
            DemIndicatorRef = WarningIndicator
      DTCClass_DTC_0x114497 (DemDTCClass): DemDTCSeverity=DEM_DTC_SEV_NO_SEVERITY, DemUdsDTC=1131671, DemImmediateNvStorage=false
      DTC_0xd10587 (DemEventParameter):
        DemEventKind = DEM_EVENT_KIND_SWC
        DemEventTimeSeries = DEM_TIMESERIES_SNAPSHOT_NONE
        DemEventAvailable = true
        DemEventId = 105
        DemEventAvailableInVariant = true
        DemEventLatchTestFailed = false
        DemEventCreateInfoPort = true
        DemDTCClassRef = DTCClass_DTC_0xd10587
        DemExtendedDataClassRef = ExtendedDataClass_83dcefb7
        DemFreezeFrameClassRef = FreezeFrameClass_5f5b5001
        DemFreezeFrameRecNumClassRef = FreezeFrameRecNumClass_f98c8aa7
        DemEventClass:
          DemAgingAllowed = true
          DemAgingCycleCounterThreshold = 40
          DemEventDestination = DEM_DTC_ORIGIN_PRIMARY_MEMORY
          DemEventPriority = 2
          DemEventSignificance = DEM_EVENT_SIGNIFICANCE_FAULT
          DemEventFailureCycleCounterThreshold = 0
          DemConsiderPtoStatus = false
          DemFFPrestorageSupported = false
          DemAgingCycleRef = PowerCycle
          DemEnableConditionGroupRef = EnableConditionGroup_35324f44
          DemOperationCycleRef = PowerCycle
          DemDebounceAlgorithmClass
            DemDebounceCounterBased:
              DemDebounceCounterDecrementStepSize = 1
              DemDebounceCounterIncrementStepSize = 1
              DemDebounceCounterJumpDown = false
              DemDebounceCounterJumpUp = true
              DemDebounceBehavior = DEM_DEBOUNCE_FREEZE
              DemDebounceCounterFailedThreshold = 127
              DemDebounceCounterJumpDownValue = 0
              DemDebounceCounterJumpUpValue = 0
              DemDebounceCounterPassedThreshold = -128
              DemDebounceCounterStorage = false
              DemDebounceContinuous = false
          IndicatorAttribute_WarningIndicator (DemIndicatorAttribute):
            DemIndicatorFailureCycleSource = DEM_FAILURE_CYCLE_EVENT
            DemIndicatorBehaviour = DEM_INDICATOR_CONTINUOUS
            DemIndicatorHealingCycleCounterThreshold = 3
            DemIndicatorHealingCycleRef = PowerCycle
            DemIndicatorRef = WarningIndicator
      DTCClass_DTC_0xc19b87 (DemDTCClass): DemDTCSeverity=DEM_DTC_SEV_NO_SEVERITY, DemUdsDTC=12688263, DemImmediateNvStorage=false
      3 x DemEventParameter, all with DemEventKind=DEM_EVENT_KIND_SWC, DemEventTimeSeries=DEM_TIMESERIES_SNAPSHOT_NONE, DemEventAvailable=true, DemEventAvailableInVariant=true, DemEventLatchTestFailed=false, DemEventCreateInfoPort=true, DemExtendedDataClassRef=ExtendedDataClass_83dcefb7, DemFreezeFrameClassRef=FreezeFrameClass_5f5b5001, DemFreezeFrameRecNumClassRef=FreezeFrameRecNumClass_f98c8aa7:
        DTC_0xc16b87: DemEventId=81, DemDTCClassRef=DTCClass_DTC_0xc16b87
          DemEventClass:
            DemAgingAllowed = true
            DemAgingCycleCounterThreshold = 40
            DemEventDestination = DEM_DTC_ORIGIN_PRIMARY_MEMORY
            DemEventPriority = 2
            DemEventSignificance = DEM_EVENT_SIGNIFICANCE_FAULT
            DemEventFailureCycleCounterThreshold = 0
            DemConsiderPtoStatus = false
            DemFFPrestorageSupported = false
            DemAgingCycleRef = PowerCycle
            DemEnableConditionGroupRef = EnableConditionGroup_f3616881
            DemOperationCycleRef = PowerCycle
            DemDebounceAlgorithmClass
              DemDebounceCounterBased:
                DemDebounceCounterDecrementStepSize = 1
                DemDebounceCounterIncrementStepSize = 1
                DemDebounceCounterJumpDown = false
                DemDebounceCounterJumpUp = true
                DemDebounceBehavior = DEM_DEBOUNCE_FREEZE
                DemDebounceCounterFailedThreshold = 127
                DemDebounceCounterJumpDownValue = 0
                DemDebounceCounterJumpUpValue = 0
                DemDebounceCounterPassedThreshold = -128
                DemDebounceCounterStorage = false
                DemDebounceContinuous = false
            IndicatorAttribute_WarningIndicator (DemIndicatorAttribute):
              DemIndicatorFailureCycleSource = DEM_FAILURE_CYCLE_EVENT
              DemIndicatorBehaviour = DEM_INDICATOR_CONTINUOUS
              DemIndicatorHealingCycleCounterThreshold = 3
              DemIndicatorHealingCycleRef = PowerCycle
              DemIndicatorRef = WarningIndicator
        DTC_0x908356: DemEventId=79, DemDTCClassRef=DTCClass_DTC_0x908356
          DemEventClass:
            DemAgingAllowed = true
            DemAgingCycleCounterThreshold = 40
            DemEventDestination = DEM_DTC_ORIGIN_PRIMARY_MEMORY
            DemEventPriority = 2
            DemEventSignificance = DEM_EVENT_SIGNIFICANCE_FAULT
            DemEventFailureCycleCounterThreshold = 0
            DemConsiderPtoStatus = false
            DemFFPrestorageSupported = false
            DemAgingCycleRef = PowerCycle
            DemEnableConditionGroupRef = EnableConditionGroup_bbe52cb7
            DemOperationCycleRef = PowerCycle
            DemDebounceAlgorithmClass
              DemDebounceCounterBased:
                DemDebounceCounterDecrementStepSize = 1
                DemDebounceCounterIncrementStepSize = 1
                DemDebounceCounterJumpDown = false
                DemDebounceCounterJumpUp = true
                DemDebounceBehavior = DEM_DEBOUNCE_FREEZE
                DemDebounceCounterFailedThreshold = 127
                DemDebounceCounterJumpDownValue = 0
                DemDebounceCounterJumpUpValue = 0
                DemDebounceCounterPassedThreshold = -128
                DemDebounceCounterStorage = false
                DemDebounceContinuous = false
            IndicatorAttribute_WarningIndicator (DemIndicatorAttribute):
              DemIndicatorFailureCycleSource = DEM_FAILURE_CYCLE_EVENT
              DemIndicatorBehaviour = DEM_INDICATOR_CONTINUOUS
              DemIndicatorHealingCycleCounterThreshold = 3
              DemIndicatorHealingCycleRef = PowerCycle
              DemIndicatorRef = WarningIndicator
        DTC_0x116819: DemEventId=65, DemDTCClassRef=DTCClass_DTC_0x116819
          DemEventClass:
            DemAgingAllowed = true
            DemAgingCycleCounterThreshold = 40
            DemEventDestination = DEM_DTC_ORIGIN_PRIMARY_MEMORY
            DemEventPriority = 2
            DemEventSignificance = DEM_EVENT_SIGNIFICANCE_FAULT
            DemEventFailureCycleCounterThreshold = 0
            DemConsiderPtoStatus = false
            DemFFPrestorageSupported = false
            DemAgingCycleRef = PowerCycle
            DemOperationCycleRef = PowerCycle
            DemDebounceAlgorithmClass
              DemDebounceCounterBased:
                DemDebounceCounterDecrementStepSize = 1
                DemDebounceCounterIncrementStepSize = 1
                DemDebounceCounterJumpDown = false
                DemDebounceCounterJumpUp = true
                DemDebounceBehavior = DEM_DEBOUNCE_FREEZE
                DemDebounceCounterFailedThreshold = 127
                DemDebounceCounterJumpDownValue = 0
                DemDebounceCounterJumpUpValue = 0
                DemDebounceCounterPassedThreshold = -128
                DemDebounceCounterStorage = false
                DemDebounceContinuous = false
            IndicatorAttribute_WarningIndicator (DemIndicatorAttribute):
              DemIndicatorFailureCycleSource = DEM_FAILURE_CYCLE_EVENT
              DemIndicatorBehaviour = DEM_INDICATOR_CONTINUOUS
              DemIndicatorHealingCycleCounterThreshold = 3
              DemIndicatorHealingCycleRef = PowerCycle
              DemIndicatorRef = WarningIndicator
      3 x DemDTCClass, all with DemDTCSeverity=DEM_DTC_SEV_NO_SEVERITY, DemImmediateNvStorage=false:
        DTCClass_DTC_0x115692: DemUdsDTC=1136274
        DTCClass_DTC_0xc19987: DemUdsDTC=12687751
        DTCClass_DTC_0x117197: DemUdsDTC=1143191
      DTC_0x114992 (DemEventParameter):
        DemEventKind = DEM_EVENT_KIND_SWC
        DemEventTimeSeries = DEM_TIMESERIES_SNAPSHOT_NONE
        DemEventAvailable = true
        DemEventId = 49
        DemEventAvailableInVariant = true
        DemEventLatchTestFailed = false
        DemEventCreateInfoPort = true
        DemDTCClassRef = DTCClass_DTC_0x114992
        DemExtendedDataClassRef = ExtendedDataClass_83dcefb7
        DemFreezeFrameClassRef = FreezeFrameClass_5f5b5001
        DemFreezeFrameRecNumClassRef = FreezeFrameRecNumClass_f98c8aa7
        DemEventClass:
          DemAgingAllowed = true
          DemAgingCycleCounterThreshold = 40
          DemEventDestination = DEM_DTC_ORIGIN_PRIMARY_MEMORY
          DemEventPriority = 1
          DemEventSignificance = DEM_EVENT_SIGNIFICANCE_FAULT
          DemEventFailureCycleCounterThreshold = 0
          DemConsiderPtoStatus = false
          DemFFPrestorageSupported = false
          DemAgingCycleRef = PowerCycle
          DemEnableConditionGroupRef = EnableConditionGroup_fdfec498
          DemOperationCycleRef = PowerCycle
          DemDebounceAlgorithmClass
            DemDebounceCounterBased:
              DemDebounceCounterDecrementStepSize = 1
              DemDebounceCounterIncrementStepSize = 1
              DemDebounceCounterJumpDown = false
              DemDebounceCounterJumpUp = true
              DemDebounceBehavior = DEM_DEBOUNCE_FREEZE
              DemDebounceCounterFailedThreshold = 127
              DemDebounceCounterJumpDownValue = 0
              DemDebounceCounterJumpUpValue = 0
              DemDebounceCounterPassedThreshold = -128
              DemDebounceCounterStorage = false
              DemDebounceContinuous = false
          IndicatorAttribute_WarningIndicator (DemIndicatorAttribute):
            DemIndicatorFailureCycleSource = DEM_FAILURE_CYCLE_EVENT
            DemIndicatorBehaviour = DEM_INDICATOR_CONTINUOUS
            DemIndicatorHealingCycleCounterThreshold = 3
            DemIndicatorHealingCycleRef = PowerCycle
            DemIndicatorRef = WarningIndicator
      DTC_0xc14687 (DemEventParameter):
        DemEventKind = DEM_EVENT_KIND_SWC
        DemEventTimeSeries = DEM_TIMESERIES_SNAPSHOT_NONE
        DemEventAvailable = true
        DemEventId = 92
        DemEventAvailableInVariant = true
        DemEventLatchTestFailed = false
        DemEventCreateInfoPort = true
        DemDTCClassRef = DTCClass_DTC_0xc14687
        DemExtendedDataClassRef = ExtendedDataClass_83dcefb7
        DemFreezeFrameClassRef = FreezeFrameClass_5f5b5001
        DemFreezeFrameRecNumClassRef = FreezeFrameRecNumClass_f98c8aa7
        DemEventClass:
          DemAgingAllowed = true
          DemAgingCycleCounterThreshold = 40
          DemEventDestination = DEM_DTC_ORIGIN_PRIMARY_MEMORY
          DemEventPriority = 2
          DemEventSignificance = DEM_EVENT_SIGNIFICANCE_FAULT
          DemEventFailureCycleCounterThreshold = 0
          DemConsiderPtoStatus = false
          DemFFPrestorageSupported = false
          DemAgingCycleRef = PowerCycle
          DemEnableConditionGroupRef = EnableConditionGroup_f3616881
          DemOperationCycleRef = PowerCycle
          DemDebounceAlgorithmClass
            DemDebounceCounterBased:
              DemDebounceCounterDecrementStepSize = 1
              DemDebounceCounterIncrementStepSize = 1
              DemDebounceCounterJumpDown = false
              DemDebounceCounterJumpUp = true
              DemDebounceBehavior = DEM_DEBOUNCE_FREEZE
              DemDebounceCounterFailedThreshold = 127
              DemDebounceCounterJumpDownValue = 0
              DemDebounceCounterJumpUpValue = 0
              DemDebounceCounterPassedThreshold = -128
              DemDebounceCounterStorage = false
              DemDebounceContinuous = false
          IndicatorAttribute_WarningIndicator (DemIndicatorAttribute):
            DemIndicatorFailureCycleSource = DEM_FAILURE_CYCLE_EVENT
            DemIndicatorBehaviour = DEM_INDICATOR_CONTINUOUS
            DemIndicatorHealingCycleCounterThreshold = 3
            DemIndicatorHealingCycleRef = PowerCycle
            DemIndicatorRef = WarningIndicator
      DTCClass_DTC_0x116d05 (DemDTCClass): DemDTCSeverity=DEM_DTC_SEV_NO_SEVERITY, DemUdsDTC=1142021, DemImmediateNvStorage=false
      DTC_0x114197 (DemEventParameter):
        DemEventKind = DEM_EVENT_KIND_SWC
        DemEventTimeSeries = DEM_TIMESERIES_SNAPSHOT_NONE
        DemEventAvailable = true
        DemEventId = 41
        DemEventAvailableInVariant = true
        DemEventLatchTestFailed = false
        DemEventCreateInfoPort = true
        DemDTCClassRef = DTCClass_DTC_0x114197
        DemExtendedDataClassRef = ExtendedDataClass_83dcefb7
        DemFreezeFrameClassRef = FreezeFrameClass_5f5b5001
        DemFreezeFrameRecNumClassRef = FreezeFrameRecNumClass_f98c8aa7
        DemEventClass:
          DemAgingAllowed = true
          DemAgingCycleCounterThreshold = 40
          DemEventDestination = DEM_DTC_ORIGIN_PRIMARY_MEMORY
          DemEventPriority = 1
          DemEventSignificance = DEM_EVENT_SIGNIFICANCE_FAULT
          DemEventFailureCycleCounterThreshold = 0
          DemConsiderPtoStatus = false
          DemFFPrestorageSupported = false
          DemAgingCycleRef = PowerCycle
          DemEnableConditionGroupRef = EnableConditionGroup_983000c1
          DemOperationCycleRef = PowerCycle
          DemDebounceAlgorithmClass
            DemDebounceCounterBased:
              DemDebounceCounterDecrementStepSize = 1
              DemDebounceCounterIncrementStepSize = 1
              DemDebounceCounterJumpDown = false
              DemDebounceCounterJumpUp = true
              DemDebounceBehavior = DEM_DEBOUNCE_FREEZE
              DemDebounceCounterFailedThreshold = 127
              DemDebounceCounterJumpDownValue = 0
              DemDebounceCounterJumpUpValue = 0
              DemDebounceCounterPassedThreshold = -128
              DemDebounceCounterStorage = false
              DemDebounceContinuous = false
          IndicatorAttribute_WarningIndicator (DemIndicatorAttribute):
            DemIndicatorFailureCycleSource = DEM_FAILURE_CYCLE_EVENT
            DemIndicatorBehaviour = DEM_INDICATOR_CONTINUOUS
            DemIndicatorHealingCycleCounterThreshold = 3
            DemIndicatorHealingCycleRef = PowerCycle
            DemIndicatorRef = WarningIndicator
      DTCClass_DTC_0x117511 (DemDTCClass): DemDTCSeverity=DEM_DTC_SEV_NO_SEVERITY, DemUdsDTC=1144081, DemImmediateNvStorage=false
      DTC_0x116494 (DemEventParameter):
        DemEventKind = DEM_EVENT_KIND_SWC
        DemEventTimeSeries = DEM_TIMESERIES_SNAPSHOT_NONE
        DemEventAvailable = true
        DemEventId = 61
        DemEventAvailableInVariant = true
        DemEventLatchTestFailed = false
        DemEventCreateInfoPort = true
        DemDTCClassRef = DTCClass_DTC_0x116494
        DemExtendedDataClassRef = ExtendedDataClass_83dcefb7
        DemFreezeFrameClassRef = FreezeFrameClass_5f5b5001
        DemFreezeFrameRecNumClassRef = FreezeFrameRecNumClass_f98c8aa7
        DemEventClass:
          DemAgingAllowed = true
          DemAgingCycleCounterThreshold = 40
          DemEventDestination = DEM_DTC_ORIGIN_PRIMARY_MEMORY
          DemEventPriority = 2
          DemEventSignificance = DEM_EVENT_SIGNIFICANCE_FAULT
          DemEventFailureCycleCounterThreshold = 0
          DemConsiderPtoStatus = false
          DemFFPrestorageSupported = false
          DemAgingCycleRef = PowerCycle
          DemEnableConditionGroupRef = EnableConditionGroup_fdfec498
          DemOperationCycleRef = PowerCycle
          DemDebounceAlgorithmClass
            DemDebounceCounterBased:
              DemDebounceCounterDecrementStepSize = 1
              DemDebounceCounterIncrementStepSize = 1
              DemDebounceCounterJumpDown = false
              DemDebounceCounterJumpUp = true
              DemDebounceBehavior = DEM_DEBOUNCE_FREEZE
              DemDebounceCounterFailedThreshold = 127
              DemDebounceCounterJumpDownValue = 0
              DemDebounceCounterJumpUpValue = 0
              DemDebounceCounterPassedThreshold = -128
              DemDebounceCounterStorage = false
              DemDebounceContinuous = false
          IndicatorAttribute_WarningIndicator (DemIndicatorAttribute):
            DemIndicatorFailureCycleSource = DEM_FAILURE_CYCLE_EVENT
            DemIndicatorBehaviour = DEM_INDICATOR_CONTINUOUS
            DemIndicatorHealingCycleCounterThreshold = 3
            DemIndicatorHealingCycleRef = PowerCycle
            DemIndicatorRef = WarningIndicator
      3 x DemDTCClass, all with DemDTCSeverity=DEM_DTC_SEV_NO_SEVERITY, DemImmediateNvStorage=false:
        DTCClass_DTC_0x113397: DemUdsDTC=1127319
        DTCClass_DTC_0x110311: DemUdsDTC=1114897
        DTCClass_DTC_0x117b94: DemUdsDTC=1145748
      DTC_0x117819 (DemEventParameter):
        DemEventKind = DEM_EVENT_KIND_SWC
        DemEventTimeSeries = DEM_TIMESERIES_SNAPSHOT_NONE
        DemEventAvailable = true
        DemEventId = 75
        DemEventAvailableInVariant = true
        DemEventLatchTestFailed = false
        DemEventCreateInfoPort = true
        DemDTCClassRef = DTCClass_DTC_0x117819
        DemExtendedDataClassRef = ExtendedDataClass_83dcefb7
        DemFreezeFrameClassRef = FreezeFrameClass_5f5b5001
        DemFreezeFrameRecNumClassRef = FreezeFrameRecNumClass_f98c8aa7
        DemEventClass:
          DemAgingAllowed = true
          DemAgingCycleCounterThreshold = 40
          DemEventDestination = DEM_DTC_ORIGIN_PRIMARY_MEMORY
          DemEventPriority = 2
          DemEventSignificance = DEM_EVENT_SIGNIFICANCE_FAULT
          DemEventFailureCycleCounterThreshold = 0
          DemConsiderPtoStatus = false
          DemFFPrestorageSupported = false
          DemAgingCycleRef = PowerCycle
          DemOperationCycleRef = PowerCycle
          DemDebounceAlgorithmClass
            DemDebounceCounterBased:
              DemDebounceCounterDecrementStepSize = 1
              DemDebounceCounterIncrementStepSize = 1
              DemDebounceCounterJumpDown = false
              DemDebounceCounterJumpUp = true
              DemDebounceBehavior = DEM_DEBOUNCE_FREEZE
              DemDebounceCounterFailedThreshold = 127
              DemDebounceCounterJumpDownValue = 0
              DemDebounceCounterJumpUpValue = 0
              DemDebounceCounterPassedThreshold = -128
              DemDebounceCounterStorage = false
              DemDebounceContinuous = false
          IndicatorAttribute_WarningIndicator (DemIndicatorAttribute):
            DemIndicatorFailureCycleSource = DEM_FAILURE_CYCLE_EVENT
            DemIndicatorBehaviour = DEM_INDICATOR_CONTINUOUS
            DemIndicatorHealingCycleCounterThreshold = 3
            DemIndicatorHealingCycleRef = PowerCycle
            DemIndicatorRef = WarningIndicator
      DTCClass_DTC_0x116097 (DemDTCClass): DemDTCSeverity=DEM_DTC_SEV_NO_SEVERITY, DemUdsDTC=1138839, DemImmediateNvStorage=false
      DTC_0x111152 (DemEventParameter):
        DemEventKind = DEM_EVENT_KIND_SWC
        DemEventTimeSeries = DEM_TIMESERIES_SNAPSHOT_NONE
        DemEventAvailable = true
        DemEventId = 28
        DemEventAvailableInVariant = true
        DemEventLatchTestFailed = false
        DemEventCreateInfoPort = true
        DemDTCClassRef = DTCClass_DTC_0x111152
        DemExtendedDataClassRef = ExtendedDataClass_83dcefb7
        DemFreezeFrameClassRef = FreezeFrameClass_5f5b5001
        DemFreezeFrameRecNumClassRef = FreezeFrameRecNumClass_f98c8aa7
        DemEventClass:
          DemAgingAllowed = true
          DemAgingCycleCounterThreshold = 40
          DemEventDestination = DEM_DTC_ORIGIN_PRIMARY_MEMORY
          DemEventPriority = 1
          DemEventSignificance = DEM_EVENT_SIGNIFICANCE_FAULT
          DemEventFailureCycleCounterThreshold = 0
          DemConsiderPtoStatus = false
          DemFFPrestorageSupported = false
          DemAgingCycleRef = PowerCycle
          DemEnableConditionGroupRef = EnableConditionGroup_bbe52cb7
          DemOperationCycleRef = PowerCycle
          DemDebounceAlgorithmClass
            DemDebounceCounterBased:
              DemDebounceCounterDecrementStepSize = 1
              DemDebounceCounterIncrementStepSize = 1
              DemDebounceCounterJumpDown = false
              DemDebounceCounterJumpUp = true
              DemDebounceBehavior = DEM_DEBOUNCE_FREEZE
              DemDebounceCounterFailedThreshold = 127
              DemDebounceCounterJumpDownValue = 0
              DemDebounceCounterJumpUpValue = 0
              DemDebounceCounterPassedThreshold = -128
              DemDebounceCounterStorage = false
              DemDebounceContinuous = false
          IndicatorAttribute_WarningIndicator (DemIndicatorAttribute):
            DemIndicatorFailureCycleSource = DEM_FAILURE_CYCLE_EVENT
            DemIndicatorBehaviour = DEM_INDICATOR_CONTINUOUS
            DemIndicatorHealingCycleCounterThreshold = 3
            DemIndicatorHealingCycleRef = PowerCycle
            DemIndicatorRef = WarningIndicator
      DTCClass_DTC_0xc16687 (DemDTCClass): DemDTCSeverity=DEM_DTC_SEV_NO_SEVERITY, DemUdsDTC=12674695, DemImmediateNvStorage=false
      DTC_0xc11187 (DemEventParameter):
        DemEventKind = DEM_EVENT_KIND_SWC
        DemEventTimeSeries = DEM_TIMESERIES_SNAPSHOT_NONE
        DemEventAvailable = true
        DemEventId = 89
        DemEventAvailableInVariant = true
        DemEventLatchTestFailed = false
        DemEventCreateInfoPort = true
        DemDTCClassRef = DTCClass_DTC_0xc11187
        DemExtendedDataClassRef = ExtendedDataClass_83dcefb7
        DemFreezeFrameClassRef = FreezeFrameClass_5f5b5001
        DemFreezeFrameRecNumClassRef = FreezeFrameRecNumClass_f98c8aa7
        DemEventClass:
          DemAgingAllowed = true
          DemAgingCycleCounterThreshold = 40
          DemEventDestination = DEM_DTC_ORIGIN_PRIMARY_MEMORY
          DemEventPriority = 1
          DemEventSignificance = DEM_EVENT_SIGNIFICANCE_FAULT
          DemEventFailureCycleCounterThreshold = 0
          DemConsiderPtoStatus = false
          DemFFPrestorageSupported = false
          DemAgingCycleRef = PowerCycle
          DemEnableConditionGroupRef = EnableConditionGroup_f3616881
          DemOperationCycleRef = PowerCycle
          DemDebounceAlgorithmClass
            DemDebounceCounterBased:
              DemDebounceCounterDecrementStepSize = 1
              DemDebounceCounterIncrementStepSize = 1
              DemDebounceCounterJumpDown = false
              DemDebounceCounterJumpUp = true
              DemDebounceBehavior = DEM_DEBOUNCE_FREEZE
              DemDebounceCounterFailedThreshold = 127
              DemDebounceCounterJumpDownValue = 0
              DemDebounceCounterJumpUpValue = 0
              DemDebounceCounterPassedThreshold = -128
              DemDebounceCounterStorage = false
              DemDebounceContinuous = false
          IndicatorAttribute_WarningIndicator (DemIndicatorAttribute):
            DemIndicatorFailureCycleSource = DEM_FAILURE_CYCLE_EVENT
            DemIndicatorBehaviour = DEM_INDICATOR_CONTINUOUS
            DemIndicatorHealingCycleCounterThreshold = 3
            DemIndicatorHealingCycleRef = PowerCycle
            DemIndicatorRef = WarningIndicator
      DTCClass_DTC_0x117f08 (DemDTCClass): DemDTCSeverity=DEM_DTC_SEV_NO_SEVERITY, DemUdsDTC=1146632, DemImmediateNvStorage=false
      DTC_0x113697 (DemEventParameter):
        DemEventKind = DEM_EVENT_KIND_SWC
        DemEventTimeSeries = DEM_TIMESERIES_SNAPSHOT_NONE
        DemEventAvailable = true
        DemEventId = 36
        DemEventAvailableInVariant = true
        DemEventLatchTestFailed = false
        DemEventCreateInfoPort = true
        DemDTCClassRef = DTCClass_DTC_0x113697
        DemExtendedDataClassRef = ExtendedDataClass_83dcefb7
        DemFreezeFrameClassRef = FreezeFrameClass_c715a583
        DemFreezeFrameRecNumClassRef = FreezeFrameRecNumClass_f98c8aa7
        DemEventClass:
          DemAgingAllowed = true
          DemAgingCycleCounterThreshold = 40
          DemEventDestination = DEM_DTC_ORIGIN_PRIMARY_MEMORY
          DemEventPriority = 1
          DemEventSignificance = DEM_EVENT_SIGNIFICANCE_FAULT
          DemEventFailureCycleCounterThreshold = 0
          DemConsiderPtoStatus = false
          DemFFPrestorageSupported = false
          DemAgingCycleRef = PowerCycle
          DemEnableConditionGroupRef = EnableConditionGroup_fdfec498
          DemOperationCycleRef = PowerCycle
          DemDebounceAlgorithmClass
            DemDebounceCounterBased:
              DemDebounceCounterDecrementStepSize = 1
              DemDebounceCounterIncrementStepSize = 1
              DemDebounceCounterJumpDown = false
              DemDebounceCounterJumpUp = true
              DemDebounceBehavior = DEM_DEBOUNCE_FREEZE
              DemDebounceCounterFailedThreshold = 127
              DemDebounceCounterJumpDownValue = 0
              DemDebounceCounterJumpUpValue = 0
              DemDebounceCounterPassedThreshold = -128
              DemDebounceCounterStorage = false
              DemDebounceContinuous = false
          IndicatorAttribute_WarningIndicator (DemIndicatorAttribute):
            DemIndicatorFailureCycleSource = DEM_FAILURE_CYCLE_EVENT
            DemIndicatorBehaviour = DEM_INDICATOR_CONTINUOUS
            DemIndicatorHealingCycleCounterThreshold = 3
            DemIndicatorHealingCycleRef = PowerCycle
            DemIndicatorRef = WarningIndicator
      DTCClass_DTC_0xc10f87 (DemDTCClass): DemDTCSeverity=DEM_DTC_SEV_NO_SEVERITY, DemUdsDTC=12652423, DemImmediateNvStorage=false
      DTC_0x115192 (DemEventParameter):
        DemEventKind = DEM_EVENT_KIND_SWC
        DemEventTimeSeries = DEM_TIMESERIES_SNAPSHOT_NONE
        DemEventAvailable = true
        DemEventId = 51
        DemEventAvailableInVariant = true
        DemEventLatchTestFailed = false
        DemEventCreateInfoPort = true
        DemDTCClassRef = DTCClass_DTC_0x115192
        DemExtendedDataClassRef = ExtendedDataClass_83dcefb7
        DemFreezeFrameClassRef = FreezeFrameClass_5f5b5001
        DemFreezeFrameRecNumClassRef = FreezeFrameRecNumClass_f98c8aa7
        DemEventClass:
          DemAgingAllowed = true
          DemAgingCycleCounterThreshold = 40
          DemEventDestination = DEM_DTC_ORIGIN_PRIMARY_MEMORY
          DemEventPriority = 2
          DemEventSignificance = DEM_EVENT_SIGNIFICANCE_FAULT
          DemEventFailureCycleCounterThreshold = 0
          DemConsiderPtoStatus = false
          DemFFPrestorageSupported = false
          DemAgingCycleRef = PowerCycle
          DemEnableConditionGroupRef = EnableConditionGroup_fdfec498
          DemOperationCycleRef = PowerCycle
          DemDebounceAlgorithmClass
            DemDebounceCounterBased:
              DemDebounceCounterDecrementStepSize = 1
              DemDebounceCounterIncrementStepSize = 1
              DemDebounceCounterJumpDown = false
              DemDebounceCounterJumpUp = true
              DemDebounceBehavior = DEM_DEBOUNCE_FREEZE
              DemDebounceCounterFailedThreshold = 127
              DemDebounceCounterJumpDownValue = 0
              DemDebounceCounterJumpUpValue = 0
              DemDebounceCounterPassedThreshold = -128
              DemDebounceCounterStorage = false
              DemDebounceContinuous = false
          IndicatorAttribute_WarningIndicator (DemIndicatorAttribute):
            DemIndicatorFailureCycleSource = DEM_FAILURE_CYCLE_EVENT
            DemIndicatorBehaviour = DEM_INDICATOR_CONTINUOUS
            DemIndicatorHealingCycleCounterThreshold = 3
            DemIndicatorHealingCycleRef = PowerCycle
            DemIndicatorRef = WarningIndicator
      DTCClass_DTC_0x116a96 (DemDTCClass): DemDTCSeverity=DEM_DTC_SEV_NO_SEVERITY, DemUdsDTC=1141398, DemImmediateNvStorage=false
      DTCClass_DTC_0x117617 (DemDTCClass): DemDTCSeverity=DEM_DTC_SEV_NO_SEVERITY, DemUdsDTC=1144343, DemImmediateNvStorage=false
      DTC_0x116716 (DemEventParameter):
        DemEventKind = DEM_EVENT_KIND_SWC
        DemEventTimeSeries = DEM_TIMESERIES_SNAPSHOT_NONE
        DemEventAvailable = true
        DemEventId = 64
        DemEventAvailableInVariant = true
        DemEventLatchTestFailed = false
        DemEventCreateInfoPort = true
        DemDTCClassRef = DTCClass_DTC_0x116716
        DemExtendedDataClassRef = ExtendedDataClass_83dcefb7
        DemFreezeFrameClassRef = FreezeFrameClass_5f5b5001
        DemFreezeFrameRecNumClassRef = FreezeFrameRecNumClass_f98c8aa7
        DemEventClass:
          DemAgingAllowed = true
          DemAgingCycleCounterThreshold = 40
          DemEventDestination = DEM_DTC_ORIGIN_PRIMARY_MEMORY
          DemEventPriority = 1
          DemEventSignificance = DEM_EVENT_SIGNIFICANCE_FAULT
          DemEventFailureCycleCounterThreshold = 0
          DemConsiderPtoStatus = false
          DemFFPrestorageSupported = false
          DemAgingCycleRef = PowerCycle
          DemOperationCycleRef = PowerCycle
          DemDebounceAlgorithmClass
            DemDebounceCounterBased:
              DemDebounceCounterDecrementStepSize = 1
              DemDebounceCounterIncrementStepSize = 1
              DemDebounceCounterJumpDown = false
              DemDebounceCounterJumpUp = true
              DemDebounceBehavior = DEM_DEBOUNCE_FREEZE
              DemDebounceCounterFailedThreshold = 127
              DemDebounceCounterJumpDownValue = 0
              DemDebounceCounterJumpUpValue = 0
              DemDebounceCounterPassedThreshold = -128
              DemDebounceCounterStorage = false
              DemDebounceContinuous = false
          IndicatorAttribute_WarningIndicator (DemIndicatorAttribute):
            DemIndicatorFailureCycleSource = DEM_FAILURE_CYCLE_EVENT
            DemIndicatorBehaviour = DEM_INDICATOR_CONTINUOUS
            DemIndicatorHealingCycleCounterThreshold = 3
            DemIndicatorHealingCycleRef = PowerCycle
            DemIndicatorRef = WarningIndicator
      3 x DemDTCClass, all with DemDTCSeverity=DEM_DTC_SEV_NO_SEVERITY, DemImmediateNvStorage=false:
        DTCClass_DTC_0xc29887: DemUdsDTC=12753031
        DTCClass_DTC_0xc20700: DemUdsDTC=12715776
        DTCClass_DTC_0x117a4c: DemUdsDTC=1145420
      DTC_0x114892 (DemEventParameter):
        DemEventKind = DEM_EVENT_KIND_SWC
        DemEventTimeSeries = DEM_TIMESERIES_SNAPSHOT_NONE
        DemEventAvailable = true
        DemEventId = 48
        DemEventAvailableInVariant = true
        DemEventLatchTestFailed = false
        DemEventCreateInfoPort = true
        DemDTCClassRef = DTCClass_DTC_0x114892
        DemExtendedDataClassRef = ExtendedDataClass_83dcefb7
        DemFreezeFrameClassRef = FreezeFrameClass_c715a583
        DemFreezeFrameRecNumClassRef = FreezeFrameRecNumClass_f98c8aa7
        DemEventClass:
          DemAgingAllowed = true
          DemAgingCycleCounterThreshold = 40
          DemEventDestination = DEM_DTC_ORIGIN_PRIMARY_MEMORY
          DemEventPriority = 1
          DemEventSignificance = DEM_EVENT_SIGNIFICANCE_FAULT
          DemEventFailureCycleCounterThreshold = 0
          DemConsiderPtoStatus = false
          DemFFPrestorageSupported = false
          DemAgingCycleRef = PowerCycle
          DemEnableConditionGroupRef = EnableConditionGroup_fdfec498
          DemOperationCycleRef = PowerCycle
          DemDebounceAlgorithmClass
            DemDebounceCounterBased:
              DemDebounceCounterDecrementStepSize = 1
              DemDebounceCounterIncrementStepSize = 1
              DemDebounceCounterJumpDown = false
              DemDebounceCounterJumpUp = true
              DemDebounceBehavior = DEM_DEBOUNCE_FREEZE
              DemDebounceCounterFailedThreshold = 127
              DemDebounceCounterJumpDownValue = 0
              DemDebounceCounterJumpUpValue = 0
              DemDebounceCounterPassedThreshold = -128
              DemDebounceCounterStorage = false
              DemDebounceContinuous = false
          IndicatorAttribute_WarningIndicator (DemIndicatorAttribute):
            DemIndicatorFailureCycleSource = DEM_FAILURE_CYCLE_EVENT
            DemIndicatorBehaviour = DEM_INDICATOR_CONTINUOUS
            DemIndicatorHealingCycleCounterThreshold = 3
            DemIndicatorHealingCycleRef = PowerCycle
            DemIndicatorRef = WarningIndicator
      4 x DemDTCClass, all with DemDTCSeverity=DEM_DTC_SEV_NO_SEVERITY, DemImmediateNvStorage=false:
        DTCClass_DTC_0x111f16: DemUdsDTC=1122070
        DTCClass_DTC_0x116e05: DemUdsDTC=1142277
        DTCClass_DTC_0x113497: DemUdsDTC=1127575
        DTCClass_DTC_0xc29a87: DemUdsDTC=12753543
      3 x DemEventParameter, all with DemEventKind=DEM_EVENT_KIND_SWC, DemEventTimeSeries=DEM_TIMESERIES_SNAPSHOT_NONE, DemEventAvailable=true, DemEventAvailableInVariant=true, DemEventLatchTestFailed=false, DemEventCreateInfoPort=true, DemExtendedDataClassRef=ExtendedDataClass_83dcefb7, DemFreezeFrameClassRef=FreezeFrameClass_5f5b5001, DemFreezeFrameRecNumClassRef=FreezeFrameRecNumClass_f98c8aa7:
        DTC_0x116397: DemEventId=60, DemDTCClassRef=DTCClass_DTC_0x116397
          DemEventClass:
            DemAgingAllowed = true
            DemAgingCycleCounterThreshold = 40
            DemEventDestination = DEM_DTC_ORIGIN_PRIMARY_MEMORY
            DemEventPriority = 1
            DemEventSignificance = DEM_EVENT_SIGNIFICANCE_FAULT
            DemEventFailureCycleCounterThreshold = 0
            DemConsiderPtoStatus = false
            DemFFPrestorageSupported = false
            DemAgingCycleRef = PowerCycle
            DemEnableConditionGroupRef = EnableConditionGroup_bbe52cb7
            DemOperationCycleRef = PowerCycle
            DemDebounceAlgorithmClass
              DemDebounceCounterBased:
                DemDebounceCounterDecrementStepSize = 1
                DemDebounceCounterIncrementStepSize = 1
                DemDebounceCounterJumpDown = false
                DemDebounceCounterJumpUp = true
                DemDebounceBehavior = DEM_DEBOUNCE_FREEZE
                DemDebounceCounterFailedThreshold = 127
                DemDebounceCounterJumpDownValue = 0
                DemDebounceCounterJumpUpValue = 0
                DemDebounceCounterPassedThreshold = -128
                DemDebounceCounterStorage = false
                DemDebounceContinuous = false
            IndicatorAttribute_WarningIndicator (DemIndicatorAttribute):
              DemIndicatorFailureCycleSource = DEM_FAILURE_CYCLE_EVENT
              DemIndicatorBehaviour = DEM_INDICATOR_CONTINUOUS
              DemIndicatorHealingCycleCounterThreshold = 3
              DemIndicatorHealingCycleRef = PowerCycle
              DemIndicatorRef = WarningIndicator
        DTC_0x114097: DemEventId=40, DemDTCClassRef=DTCClass_DTC_0x114097
          DemEventClass:
            DemAgingAllowed = true
            DemAgingCycleCounterThreshold = 40
            DemEventDestination = DEM_DTC_ORIGIN_PRIMARY_MEMORY
            DemEventPriority = 1
            DemEventSignificance = DEM_EVENT_SIGNIFICANCE_FAULT
            DemEventFailureCycleCounterThreshold = 0
            DemConsiderPtoStatus = false
            DemFFPrestorageSupported = false
            DemAgingCycleRef = PowerCycle
            DemEnableConditionGroupRef = EnableConditionGroup_983000c1
            DemOperationCycleRef = PowerCycle
            DemDebounceAlgorithmClass
              DemDebounceCounterBased:
                DemDebounceCounterDecrementStepSize = 1
                DemDebounceCounterIncrementStepSize = 1
                DemDebounceCounterJumpDown = false
                DemDebounceCounterJumpUp = true
                DemDebounceBehavior = DEM_DEBOUNCE_FREEZE
                DemDebounceCounterFailedThreshold = 127
                DemDebounceCounterJumpDownValue = 0
                DemDebounceCounterJumpUpValue = 0
                DemDebounceCounterPassedThreshold = -128
                DemDebounceCounterStorage = false
                DemDebounceContinuous = false
            IndicatorAttribute_WarningIndicator (DemIndicatorAttribute):
              DemIndicatorFailureCycleSource = DEM_FAILURE_CYCLE_EVENT
              DemIndicatorBehaviour = DEM_INDICATOR_CONTINUOUS
              DemIndicatorHealingCycleCounterThreshold = 3
              DemIndicatorHealingCycleRef = PowerCycle
              DemIndicatorRef = WarningIndicator
        DTC_0x11794b: DemEventId=23, DemDTCClassRef=DTCClass_DTC_0x11794b
          DemEventClass:
            DemAgingAllowed = true
            DemAgingCycleCounterThreshold = 40
            DemEventDestination = DEM_DTC_ORIGIN_PRIMARY_MEMORY
            DemEventPriority = 2
            DemEventSignificance = DEM_EVENT_SIGNIFICANCE_FAULT
            DemEventFailureCycleCounterThreshold = 0
            DemConsiderPtoStatus = false
            DemFFPrestorageSupported = false
            DemAgingCycleRef = PowerCycle
            DemOperationCycleRef = PowerCycle
            DemDebounceAlgorithmClass
              DemDebounceCounterBased:
                DemDebounceCounterDecrementStepSize = 1
                DemDebounceCounterIncrementStepSize = 1
                DemDebounceCounterJumpDown = false
                DemDebounceCounterJumpUp = true
                DemDebounceBehavior = DEM_DEBOUNCE_FREEZE
                DemDebounceCounterFailedThreshold = 127
                DemDebounceCounterJumpDownValue = 0
                DemDebounceCounterJumpUpValue = 0
                DemDebounceCounterPassedThreshold = -128
                DemDebounceCounterStorage = false
                DemDebounceContinuous = false
            IndicatorAttribute_WarningIndicator (DemIndicatorAttribute):
              DemIndicatorFailureCycleSource = DEM_FAILURE_CYCLE_EVENT
              DemIndicatorBehaviour = DEM_INDICATOR_CONTINUOUS
              DemIndicatorHealingCycleCounterThreshold = 3
              DemIndicatorHealingCycleRef = PowerCycle
              DemIndicatorRef = WarningIndicator
      DTCClass_DTC_0xc20087 (DemDTCClass): DemDTCSeverity=DEM_DTC_SEV_NO_SEVERITY, DemUdsDTC=12714119, DemImmediateNvStorage=false
      DTC_0x117716 (DemEventParameter):
        DemEventKind = DEM_EVENT_KIND_SWC
        DemEventTimeSeries = DEM_TIMESERIES_SNAPSHOT_NONE
        DemEventAvailable = true
        DemEventId = 74
        DemEventAvailableInVariant = true
        DemEventLatchTestFailed = false
        DemEventCreateInfoPort = true
        DemDTCClassRef = DTCClass_DTC_0x117716
        DemExtendedDataClassRef = ExtendedDataClass_83dcefb7
        DemFreezeFrameClassRef = FreezeFrameClass_5f5b5001
        DemFreezeFrameRecNumClassRef = FreezeFrameRecNumClass_f98c8aa7
        DemEventClass:
          DemAgingAllowed = true
          DemAgingCycleCounterThreshold = 40
          DemEventDestination = DEM_DTC_ORIGIN_PRIMARY_MEMORY
          DemEventPriority = 2
          DemEventSignificance = DEM_EVENT_SIGNIFICANCE_FAULT
          DemEventFailureCycleCounterThreshold = 0
          DemConsiderPtoStatus = false
          DemFFPrestorageSupported = false
          DemAgingCycleRef = PowerCycle
          DemOperationCycleRef = PowerCycle
          DemDebounceAlgorithmClass
            DemDebounceCounterBased:
              DemDebounceCounterDecrementStepSize = 1
              DemDebounceCounterIncrementStepSize = 1
              DemDebounceCounterJumpDown = false
              DemDebounceCounterJumpUp = true
              DemDebounceBehavior = DEM_DEBOUNCE_FREEZE
              DemDebounceCounterFailedThreshold = 127
              DemDebounceCounterJumpDownValue = 0
              DemDebounceCounterJumpUpValue = 0
              DemDebounceCounterPassedThreshold = -128
              DemDebounceCounterStorage = false
              DemDebounceContinuous = false
          IndicatorAttribute_WarningIndicator (DemIndicatorAttribute):
            DemIndicatorFailureCycleSource = DEM_FAILURE_CYCLE_EVENT
            DemIndicatorBehaviour = DEM_INDICATOR_CONTINUOUS
            DemIndicatorHealingCycleCounterThreshold = 3
            DemIndicatorHealingCycleRef = PowerCycle
            DemIndicatorRef = WarningIndicator
      DTCClass_DTC_0xc14087 (DemDTCClass): DemDTCSeverity=DEM_DTC_SEV_NO_SEVERITY, DemUdsDTC=12664967, DemImmediateNvStorage=false
      DTC_0x113597 (DemEventParameter):
        DemEventKind = DEM_EVENT_KIND_SWC
        DemEventTimeSeries = DEM_TIMESERIES_SNAPSHOT_NONE
        DemEventAvailable = true
        DemEventId = 35
        DemEventAvailableInVariant = true
        DemEventLatchTestFailed = false
        DemEventCreateInfoPort = true
        DemDTCClassRef = DTCClass_DTC_0x113597
        DemExtendedDataClassRef = ExtendedDataClass_83dcefb7
        DemFreezeFrameClassRef = FreezeFrameClass_c715a583
        DemFreezeFrameRecNumClassRef = FreezeFrameRecNumClass_f98c8aa7
        DemEventClass:
          DemAgingAllowed = true
          DemAgingCycleCounterThreshold = 40
          DemEventDestination = DEM_DTC_ORIGIN_PRIMARY_MEMORY
          DemEventPriority = 1
          DemEventSignificance = DEM_EVENT_SIGNIFICANCE_FAULT
          DemEventFailureCycleCounterThreshold = 0
          DemConsiderPtoStatus = false
          DemFFPrestorageSupported = false
          DemAgingCycleRef = PowerCycle
          DemEnableConditionGroupRef = EnableConditionGroup_fdfec498
          DemOperationCycleRef = PowerCycle
          DemDebounceAlgorithmClass
            DemDebounceCounterBased:
              DemDebounceCounterDecrementStepSize = 1
              DemDebounceCounterIncrementStepSize = 1
              DemDebounceCounterJumpDown = false
              DemDebounceCounterJumpUp = true
              DemDebounceBehavior = DEM_DEBOUNCE_FREEZE
              DemDebounceCounterFailedThreshold = 127
              DemDebounceCounterJumpDownValue = 0
              DemDebounceCounterJumpUpValue = 0
              DemDebounceCounterPassedThreshold = -128
              DemDebounceCounterStorage = false
              DemDebounceContinuous = false
          IndicatorAttribute_WarningIndicator (DemIndicatorAttribute):
            DemIndicatorFailureCycleSource = DEM_FAILURE_CYCLE_EVENT
            DemIndicatorBehaviour = DEM_INDICATOR_CONTINUOUS
            DemIndicatorHealingCycleCounterThreshold = 3
            DemIndicatorHealingCycleRef = PowerCycle
            DemIndicatorRef = WarningIndicator
      5 x DemDTCClass, all with DemDTCSeverity=DEM_DTC_SEV_NO_SEVERITY, DemImmediateNvStorage=false:
        DTCClass_DTC_0x116197: DemUdsDTC=1139095
        DTCClass_DTC_0x11281e: DemUdsDTC=1124382
        DTCClass_DTC_0x116996: DemUdsDTC=1141142
        DTCClass_DTC_0xc14887: DemUdsDTC=12667015
        DTCClass_DTC_0x114697: DemUdsDTC=1132183
      DTC_0x116f05 (DemEventParameter):
        DemEventKind = DEM_EVENT_KIND_SWC
        DemEventTimeSeries = DEM_TIMESERIES_SNAPSHOT_NONE
        DemEventAvailable = true
        DemEventId = 11
        DemEventAvailableInVariant = true
        DemEventLatchTestFailed = false
        DemEventCreateInfoPort = true
        DemDTCClassRef = DTCClass_DTC_0x116f05
        DemExtendedDataClassRef = ExtendedDataClass_83dcefb7
        DemFreezeFrameClassRef = FreezeFrameClass_5f5b5001
        DemFreezeFrameRecNumClassRef = FreezeFrameRecNumClass_f98c8aa7
        DemEventClass:
          DemAgingAllowed = true
          DemAgingCycleCounterThreshold = 40
          DemEventDestination = DEM_DTC_ORIGIN_PRIMARY_MEMORY
          DemEventPriority = 1
          DemEventSignificance = DEM_EVENT_SIGNIFICANCE_FAULT
          DemEventFailureCycleCounterThreshold = 0
          DemConsiderPtoStatus = false
          DemFFPrestorageSupported = false
          DemAgingCycleRef = PowerCycle
          DemOperationCycleRef = PowerCycle
          DemDebounceAlgorithmClass
            DemDebounceCounterBased:
              DemDebounceCounterDecrementStepSize = 1
              DemDebounceCounterIncrementStepSize = 1
              DemDebounceCounterJumpDown = false
              DemDebounceCounterJumpUp = true
              DemDebounceBehavior = DEM_DEBOUNCE_FREEZE
              DemDebounceCounterFailedThreshold = 127
              DemDebounceCounterJumpDownValue = 0
              DemDebounceCounterJumpUpValue = 0
              DemDebounceCounterPassedThreshold = -128
              DemDebounceCounterStorage = false
              DemDebounceContinuous = false
          IndicatorAttribute_WarningIndicator (DemIndicatorAttribute):
            DemIndicatorFailureCycleSource = DEM_FAILURE_CYCLE_EVENT
            DemIndicatorBehaviour = DEM_INDICATOR_CONTINUOUS
            DemIndicatorHealingCycleCounterThreshold = 3
            DemIndicatorHealingCycleRef = PowerCycle
            DemIndicatorRef = WarningIndicator
      DTCClass_DTC_0x115e1a (DemDTCClass): DemDTCSeverity=DEM_DTC_SEV_NO_SEVERITY, DemUdsDTC=1138202, DemImmediateNvStorage=false
      DTCClass_DTC_0x114571 (DemDTCClass): DemDTCSeverity=DEM_DTC_SEV_NO_SEVERITY, DemUdsDTC=1131889, DemImmediateNvStorage=false
      DTC_0xc20087 (DemEventParameter):
        DemEventKind = DEM_EVENT_KIND_SWC
        DemEventTimeSeries = DEM_TIMESERIES_SNAPSHOT_NONE
        DemEventAvailable = true
        DemEventId = 98
        DemEventAvailableInVariant = true
        DemEventLatchTestFailed = false
        DemEventCreateInfoPort = true
        DemDTCClassRef = DTCClass_DTC_0xc20087
        DemExtendedDataClassRef = ExtendedDataClass_83dcefb7
        DemFreezeFrameClassRef = FreezeFrameClass_5f5b5001
        DemFreezeFrameRecNumClassRef = FreezeFrameRecNumClass_f98c8aa7
        DemEventClass:
          DemAgingAllowed = true
          DemAgingCycleCounterThreshold = 40
          DemEventDestination = DEM_DTC_ORIGIN_PRIMARY_MEMORY
          DemEventPriority = 2
          DemEventSignificance = DEM_EVENT_SIGNIFICANCE_FAULT
          DemEventFailureCycleCounterThreshold = 0
          DemConsiderPtoStatus = false
          DemFFPrestorageSupported = false
          DemAgingCycleRef = PowerCycle
          DemEnableConditionGroupRef = EnableConditionGroup_f3616881
          DemOperationCycleRef = PowerCycle
          DemDebounceAlgorithmClass
            DemDebounceCounterBased:
              DemDebounceCounterDecrementStepSize = 1
              DemDebounceCounterIncrementStepSize = 1
              DemDebounceCounterJumpDown = false
              DemDebounceCounterJumpUp = true
              DemDebounceBehavior = DEM_DEBOUNCE_FREEZE
              DemDebounceCounterFailedThreshold = 127
              DemDebounceCounterJumpDownValue = 0
              DemDebounceCounterJumpUpValue = 0
              DemDebounceCounterPassedThreshold = -128
              DemDebounceCounterStorage = false
              DemDebounceContinuous = false
          IndicatorAttribute_WarningIndicator (DemIndicatorAttribute):
            DemIndicatorFailureCycleSource = DEM_FAILURE_CYCLE_EVENT
            DemIndicatorBehaviour = DEM_INDICATOR_CONTINUOUS
            DemIndicatorHealingCycleCounterThreshold = 3
            DemIndicatorHealingCycleRef = PowerCycle
            DemIndicatorRef = WarningIndicator
      DTCClass_DTC_0x117716 (DemDTCClass): DemDTCSeverity=DEM_DTC_SEV_NO_SEVERITY, DemUdsDTC=1144598, DemImmediateNvStorage=false
      DTC_0x115092 (DemEventParameter):
        DemEventKind = DEM_EVENT_KIND_SWC
        DemEventTimeSeries = DEM_TIMESERIES_SNAPSHOT_NONE
        DemEventAvailable = true
        DemEventId = 50
        DemEventAvailableInVariant = true
        DemEventLatchTestFailed = false
        DemEventCreateInfoPort = true
        DemDTCClassRef = DTCClass_DTC_0x115092
        DemExtendedDataClassRef = ExtendedDataClass_83dcefb7
        DemFreezeFrameClassRef = FreezeFrameClass_5f5b5001
        DemFreezeFrameRecNumClassRef = FreezeFrameRecNumClass_f98c8aa7
        DemEventClass:
          DemAgingAllowed = true
          DemAgingCycleCounterThreshold = 40
          DemEventDestination = DEM_DTC_ORIGIN_PRIMARY_MEMORY
          DemEventPriority = 2
          DemEventSignificance = DEM_EVENT_SIGNIFICANCE_FAULT
          DemEventFailureCycleCounterThreshold = 0
          DemConsiderPtoStatus = false
          DemFFPrestorageSupported = false
          DemAgingCycleRef = PowerCycle
          DemEnableConditionGroupRef = EnableConditionGroup_fdfec498
          DemOperationCycleRef = PowerCycle
          DemDebounceAlgorithmClass
            DemDebounceCounterBased:
              DemDebounceCounterDecrementStepSize = 1
              DemDebounceCounterIncrementStepSize = 1
              DemDebounceCounterJumpDown = false
              DemDebounceCounterJumpUp = true
              DemDebounceBehavior = DEM_DEBOUNCE_FREEZE
              DemDebounceCounterFailedThreshold = 127
              DemDebounceCounterJumpDownValue = 0
              DemDebounceCounterJumpUpValue = 0
              DemDebounceCounterPassedThreshold = -128
              DemDebounceCounterStorage = false
              DemDebounceContinuous = false
          IndicatorAttribute_WarningIndicator (DemIndicatorAttribute):
            DemIndicatorFailureCycleSource = DEM_FAILURE_CYCLE_EVENT
            DemIndicatorBehaviour = DEM_INDICATOR_CONTINUOUS
            DemIndicatorHealingCycleCounterThreshold = 3
            DemIndicatorHealingCycleRef = PowerCycle
            DemIndicatorRef = WarningIndicator
      DTCClass_DTC_0xd13787 (DemDTCClass): DemDTCSeverity=DEM_DTC_SEV_NO_SEVERITY, DemUdsDTC=13711239, DemImmediateNvStorage=false
      DTC_0xc07488 (DemEventParameter):
        DemEventKind = DEM_EVENT_KIND_SWC
        DemEventTimeSeries = DEM_TIMESERIES_SNAPSHOT_NONE
        DemEventAvailable = true
        DemEventId = 86
        DemEventAvailableInVariant = true
        DemEventLatchTestFailed = false
        DemEventCreateInfoPort = true
        DemDTCClassRef = DTCClass_DTC_0xc07488
        DemExtendedDataClassRef = ExtendedDataClass_83dcefb7
        DemFreezeFrameClassRef = FreezeFrameClass_5f5b5001
        DemFreezeFrameRecNumClassRef = FreezeFrameRecNumClass_f98c8aa7
        DemEventClass:
          DemAgingAllowed = true
          DemAgingCycleCounterThreshold = 40
          DemEventDestination = DEM_DTC_ORIGIN_PRIMARY_MEMORY
          DemEventPriority = 1
          DemEventSignificance = DEM_EVENT_SIGNIFICANCE_FAULT
          DemEventFailureCycleCounterThreshold = 0
          DemConsiderPtoStatus = false
          DemFFPrestorageSupported = false
          DemAgingCycleRef = PowerCycle
          DemEnableConditionGroupRef = EnableConditionGroup_c81fc67e
          DemOperationCycleRef = PowerCycle
          DemDebounceAlgorithmClass
            DemDebounceCounterBased:
              DemDebounceCounterDecrementStepSize = 1
              DemDebounceCounterIncrementStepSize = 1
              DemDebounceCounterJumpDown = false
              DemDebounceCounterJumpUp = true
              DemDebounceBehavior = DEM_DEBOUNCE_FREEZE
              DemDebounceCounterFailedThreshold = 127
              DemDebounceCounterJumpDownValue = 0
              DemDebounceCounterJumpUpValue = 0
              DemDebounceCounterPassedThreshold = -128
              DemDebounceCounterStorage = false
              DemDebounceContinuous = false
          IndicatorAttribute_WarningIndicator (DemIndicatorAttribute):
            DemIndicatorFailureCycleSource = DEM_FAILURE_CYCLE_EVENT
            DemIndicatorBehaviour = DEM_INDICATOR_CONTINUOUS
            DemIndicatorHealingCycleCounterThreshold = 3
            DemIndicatorHealingCycleRef = PowerCycle
            DemIndicatorRef = WarningIndicator
      DTC_0x116617 (DemEventParameter):
        DemEventKind = DEM_EVENT_KIND_SWC
        DemEventTimeSeries = DEM_TIMESERIES_SNAPSHOT_NONE
        DemEventAvailable = true
        DemEventId = 63
        DemEventAvailableInVariant = true
        DemEventLatchTestFailed = false
        DemEventCreateInfoPort = true
        DemDTCClassRef = DTCClass_DTC_0x116617
        DemExtendedDataClassRef = ExtendedDataClass_83dcefb7
        DemFreezeFrameClassRef = FreezeFrameClass_5f5b5001
        DemFreezeFrameRecNumClassRef = FreezeFrameRecNumClass_f98c8aa7
        DemEventClass:
          DemAgingAllowed = true
          DemAgingCycleCounterThreshold = 40
          DemEventDestination = DEM_DTC_ORIGIN_PRIMARY_MEMORY
          DemEventPriority = 1
          DemEventSignificance = DEM_EVENT_SIGNIFICANCE_FAULT
          DemEventFailureCycleCounterThreshold = 0
          DemConsiderPtoStatus = false
          DemFFPrestorageSupported = false
          DemAgingCycleRef = PowerCycle
          DemOperationCycleRef = PowerCycle
          DemDebounceAlgorithmClass
            DemDebounceCounterBased:
              DemDebounceCounterDecrementStepSize = 1
              DemDebounceCounterIncrementStepSize = 1
              DemDebounceCounterJumpDown = false
              DemDebounceCounterJumpUp = true
              DemDebounceBehavior = DEM_DEBOUNCE_FREEZE
              DemDebounceCounterFailedThreshold = 127
              DemDebounceCounterJumpDownValue = 0
              DemDebounceCounterJumpUpValue = 0
              DemDebounceCounterPassedThreshold = -128
              DemDebounceCounterStorage = false
              DemDebounceContinuous = false
          IndicatorAttribute_WarningIndicator (DemIndicatorAttribute):
            DemIndicatorFailureCycleSource = DEM_FAILURE_CYCLE_EVENT
            DemIndicatorBehaviour = DEM_INDICATOR_CONTINUOUS
            DemIndicatorHealingCycleCounterThreshold = 3
            DemIndicatorHealingCycleRef = PowerCycle
            DemIndicatorRef = WarningIndicator
      DTCClass_DTC_0x11794b (DemDTCClass): DemDTCSeverity=DEM_DTC_SEV_NO_SEVERITY, DemUdsDTC=1145163, DemImmediateNvStorage=false
      DTC_0x115a92 (DemEventParameter):
        DemEventKind = DEM_EVENT_KIND_SWC
        DemEventTimeSeries = DEM_TIMESERIES_SNAPSHOT_NONE
        DemEventAvailable = true
        DemEventId = 3
        DemEventAvailableInVariant = true
        DemEventLatchTestFailed = false
        DemEventCreateInfoPort = true
        DemDTCClassRef = DTCClass_DTC_0x115a92
        DemExtendedDataClassRef = ExtendedDataClass_83dcefb7
        DemFreezeFrameClassRef = FreezeFrameClass_5f5b5001
        DemFreezeFrameRecNumClassRef = FreezeFrameRecNumClass_f98c8aa7
        DemEventClass:
          DemAgingAllowed = true
          DemAgingCycleCounterThreshold = 40
          DemEventDestination = DEM_DTC_ORIGIN_PRIMARY_MEMORY
          DemEventPriority = 2
          DemEventSignificance = DEM_EVENT_SIGNIFICANCE_FAULT
          DemEventFailureCycleCounterThreshold = 0
          DemConsiderPtoStatus = false
          DemFFPrestorageSupported = false
          DemAgingCycleRef = PowerCycle
          DemEnableConditionGroupRef = EnableConditionGroup_fdfec498
          DemOperationCycleRef = PowerCycle
          DemDebounceAlgorithmClass
            DemDebounceCounterBased:
              DemDebounceCounterDecrementStepSize = 1
              DemDebounceCounterIncrementStepSize = 1
              DemDebounceCounterJumpDown = false
              DemDebounceCounterJumpUp = true
              DemDebounceBehavior = DEM_DEBOUNCE_FREEZE
              DemDebounceCounterFailedThreshold = 127
              DemDebounceCounterJumpDownValue = 0
              DemDebounceCounterJumpUpValue = 0
              DemDebounceCounterPassedThreshold = -128
              DemDebounceCounterStorage = false
              DemDebounceContinuous = false
          IndicatorAttribute_WarningIndicator (DemIndicatorAttribute):
            DemIndicatorFailureCycleSource = DEM_FAILURE_CYCLE_EVENT
            DemIndicatorBehaviour = DEM_INDICATOR_CONTINUOUS
            DemIndicatorHealingCycleCounterThreshold = 3
            DemIndicatorHealingCycleRef = PowerCycle
            DemIndicatorRef = WarningIndicator
      DTC_0xc14887 (DemEventParameter):
        DemEventKind = DEM_EVENT_KIND_SWC
        DemEventTimeSeries = DEM_TIMESERIES_SNAPSHOT_NONE
        DemEventAvailable = true
        DemEventId = 94
        DemEventAvailableInVariant = true
        DemEventLatchTestFailed = false
        DemEventCreateInfoPort = true
        DemDTCClassRef = DTCClass_DTC_0xc14887
        DemExtendedDataClassRef = ExtendedDataClass_83dcefb7
        DemFreezeFrameClassRef = FreezeFrameClass_5f5b5001
        DemFreezeFrameRecNumClassRef = FreezeFrameRecNumClass_f98c8aa7
        DemEventClass:
          DemAgingAllowed = true
          DemAgingCycleCounterThreshold = 40
          DemEventDestination = DEM_DTC_ORIGIN_PRIMARY_MEMORY
          DemEventPriority = 2
          DemEventSignificance = DEM_EVENT_SIGNIFICANCE_FAULT
          DemEventFailureCycleCounterThreshold = 0
          DemConsiderPtoStatus = false
          DemFFPrestorageSupported = false
          DemAgingCycleRef = PowerCycle
          DemEnableConditionGroupRef = EnableConditionGroup_35324f44
          DemOperationCycleRef = PowerCycle
          DemDebounceAlgorithmClass
            DemDebounceCounterBased:
              DemDebounceCounterDecrementStepSize = 1
              DemDebounceCounterIncrementStepSize = 1
              DemDebounceCounterJumpDown = false
              DemDebounceCounterJumpUp = true
              DemDebounceBehavior = DEM_DEBOUNCE_FREEZE
              DemDebounceCounterFailedThreshold = 127
              DemDebounceCounterJumpDownValue = 0
              DemDebounceCounterJumpUpValue = 0
              DemDebounceCounterPassedThreshold = -128
              DemDebounceCounterStorage = false
              DemDebounceContinuous = false
          IndicatorAttribute_WarningIndicator (DemIndicatorAttribute):
            DemIndicatorFailureCycleSource = DEM_FAILURE_CYCLE_EVENT
            DemIndicatorBehaviour = DEM_INDICATOR_CONTINUOUS
            DemIndicatorHealingCycleCounterThreshold = 3
            DemIndicatorHealingCycleRef = PowerCycle
            DemIndicatorRef = WarningIndicator
      DTCClass_DTC_0x116f05 (DemDTCClass): DemDTCSeverity=DEM_DTC_SEV_NO_SEVERITY, DemUdsDTC=1142533, DemImmediateNvStorage=false
      DTCClass_DTC_0x115092 (DemDTCClass): DemDTCSeverity=DEM_DTC_SEV_NO_SEVERITY, DemUdsDTC=1134738, DemImmediateNvStorage=false
      DTC_0xc14087 (DemEventParameter):
        DemEventKind = DEM_EVENT_KIND_SWC
        DemEventTimeSeries = DEM_TIMESERIES_SNAPSHOT_NONE
        DemEventAvailable = true
        DemEventId = 91
        DemEventAvailableInVariant = true
        DemEventLatchTestFailed = false
        DemEventCreateInfoPort = true
        DemDTCClassRef = DTCClass_DTC_0xc14087
        DemExtendedDataClassRef = ExtendedDataClass_83dcefb7
        DemFreezeFrameClassRef = FreezeFrameClass_5f5b5001
        DemFreezeFrameRecNumClassRef = FreezeFrameRecNumClass_f98c8aa7
        DemEventClass:
          DemAgingAllowed = true
          DemAgingCycleCounterThreshold = 40
          DemEventDestination = DEM_DTC_ORIGIN_PRIMARY_MEMORY
          DemEventPriority = 1
          DemEventSignificance = DEM_EVENT_SIGNIFICANCE_FAULT
          DemEventFailureCycleCounterThreshold = 0
          DemConsiderPtoStatus = false
          DemFFPrestorageSupported = false
          DemAgingCycleRef = PowerCycle
          DemEnableConditionGroupRef = EnableConditionGroup_f3616881
          DemOperationCycleRef = PowerCycle
          DemDebounceAlgorithmClass
            DemDebounceCounterBased:
              DemDebounceCounterDecrementStepSize = 1
              DemDebounceCounterIncrementStepSize = 1
              DemDebounceCounterJumpDown = false
              DemDebounceCounterJumpUp = true
              DemDebounceBehavior = DEM_DEBOUNCE_FREEZE
              DemDebounceCounterFailedThreshold = 127
              DemDebounceCounterJumpDownValue = 0
              DemDebounceCounterJumpUpValue = 0
              DemDebounceCounterPassedThreshold = -128
              DemDebounceCounterStorage = false
              DemDebounceContinuous = false
          IndicatorAttribute_WarningIndicator (DemIndicatorAttribute):
            DemIndicatorFailureCycleSource = DEM_FAILURE_CYCLE_EVENT
            DemIndicatorBehaviour = DEM_INDICATOR_CONTINUOUS
            DemIndicatorHealingCycleCounterThreshold = 3
            DemIndicatorHealingCycleRef = PowerCycle
            DemIndicatorRef = WarningIndicator
      DTCClass_DTC_0x113597 (DemDTCClass): DemDTCSeverity=DEM_DTC_SEV_NO_SEVERITY, DemUdsDTC=1127831, DemImmediateNvStorage=false
      DTC_0x114792 (DemEventParameter):
        DemEventKind = DEM_EVENT_KIND_SWC
        DemEventTimeSeries = DEM_TIMESERIES_SNAPSHOT_NONE
        DemEventAvailable = true
        DemEventId = 47
        DemEventAvailableInVariant = true
        DemEventLatchTestFailed = false
        DemEventCreateInfoPort = true
        DemDTCClassRef = DTCClass_DTC_0x114792
        DemExtendedDataClassRef = ExtendedDataClass_83dcefb7
        DemFreezeFrameClassRef = FreezeFrameClass_5f5b5001
        DemFreezeFrameRecNumClassRef = FreezeFrameRecNumClass_f98c8aa7
        DemEventClass:
          DemAgingAllowed = true
          DemAgingCycleCounterThreshold = 40
          DemEventDestination = DEM_DTC_ORIGIN_PRIMARY_MEMORY
          DemEventPriority = 1
          DemEventSignificance = DEM_EVENT_SIGNIFICANCE_FAULT
          DemEventFailureCycleCounterThreshold = 0
          DemConsiderPtoStatus = false
          DemFFPrestorageSupported = false
          DemAgingCycleRef = PowerCycle
          DemEnableConditionGroupRef = EnableConditionGroup_fdfec498
          DemOperationCycleRef = PowerCycle
          DemDebounceAlgorithmClass
            DemDebounceCounterBased:
              DemDebounceCounterDecrementStepSize = 1
              DemDebounceCounterIncrementStepSize = 1
              DemDebounceCounterJumpDown = false
              DemDebounceCounterJumpUp = true
              DemDebounceBehavior = DEM_DEBOUNCE_FREEZE
              DemDebounceCounterFailedThreshold = 127
              DemDebounceCounterJumpDownValue = 0
              DemDebounceCounterJumpUpValue = 0
              DemDebounceCounterPassedThreshold = -128
              DemDebounceCounterStorage = false
              DemDebounceContinuous = false
          IndicatorAttribute_WarningIndicator (DemIndicatorAttribute):
            DemIndicatorFailureCycleSource = DEM_FAILURE_CYCLE_EVENT
            DemIndicatorBehaviour = DEM_INDICATOR_CONTINUOUS
            DemIndicatorHealingCycleCounterThreshold = 3
            DemIndicatorHealingCycleRef = PowerCycle
            DemIndicatorRef = WarningIndicator
      DTC_0x11291c (DemEventParameter):
        DemEventKind = DEM_EVENT_KIND_SWC
        DemEventTimeSeries = DEM_TIMESERIES_SNAPSHOT_NONE
        DemEventAvailable = true
        DemEventId = 19
        DemEventAvailableInVariant = true
        DemEventLatchTestFailed = false
        DemEventCreateInfoPort = true
        DemDTCClassRef = DTCClass_DTC_0x11291c
        DemExtendedDataClassRef = ExtendedDataClass_83dcefb7
        DemFreezeFrameClassRef = FreezeFrameClass_a7d22c66
        DemFreezeFrameRecNumClassRef = FreezeFrameRecNumClass_f98c8aa7
        DemEventClass:
          DemAgingAllowed = true
          DemAgingCycleCounterThreshold = 40
          DemEventDestination = DEM_DTC_ORIGIN_PRIMARY_MEMORY
          DemEventPriority = 1
          DemEventSignificance = DEM_EVENT_SIGNIFICANCE_FAULT
          DemEventFailureCycleCounterThreshold = 0
          DemConsiderPtoStatus = false
          DemFFPrestorageSupported = false
          DemAgingCycleRef = PowerCycle
          DemEnableConditionGroupRef = EnableConditionGroup_bbe52cb7
          DemOperationCycleRef = PowerCycle
          DemDebounceAlgorithmClass
            DemDebounceCounterBased:
              DemDebounceCounterDecrementStepSize = 1
              DemDebounceCounterIncrementStepSize = 1
              DemDebounceCounterJumpDown = false
              DemDebounceCounterJumpUp = true
              DemDebounceBehavior = DEM_DEBOUNCE_FREEZE
              DemDebounceCounterFailedThreshold = 127
              DemDebounceCounterJumpDownValue = 0
              DemDebounceCounterJumpUpValue = 0
              DemDebounceCounterPassedThreshold = -128
              DemDebounceCounterStorage = false
              DemDebounceContinuous = false
          IndicatorAttribute_WarningIndicator (DemIndicatorAttribute):
            DemIndicatorFailureCycleSource = DEM_FAILURE_CYCLE_EVENT
            DemIndicatorBehaviour = DEM_INDICATOR_CONTINUOUS
            DemIndicatorHealingCycleCounterThreshold = 3
            DemIndicatorHealingCycleRef = PowerCycle
            DemIndicatorRef = WarningIndicator
      3 x DemDTCClass, all with DemDTCSeverity=DEM_DTC_SEV_NO_SEVERITY, DemImmediateNvStorage=false:
        DTCClass_DTC_0x115a92: DemUdsDTC=1137298
        DTCClass_DTC_0xd12688: DemUdsDTC=13706888
        DTCClass_DTC_0x116617: DemUdsDTC=1140247
      DTC_0x116a96 (DemEventParameter):
        DemEventKind = DEM_EVENT_KIND_SWC
        DemEventTimeSeries = DEM_TIMESERIES_SNAPSHOT_NONE
        DemEventAvailable = true
        DemEventId = 7
        DemEventAvailableInVariant = true
        DemEventLatchTestFailed = false
        DemEventCreateInfoPort = true
        DemDTCClassRef = DTCClass_DTC_0x116a96
        DemExtendedDataClassRef = ExtendedDataClass_83dcefb7
        DemFreezeFrameClassRef = FreezeFrameClass_5f5b5001
        DemFreezeFrameRecNumClassRef = FreezeFrameRecNumClass_f98c8aa7
        DemEventClass:
          DemAgingAllowed = true
          DemAgingCycleCounterThreshold = 40
          DemEventDestination = DEM_DTC_ORIGIN_PRIMARY_MEMORY
          DemEventPriority = 1
          DemEventSignificance = DEM_EVENT_SIGNIFICANCE_FAULT
          DemEventFailureCycleCounterThreshold = 0
          DemConsiderPtoStatus = false
          DemFFPrestorageSupported = false
          DemAgingCycleRef = PowerCycle
          DemOperationCycleRef = PowerCycle
          DemDebounceAlgorithmClass
            DemDebounceCounterBased:
              DemDebounceCounterDecrementStepSize = 1
              DemDebounceCounterIncrementStepSize = 1
              DemDebounceCounterJumpDown = false
              DemDebounceCounterJumpUp = true
              DemDebounceBehavior = DEM_DEBOUNCE_FREEZE
              DemDebounceCounterFailedThreshold = 127
              DemDebounceCounterJumpDownValue = 0
              DemDebounceCounterJumpUpValue = 0
              DemDebounceCounterPassedThreshold = -128
              DemDebounceCounterStorage = false
              DemDebounceContinuous = false
          IndicatorAttribute_WarningIndicator (DemIndicatorAttribute):
            DemIndicatorFailureCycleSource = DEM_FAILURE_CYCLE_EVENT
            DemIndicatorBehaviour = DEM_INDICATOR_CONTINUOUS
            DemIndicatorHealingCycleCounterThreshold = 3
            DemIndicatorHealingCycleRef = PowerCycle
            DemIndicatorRef = WarningIndicator
      DTC_0x117617 (DemEventParameter):
        DemEventKind = DEM_EVENT_KIND_SWC
        DemEventTimeSeries = DEM_TIMESERIES_SNAPSHOT_NONE
        DemEventAvailable = true
        DemEventId = 73
        DemEventAvailableInVariant = true
        DemEventLatchTestFailed = false
        DemEventCreateInfoPort = true
        DemDTCClassRef = DTCClass_DTC_0x117617
        DemExtendedDataClassRef = ExtendedDataClass_83dcefb7
        DemFreezeFrameClassRef = FreezeFrameClass_5f5b5001
        DemFreezeFrameRecNumClassRef = FreezeFrameRecNumClass_f98c8aa7
        DemEventClass:
          DemAgingAllowed = true
          DemAgingCycleCounterThreshold = 40
          DemEventDestination = DEM_DTC_ORIGIN_PRIMARY_MEMORY
          DemEventPriority = 2
          DemEventSignificance = DEM_EVENT_SIGNIFICANCE_FAULT
          DemEventFailureCycleCounterThreshold = 0
          DemConsiderPtoStatus = false
          DemFFPrestorageSupported = false
          DemAgingCycleRef = PowerCycle
          DemOperationCycleRef = PowerCycle
          DemDebounceAlgorithmClass
            DemDebounceCounterBased:
              DemDebounceCounterDecrementStepSize = 1
              DemDebounceCounterIncrementStepSize = 1
              DemDebounceCounterJumpDown = false
              DemDebounceCounterJumpUp = true
              DemDebounceBehavior = DEM_DEBOUNCE_FREEZE
              DemDebounceCounterFailedThreshold = 127
              DemDebounceCounterJumpDownValue = 0
              DemDebounceCounterJumpUpValue = 0
              DemDebounceCounterPassedThreshold = -128
              DemDebounceCounterStorage = false
              DemDebounceContinuous = false
          IndicatorAttribute_WarningIndicator (DemIndicatorAttribute):
            DemIndicatorFailureCycleSource = DEM_FAILURE_CYCLE_EVENT
            DemIndicatorBehaviour = DEM_INDICATOR_CONTINUOUS
            DemIndicatorHealingCycleCounterThreshold = 3
            DemIndicatorHealingCycleRef = PowerCycle
            DemIndicatorRef = WarningIndicator
      DTCClass_DTC_0xc20187 (DemDTCClass): DemDTCSeverity=DEM_DTC_SEV_NO_SEVERITY, DemUdsDTC=12714375, DemImmediateNvStorage=false
      DTCClass_DTC_0x11291c (DemDTCClass): DemDTCSeverity=DEM_DTC_SEV_NO_SEVERITY, DemUdsDTC=1124636, DemImmediateNvStorage=false
      DTC_0x113497 (DemEventParameter):
        DemEventKind = DEM_EVENT_KIND_SWC
        DemEventTimeSeries = DEM_TIMESERIES_SNAPSHOT_NONE
        DemEventAvailable = true
        DemEventId = 34
        DemEventAvailableInVariant = true
        DemEventLatchTestFailed = false
        DemEventCreateInfoPort = true
        DemDTCClassRef = DTCClass_DTC_0x113497
        DemExtendedDataClassRef = ExtendedDataClass_83dcefb7
        DemFreezeFrameClassRef = FreezeFrameClass_5f5b5001
        DemFreezeFrameRecNumClassRef = FreezeFrameRecNumClass_f98c8aa7
        DemEventClass:
          DemAgingAllowed = true
          DemAgingCycleCounterThreshold = 40
          DemEventDestination = DEM_DTC_ORIGIN_PRIMARY_MEMORY
          DemEventPriority = 1
          DemEventSignificance = DEM_EVENT_SIGNIFICANCE_FAULT
          DemEventFailureCycleCounterThreshold = 0
          DemConsiderPtoStatus = false
          DemFFPrestorageSupported = false
          DemAgingCycleRef = PowerCycle
          DemEnableConditionGroupRef = EnableConditionGroup_fdfec498
          DemOperationCycleRef = PowerCycle
          DemDebounceAlgorithmClass
            DemDebounceCounterBased:
              DemDebounceCounterDecrementStepSize = 1
              DemDebounceCounterIncrementStepSize = 1
              DemDebounceCounterJumpDown = false
              DemDebounceCounterJumpUp = true
              DemDebounceBehavior = DEM_DEBOUNCE_FREEZE
              DemDebounceCounterFailedThreshold = 127
              DemDebounceCounterJumpDownValue = 0
              DemDebounceCounterJumpUpValue = 0
              DemDebounceCounterPassedThreshold = -128
              DemDebounceCounterStorage = false
              DemDebounceContinuous = false
          IndicatorAttribute_WarningIndicator (DemIndicatorAttribute):
            DemIndicatorFailureCycleSource = DEM_FAILURE_CYCLE_EVENT
            DemIndicatorBehaviour = DEM_INDICATOR_CONTINUOUS
            DemIndicatorHealingCycleCounterThreshold = 3
            DemIndicatorHealingCycleRef = PowerCycle
            DemIndicatorRef = WarningIndicator
      DTCClass_DTC_0xc10387 (DemDTCClass): DemDTCSeverity=DEM_DTC_SEV_NO_SEVERITY, DemUdsDTC=12649351, DemImmediateNvStorage=false
      DTC_0x117a4c (DemEventParameter):
        DemEventKind = DEM_EVENT_KIND_SWC
        DemEventTimeSeries = DEM_TIMESERIES_SNAPSHOT_NONE
        DemEventAvailable = true
        DemEventId = 12
        DemEventAvailableInVariant = true
        DemEventLatchTestFailed = false
        DemEventCreateInfoPort = true
        DemDTCClassRef = DTCClass_DTC_0x117a4c
        DemExtendedDataClassRef = ExtendedDataClass_83dcefb7
        DemFreezeFrameClassRef = FreezeFrameClass_5f5b5001
        DemFreezeFrameRecNumClassRef = FreezeFrameRecNumClass_f98c8aa7
        DemEventClass:
          DemAgingAllowed = true
          DemAgingCycleCounterThreshold = 40
          DemEventDestination = DEM_DTC_ORIGIN_PRIMARY_MEMORY
          DemEventPriority = 2
          DemEventSignificance = DEM_EVENT_SIGNIFICANCE_FAULT
          DemEventFailureCycleCounterThreshold = 0
          DemConsiderPtoStatus = false
          DemFFPrestorageSupported = false
          DemAgingCycleRef = PowerCycle
          DemOperationCycleRef = PowerCycle
          DemDebounceAlgorithmClass
            DemDebounceCounterBased:
              DemDebounceCounterDecrementStepSize = 1
              DemDebounceCounterIncrementStepSize = 1
              DemDebounceCounterJumpDown = false
              DemDebounceCounterJumpUp = true
              DemDebounceBehavior = DEM_DEBOUNCE_FREEZE
              DemDebounceCounterFailedThreshold = 127
              DemDebounceCounterJumpDownValue = 0
              DemDebounceCounterJumpUpValue = 0
              DemDebounceCounterPassedThreshold = -128
              DemDebounceCounterStorage = false
              DemDebounceContinuous = false
          IndicatorAttribute_WarningIndicator (DemIndicatorAttribute):
            DemIndicatorFailureCycleSource = DEM_FAILURE_CYCLE_EVENT
            DemIndicatorBehaviour = DEM_INDICATOR_CONTINUOUS
            DemIndicatorHealingCycleCounterThreshold = 3
            DemIndicatorHealingCycleRef = PowerCycle
            DemIndicatorRef = WarningIndicator
      DTC_0xd12688 (DemEventParameter):
        DemEventKind = DEM_EVENT_KIND_SWC
        DemEventTimeSeries = DEM_TIMESERIES_SNAPSHOT_NONE
        DemEventAvailable = true
        DemEventId = 106
        DemEventAvailableInVariant = true
        DemEventLatchTestFailed = false
        DemEventCreateInfoPort = true
        DemDTCClassRef = DTCClass_DTC_0xd12688
        DemExtendedDataClassRef = ExtendedDataClass_83dcefb7
        DemFreezeFrameClassRef = FreezeFrameClass_5f5b5001
        DemFreezeFrameRecNumClassRef = FreezeFrameRecNumClass_f98c8aa7
        DemEventClass:
          DemAgingAllowed = true
          DemAgingCycleCounterThreshold = 40
          DemEventDestination = DEM_DTC_ORIGIN_PRIMARY_MEMORY
          DemEventPriority = 1
          DemEventSignificance = DEM_EVENT_SIGNIFICANCE_FAULT
          DemEventFailureCycleCounterThreshold = 0
          DemConsiderPtoStatus = false
          DemFFPrestorageSupported = false
          DemAgingCycleRef = PowerCycle
          DemEnableConditionGroupRef = EnableConditionGroup_c81fc67e
          DemOperationCycleRef = PowerCycle
          DemDebounceAlgorithmClass
            DemDebounceCounterBased:
              DemDebounceCounterDecrementStepSize = 1
              DemDebounceCounterIncrementStepSize = 1
              DemDebounceCounterJumpDown = false
              DemDebounceCounterJumpUp = true
              DemDebounceBehavior = DEM_DEBOUNCE_FREEZE
              DemDebounceCounterFailedThreshold = 127
              DemDebounceCounterJumpDownValue = 0
              DemDebounceCounterJumpUpValue = 0
              DemDebounceCounterPassedThreshold = -128
              DemDebounceCounterStorage = false
              DemDebounceContinuous = false
          IndicatorAttribute_WarningIndicator (DemIndicatorAttribute):
            DemIndicatorFailureCycleSource = DEM_FAILURE_CYCLE_EVENT
            DemIndicatorBehaviour = DEM_INDICATOR_CONTINUOUS
            DemIndicatorHealingCycleCounterThreshold = 3
            DemIndicatorHealingCycleRef = PowerCycle
            DemIndicatorRef = WarningIndicator
      DTCClass_DTC_0x114792 (DemDTCClass): DemDTCSeverity=DEM_DTC_SEV_NO_SEVERITY, DemUdsDTC=1132434, DemImmediateNvStorage=false
      DTC_0x111f16 (DemEventParameter):
        DemEventKind = DEM_EVENT_KIND_SWC
        DemEventTimeSeries = DEM_TIMESERIES_SNAPSHOT_NONE
        DemEventAvailable = true
        DemEventId = 2
        DemEventAvailableInVariant = true
        DemEventLatchTestFailed = false
        DemEventCreateInfoPort = true
        DemDTCClassRef = DTCClass_DTC_0x111f16
        DemExtendedDataClassRef = ExtendedDataClass_83dcefb7
        DemFreezeFrameClassRef = FreezeFrameClass_d96350db
        DemFreezeFrameRecNumClassRef = FreezeFrameRecNumClass_f98c8aa7
        DemEventClass:
          DemAgingAllowed = true
          DemAgingCycleCounterThreshold = 40
          DemEventDestination = DEM_DTC_ORIGIN_PRIMARY_MEMORY
          DemEventPriority = 1
          DemEventSignificance = DEM_EVENT_SIGNIFICANCE_FAULT
          DemEventFailureCycleCounterThreshold = 0
          DemConsiderPtoStatus = false
          DemFFPrestorageSupported = false
          DemAgingCycleRef = PowerCycle
          DemEnableConditionGroupRef = EnableConditionGroup_fdfec498
          DemOperationCycleRef = PowerCycle
          DemDebounceAlgorithmClass
            DemDebounceCounterBased:
              DemDebounceCounterDecrementStepSize = 1
              DemDebounceCounterIncrementStepSize = 1
              DemDebounceCounterJumpDown = false
              DemDebounceCounterJumpUp = true
              DemDebounceBehavior = DEM_DEBOUNCE_FREEZE
              DemDebounceCounterFailedThreshold = 127
              DemDebounceCounterJumpDownValue = 0
              DemDebounceCounterJumpUpValue = 0
              DemDebounceCounterPassedThreshold = -128
              DemDebounceCounterStorage = false
              DemDebounceContinuous = false
          IndicatorAttribute_WarningIndicator (DemIndicatorAttribute):
            DemIndicatorFailureCycleSource = DEM_FAILURE_CYCLE_EVENT
            DemIndicatorBehaviour = DEM_INDICATOR_CONTINUOUS
            DemIndicatorHealingCycleCounterThreshold = 3
            DemIndicatorHealingCycleRef = PowerCycle
            DemIndicatorRef = WarningIndicator
      DTCClass_DTC_0x117819 (DemDTCClass): DemDTCSeverity=DEM_DTC_SEV_NO_SEVERITY, DemUdsDTC=1144857, DemImmediateNvStorage=false
      5 x DemEventParameter, all with DemEventKind=DEM_EVENT_KIND_SWC, DemEventTimeSeries=DEM_TIMESERIES_SNAPSHOT_NONE, DemEventAvailable=true, DemEventAvailableInVariant=true, DemEventLatchTestFailed=false, DemEventCreateInfoPort=true, DemExtendedDataClassRef=ExtendedDataClass_83dcefb7, DemFreezeFrameClassRef=FreezeFrameClass_5f5b5001, DemFreezeFrameRecNumClassRef=FreezeFrameRecNumClass_f98c8aa7:
        DTC_0x116e05: DemEventId=10, DemDTCClassRef=DTCClass_DTC_0x116e05
          DemEventClass:
            DemAgingAllowed = true
            DemAgingCycleCounterThreshold = 40
            DemEventDestination = DEM_DTC_ORIGIN_PRIMARY_MEMORY
            DemEventPriority = 1
            DemEventSignificance = DEM_EVENT_SIGNIFICANCE_FAULT
            DemEventFailureCycleCounterThreshold = 0
            DemConsiderPtoStatus = false
            DemFFPrestorageSupported = false
            DemAgingCycleRef = PowerCycle
            DemOperationCycleRef = PowerCycle
            DemDebounceAlgorithmClass
              DemDebounceCounterBased:
                DemDebounceCounterDecrementStepSize = 1
                DemDebounceCounterIncrementStepSize = 1
                DemDebounceCounterJumpDown = false
                DemDebounceCounterJumpUp = true
                DemDebounceBehavior = DEM_DEBOUNCE_FREEZE
                DemDebounceCounterFailedThreshold = 127
                DemDebounceCounterJumpDownValue = 0
                DemDebounceCounterJumpUpValue = 0
                DemDebounceCounterPassedThreshold = -128
                DemDebounceCounterStorage = false
                DemDebounceContinuous = false
            IndicatorAttribute_WarningIndicator (DemIndicatorAttribute):
              DemIndicatorFailureCycleSource = DEM_FAILURE_CYCLE_EVENT
              DemIndicatorBehaviour = DEM_INDICATOR_CONTINUOUS
              DemIndicatorHealingCycleCounterThreshold = 3
              DemIndicatorHealingCycleRef = PowerCycle
              DemIndicatorRef = WarningIndicator
        DTC_0x116996: DemEventId=66, DemDTCClassRef=DTCClass_DTC_0x116996
          DemEventClass:
            DemAgingAllowed = true
            DemAgingCycleCounterThreshold = 40
            DemEventDestination = DEM_DTC_ORIGIN_PRIMARY_MEMORY
            DemEventPriority = 1
            DemEventSignificance = DEM_EVENT_SIGNIFICANCE_FAULT
            DemEventFailureCycleCounterThreshold = 0
            DemConsiderPtoStatus = false
            DemFFPrestorageSupported = false
            DemAgingCycleRef = PowerCycle
            DemOperationCycleRef = PowerCycle
            DemDebounceAlgorithmClass
              DemDebounceCounterBased:
                DemDebounceCounterDecrementStepSize = 1
                DemDebounceCounterIncrementStepSize = 1
                DemDebounceCounterJumpDown = false
                DemDebounceCounterJumpUp = true
                DemDebounceBehavior = DEM_DEBOUNCE_FREEZE
                DemDebounceCounterFailedThreshold = 127
                DemDebounceCounterJumpDownValue = 0
                DemDebounceCounterJumpUpValue = 0
                DemDebounceCounterPassedThreshold = -128
                DemDebounceCounterStorage = false
                DemDebounceContinuous = false
            IndicatorAttribute_WarningIndicator (DemIndicatorAttribute):
              DemIndicatorFailureCycleSource = DEM_FAILURE_CYCLE_EVENT
              DemIndicatorBehaviour = DEM_INDICATOR_CONTINUOUS
              DemIndicatorHealingCycleCounterThreshold = 3
              DemIndicatorHealingCycleRef = PowerCycle
              DemIndicatorRef = WarningIndicator
        DTC_0x115e1a: DemEventId=6, DemDTCClassRef=DTCClass_DTC_0x115e1a
          DemEventClass:
            DemAgingAllowed = true
            DemAgingCycleCounterThreshold = 40
            DemEventDestination = DEM_DTC_ORIGIN_PRIMARY_MEMORY
            DemEventPriority = 2
            DemEventSignificance = DEM_EVENT_SIGNIFICANCE_FAULT
            DemEventFailureCycleCounterThreshold = 0
            DemConsiderPtoStatus = false
            DemFFPrestorageSupported = false
            DemAgingCycleRef = PowerCycle
            DemEnableConditionGroupRef = EnableConditionGroup_fdfec498
            DemOperationCycleRef = No_known_corrective_action
            DemDebounceAlgorithmClass
              DemDebounceCounterBased:
                DemDebounceCounterDecrementStepSize = 1
                DemDebounceCounterIncrementStepSize = 1
                DemDebounceCounterJumpDown = false
                DemDebounceCounterJumpUp = true
                DemDebounceBehavior = DEM_DEBOUNCE_FREEZE
                DemDebounceCounterFailedThreshold = 127
                DemDebounceCounterJumpDownValue = 0
                DemDebounceCounterJumpUpValue = 0
                DemDebounceCounterPassedThreshold = -128
                DemDebounceCounterStorage = false
                DemDebounceContinuous = false
            IndicatorAttribute_WarningIndicator (DemIndicatorAttribute):
              DemIndicatorFailureCycleSource = DEM_FAILURE_CYCLE_EVENT
              DemIndicatorBehaviour = DEM_INDICATOR_CONTINUOUS
              DemIndicatorHealingCycleCounterThreshold = 3
              DemIndicatorHealingCycleRef = No_known_corrective_action
              DemIndicatorRef = WarningIndicator
        DTC_0x114697: DemEventId=46, DemDTCClassRef=DTCClass_DTC_0x114697
          DemEventClass:
            DemAgingAllowed = true
            DemAgingCycleCounterThreshold = 40
            DemEventDestination = DEM_DTC_ORIGIN_PRIMARY_MEMORY
            DemEventPriority = 1
            DemEventSignificance = DEM_EVENT_SIGNIFICANCE_FAULT
            DemEventFailureCycleCounterThreshold = 0
            DemConsiderPtoStatus = false
            DemFFPrestorageSupported = false
            DemAgingCycleRef = PowerCycle
            DemEnableConditionGroupRef = EnableConditionGroup_bbe52cb7
            DemOperationCycleRef = PowerCycle
            DemDebounceAlgorithmClass
              DemDebounceCounterBased:
                DemDebounceCounterDecrementStepSize = 1
                DemDebounceCounterIncrementStepSize = 1
                DemDebounceCounterJumpDown = false
                DemDebounceCounterJumpUp = true
                DemDebounceBehavior = DEM_DEBOUNCE_FREEZE
                DemDebounceCounterFailedThreshold = 127
                DemDebounceCounterJumpDownValue = 0
                DemDebounceCounterJumpUpValue = 0
                DemDebounceCounterPassedThreshold = -128
                DemDebounceCounterStorage = false
                DemDebounceContinuous = false
            IndicatorAttribute_WarningIndicator (DemIndicatorAttribute):
              DemIndicatorFailureCycleSource = DEM_FAILURE_CYCLE_EVENT
              DemIndicatorBehaviour = DEM_INDICATOR_CONTINUOUS
              DemIndicatorHealingCycleCounterThreshold = 3
              DemIndicatorHealingCycleRef = PowerCycle
              DemIndicatorRef = WarningIndicator
        DTC_0xc14787: DemEventId=93, DemDTCClassRef=DTCClass_DTC_0xc14787
          DemEventClass:
            DemAgingAllowed = true
            DemAgingCycleCounterThreshold = 40
            DemEventDestination = DEM_DTC_ORIGIN_PRIMARY_MEMORY
            DemEventPriority = 2
            DemEventSignificance = DEM_EVENT_SIGNIFICANCE_FAULT
            DemEventFailureCycleCounterThreshold = 0
            DemConsiderPtoStatus = false
            DemFFPrestorageSupported = false
            DemAgingCycleRef = PowerCycle
            DemEnableConditionGroupRef = EnableConditionGroup_f3616881
            DemOperationCycleRef = PowerCycle
            DemDebounceAlgorithmClass
              DemDebounceCounterBased:
                DemDebounceCounterDecrementStepSize = 1
                DemDebounceCounterIncrementStepSize = 1
                DemDebounceCounterJumpDown = false
                DemDebounceCounterJumpUp = true
                DemDebounceBehavior = DEM_DEBOUNCE_FREEZE
                DemDebounceCounterFailedThreshold = 127
                DemDebounceCounterJumpDownValue = 0
                DemDebounceCounterJumpUpValue = 0
                DemDebounceCounterPassedThreshold = -128
                DemDebounceCounterStorage = false
                DemDebounceContinuous = false
            IndicatorAttribute_WarningIndicator (DemIndicatorAttribute):
              DemIndicatorFailureCycleSource = DEM_FAILURE_CYCLE_EVENT
              DemIndicatorBehaviour = DEM_INDICATOR_CONTINUOUS
              DemIndicatorHealingCycleCounterThreshold = 3
              DemIndicatorHealingCycleRef = PowerCycle
              DemIndicatorRef = WarningIndicator
      3 x DemDTCClass, all with DemDTCSeverity=DEM_DTC_SEV_NO_SEVERITY, DemImmediateNvStorage=false:
        DTCClass_DTC_0x115192: DemUdsDTC=1134994
        DTCClass_DTC_0x111152: DemUdsDTC=1118546
        DTCClass_DTC_0x113697: DemUdsDTC=1128087
      5 x DemEventParameter, all with DemEventKind=DEM_EVENT_KIND_SWC, DemEventTimeSeries=DEM_TIMESERIES_SNAPSHOT_NONE, DemEventAvailable=true, DemEventAvailableInVariant=true, DemEventLatchTestFailed=false, DemEventCreateInfoPort=true, DemExtendedDataClassRef=ExtendedDataClass_83dcefb7, DemFreezeFrameRecNumClassRef=FreezeFrameRecNumClass_f98c8aa7:
        DTC_0xd13787: DemEventId=107, DemDTCClassRef=DTCClass_DTC_0xd13787, DemFreezeFrameClassRef=FreezeFrameClass_5f5b5001
          DemEventClass:
            DemAgingAllowed = true
            DemAgingCycleCounterThreshold = 40
            DemEventDestination = DEM_DTC_ORIGIN_PRIMARY_MEMORY
            DemEventPriority = 2
            DemEventSignificance = DEM_EVENT_SIGNIFICANCE_FAULT
            DemEventFailureCycleCounterThreshold = 0
            DemConsiderPtoStatus = false
            DemFFPrestorageSupported = false
            DemAgingCycleRef = PowerCycle
            DemEnableConditionGroupRef = EnableConditionGroup_f3616881
            DemOperationCycleRef = PowerCycle
            DemDebounceAlgorithmClass
              DemDebounceCounterBased:
                DemDebounceCounterDecrementStepSize = 1
                DemDebounceCounterIncrementStepSize = 1
                DemDebounceCounterJumpDown = false
                DemDebounceCounterJumpUp = true
                DemDebounceBehavior = DEM_DEBOUNCE_FREEZE
                DemDebounceCounterFailedThreshold = 127
                DemDebounceCounterJumpDownValue = 0
                DemDebounceCounterJumpUpValue = 0
                DemDebounceCounterPassedThreshold = -128
                DemDebounceCounterStorage = false
                DemDebounceContinuous = false
            IndicatorAttribute_WarningIndicator (DemIndicatorAttribute):
              DemIndicatorFailureCycleSource = DEM_FAILURE_CYCLE_EVENT
              DemIndicatorBehaviour = DEM_INDICATOR_CONTINUOUS
              DemIndicatorHealingCycleCounterThreshold = 3
              DemIndicatorHealingCycleRef = PowerCycle
              DemIndicatorRef = WarningIndicator
        DTC_0x114571: DemEventId=45, DemDTCClassRef=DTCClass_DTC_0x114571, DemFreezeFrameClassRef=FreezeFrameClass_376d31f7
          DemEventClass:
            DemAgingAllowed = true
            DemAgingCycleCounterThreshold = 40
            DemEventDestination = DEM_DTC_ORIGIN_PRIMARY_MEMORY
            DemEventPriority = 2
            DemEventSignificance = DEM_EVENT_SIGNIFICANCE_FAULT
            DemEventFailureCycleCounterThreshold = 0
            DemConsiderPtoStatus = false
            DemFFPrestorageSupported = false
            DemAgingCycleRef = PowerCycle
            DemEnableConditionGroupRef = EnableConditionGroup_fdfec498
            DemOperationCycleRef = PowerCycle
            DemDebounceAlgorithmClass
              DemDebounceCounterBased:
                DemDebounceCounterDecrementStepSize = 1
                DemDebounceCounterIncrementStepSize = 1
                DemDebounceCounterJumpDown = false
                DemDebounceCounterJumpUp = true
                DemDebounceBehavior = DEM_DEBOUNCE_FREEZE
                DemDebounceCounterFailedThreshold = 127
                DemDebounceCounterJumpDownValue = 0
                DemDebounceCounterJumpUpValue = 0
                DemDebounceCounterPassedThreshold = -128
                DemDebounceCounterStorage = false
                DemDebounceContinuous = false
            IndicatorAttribute_WarningIndicator (DemIndicatorAttribute):
              DemIndicatorFailureCycleSource = DEM_FAILURE_CYCLE_EVENT
              DemIndicatorBehaviour = DEM_INDICATOR_CONTINUOUS
              DemIndicatorHealingCycleCounterThreshold = 3
              DemIndicatorHealingCycleRef = PowerCycle
              DemIndicatorRef = WarningIndicator
        DTC_0x11281e: DemEventId=18, DemDTCClassRef=DTCClass_DTC_0x11281e, DemFreezeFrameClassRef=FreezeFrameClass_5f5b5001
          DemEventClass:
            DemAgingAllowed = true
            DemAgingCycleCounterThreshold = 40
            DemEventDestination = DEM_DTC_ORIGIN_PRIMARY_MEMORY
            DemEventPriority = 1
            DemEventSignificance = DEM_EVENT_SIGNIFICANCE_FAULT
            DemEventFailureCycleCounterThreshold = 0
            DemConsiderPtoStatus = false
            DemFFPrestorageSupported = false
            DemAgingCycleRef = PowerCycle
            DemEnableConditionGroupRef = EnableConditionGroup_bbe52cb7
            DemOperationCycleRef = PowerCycle
            DemDebounceAlgorithmClass
              DemDebounceCounterBased:
                DemDebounceCounterDecrementStepSize = 1
                DemDebounceCounterIncrementStepSize = 1
                DemDebounceCounterJumpDown = false
                DemDebounceCounterJumpUp = true
                DemDebounceBehavior = DEM_DEBOUNCE_FREEZE
                DemDebounceCounterFailedThreshold = 127
                DemDebounceCounterJumpDownValue = 0
                DemDebounceCounterJumpUpValue = 0
                DemDebounceCounterPassedThreshold = -128
                DemDebounceCounterStorage = false
                DemDebounceContinuous = false
            IndicatorAttribute_WarningIndicator (DemIndicatorAttribute):
              DemIndicatorFailureCycleSource = DEM_FAILURE_CYCLE_EVENT
              DemIndicatorBehaviour = DEM_INDICATOR_CONTINUOUS
              DemIndicatorHealingCycleCounterThreshold = 3
              DemIndicatorHealingCycleRef = PowerCycle
              DemIndicatorRef = WarningIndicator
        DTC_0x116197: DemEventId=59, DemDTCClassRef=DTCClass_DTC_0x116197, DemFreezeFrameClassRef=FreezeFrameClass_5f5b5001
          DemEventClass:
            DemAgingAllowed = true
            DemAgingCycleCounterThreshold = 40
            DemEventDestination = DEM_DTC_ORIGIN_PRIMARY_MEMORY
            DemEventPriority = 2
            DemEventSignificance = DEM_EVENT_SIGNIFICANCE_FAULT
            DemEventFailureCycleCounterThreshold = 0
            DemConsiderPtoStatus = false
            DemFFPrestorageSupported = false
            DemAgingCycleRef = PowerCycle
            DemEnableConditionGroupRef = EnableConditionGroup_fdfec498
            DemOperationCycleRef = PowerCycle
            DemDebounceAlgorithmClass
              DemDebounceCounterBased:
                DemDebounceCounterDecrementStepSize = 1
                DemDebounceCounterIncrementStepSize = 1
                DemDebounceCounterJumpDown = false
                DemDebounceCounterJumpUp = true
                DemDebounceBehavior = DEM_DEBOUNCE_FREEZE
                DemDebounceCounterFailedThreshold = 127
                DemDebounceCounterJumpDownValue = 0
                DemDebounceCounterJumpUpValue = 0
                DemDebounceCounterPassedThreshold = -128
                DemDebounceCounterStorage = false
                DemDebounceContinuous = false
            IndicatorAttribute_WarningIndicator (DemIndicatorAttribute):
              DemIndicatorFailureCycleSource = DEM_FAILURE_CYCLE_EVENT
              DemIndicatorBehaviour = DEM_INDICATOR_CONTINUOUS
              DemIndicatorHealingCycleCounterThreshold = 3
              DemIndicatorHealingCycleRef = PowerCycle
              DemIndicatorRef = WarningIndicator
        DTC_0xc29887: DemEventId=103, DemDTCClassRef=DTCClass_DTC_0xc29887, DemFreezeFrameClassRef=FreezeFrameClass_5f5b5001
          DemEventClass:
            DemAgingAllowed = false
            DemAgingCycleCounterThreshold = 0
            DemEventDestination = DEM_DTC_ORIGIN_PRIMARY_MEMORY
            DemEventPriority = 1
            DemEventSignificance = DEM_EVENT_SIGNIFICANCE_FAULT
            DemEventFailureCycleCounterThreshold = 0
            DemConsiderPtoStatus = false
            DemFFPrestorageSupported = false
            DemAgingCycleRef = PowerCycle
            DemEnableConditionGroupRef = EnableConditionGroup_f3616881
            DemOperationCycleRef = PowerCycle
            DemDebounceAlgorithmClass
              DemDebounceCounterBased:
                DemDebounceCounterDecrementStepSize = 1
                DemDebounceCounterIncrementStepSize = 1
                DemDebounceCounterJumpDown = false
                DemDebounceCounterJumpUp = true
                DemDebounceBehavior = DEM_DEBOUNCE_FREEZE
                DemDebounceCounterFailedThreshold = 127
                DemDebounceCounterJumpDownValue = 0
                DemDebounceCounterJumpUpValue = 0
                DemDebounceCounterPassedThreshold = -128
                DemDebounceCounterStorage = false
                DemDebounceContinuous = false
            IndicatorAttribute_WarningIndicator (DemIndicatorAttribute):
              DemIndicatorFailureCycleSource = DEM_FAILURE_CYCLE_EVENT
              DemIndicatorBehaviour = DEM_INDICATOR_CONTINUOUS
              DemIndicatorHealingCycleCounterThreshold = 3
              DemIndicatorHealingCycleRef = PowerCycle
              DemIndicatorRef = WarningIndicator
      DTCClass_DTC_0x116716 (DemDTCClass): DemDTCSeverity=DEM_DTC_SEV_NO_SEVERITY, DemUdsDTC=1140502, DemImmediateNvStorage=false
      DTCClass_DTC_0xc16b87 (DemDTCClass): DemDTCSeverity=DEM_DTC_SEV_NO_SEVERITY, DemUdsDTC=12675975, DemImmediateNvStorage=false
      DTC_0x113397 (DemEventParameter):
        DemEventKind = DEM_EVENT_KIND_SWC
        DemEventTimeSeries = DEM_TIMESERIES_SNAPSHOT_NONE
        DemEventAvailable = true
        DemEventId = 33
        DemEventAvailableInVariant = true
        DemEventLatchTestFailed = false
        DemEventCreateInfoPort = true
        DemDTCClassRef = DTCClass_DTC_0x113397
        DemExtendedDataClassRef = ExtendedDataClass_83dcefb7
        DemFreezeFrameClassRef = FreezeFrameClass_d96350db
        DemFreezeFrameRecNumClassRef = FreezeFrameRecNumClass_f98c8aa7
        DemEventClass:
          DemAgingAllowed = true
          DemAgingCycleCounterThreshold = 40
          DemEventDestination = DEM_DTC_ORIGIN_PRIMARY_MEMORY
          DemEventPriority = 1
          DemEventSignificance = DEM_EVENT_SIGNIFICANCE_FAULT
          DemEventFailureCycleCounterThreshold = 0
          DemConsiderPtoStatus = false
          DemFFPrestorageSupported = false
          DemAgingCycleRef = PowerCycle
          DemEnableConditionGroupRef = EnableConditionGroup_fdfec498
          DemOperationCycleRef = PowerCycle
          DemDebounceAlgorithmClass
            DemDebounceCounterBased:
              DemDebounceCounterDecrementStepSize = 1
              DemDebounceCounterIncrementStepSize = 1
              DemDebounceCounterJumpDown = false
              DemDebounceCounterJumpUp = true
              DemDebounceBehavior = DEM_DEBOUNCE_FREEZE
              DemDebounceCounterFailedThreshold = 127
              DemDebounceCounterJumpDownValue = 0
              DemDebounceCounterJumpUpValue = 0
              DemDebounceCounterPassedThreshold = -128
              DemDebounceCounterStorage = false
              DemDebounceContinuous = false
          IndicatorAttribute_WarningIndicator (DemIndicatorAttribute):
            DemIndicatorFailureCycleSource = DEM_FAILURE_CYCLE_EVENT
            DemIndicatorBehaviour = DEM_INDICATOR_CONTINUOUS
            DemIndicatorHealingCycleCounterThreshold = 3
            DemIndicatorHealingCycleRef = PowerCycle
            DemIndicatorRef = WarningIndicator
      DTC_0x117511 (DemEventParameter):
        DemEventKind = DEM_EVENT_KIND_SWC
        DemEventTimeSeries = DEM_TIMESERIES_SNAPSHOT_NONE
        DemEventAvailable = true
        DemEventId = 72
        DemEventAvailableInVariant = true
        DemEventLatchTestFailed = false
        DemEventCreateInfoPort = true
        DemDTCClassRef = DTCClass_DTC_0x117511
        DemExtendedDataClassRef = ExtendedDataClass_83dcefb7
        DemFreezeFrameClassRef = FreezeFrameClass_5f5b5001
        DemFreezeFrameRecNumClassRef = FreezeFrameRecNumClass_f98c8aa7
        DemEventClass:
          DemAgingAllowed = true
          DemAgingCycleCounterThreshold = 0
          DemEventDestination = DEM_DTC_ORIGIN_PRIMARY_MEMORY
          DemEventPriority = 1
          DemEventSignificance = DEM_EVENT_SIGNIFICANCE_FAULT
          DemEventFailureCycleCounterThreshold = 0
          DemConsiderPtoStatus = false
          DemFFPrestorageSupported = false
          DemAgingCycleRef = PowerCycle
          DemEnableConditionGroupRef = EnableConditionGroup_bbe52cb7
          DemOperationCycleRef = PowerCycle
          DemDebounceAlgorithmClass
            DemDebounceCounterBased:
              DemDebounceCounterDecrementStepSize = 1
              DemDebounceCounterIncrementStepSize = 1
              DemDebounceCounterJumpDown = false
              DemDebounceCounterJumpUp = true
              DemDebounceBehavior = DEM_DEBOUNCE_FREEZE
              DemDebounceCounterFailedThreshold = 127
              DemDebounceCounterJumpDownValue = 0
              DemDebounceCounterJumpUpValue = 0
              DemDebounceCounterPassedThreshold = -128
              DemDebounceCounterStorage = false
              DemDebounceContinuous = false
          IndicatorAttribute_WarningIndicator (DemIndicatorAttribute):
            DemIndicatorFailureCycleSource = DEM_FAILURE_CYCLE_EVENT
            DemIndicatorBehaviour = DEM_INDICATOR_CONTINUOUS
            DemIndicatorHealingCycleCounterThreshold = 3
            DemIndicatorHealingCycleRef = PowerCycle
            DemIndicatorRef = WarningIndicator
      DTCClass_DTC_0x114097 (DemDTCClass): DemDTCSeverity=DEM_DTC_SEV_NO_SEVERITY, DemUdsDTC=1130647, DemImmediateNvStorage=false
      DTC_0x117197 (DemEventParameter):
        DemEventKind = DEM_EVENT_KIND_SWC
        DemEventTimeSeries = DEM_TIMESERIES_SNAPSHOT_NONE
        DemEventAvailable = true
        DemEventId = 68
        DemEventAvailableInVariant = true
        DemEventLatchTestFailed = false
        DemEventCreateInfoPort = true
        DemDTCClassRef = DTCClass_DTC_0x117197
        DemExtendedDataClassRef = ExtendedDataClass_83dcefb7
        DemFreezeFrameClassRef = FreezeFrameClass_5f5b5001
        DemFreezeFrameRecNumClassRef = FreezeFrameRecNumClass_f98c8aa7
        DemEventClass:
          DemAgingAllowed = true
          DemAgingCycleCounterThreshold = 40
          DemEventDestination = DEM_DTC_ORIGIN_PRIMARY_MEMORY
          DemEventPriority = 1
          DemEventSignificance = DEM_EVENT_SIGNIFICANCE_FAULT
          DemEventFailureCycleCounterThreshold = 0
          DemConsiderPtoStatus = false
          DemFFPrestorageSupported = false
          DemAgingCycleRef = PowerCycle
          DemEnableConditionGroupRef = EnableConditionGroup_fdfec498
          DemOperationCycleRef = PowerCycle
          DemDebounceAlgorithmClass
            DemDebounceCounterBased:
              DemDebounceCounterDecrementStepSize = 1
              DemDebounceCounterIncrementStepSize = 1
              DemDebounceCounterJumpDown = false
              DemDebounceCounterJumpUp = true
              DemDebounceBehavior = DEM_DEBOUNCE_FREEZE
              DemDebounceCounterFailedThreshold = 127
              DemDebounceCounterJumpDownValue = 0
              DemDebounceCounterJumpUpValue = 0
              DemDebounceCounterPassedThreshold = -128
              DemDebounceCounterStorage = false
              DemDebounceContinuous = false
          IndicatorAttribute_WarningIndicator (DemIndicatorAttribute):
            DemIndicatorFailureCycleSource = DEM_FAILURE_CYCLE_EVENT
            DemIndicatorBehaviour = DEM_INDICATOR_CONTINUOUS
            DemIndicatorHealingCycleCounterThreshold = 3
            DemIndicatorHealingCycleRef = PowerCycle
            DemIndicatorRef = WarningIndicator
      DTC_0xc20700 (DemEventParameter):
        DemEventKind = DEM_EVENT_KIND_SWC
        DemEventTimeSeries = DEM_TIMESERIES_SNAPSHOT_NONE
        DemEventAvailable = true
        DemEventId = 101
        DemEventAvailableInVariant = true
        DemEventLatchTestFailed = false
        DemEventCreateInfoPort = true
        DemDTCClassRef = DTCClass_DTC_0xc20700
        DemExtendedDataClassRef = ExtendedDataClass_83dcefb7
        DemFreezeFrameClassRef = FreezeFrameClass_5f5b5001
        DemFreezeFrameRecNumClassRef = FreezeFrameRecNumClass_f98c8aa7
        DemEventClass:
          DemAgingAllowed = true
          DemAgingCycleCounterThreshold = 40
          DemEventDestination = DEM_DTC_ORIGIN_PRIMARY_MEMORY
          DemEventPriority = 2
          DemEventSignificance = DEM_EVENT_SIGNIFICANCE_FAULT
          DemEventFailureCycleCounterThreshold = 0
          DemConsiderPtoStatus = false
          DemFFPrestorageSupported = false
          DemAgingCycleRef = PowerCycle
          DemEnableConditionGroupRef = EnableConditionGroup_4ffb066f
          DemOperationCycleRef = PowerCycle
          DemDebounceAlgorithmClass
            DemDebounceCounterBased:
              DemDebounceCounterDecrementStepSize = 1
              DemDebounceCounterIncrementStepSize = 1
              DemDebounceCounterJumpDown = false
              DemDebounceCounterJumpUp = true
              DemDebounceBehavior = DEM_DEBOUNCE_FREEZE
              DemDebounceCounterFailedThreshold = 127
              DemDebounceCounterJumpDownValue = 0
              DemDebounceCounterJumpUpValue = 0
              DemDebounceCounterPassedThreshold = -128
              DemDebounceCounterStorage = false
              DemDebounceContinuous = false
          IndicatorAttribute_WarningIndicator (DemIndicatorAttribute):
            DemIndicatorFailureCycleSource = DEM_FAILURE_CYCLE_EVENT
            DemIndicatorBehaviour = DEM_INDICATOR_CONTINUOUS
            DemIndicatorHealingCycleCounterThreshold = 3
            DemIndicatorHealingCycleRef = PowerCycle
            DemIndicatorRef = WarningIndicator
      DTCClass_DTC_0xc14687 (DemDTCClass): DemDTCSeverity=DEM_DTC_SEV_NO_SEVERITY, DemUdsDTC=12666503, DemImmediateNvStorage=false
      DTC_0xc29a87 (DemEventParameter):
        DemEventKind = DEM_EVENT_KIND_SWC
        DemEventTimeSeries = DEM_TIMESERIES_SNAPSHOT_NONE
        DemEventAvailable = true
        DemEventId = 84
        DemEventAvailableInVariant = true
        DemEventLatchTestFailed = false
        DemEventCreateInfoPort = true
        DemDTCClassRef = DTCClass_DTC_0xc29a87
        DemExtendedDataClassRef = ExtendedDataClass_83dcefb7
        DemFreezeFrameClassRef = FreezeFrameClass_5f5b5001
        DemFreezeFrameRecNumClassRef = FreezeFrameRecNumClass_f98c8aa7
        DemEventClass:
          DemAgingAllowed = true
          DemAgingCycleCounterThreshold = 40
          DemEventDestination = DEM_DTC_ORIGIN_PRIMARY_MEMORY
          DemEventPriority = 2
          DemEventSignificance = DEM_EVENT_SIGNIFICANCE_FAULT
          DemEventFailureCycleCounterThreshold = 0
          DemConsiderPtoStatus = false
          DemFFPrestorageSupported = false
          DemAgingCycleRef = PowerCycle
          DemEnableConditionGroupRef = EnableConditionGroup_4ffb066f
          DemOperationCycleRef = PowerCycle
          DemDebounceAlgorithmClass
            DemDebounceCounterBased:
              DemDebounceCounterDecrementStepSize = 1
              DemDebounceCounterIncrementStepSize = 1
              DemDebounceCounterJumpDown = false
              DemDebounceCounterJumpUp = true
              DemDebounceBehavior = DEM_DEBOUNCE_FREEZE
              DemDebounceCounterFailedThreshold = 127
              DemDebounceCounterJumpDownValue = 0
              DemDebounceCounterJumpUpValue = 0
              DemDebounceCounterPassedThreshold = -128
              DemDebounceCounterStorage = false
              DemDebounceContinuous = false
          IndicatorAttribute_WarningIndicator (DemIndicatorAttribute):
            DemIndicatorFailureCycleSource = DEM_FAILURE_CYCLE_EVENT
            DemIndicatorBehaviour = DEM_INDICATOR_CONTINUOUS
            DemIndicatorHealingCycleCounterThreshold = 3
            DemIndicatorHealingCycleRef = PowerCycle
            DemIndicatorRef = WarningIndicator
      DTCClass_DTC_0x116397 (DemDTCClass): DemDTCSeverity=DEM_DTC_SEV_NO_SEVERITY, DemUdsDTC=1139607, DemImmediateNvStorage=false
      DTC_0x115692 (DemEventParameter):
        DemEventKind = DEM_EVENT_KIND_SWC
        DemEventTimeSeries = DEM_TIMESERIES_SNAPSHOT_NONE
        DemEventAvailable = true
        DemEventId = 56
        DemEventAvailableInVariant = true
        DemEventLatchTestFailed = false
        DemEventCreateInfoPort = true
        DemDTCClassRef = DTCClass_DTC_0x115692
        DemExtendedDataClassRef = ExtendedDataClass_83dcefb7
        DemFreezeFrameClassRef = FreezeFrameClass_5f5b5001
        DemFreezeFrameRecNumClassRef = FreezeFrameRecNumClass_f98c8aa7
        DemEventClass:
          DemAgingAllowed = true
          DemAgingCycleCounterThreshold = 40
          DemEventDestination = DEM_DTC_ORIGIN_PRIMARY_MEMORY
          DemEventPriority = 2
          DemEventSignificance = DEM_EVENT_SIGNIFICANCE_FAULT
          DemEventFailureCycleCounterThreshold = 0
          DemConsiderPtoStatus = false
          DemFFPrestorageSupported = false
          DemAgingCycleRef = PowerCycle
          DemEnableConditionGroupRef = EnableConditionGroup_fdfec498
          DemOperationCycleRef = PowerCycle
          DemDebounceAlgorithmClass
            DemDebounceCounterBased:
              DemDebounceCounterDecrementStepSize = 1
              DemDebounceCounterIncrementStepSize = 1
              DemDebounceCounterJumpDown = false
              DemDebounceCounterJumpUp = true
              DemDebounceBehavior = DEM_DEBOUNCE_FREEZE
              DemDebounceCounterFailedThreshold = 127
              DemDebounceCounterJumpDownValue = 0
              DemDebounceCounterJumpUpValue = 0
              DemDebounceCounterPassedThreshold = -128
              DemDebounceCounterStorage = false
              DemDebounceContinuous = false
          IndicatorAttribute_WarningIndicator (DemIndicatorAttribute):
            DemIndicatorFailureCycleSource = DEM_FAILURE_CYCLE_EVENT
            DemIndicatorBehaviour = DEM_INDICATOR_CONTINUOUS
            DemIndicatorHealingCycleCounterThreshold = 3
            DemIndicatorHealingCycleRef = PowerCycle
            DemIndicatorRef = WarningIndicator
      DTCClass_DTC_0x114892 (DemDTCClass): DemDTCSeverity=DEM_DTC_SEV_NO_SEVERITY, DemUdsDTC=1132690, DemImmediateNvStorage=false
      3 x DemEventParameter, all with DemEventKind=DEM_EVENT_KIND_SWC, DemEventTimeSeries=DEM_TIMESERIES_SNAPSHOT_NONE, DemEventAvailable=true, DemEventAvailableInVariant=true, DemEventLatchTestFailed=false, DemEventCreateInfoPort=true, DemExtendedDataClassRef=ExtendedDataClass_83dcefb7, DemFreezeFrameClassRef=FreezeFrameClass_5f5b5001, DemFreezeFrameRecNumClassRef=FreezeFrameRecNumClass_f98c8aa7:
        DTC_0xc20287: DemEventId=100, DemDTCClassRef=DTCClass_DTC_0xc20287
          DemEventClass:
            DemAgingAllowed = true
            DemAgingCycleCounterThreshold = 40
            DemEventDestination = DEM_DTC_ORIGIN_PRIMARY_MEMORY
            DemEventPriority = 2
            DemEventSignificance = DEM_EVENT_SIGNIFICANCE_FAULT
            DemEventFailureCycleCounterThreshold = 0
            DemConsiderPtoStatus = false
            DemFFPrestorageSupported = false
            DemAgingCycleRef = PowerCycle
            DemEnableConditionGroupRef = EnableConditionGroup_f3616881
            DemOperationCycleRef = PowerCycle
            DemDebounceAlgorithmClass
              DemDebounceCounterBased:
                DemDebounceCounterDecrementStepSize = 1
                DemDebounceCounterIncrementStepSize = 1
                DemDebounceCounterJumpDown = false
                DemDebounceCounterJumpUp = true
                DemDebounceBehavior = DEM_DEBOUNCE_FREEZE
                DemDebounceCounterFailedThreshold = 127
                DemDebounceCounterJumpDownValue = 0
                DemDebounceCounterJumpUpValue = 0
                DemDebounceCounterPassedThreshold = -128
                DemDebounceCounterStorage = false
                DemDebounceContinuous = false
            IndicatorAttribute_WarningIndicator (DemIndicatorAttribute):
              DemIndicatorFailureCycleSource = DEM_FAILURE_CYCLE_EVENT
              DemIndicatorBehaviour = DEM_INDICATOR_CONTINUOUS
              DemIndicatorHealingCycleCounterThreshold = 3
              DemIndicatorHealingCycleRef = PowerCycle
              DemIndicatorRef = WarningIndicator
        DTC_0x116d05: DemEventId=9, DemDTCClassRef=DTCClass_DTC_0x116d05
          DemEventClass:
            DemAgingAllowed = true
            DemAgingCycleCounterThreshold = 40
            DemEventDestination = DEM_DTC_ORIGIN_PRIMARY_MEMORY
            DemEventPriority = 1
            DemEventSignificance = DEM_EVENT_SIGNIFICANCE_FAULT
            DemEventFailureCycleCounterThreshold = 0
            DemConsiderPtoStatus = false
            DemFFPrestorageSupported = false
            DemAgingCycleRef = PowerCycle
            DemOperationCycleRef = PowerCycle
            DemDebounceAlgorithmClass
              DemDebounceCounterBased:
                DemDebounceCounterDecrementStepSize = 1
                DemDebounceCounterIncrementStepSize = 1
                DemDebounceCounterJumpDown = false
                DemDebounceCounterJumpUp = true
                DemDebounceBehavior = DEM_DEBOUNCE_FREEZE
                DemDebounceCounterFailedThreshold = 127
                DemDebounceCounterJumpDownValue = 0
                DemDebounceCounterJumpUpValue = 0
                DemDebounceCounterPassedThreshold = -128
                DemDebounceCounterStorage = false
                DemDebounceContinuous = false
            IndicatorAttribute_WarningIndicator (DemIndicatorAttribute):
              DemIndicatorFailureCycleSource = DEM_FAILURE_CYCLE_EVENT
              DemIndicatorBehaviour = DEM_INDICATOR_CONTINUOUS
              DemIndicatorHealingCycleCounterThreshold = 3
              DemIndicatorHealingCycleRef = PowerCycle
              DemIndicatorRef = WarningIndicator
        DTC_0xd11b87: DemEventId=104, DemDTCClassRef=DTCClass_DTC_0xd11b87
          DemEventClass:
            DemAgingAllowed = true
            DemAgingCycleCounterThreshold = 40
            DemEventDestination = DEM_DTC_ORIGIN_PRIMARY_MEMORY
            DemEventPriority = 2
            DemEventSignificance = DEM_EVENT_SIGNIFICANCE_FAULT
            DemEventFailureCycleCounterThreshold = 0
            DemConsiderPtoStatus = false
            DemFFPrestorageSupported = false
            DemAgingCycleRef = PowerCycle
            DemEnableConditionGroupRef = EnableConditionGroup_35324f44
            DemOperationCycleRef = PowerCycle
            DemDebounceAlgorithmClass
              DemDebounceCounterBased:
                DemDebounceCounterDecrementStepSize = 1
                DemDebounceCounterIncrementStepSize = 1
                DemDebounceCounterJumpDown = false
                DemDebounceCounterJumpUp = true
                DemDebounceBehavior = DEM_DEBOUNCE_FREEZE
                DemDebounceCounterFailedThreshold = 127
                DemDebounceCounterJumpDownValue = 0
                DemDebounceCounterJumpUpValue = 0
                DemDebounceCounterPassedThreshold = -128
                DemDebounceCounterStorage = false
                DemDebounceContinuous = false
            IndicatorAttribute_WarningIndicator (DemIndicatorAttribute):
              DemIndicatorFailureCycleSource = DEM_FAILURE_CYCLE_EVENT
              DemIndicatorBehaviour = DEM_INDICATOR_CONTINUOUS
              DemIndicatorHealingCycleCounterThreshold = 3
              DemIndicatorHealingCycleRef = PowerCycle
              DemIndicatorRef = WarningIndicator
      DTCClass_DTC_0x908116 (DemDTCClass): DemDTCSeverity=DEM_DTC_SEV_NO_SEVERITY, DemUdsDTC=9470230, DemImmediateNvStorage=false
      DTC_0x117b94 (DemEventParameter):
        DemEventKind = DEM_EVENT_KIND_SWC
        DemEventTimeSeries = DEM_TIMESERIES_SNAPSHOT_NONE
        DemEventAvailable = true
        DemEventId = 13
        DemEventAvailableInVariant = true
        DemEventLatchTestFailed = false
        DemEventCreateInfoPort = true
        DemDTCClassRef = DTCClass_DTC_0x117b94
        DemExtendedDataClassRef = ExtendedDataClass_83dcefb7
        DemFreezeFrameClassRef = FreezeFrameClass_5f5b5001
        DemFreezeFrameRecNumClassRef = FreezeFrameRecNumClass_f98c8aa7
        DemEventClass:
          DemAgingAllowed = true
          DemAgingCycleCounterThreshold = 40
          DemEventDestination = DEM_DTC_ORIGIN_PRIMARY_MEMORY
          DemEventPriority = 2
          DemEventSignificance = DEM_EVENT_SIGNIFICANCE_FAULT
          DemEventFailureCycleCounterThreshold = 0
          DemConsiderPtoStatus = false
          DemFFPrestorageSupported = false
          DemAgingCycleRef = PowerCycle
          DemOperationCycleRef = PowerCycle
          DemDebounceAlgorithmClass
            DemDebounceCounterBased:
              DemDebounceCounterDecrementStepSize = 1
              DemDebounceCounterIncrementStepSize = 1
              DemDebounceCounterJumpDown = false
              DemDebounceCounterJumpUp = true
              DemDebounceBehavior = DEM_DEBOUNCE_FREEZE
              DemDebounceCounterFailedThreshold = 127
              DemDebounceCounterJumpDownValue = 0
              DemDebounceCounterJumpUpValue = 0
              DemDebounceCounterPassedThreshold = -128
              DemDebounceCounterStorage = false
              DemDebounceContinuous = false
          IndicatorAttribute_WarningIndicator (DemIndicatorAttribute):
            DemIndicatorFailureCycleSource = DEM_FAILURE_CYCLE_EVENT
            DemIndicatorBehaviour = DEM_INDICATOR_CONTINUOUS
            DemIndicatorHealingCycleCounterThreshold = 3
            DemIndicatorHealingCycleRef = PowerCycle
            DemIndicatorRef = WarningIndicator
      3 x DemDTCClass, all with DemDTCSeverity=DEM_DTC_SEV_NO_SEVERITY, DemImmediateNvStorage=false:
        DTCClass_DTC_0x908356: DemUdsDTC=9470806
        DTCClass_DTC_0x11571e: DemUdsDTC=1136414
        DTCClass_DTC_0x115292: DemUdsDTC=1135250
      DTC_0x110311 (DemEventParameter):
        DemEventKind = DEM_EVENT_KIND_SWC
        DemEventTimeSeries = DEM_TIMESERIES_SNAPSHOT_NONE
        DemEventAvailable = true
        DemEventId = 27
        DemEventAvailableInVariant = true
        DemEventLatchTestFailed = false
        DemEventCreateInfoPort = true
        DemDTCClassRef = DTCClass_DTC_0x110311
        DemExtendedDataClassRef = ExtendedDataClass_83dcefb7
        DemFreezeFrameClassRef = FreezeFrameClass_5f5b5001
        DemFreezeFrameRecNumClassRef = FreezeFrameRecNumClass_f98c8aa7
        DemEventClass:
          DemAgingAllowed = true
          DemAgingCycleCounterThreshold = 40
          DemEventDestination = DEM_DTC_ORIGIN_PRIMARY_MEMORY
          DemEventPriority = 1
          DemEventSignificance = DEM_EVENT_SIGNIFICANCE_FAULT
          DemEventFailureCycleCounterThreshold = 0
          DemConsiderPtoStatus = false
          DemFFPrestorageSupported = false
          DemAgingCycleRef = PowerCycle
          DemEnableConditionGroupRef = EnableConditionGroup_bbe52cb7
          DemOperationCycleRef = PowerCycle
          DemDebounceAlgorithmClass
            DemDebounceCounterBased:
              DemDebounceCounterDecrementStepSize = 1
              DemDebounceCounterIncrementStepSize = 1
              DemDebounceCounterJumpDown = false
              DemDebounceCounterJumpUp = true
              DemDebounceBehavior = DEM_DEBOUNCE_FREEZE
              DemDebounceCounterFailedThreshold = 127
              DemDebounceCounterJumpDownValue = 0
              DemDebounceCounterJumpUpValue = 0
              DemDebounceCounterPassedThreshold = -128
              DemDebounceCounterStorage = false
              DemDebounceContinuous = false
          IndicatorAttribute_WarningIndicator (DemIndicatorAttribute):
            DemIndicatorFailureCycleSource = DEM_FAILURE_CYCLE_EVENT
            DemIndicatorBehaviour = DEM_INDICATOR_CONTINUOUS
            DemIndicatorHealingCycleCounterThreshold = 3
            DemIndicatorHealingCycleRef = PowerCycle
            DemIndicatorRef = WarningIndicator
      DTCClass_DTC_0x111252 (DemDTCClass): DemDTCSeverity=DEM_DTC_SEV_NO_SEVERITY, DemUdsDTC=1118802, DemImmediateNvStorage=false
      DTC_0x116097 (DemEventParameter):
        DemEventKind = DEM_EVENT_KIND_SWC
        DemEventTimeSeries = DEM_TIMESERIES_SNAPSHOT_NONE
        DemEventAvailable = true
        DemEventId = 58
        DemEventAvailableInVariant = true
        DemEventLatchTestFailed = false
        DemEventCreateInfoPort = true
        DemDTCClassRef = DTCClass_DTC_0x116097
        DemExtendedDataClassRef = ExtendedDataClass_83dcefb7
        DemFreezeFrameClassRef = FreezeFrameClass_5f5b5001
        DemFreezeFrameRecNumClassRef = FreezeFrameRecNumClass_f98c8aa7
        DemEventClass:
          DemAgingAllowed = true
          DemAgingCycleCounterThreshold = 40
          DemEventDestination = DEM_DTC_ORIGIN_PRIMARY_MEMORY
          DemEventPriority = 1
          DemEventSignificance = DEM_EVENT_SIGNIFICANCE_FAULT
          DemEventFailureCycleCounterThreshold = 0
          DemConsiderPtoStatus = false
          DemFFPrestorageSupported = false
          DemAgingCycleRef = PowerCycle
          DemEnableConditionGroupRef = EnableConditionGroup_983000c1
          DemOperationCycleRef = No_known_corrective_action
          DemDebounceAlgorithmClass
            DemDebounceCounterBased:
              DemDebounceCounterDecrementStepSize = 1
              DemDebounceCounterIncrementStepSize = 1
              DemDebounceCounterJumpDown = false
              DemDebounceCounterJumpUp = true
              DemDebounceBehavior = DEM_DEBOUNCE_FREEZE
              DemDebounceCounterFailedThreshold = 127
              DemDebounceCounterJumpDownValue = 0
              DemDebounceCounterJumpUpValue = 0
              DemDebounceCounterPassedThreshold = -128
              DemDebounceCounterStorage = false
              DemDebounceContinuous = false
          IndicatorAttribute_WarningIndicator (DemIndicatorAttribute):
            DemIndicatorFailureCycleSource = DEM_FAILURE_CYCLE_EVENT
            DemIndicatorBehaviour = DEM_INDICATOR_CONTINUOUS
            DemIndicatorHealingCycleCounterThreshold = 3
            DemIndicatorHealingCycleRef = No_known_corrective_action
            DemIndicatorRef = WarningIndicator
      DTCClass_DTC_0x113797 (DemDTCClass): DemDTCSeverity=DEM_DTC_SEV_NO_SEVERITY, DemUdsDTC=1128343, DemImmediateNvStorage=false
      DTC_0x117f08 (DemEventParameter):
        DemEventKind = DEM_EVENT_KIND_SWC
        DemEventTimeSeries = DEM_TIMESERIES_SNAPSHOT_NONE
        DemEventAvailable = true
        DemEventId = 17
        DemEventAvailableInVariant = true
        DemEventLatchTestFailed = false
        DemEventCreateInfoPort = true
        DemDTCClassRef = DTCClass_DTC_0x117f08
        DemExtendedDataClassRef = ExtendedDataClass_83dcefb7
        DemFreezeFrameClassRef = FreezeFrameClass_5f5b5001
        DemFreezeFrameRecNumClassRef = FreezeFrameRecNumClass_f98c8aa7
        DemEventClass:
          DemAgingAllowed = true
          DemAgingCycleCounterThreshold = 40
          DemEventDestination = DEM_DTC_ORIGIN_PRIMARY_MEMORY
          DemEventPriority = 2
          DemEventSignificance = DEM_EVENT_SIGNIFICANCE_FAULT
          DemEventFailureCycleCounterThreshold = 0
          DemConsiderPtoStatus = false
          DemFFPrestorageSupported = false
          DemAgingCycleRef = PowerCycle
          DemEnableConditionGroupRef = EnableConditionGroup_4ffb066f
          DemOperationCycleRef = PowerCycle
          DemDebounceAlgorithmClass
            DemDebounceCounterBased:
              DemDebounceCounterDecrementStepSize = 1
              DemDebounceCounterIncrementStepSize = 1
              DemDebounceCounterJumpDown = false
              DemDebounceCounterJumpUp = true
              DemDebounceBehavior = DEM_DEBOUNCE_FREEZE
              DemDebounceCounterFailedThreshold = 127
              DemDebounceCounterJumpDownValue = 0
              DemDebounceCounterJumpUpValue = 0
              DemDebounceCounterPassedThreshold = -128
              DemDebounceCounterStorage = false
              DemDebounceContinuous = false
          IndicatorAttribute_WarningIndicator (DemIndicatorAttribute):
            DemIndicatorFailureCycleSource = DEM_FAILURE_CYCLE_EVENT
            DemIndicatorBehaviour = DEM_INDICATOR_CONTINUOUS
            DemIndicatorHealingCycleCounterThreshold = 3
            DemIndicatorHealingCycleRef = PowerCycle
            DemIndicatorRef = WarningIndicator
      4 x DemDTCClass, all with DemDTCSeverity=DEM_DTC_SEV_NO_SEVERITY, DemImmediateNvStorage=false:
        DTCClass_DTC_0xc11187: DemUdsDTC=12652935
        DTCClass_DTC_0x116819: DemUdsDTC=1140761
        DTCClass_DTC_0xd10587: DemUdsDTC=13698439
        DTCClass_DTC_0xc07488: DemUdsDTC=12612744
