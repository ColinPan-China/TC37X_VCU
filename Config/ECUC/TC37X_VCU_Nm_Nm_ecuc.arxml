AUTOSAR XML (schema 00048)
package /ActiveEcuC
  module config Nm: implementation-config-variant=VARIANT-PRE-COMPILE, module-description=Nm_Impl
    NmGlobalConfig
      NmGlobalFeatures:
        NmNodeIdEnabled = true
        NmUserDataEnabled = true
        NmBusSynchronizationEnabled = false
        NmCarWakeUpRxEnabled = false
        NmComControlEnabled = true
        NmComUserDataSupport = false
        NmCoordinatorSupportEnabled = false
        NmNodeDetectionEnabled = false
        NmPduRxIndicationEnabled = false
        NmRemoteSleepIndEnabled = false
        NmRepeatMsgIndEnabled = false
        NmStateChangeIndEnabled = true
        NmMacroLayerEnabled = false
        NmCoordinatorSyncSupport = false
        NmRuntimeMeasurementSupport = false
        NmCoordinatorRequestChannelsInBusSleep = false
        NmCoordinatorPassiveStartUpForwarding = false
        NmStateChangeIndCallback = BswM_Nm_StateChangeNotification
        NmCallbacksPrototypeHeader = BswM_Nm.h
      NmGeneration:
        NmOutOfBoundsWriteSanitizer = false
        NmOutOfBoundsReadSanitizer = false
        NmShortSymbols = false
        NmInterfacesForDeactivatedData = false
        NmReferringKeysInComments = false
      NmGlobalProperties: NmDevErrorDetect=true, NmVersionInfoApi=false, NmSafeBswChecks=false
      NmGlobalConstants
    5 x NmChannelConfig, all with NmChannelSleepMaster=false, NmStateReportEnabled=false, NmSynchronizingNetwork=false, NmPassiveModeEnabled=false:
      CN_TC37X_VCU_CAN00_07b6c9c8: NmChannelId=2, NmComMChannelRef=CN_TC37X_VCU_CAN00_07b6c9c8
        TC37X_VCU_CAN00_CAN_cc8c31fa (NmBusType)
          NmStandardBusNmConfig: NmStandardBusType=NM_BUSNM_CANNM  # TC37X_VCU_CAN00_CAN
      CN_TC37X_VCU_CAN01_70b1f95e: NmChannelId=3, NmComMChannelRef=CN_TC37X_VCU_CAN01_70b1f95e
        TC37X_VCU_CAN01_CAN_f1ec184a (NmBusType)
          NmStandardBusNmConfig: NmStandardBusType=NM_BUSNM_CANNM  # TC37X_VCU_CAN01_CAN
      CN_TC37X_VCU_CAN03_9ebf9872: NmChannelId=4, NmComMChannelRef=CN_TC37X_VCU_CAN03_9ebf9872
        TC37X_VCU_CAN03_CAN_8b2c4b2a (NmBusType)
          NmStandardBusNmConfig: NmStandardBusType=NM_BUSNM_CANNM  # TC37X_VCU_CAN03_CAN
      CN_ATOM_CANFD_Matrix_CH_V600_202502_a4d436ac: NmChannelId=0, NmComMChannelRef=CN_ATOM_CANFD_Matrix_CH_V600_202502_a4d436ac
        ATOM_CANFD_Matrix_CH_V600_202502_CAN_b5bd2095 (NmBusType)
          NmStandardBusNmConfig: NmStandardBusType=NM_BUSNM_CANNM  # ATOM_CANFD_Matrix_CH_V600_202502_CAN
      CN_ATOM_CAN_Matrix_PT_V600_20250211_9b894f3d: NmChannelId=1, NmComMChannelRef=CN_ATOM_CAN_Matrix_PT_V600_20250211_9b894f3d
        ATOM_CAN_Matrix_PT_V600_20250211_CAN_5212fbaf (NmBusType)
          NmStandardBusNmConfig: NmStandardBusType=NM_BUSNM_CANNM  # ATOM_CAN_Matrix_PT_V600_20250211_CAN
