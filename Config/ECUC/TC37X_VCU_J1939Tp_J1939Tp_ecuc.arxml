AUTOSAR XML (schema 00048)
package /ActiveEcuC
  module config J1939Tp: implementation-config-variant=VARIANT-PRE-COMPILE, module-description=J1939Tp_Impl
    J1939TpConfiguration
      6 x J1939TpTxChannel, all with J1939TpTxDa=86, J1939TpTxSa=244, J1939TpTxChannelComMNetworkHandleRef=CN_J1939_bms_dea99804:
        J1939_bms_J1939_1f2dfa0e
          J1939TpRxFcNPdu_dc318261 (J1939TpRxFcNPdu): J1939TpRxFcNPduId=0, J1939TpRxFcNPduRef=TPCM_Tp_oJ1939_bms_7c7c1783_Rx
          BCS_oJ1939_bms_735a2330 (J1939TpTxPg): J1939TpTxPgDynLength=false, J1939TpTxPgPGN=4352
            BCS_oJ1939_bms_baf9d3e6_Tx (J1939TpTxNSdu): J1939TpTxNSduId=0, J1939TpTxNSduRef=BCS_oJ1939_bms_baf9d3e6_Tx
          J1939TpTxDtNPdu_dc318261 (J1939TpTxDtNPdu): J1939TpTxDtNPduTxConfId=1, J1939TpTxDtNPduRef=TPDT_Tp_oJ1939_bms_8162bd5c_Tx
          J1939TpTxCmNPdu_dc318261 (J1939TpTxCmNPdu): J1939TpTxCmNPduTxConfId=0, J1939TpTxCmNPduRef=TPCM_Tp_oJ1939_bms_7c7c1783_Tx
        J1939_bms_J1939_537c2fa8
          J1939TpTxDtNPdu_3c21c804 (J1939TpTxDtNPdu): J1939TpTxDtNPduTxConfId=1, J1939TpTxDtNPduRef=TPDT_Tp_oJ1939_bms_8162bd5c_Tx
          BSOC_oJ1939_bms_7857d18e (J1939TpTxPg): J1939TpTxPgDynLength=false, J1939TpTxPgPGN=5888
            BSOC_oJ1939_bms_340842a2_Tx (J1939TpTxNSdu): J1939TpTxNSduId=3, J1939TpTxNSduRef=BSOC_oJ1939_bms_340842a2_Tx
          J1939TpTxCmNPdu_3c21c804 (J1939TpTxCmNPdu): J1939TpTxCmNPduTxConfId=0, J1939TpTxCmNPduRef=TPCM_Tp_oJ1939_bms_7c7c1783_Tx
          J1939TpRxFcNPdu_3c21c804 (J1939TpRxFcNPdu): J1939TpRxFcNPduId=0, J1939TpRxFcNPduRef=TPCM_Tp_oJ1939_bms_7c7c1783_Rx
        J1939_bms_J1939_91531f31
          J1939TpTxDtNPdu_6a2e8a3e (J1939TpTxDtNPdu): J1939TpTxDtNPduTxConfId=1, J1939TpTxDtNPduRef=TPDT_Tp_oJ1939_bms_8162bd5c_Tx
          J1939TpRxFcNPdu_6a2e8a3e (J1939TpRxFcNPdu): J1939TpRxFcNPduId=0, J1939TpRxFcNPduRef=TPCM_Tp_oJ1939_bms_7c7c1783_Rx
          BMT_oJ1939_bms_ba4bdc7d (J1939TpTxPg): J1939TpTxPgDynLength=false, J1939TpTxPgPGN=5632
            BMT_oJ1939_bms_38156aba_Tx (J1939TpTxNSdu): J1939TpTxNSduId=5, J1939TpTxNSduRef=BMT_oJ1939_bms_38156aba_Tx
          J1939TpTxCmNPdu_6a2e8a3e (J1939TpTxCmNPdu): J1939TpTxCmNPduTxConfId=0, J1939TpTxCmNPduRef=TPCM_Tp_oJ1939_bms_7c7c1783_Tx
        J1939_bms_J1939_7d6881ae
          J1939TpTxCmNPdu_0f7dc027 (J1939TpTxCmNPdu): J1939TpTxCmNPduTxConfId=0, J1939TpTxCmNPduRef=TPCM_Tp_oJ1939_bms_7c7c1783_Tx
          BMV_oJ1939_bms_d12ca733 (J1939TpTxPg): J1939TpTxPgDynLength=false, J1939TpTxPgPGN=5376
            BMV_oJ1939_bms_25dabb18_Tx (J1939TpTxNSdu): J1939TpTxNSduId=1, J1939TpTxNSduRef=BMV_oJ1939_bms_25dabb18_Tx
          J1939TpRxFcNPdu_0f7dc027 (J1939TpRxFcNPdu): J1939TpRxFcNPduId=0, J1939TpRxFcNPduRef=TPCM_Tp_oJ1939_bms_7c7c1783_Rx
          J1939TpTxDtNPdu_0f7dc027 (J1939TpTxDtNPdu): J1939TpTxDtNPduTxConfId=1, J1939TpTxDtNPduRef=TPDT_Tp_oJ1939_bms_8162bd5c_Tx
        J1939_bms_J1939_9395bbb3
          J1939TpRxFcNPdu_962cab65 (J1939TpRxFcNPdu): J1939TpRxFcNPduId=0, J1939TpRxFcNPduRef=TPCM_Tp_oJ1939_bms_7c7c1783_Rx
          BRM_oJ1939_bms_c870aba2 (J1939TpTxPg): J1939TpTxPgDynLength=false, J1939TpTxPgPGN=512
            BRM_oJ1939_bms_e96b01db_Tx (J1939TpTxNSdu): J1939TpTxNSduId=4, J1939TpTxNSduRef=BRM_oJ1939_bms_e96b01db_Tx
          J1939TpTxDtNPdu_962cab65 (J1939TpTxDtNPdu): J1939TpTxDtNPduTxConfId=1, J1939TpTxDtNPduRef=TPDT_Tp_oJ1939_bms_8162bd5c_Tx
          J1939TpTxCmNPdu_962cab65 (J1939TpTxCmNPdu): J1939TpTxCmNPduTxConfId=0, J1939TpTxCmNPduRef=TPCM_Tp_oJ1939_bms_7c7c1783_Tx
        J1939_bms_J1939_68b328fe
          J1939TpRxFcNPdu_e84075a6 (J1939TpRxFcNPdu): J1939TpRxFcNPduId=0, J1939TpRxFcNPduRef=TPCM_Tp_oJ1939_bms_7c7c1783_Rx
          J1939TpTxDtNPdu_e84075a6 (J1939TpTxDtNPdu): J1939TpTxDtNPduTxConfId=1, J1939TpTxDtNPduRef=TPDT_Tp_oJ1939_bms_8162bd5c_Tx
          J1939TpTxCmNPdu_e84075a6 (J1939TpTxCmNPdu): J1939TpTxCmNPduTxConfId=0, J1939TpTxCmNPduRef=TPCM_Tp_oJ1939_bms_7c7c1783_Tx
          BCP_oJ1939_bms_18c5a8cb (J1939TpTxPg): J1939TpTxPgDynLength=false, J1939TpTxPgPGN=1536
            BCP_oJ1939_bms_a9d1ea95_Tx (J1939TpTxNSdu): J1939TpTxNSduId=2, J1939TpTxNSduRef=BCP_oJ1939_bms_a9d1ea95_Tx
    J1939TpGeneral:
      J1939TpDevErrorDetect = true
      J1939TpMainFunctionPeriod = 0.01
      J1939TpTxConfTimeout = 1.5
      J1939TpVersionInfoApi = false
      J1939TpSupportBam = true
      J1939TpSupportCmdt = true
      J1939TpSupportEtp = false
      J1939TpSupportFptp = false
      J1939TpRuntimeErrorReport = true
      J1939TpSafeBswChecks = false
