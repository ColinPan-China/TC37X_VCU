AUTOSAR XML (schema 00048)
package /Spi
  module config Spi: implementation-config-variant=VARIANT-POST-BUILD, module-description=Spi_Impl
    CommonPublishedInformation:
      ArMajorVersion = 4
      ArMinorVersion = 2
      ArPatchVersion = 2
      ModuleId = 83
      Release = _TRICORE_TC377
      SwMajorVersion = 10
      SwMinorVersion = 40
      SwPatchVersion = 2
      VendorId = 17
    SpiDriver: SpiMaxChannel=7, SpiMaxJob=7, SpiMaxSequence=6, SpiSystemClock=McuClockReferencePointConfig
      7 x SpiChannel, all with SpiChannelType=EB, SpiDataWidth=8, SpiEbMaxLength=8190, SpiIbNBuffers=10:
        SpiChannel_TJA1145_0: SpiChannelId=2, SpiTransferStart=MSB
        SpiChannel_TJA1145_1: SpiChannelId=3, SpiTransferStart=LSB
        SpiChannel_TJA1145_2: SpiChannelId=4, SpiTransferStart=LSB
        SpiChannel_TJA1145_3: SpiChannelId=5, SpiTransferStart=LSB
        SpiChannel_TLE8888: SpiChannelId=0, SpiDefaultData=0, SpiTransferStart=LSB
        SpiChannel_TLE9201: SpiChannelId=1, SpiDefaultData=0, SpiTransferStart=MSB
        SpiChannel_TLE9410_SPI1: SpiChannelId=6, SpiDefaultData=0, SpiTransferStart=LSB
      4 x SpiExternalDevice, all with SpiAutoCalcBaudParams=true, SpiAutoCalcDelayParams=true, SpiCsPolarity=LOW, SpiCsSelection=CS_VIA_PERIPHERAL_ENGINE, SpiDataShiftEdge=LEADING, SpiEnableCs=true, SpiParitySupport=UNUSED, SpiShiftClockIdleLevel=LOW:
        SpiExternalDevice_TJA1145: SpiBaudrate=20000, SpiCsIdentifier=CHANNEL3, SpiHwUnit=QSPI4, SpiIdleTime=1E-7, SpiTimeClk2Cs=1E-7, SpiTrailingTime=1E-7
        SpiExternalDevice_TLE8888: SpiBaudrate=2000000, SpiCsIdentifier=CHANNEL10, SpiHwUnit=QSPI3, SpiIdleTime=1E-7, SpiTimeClk2Cs=1E-7, SpiTrailingTime=1E-7
        SpiExternalDevice_TLE9201: SpiBaudrate=20000, SpiCsIdentifier=CHANNEL0, SpiHwUnit=QSPI2, SpiIdleTime=1E-7, SpiTimeClk2Cs=1E-7, SpiTrailingTime=1E-7
        SpiExternalDevice_TLE9410_SPI1: SpiBaudrate=20000, SpiCsIdentifier=CHANNEL8, SpiHwUnit=QSPI1, SpiIdleTime=4E-7, SpiTimeClk2Cs=4E-7, SpiTrailingTime=4E-7
      7 x SpiJob, all with SpiFrameBasedCS=false, SpiHwUnitSynchronous=SYNCHRONOUS, SpiJobPriority=0:
        SpiJob_TJA1145_0: SpiJobId=2, SpiDeviceAssignment=SpiExternalDevice_TJA1145
          SpiChannelList_0 (SpiChannelList): SpiChannelIndex=0, SpiChannelAssignment=SpiChannel_TJA1145_0
        SpiJob_TJA1145_1: SpiJobId=3, SpiDeviceAssignment=SpiExternalDevice_TJA1145
          SpiChannelList_0 (SpiChannelList): SpiChannelIndex=0, SpiChannelAssignment=SpiChannel_TJA1145_1
        SpiJob_TJA1145_2: SpiJobId=4, SpiDeviceAssignment=SpiExternalDevice_TJA1145
          SpiChannelList_0 (SpiChannelList): SpiChannelIndex=0, SpiChannelAssignment=SpiChannel_TJA1145_2
        SpiJob_TJA1145_3: SpiJobId=5, SpiDeviceAssignment=SpiExternalDevice_TJA1145
          SpiChannelList_0 (SpiChannelList): SpiChannelIndex=0, SpiChannelAssignment=SpiChannel_TJA1145_3
        SpiJob_TLE8888: SpiJobId=0, SpiDeviceAssignment=SpiExternalDevice_TLE8888
          SpiChannelList_0 (SpiChannelList): SpiChannelIndex=0, SpiChannelAssignment=SpiChannel_TLE8888
        SpiJob_TLE9201: SpiJobId=1, SpiDeviceAssignment=SpiExternalDevice_TLE9201
          SpiChannelList_0 (SpiChannelList): SpiChannelIndex=0, SpiChannelAssignment=SpiChannel_TLE9201
        SpiJob_TLE9410_SPI1: SpiJobId=6, SpiDeviceAssignment=SpiExternalDevice_TLE9410_SPI1
          SpiChannelList_0 (SpiChannelList): SpiChannelIndex=0, SpiChannelAssignment=SpiChannel_TLE9410_SPI1
      6 x SpiSequence, all with SpiInterruptibleSequence=false:
        SpiSequence_TJA1145_Large: SpiSequenceId=3, SpiJobAssignment=SpiJob_TJA1145_0, SpiJobAssignment=SpiJob_TJA1145_1, SpiJobAssignment=SpiJob_TJA1145_2, SpiJobAssignment=SpiJob_TJA1145_3
        SpiSequence_TJA1145_Medium: SpiSequenceId=4, SpiJobAssignment=SpiJob_TJA1145_0, SpiJobAssignment=SpiJob_TJA1145_1, SpiJobAssignment=SpiJob_TJA1145_2
        SpiSequence_TJA1145_Norm: SpiSequenceId=2, SpiJobAssignment=SpiJob_TJA1145_0
        SpiSequence_TLE8888: SpiSeqEndNotification=SpiSeq_TLE8888_Notify, SpiSequenceId=0, SpiJobAssignment=SpiJob_TLE8888
        SpiSequence_TLE9201: SpiSeqEndNotification=SpiSeq_TLE9201_Notify, SpiSequenceId=1, SpiJobAssignment=SpiJob_TLE9201
        SpiSequence_TLE9410_SPI1: SpiSeqEndNotification=SpiSequence_TLE9410_SPI1_Notify, SpiSequenceId=5, SpiJobAssignment=SpiJob_TLE9410_SPI1
    SpiGeneral:
      SpiCancelApi = true
      SpiChannelBuffersAllowed = 1
      SpiDevErrorDetect = false
      SpiHwStatusApi = false
      SpiInitCheckApi = false
      SpiInitDeInitApiMode = SPI_MCAL_SUPERVISOR
      SpiInterruptibleSeqAllowed = true
      SpiLevelDelivered = 2
      SpiMulticoreCheckEnable = false
      SpiRuntimeApiMode = SPI_MCAL_SUPERVISOR
      SpiSafetyCheckEnable = false
      SpiSupportConcurrentSyncTransmit = false
      SpiSyncTransmitTimeoutDuration = 65535
      SpiVersionInfoApi = false
    SpiHwConfiguration_0 (SpiHwConfiguration)
      4 x SpiHwConfigurationQspi, all with SpiExternalDemux=false, SpiJobQueueLengthQspix=2, SpiSLSO0StrobeDelay=2, SpiSleepEnableQspix=false:
        SpiHwConfigurationQspi_1: SpiHWPinMRSTQspix=MRST1A_PORT10_PIN1, SpiHwConfigKernel=QSPI1
        SpiHwConfigurationQspi_2: SpiHWPinMRSTQspix=MRST2A_PORT15_PIN4, SpiHwConfigKernel=QSPI2
        SpiHwConfigurationQspi_3: SpiHWPinMRSTQspix=MRST3C_PORT01_PIN5, SpiHwConfigKernel=QSPI3
        SpiHwConfigurationQspi_4: SpiHWPinMRSTQspix=MRST4B_PORT22_PIN1, SpiHwConfigKernel=QSPI4
    SpiPublishedInformation: SpiMaxHwUnit=5
