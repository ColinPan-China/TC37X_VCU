AUTOSAR XML (schema 00048)
package /Spi
  module config Spi: implementation-config-variant=VARIANT-POST-BUILD, module-description=Spi_Impl
    CommonPublishedInformation:
      ArMajorVersion = 4
      ArMinorVersion = 2
      ArPatchVersion = 2
      ModuleId = 83
      Release = _TRICORE_TC377
      SwMajorVersion = 10
      SwMinorVersion = 40
      SwPatchVersion = 2
      VendorId = 17
    SpiDriver: SpiMaxChannel=2, SpiMaxJob=2, SpiMaxSequence=2, SpiSystemClock=McuClockReferencePointConfig
      SpiChannel_TLE8888 (SpiChannel): SpiChannelId=0, SpiChannelType=EB, SpiDataWidth=8, SpiDefaultData=0, SpiEbMaxLength=8190, SpiIbNBuffers=10, SpiTransferStart=LSB
      SpiChannel_TLE9201 (SpiChannel): SpiChannelId=1, SpiChannelType=EB, SpiDataWidth=8, SpiDefaultData=0, SpiEbMaxLength=8190, SpiIbNBuffers=10, SpiTransferStart=MSB
      SpiExternalDevice_TLE8888 (SpiExternalDevice):
        SpiAutoCalcBaudParams = true
        SpiAutoCalcDelayParams = true
        SpiBaudrate = 20000
        SpiCsIdentifier = CHANNEL10
        SpiCsPolarity = LOW
        SpiCsSelection = CS_VIA_PERIPHERAL_ENGINE
        SpiDataShiftEdge = LEADING
        SpiEnableCs = true
        SpiHwUnit = QSPI3
        SpiIdleTime = 1E-7
        SpiParitySupport = UNUSED
        SpiShiftClockIdleLevel = LOW
        SpiTimeClk2Cs = 1E-7
        SpiTrailingTime = 1E-7
      SpiExternalDevice_TLE9201 (SpiExternalDevice):
        SpiAutoCalcBaudParams = true
        SpiAutoCalcDelayParams = true
        SpiBaudrate = 20000
        SpiCsIdentifier = CHANNEL0
        SpiCsPolarity = LOW
        SpiCsSelection = CS_VIA_PERIPHERAL_ENGINE
        SpiDataShiftEdge = LEADING
        SpiEnableCs = true
        SpiHwUnit = QSPI2
        SpiIdleTime = 1E-7
        SpiParitySupport = UNUSED
        SpiShiftClockIdleLevel = LOW
        SpiTimeClk2Cs = 1E-7
        SpiTrailingTime = 1E-7
      SpiJob_TLE8888 (SpiJob): SpiFrameBasedCS=false, SpiHwUnitSynchronous=ASYNCHRONOUS, SpiJobId=0, SpiJobPriority=0, SpiDeviceAssignment=SpiExternalDevice_TLE8888
        SpiChannelList_0 (SpiChannelList): SpiChannelIndex=0, SpiChannelAssignment=SpiChannel_TLE8888
      SpiJob_TLE9201 (SpiJob): SpiFrameBasedCS=false, SpiHwUnitSynchronous=ASYNCHRONOUS, SpiJobId=1, SpiJobPriority=0, SpiDeviceAssignment=SpiExternalDevice_TLE9201
        SpiChannelList_0 (SpiChannelList): SpiChannelIndex=0, SpiChannelAssignment=SpiChannel_TLE9201
      SpiSequence_TLE8888 (SpiSequence): SpiInterruptibleSequence=false, SpiSeqEndNotification=SpiSeq_TLE8888_Notify, SpiSequenceId=0, SpiJobAssignment=SpiJob_TLE8888
      SpiSequence_TLE9201 (SpiSequence): SpiInterruptibleSequence=false, SpiSeqEndNotification=SpiSeq_TLE9201_Notify, SpiSequenceId=1, SpiJobAssignment=SpiJob_TLE9201
    SpiGeneral:
      SpiCancelApi = false
      SpiChannelBuffersAllowed = 1
      SpiDevErrorDetect = false
      SpiHwStatusApi = false
      SpiInitCheckApi = false
      SpiInitDeInitApiMode = SPI_MCAL_SUPERVISOR
      SpiInterruptibleSeqAllowed = false
      SpiLevelDelivered = 2
      SpiMulticoreCheckEnable = false
      SpiRuntimeApiMode = SPI_MCAL_SUPERVISOR
      SpiSafetyCheckEnable = false
      SpiSupportConcurrentSyncTransmit = false
      SpiSyncTransmitTimeoutDuration = 65535
      SpiVersionInfoApi = false
    SpiHwConfiguration_0 (SpiHwConfiguration)
      SpiHwConfigurationQspi_0 (SpiHwConfigurationQspi):
        SpiExternalDemux = false
        SpiHWPinMRSTQspix = MRST3C_PORT01_PIN5
        SpiHwConfigKernel = QSPI3
        SpiJobQueueLengthQspix = 2
        SpiSLSO0StrobeDelay = 2
        SpiSleepEnableQspix = false
        SpiHwDmaConfigurationQspi_0 (SpiHwDmaConfigurationQspi): SpiHwDmaChannelReceptionRef=DmaChannelConfig_QSPI3_RX, SpiHwDmaChannelTransmissionRef=DmaChannelConfig_QSPI3_TX
      SpiHwConfigurationQspi_1 (SpiHwConfigurationQspi):
        SpiExternalDemux = false
        SpiHWPinMRSTQspix = MRST2A_PORT15_PIN4
        SpiHwConfigKernel = QSPI2
        SpiJobQueueLengthQspix = 2
        SpiSLSO0StrobeDelay = 2
        SpiSleepEnableQspix = false
        SpiHwDmaConfigurationQspi_0 (SpiHwDmaConfigurationQspi): SpiHwDmaChannelReceptionRef=DmaChannelConfig_QSPI2_RX, SpiHwDmaChannelTransmissionRef=DmaChannelConfig_QSPI2_TX
    SpiPublishedInformation: SpiMaxHwUnit=5
