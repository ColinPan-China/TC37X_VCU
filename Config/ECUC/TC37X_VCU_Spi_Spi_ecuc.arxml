AUTOSAR XML (schema 00048)
package /Spi
  module config Spi: implementation-config-variant=VARIANT-POST-BUILD, module-description=Spi_Impl
    CommonPublishedInformation:
      ArMajorVersion = 4
      ArMinorVersion = 2
      ArPatchVersion = 2
      ModuleId = 83
      Release = _TRICORE_TC377
      SwMajorVersion = 10
      SwMinorVersion = 40
      SwPatchVersion = 2
      VendorId = 17
    SpiDriver: SpiMaxChannel=6, SpiMaxJob=6, SpiMaxSequence=5, SpiSystemClock=McuClockReferencePointConfig
      6 x SpiChannel, all with SpiChannelType=EB, SpiEbMaxLength=8190, SpiIbNBuffers=10:
        SpiChannel_TJA1145_0: SpiChannelId=2, SpiDataWidth=8, SpiTransferStart=MSB
        SpiChannel_TJA1145_1: SpiChannelId=3, SpiDataWidth=8, SpiTransferStart=LSB
        SpiChannel_TJA1145_2: SpiChannelId=4, SpiDataWidth=8, SpiTransferStart=LSB
        SpiChannel_TJA1145_3: SpiChannelId=5, SpiDataWidth=8, SpiTransferStart=LSB
        SpiChannel_TLE8888: SpiChannelId=0, SpiDataWidth=8, SpiDefaultData=0, SpiTransferStart=LSB
        SpiChannel_TLE9201: SpiChannelId=1, SpiDataWidth=2, SpiDefaultData=0, SpiTransferStart=MSB
      3 x SpiExternalDevice, all with SpiAutoCalcBaudParams=true, SpiAutoCalcDelayParams=true, SpiBaudrate=20000, SpiCsPolarity=LOW, SpiCsSelection=CS_VIA_PERIPHERAL_ENGINE, SpiDataShiftEdge=LEADING, SpiEnableCs=true, SpiIdleTime=1E-7, SpiParitySupport=UNUSED, SpiShiftClockIdleLevel=LOW, SpiTimeClk2Cs=1E-7, SpiTrailingTime=1E-7:
        SpiExternalDevice_TJA1145: SpiCsIdentifier=CHANNEL3, SpiHwUnit=QSPI4
        SpiExternalDevice_TLE8888: SpiCsIdentifier=CHANNEL10, SpiHwUnit=QSPI3
        SpiExternalDevice_TLE9201: SpiCsIdentifier=CHANNEL0, SpiHwUnit=QSPI2
      6 x SpiJob, all with SpiFrameBasedCS=false, SpiJobPriority=0:
        SpiJob_TJA1145_0: SpiHwUnitSynchronous=SYNCHRONOUS, SpiJobId=2, SpiDeviceAssignment=SpiExternalDevice_TJA1145
          SpiChannelList_0 (SpiChannelList): SpiChannelIndex=0, SpiChannelAssignment=SpiChannel_TJA1145_0
        SpiJob_TJA1145_1: SpiHwUnitSynchronous=SYNCHRONOUS, SpiJobId=3, SpiDeviceAssignment=SpiExternalDevice_TJA1145
          SpiChannelList_0 (SpiChannelList): SpiChannelIndex=0, SpiChannelAssignment=SpiChannel_TJA1145_1
        SpiJob_TJA1145_2: SpiHwUnitSynchronous=SYNCHRONOUS, SpiJobId=4, SpiDeviceAssignment=SpiExternalDevice_TJA1145
          SpiChannelList_0 (SpiChannelList): SpiChannelIndex=0, SpiChannelAssignment=SpiChannel_TJA1145_2
        SpiJob_TJA1145_3: SpiHwUnitSynchronous=SYNCHRONOUS, SpiJobId=5, SpiDeviceAssignment=SpiExternalDevice_TJA1145
          SpiChannelList_0 (SpiChannelList): SpiChannelIndex=0, SpiChannelAssignment=SpiChannel_TJA1145_3
        SpiJob_TLE8888: SpiHwUnitSynchronous=SYNCHRONOUS, SpiJobId=0, SpiDeviceAssignment=SpiExternalDevice_TLE8888
          SpiChannelList_0 (SpiChannelList): SpiChannelIndex=0, SpiChannelAssignment=SpiChannel_TLE8888
        SpiJob_TLE9201: SpiHwUnitSynchronous=ASYNCHRONOUS, SpiJobId=1, SpiDeviceAssignment=SpiExternalDevice_TLE9201
          SpiChannelList_0 (SpiChannelList): SpiChannelIndex=0, SpiChannelAssignment=SpiChannel_TLE9201
      5 x SpiSequence, all with SpiInterruptibleSequence=false:
        SpiSequence_TJA1145_Large: SpiSequenceId=3, SpiJobAssignment=SpiJob_TJA1145_0, SpiJobAssignment=SpiJob_TJA1145_1, SpiJobAssignment=SpiJob_TJA1145_2, SpiJobAssignment=SpiJob_TJA1145_3
        SpiSequence_TJA1145_Medium: SpiSequenceId=4, SpiJobAssignment=SpiJob_TJA1145_0, SpiJobAssignment=SpiJob_TJA1145_1, SpiJobAssignment=SpiJob_TJA1145_2
        SpiSequence_TJA1145_Norm: SpiSequenceId=2, SpiJobAssignment=SpiJob_TJA1145_0
        SpiSequence_TLE8888: SpiSeqEndNotification=SpiSeq_TLE8888_Notify, SpiSequenceId=0, SpiJobAssignment=SpiJob_TLE8888
        SpiSequence_TLE9201: SpiSeqEndNotification=SpiSeq_TLE9201_Notify, SpiSequenceId=1, SpiJobAssignment=SpiJob_TLE9201
    SpiGeneral:
      SpiCancelApi = false
      SpiChannelBuffersAllowed = 1
      SpiDevErrorDetect = false
      SpiHwStatusApi = false
      SpiInitCheckApi = false
      SpiInitDeInitApiMode = SPI_MCAL_SUPERVISOR
      SpiInterruptibleSeqAllowed = false
      SpiLevelDelivered = 2
      SpiMulticoreCheckEnable = false
      SpiRuntimeApiMode = SPI_MCAL_SUPERVISOR
      SpiSafetyCheckEnable = false
      SpiSupportConcurrentSyncTransmit = false
      SpiSyncTransmitTimeoutDuration = 65535
      SpiVersionInfoApi = false
    SpiHwConfiguration_0 (SpiHwConfiguration)
      3 x SpiHwConfigurationQspi, all with SpiExternalDemux=false, SpiJobQueueLengthQspix=2, SpiSLSO0StrobeDelay=2, SpiSleepEnableQspix=false:
        SpiHwConfigurationQspi_0: SpiHWPinMRSTQspix=MRST3C_PORT01_PIN5, SpiHwConfigKernel=QSPI3
        SpiHwConfigurationQspi_1: SpiHWPinMRSTQspix=MRST2A_PORT15_PIN4, SpiHwConfigKernel=QSPI2
          SpiHwDmaConfigurationQspi_0 (SpiHwDmaConfigurationQspi): SpiHwDmaChannelReceptionRef=DmaChannelConfig_QSPI2_RX, SpiHwDmaChannelTransmissionRef=DmaChannelConfig_QSPI2_TX
        SpiHwConfigurationQspi_2: SpiHWPinMRSTQspix=MRST4B_PORT22_PIN1, SpiHwConfigKernel=QSPI4
    SpiPublishedInformation: SpiMaxHwUnit=5
