AUTOSAR XML (schema 00048)
package /ActiveEcuC
  module config Os: implementation-config-variant=VARIANT-PRE-COMPILE, module-description=Os_Impl
    SystemTimer_Core0 (OsCounter):
      OsCounterMaxAllowedValue = 2147483647
      OsCounterMinCycle = 1
      OsCounterType = HARDWARE
      OsSecondsPerTick = 0.001
      OsCounterTicksPerBase = 100000
      OsCounterAccessingApplication = SystemApplication_OsCore{0..2}
      OsDriver: OsDriverHighResolution=false, OsDriverHardwareTimerChannelRef=STM0_Ch0, OsDriverIsrRef=CounterIsr_SystemTimer_Core0
    OsMemoryProtection
    OsOS:
      OsStackMonitoring = true
      OsStatus = EXTENDED
      OsUseGetServiceId = false
      OsUseParameterAccess = false
      OsUseResScheduler = false
      OsForcibleTermination = false
      OsGenerateCalloutStubs = true
      OsGenerateMemMap = COMPLETE
      OsGenerateMemMapForNearAddressing = true
      OsGenerateMemMapForThreads = false
      OsServiceProtection = false
      OsStackUsageMeasurement = false
      OsUseXSignalAsyncApiCalls = false
      OsFpuUsage = NONE
      OsUseCase = STANDARD
      OsScalabilityClass = SC1
      OsNumberOfCores = 3
      OsMasterCore = OsCore0
      OsSystemTimer = SystemTimer_Core0
      OsHooks: OsErrorHook=true, OsPostTaskHook=false, OsPreTaskHook=false, OsShutdownHook=true, OsStartupHook=false
      OsStackSummary
        31 x OsStack, all with OsStackSize=1024:
          OsCore0_Kernel: OsStackType=CORE_KERNEL_STACK, OsStackCore=OsCore0, OsStackUser=OsCore0
          OsCore0_Init: OsStackType=CORE_INIT_STACK, OsStackCore=OsCore0, OsStackUser=OsCore0
          OsCore0_Error: OsStackType=CORE_ERROR_STACK, OsStackCore=OsCore0, OsStackUser=OsCore0
          OsCore0_Task_Prio4294967295: OsStackType=TASK_SHARED_PRIORITY_STACK, OsStackCore=OsCore0, OsStackUser=IdleTask_OsCore0
          OsCore0_Isr_Core: OsStackType=ISR_SHARED_CORE_STACK, OsStackCore=OsCore0, OsStackUser=ADC0SR0_ISR, OsStackUser=ADC1SR0_ISR, OsStackUser=ADC2SR0_ISR, OsStackUser=ADC3SR0_ISR, OsStackUser=ADC11SR0_ISR, OsStackUser=ASCLIN2ERR_ISR, OsStackUser=ASCLIN2RX_ISR, OsStackUser=ASCLIN2TX_ISR, OsStackUser=ASCLIN1TX_ISR, OsStackUser=ASCLIN1RX_ISR, OsStackUser=ASCLIN1ERR_ISR, OsStackUser=DMACH10SR_ISR, OsStackUser=DMACH11SR_ISR, OsStackUser=QSPI3ERR_ISR, OsStackUser=QSPI3PT_ISR, OsStackUser=ADC8SR0_ISR, OsStackUser=GTMTOM1SR3_ISR, OsStackUser=GTMTOM1SR4_ISR, OsStackUser=CanIsr_3, OsStackUser=ASCLIN4TX_ISR, OsStackUser=ASCLIN4RX_ISR, OsStackUser=ASCLIN4ERR_ISR, OsStackUser=GTMTOM1SR0_ISR, OsStackUser=GTMTOM1SR1_ISR, OsStackUser=CanIsr_4, OsStackUser=ASCLIN3ERR_ISR, OsStackUser=ASCLIN3RX_ISR, OsStackUser=ASCLIN3TX_ISR, OsStackUser=CanIsr_1, OsStackUser=CanIsr_6, OsStackUser=CanIsr_0, OsStackUser=CounterIsr_SystemTimer_Core0, OsStackUser=XSignalIsr_OsCore0, OsStackUser=GTMTOM0SR2_ISR
          OsCore0_Task_Prio49: OsStackType=TASK_SHARED_PRIORITY_STACK, OsStackCore=OsCore0, OsStackUser=Default_Init_Task_Trusted
          OsCore0_Task_Prio50: OsStackType=TASK_SHARED_PRIORITY_STACK, OsStackCore=OsCore0, OsStackUser=Default_Init_Task
          Core0_Bsw_Task: OsStackType=TASK_EXTENDED_STACK, OsStackCore=OsCore0, OsStackUser=Os/Core0_Bsw_Task
          OsCore0_Shutdown: OsStackType=CORE_SHUTDOWN_STACK, OsStackCore=OsCore0, OsStackUser=OsCore0
          OsCore1_Kernel: OsStackType=CORE_KERNEL_STACK, OsStackCore=OsCore1, OsStackUser=OsCore1
          OsCore1_Init: OsStackType=CORE_INIT_STACK, OsStackCore=OsCore1, OsStackUser=OsCore1
          OsCore1_Error: OsStackType=CORE_ERROR_STACK, OsStackCore=OsCore1, OsStackUser=OsCore1
          OsCore1_Shutdown: OsStackType=CORE_SHUTDOWN_STACK, OsStackCore=OsCore1, OsStackUser=OsCore1
          OsCore2_Kernel: OsStackType=CORE_KERNEL_STACK, OsStackCore=OsCore2, OsStackUser=OsCore2
          OsCore2_Init: OsStackType=CORE_INIT_STACK, OsStackCore=OsCore2, OsStackUser=OsCore2
          OsCore2_Error: OsStackType=CORE_ERROR_STACK, OsStackCore=OsCore2, OsStackUser=OsCore2
          OsCore2_Shutdown: OsStackType=CORE_SHUTDOWN_STACK, OsStackCore=OsCore2, OsStackUser=OsCore2
          OsCore1_Task_Prio4294967295: OsStackType=TASK_SHARED_PRIORITY_STACK, OsStackCore=OsCore1, OsStackUser=IdleTask_OsCore1
          OsCore2_Task_Prio4294967295: OsStackType=TASK_SHARED_PRIORITY_STACK, OsStackCore=OsCore2, OsStackUser=IdleTask_OsCore2
          OsCore1_Task_Prio50: OsStackType=TASK_SHARED_PRIORITY_STACK, OsStackCore=OsCore1, OsStackUser=Default_Init_Task_Core1
          OsCore1_Task_Prio49: OsStackType=TASK_SHARED_PRIORITY_STACK, OsStackCore=OsCore1, OsStackUser=Default_Init_Task_Core1_Trusted
          OsCore2_Task_Prio50: OsStackType=TASK_SHARED_PRIORITY_STACK, OsStackCore=OsCore2, OsStackUser=Default_Init_Task_Core2
          OsCore2_Task_Prio49: OsStackType=TASK_SHARED_PRIORITY_STACK, OsStackCore=OsCore2, OsStackUser=Default_Init_Task_Core2_Trusted
          OsCore1_Isr_Core: OsStackType=ISR_SHARED_CORE_STACK, OsStackCore=OsCore1, OsStackUser=CounterIsr_SystemTimer_Core1, OsStackUser=XSignalIsr_OsCore1
          OsCore2_Isr_Core: OsStackType=ISR_SHARED_CORE_STACK, OsStackCore=OsCore2, OsStackUser=CounterIsr_SystemTimer_Core2, OsStackUser=XSignalIsr_OsCore2
          OsCore2_Task_Prio0: OsStackType=TASK_SHARED_PRIORITY_STACK, OsStackCore=OsCore2, OsStackUser=Core2_Asw_Init, OsStackUser=Core2_Bsw_Task, OsStackUser=Core2_Asw_Task
          OsCore1_Task_Prio40: OsStackType=TASK_SHARED_PRIORITY_STACK, OsStackCore=OsCore1, OsStackUser=Core1_Asw_Init
          Core1_Asw_Task_Qm: OsStackType=TASK_EXTENDED_STACK, OsStackCore=OsCore1, OsStackUser=Os/Core1_Asw_Task_Qm
          Core1_Bsw_Task: OsStackType=TASK_EXTENDED_STACK, OsStackCore=OsCore1, OsStackUser=Os/Core1_Bsw_Task
          OsCore0_Task_Prio64: OsStackType=TASK_SHARED_PRIORITY_STACK, OsStackCore=OsCore0, OsStackUser=Core0_AswTask
          Core0_CddTask: OsStackType=TASK_EXTENDED_STACK, OsStackCore=OsCore0, OsStackUser=Os/Core0_CddTask
    OsPublishedInformation: OsKernelVersion=7, OsPlatformName=TriCoreAurix
      TC37x (OsDerivativeInformation):
        OsMpuAlignment = 8
        OsMpuMemoryGapSize = 16
        OsMpuEndAddressAccessible = false
        OsStackAlignment = 8
        OsExceptionVectorTableAlignment = 256
        OsInterruptVectorTableAlignment = 8192
        OsHardwareManuals = User Manual: TC37X_um_appx_V1.0.0.pdf 2018.08 TC37X_ts_appx_V2.5.1.pdf 2018.04
        OsMpuPrivilegedRegionsConfigurable = false
        3 x OsPhysicalCore, all with OsPhysicalCoreType=TC1.6.2P, OsPhysicalCoreExceptionSources=8, OsPhysicalCorePrivelegedHwAccess=true:
          Core0: OsPhysicalCoreId=0, OsPhysicalCoreDefaultEntrySymbol=_start_tc0, OsPhysicalCoreMasterStartAllowed=true, OsPhysicalCoreIsAutostart=true, OsPhysicalCoreStackProtectionUnit=OsPhysicalCore0DataMpu
            OsPhysicalCore0DataMpu (OsPhysicalCoreMpu): OsPhysicalCoreMpuId=0, OsPhysicalCoreMpuMaxRegions=18, OsPhysicalCoreMpuType=DATA
            OsPhysicalCore0CodeMpu (OsPhysicalCoreMpu): OsPhysicalCoreMpuId=1, OsPhysicalCoreMpuMaxRegions=10, OsPhysicalCoreMpuType=CODE
          Core1: OsPhysicalCoreId=1, OsPhysicalCoreDefaultEntrySymbol=_start_tc1, OsPhysicalCoreMasterStartAllowed=false, OsPhysicalCoreIsAutostart=false, OsPhysicalCoreStackProtectionUnit=OsPhysicalCore1DataMpu
            OsPhysicalCore1DataMpu (OsPhysicalCoreMpu): OsPhysicalCoreMpuId=0, OsPhysicalCoreMpuMaxRegions=18, OsPhysicalCoreMpuType=DATA
            OsPhysicalCore1CodeMpu (OsPhysicalCoreMpu): OsPhysicalCoreMpuId=1, OsPhysicalCoreMpuMaxRegions=10, OsPhysicalCoreMpuType=CODE
          Core2: OsPhysicalCoreId=2, OsPhysicalCoreDefaultEntrySymbol=_start_tc2, OsPhysicalCoreMasterStartAllowed=false, OsPhysicalCoreIsAutostart=false, OsPhysicalCoreStackProtectionUnit=OsPhysicalCore2DataMpu
            OsPhysicalCore2DataMpu (OsPhysicalCoreMpu): OsPhysicalCoreMpuId=0, OsPhysicalCoreMpuMaxRegions=18, OsPhysicalCoreMpuType=DATA
            OsPhysicalCore2CodeMpu (OsPhysicalCoreMpu): OsPhysicalCoreMpuId=1, OsPhysicalCoreMpuMaxRegions=10, OsPhysicalCoreMpuType=CODE
        3 x OsHardwareTimer, all with OsHardwareTimerSize=32, OsHardwareTimerUnit=FRT, OsHardwareTimerType=STM:
          STM0: OsHardwareTimerBaseAddress=4026535936, OsHardwareTimerId=0
            STM0_Ch0 (OsHardwareTimerChannel): OsHardwareTimerChannelIntSource=768, OsHardwareTimerChannelOffset=0, OsHardwareTimerChannelId=0
            STM0_Ch1 (OsHardwareTimerChannel): OsHardwareTimerChannelIntSource=772, OsHardwareTimerChannelOffset=1, OsHardwareTimerChannelId=1
          STM1: OsHardwareTimerBaseAddress=4026536192, OsHardwareTimerId=1
            STM1_Ch0 (OsHardwareTimerChannel): OsHardwareTimerChannelIntSource=776, OsHardwareTimerChannelOffset=0, OsHardwareTimerChannelId=0
            STM1_Ch1 (OsHardwareTimerChannel): OsHardwareTimerChannelIntSource=780, OsHardwareTimerChannelOffset=1, OsHardwareTimerChannelId=1
          STM2: OsHardwareTimerBaseAddress=4026536448, OsHardwareTimerId=2
            STM2_Ch0 (OsHardwareTimerChannel): OsHardwareTimerChannelIntSource=784, OsHardwareTimerChannelOffset=0, OsHardwareTimerChannelId=0
            STM2_Ch1 (OsHardwareTimerChannel): OsHardwareTimerChannelIntSource=788, OsHardwareTimerChannelOffset=1, OsHardwareTimerChannelId=1
        AURIXTC3XX_IR (OsSystemIntCtrl): OsSystemIntCtrlMaxPrios=255, OsSystemIntCtrlPrioOrder=ASC, OsSystemIntCtrlMaxSources=8192, OsSystemIntCtrlBaseAddress=4026757120
        GPT (OsHardwareTimer): OsHardwareTimerSize=16, OsHardwareTimerUnit=PIT, OsHardwareTimerBaseAddress=4026537984, OsHardwareTimerId=0, OsHardwareTimerType=PIT
          GPT_Ch0 (OsHardwareTimerChannel): OsHardwareTimerChannelIntSource=744, OsHardwareTimerChannelOffset=0, OsHardwareTimerChannelId=0
          GPT_Ch1 (OsHardwareTimerChannel): OsHardwareTimerChannelIntSource=756, OsHardwareTimerChannelOffset=1, OsHardwareTimerChannelId=1
        OsMemoryRegionSpecifics
          18 x OsMemoryRegionAccess:
            PS0_R: OsMemoryRegionAccessRights=R, OsMemoryRegionAccessType=PROTECTION_SET0
            PS0_W: OsMemoryRegionAccessRights=W, OsMemoryRegionAccessType=PROTECTION_SET0
            PS0_X: OsMemoryRegionAccessRights=X, OsMemoryRegionAccessType=PROTECTION_SET0
            PS1_R: OsMemoryRegionAccessRights=R, OsMemoryRegionAccessType=PROTECTION_SET1
            PS1_W: OsMemoryRegionAccessRights=W, OsMemoryRegionAccessType=PROTECTION_SET1
            PS1_X: OsMemoryRegionAccessRights=X, OsMemoryRegionAccessType=PROTECTION_SET1
            PS2_R: OsMemoryRegionAccessRights=R, OsMemoryRegionAccessType=PROTECTION_SET2
            PS2_W: OsMemoryRegionAccessRights=W, OsMemoryRegionAccessType=PROTECTION_SET2
            PS2_X: OsMemoryRegionAccessRights=X, OsMemoryRegionAccessType=PROTECTION_SET2
            PS3_R: OsMemoryRegionAccessRights=R, OsMemoryRegionAccessType=PROTECTION_SET3
            PS3_W: OsMemoryRegionAccessRights=W, OsMemoryRegionAccessType=PROTECTION_SET3
            PS3_X: OsMemoryRegionAccessRights=X, OsMemoryRegionAccessType=PROTECTION_SET3
            PS4_R: OsMemoryRegionAccessRights=R, OsMemoryRegionAccessType=PROTECTION_SET4
            PS4_W: OsMemoryRegionAccessRights=W, OsMemoryRegionAccessType=PROTECTION_SET4
            PS4_X: OsMemoryRegionAccessRights=X, OsMemoryRegionAccessType=PROTECTION_SET4
            PS5_R: OsMemoryRegionAccessRights=R, OsMemoryRegionAccessType=PROTECTION_SET5
            PS5_W: OsMemoryRegionAccessRights=W, OsMemoryRegionAccessType=PROTECTION_SET5
            PS5_X: OsMemoryRegionAccessRights=X, OsMemoryRegionAccessType=PROTECTION_SET5
        DMA (OsInterruptSupportedType):
          OsInterruptSupportedTypeSeparateSources = false
          OsInterruptSupportedTypeSeparatePriority = true
          OsInterruptSupportedTypeIsMapped = false
          OsInterruptSupportedTypePostActionRequired = false
    OSDEFAULTAPPMODE (OsAppMode)
    OS_APPMODE_ANY (OsAppMode)
    OsCore0 (OsCore):
      OsCoreIsAutostart = true
      OsCoreIsAutosar = true
      OsCoreEntrySymbol = _start_tc0
      OsCorePhysicalCoreRef = Core0
      OsCoreEcucCoreRef = EcucCore0
      OsCoreIdleTask = IdleTask_OsCore0
      OsCoreSystemApplication = SystemApplication_OsCore0
      OsCoreStacks:
        OsCoreKernelStackSize = 1024
        OsCoreStartupStackSize = 1024
        OsCoreShutdownStackSize = 1024
        OsCoreErrorStackSize = 1024
        OsCoreProtectionStackSize = 1024
        OsCoreInitStackSize = 1024
      XSignalChl_OsCore1 (OsCoreXSignalChannel): OsCoreXSignalChannelSize=1, OsCoreXSignalChannelReceiverIsr=XSignalIsr_OsCore1
      XSignalChl_OsCore2 (OsCoreXSignalChannel): OsCoreXSignalChannelSize=1, OsCoreXSignalChannelReceiverIsr=XSignalIsr_OsCore2
    IdleTask_OsCore0 (OsTask):
      OsTaskActivation = 1
      OsTaskPriority = 4294967295
      OsTaskSchedule = FULL
      OsTaskStackSharing = false
      OsTaskStackSize = 1024
      OsTaskType = AUTO
      OsTaskUsesFpu = false
      OsTaskAccessingApplication = SystemApplication_OsCore{0..2}
      OsTaskAutostart: OsTaskAppModeRef=OS_APPMODE_ANY
    SystemApplication_OsCore0 (OsApplication):
      OsTrusted = true
      OsTrustedApplicationDelayTimingViolationCall = false
      OsTrustedApplicationWithProtection = false
      OsApplicationIsPrivileged = true
      OsAppUseTrustedFunctionStubs = false
      OsApplicationCoreRef = EcucCore0
      OsAppTaskRef = IdleTask_OsCore0
      OsAppCounterRef = SystemTimer_Core0
      OsAppTaskRef = Default_Init_Task
      OsAppTaskRef = Default_Init_Task_Trusted
      OsAppIsrRef = CounterIsr_SystemTimer_Core0
      OsAppTaskRef = Os/Core0_Bsw_Task
      OsAppTaskRef = Core0_AswTask
      OsAppIsrRef = ADC1SR0_ISR
      OsAppIsrRef = CanIsr_3
      OsAppIsrRef = QSPI3ERR_ISR
      OsAppIsrRef = ASCLIN3ERR_ISR
      OsAppIsrRef = ASCLIN4TX_ISR
      OsAppIsrRef = ADC0SR0_ISR
      OsAppIsrRef = ADC2SR0_ISR
      OsAppIsrRef = ADC3SR0_ISR
      OsAppIsrRef = ADC11SR0_ISR
      OsAppIsrRef = ASCLIN2ERR_ISR
      OsAppIsrRef = ASCLIN2RX_ISR
      OsAppIsrRef = ASCLIN2TX_ISR
      OsAppIsrRef = ASCLIN1ERR_ISR
      OsAppIsrRef = ASCLIN1RX_ISR
      OsAppIsrRef = ASCLIN1TX_ISR
      OsAppIsrRef = DMACH10SR_ISR
      OsAppIsrRef = DMACH11SR_ISR
      OsAppIsrRef = QSPI3PT_ISR
      OsAppIsrRef = ADC8SR0_ISR
      OsAppIsrRef = GTMTOM1SR3_ISR
      OsAppIsrRef = GTMTOM1SR4_ISR
      OsAppIsrRef = ASCLIN4ERR_ISR
      OsAppIsrRef = ASCLIN4RX_ISR
      OsAppIsrRef = GTMTOM1SR0_ISR
      OsAppIsrRef = GTMTOM1SR1_ISR
      OsAppIsrRef = CanIsr_4
      OsAppIsrRef = ASCLIN3RX_ISR
      OsAppIsrRef = CanIsr_1
      OsAppIsrRef = ASCLIN3TX_ISR
      OsAppIsrRef = CanIsr_6
      OsAppIsrRef = CanIsr_0
      OsAppEcucPartitionRef = EcucPartition_OsCore0
      OsAppAlarmRef = Rte_Al_TE2_Core0_Bsw_Task_0_10ms
      OsAppAlarmRef = Rte_Al_TE2_Core0_Bsw_Task_0_20ms
      OsAppAlarmRef = Rte_Al_TE2_Core0_Bsw_Task_0_5ms
      OsAppIsrRef = XSignalIsr_OsCore0
      OsAppAlarmRef = Rte_Al_TE_IoHwAb_IoHwAb_IoHwAbRunnable_10ms
      OsAppAlarmRef = Rte_Al_TE_IoHwAb_IoHwAb_IoHwAbRunnable_500ms
      OsAppTaskRef = Os/Core0_CddTask
      OsAppAlarmRef = Rte_Al_TE_IoHwAb_SWC_IoHwAb_SWC_Runnable_50ms
      OsAppIsrRef = GTMTOM0SR2_ISR
      OsApplicationHooks: OsAppErrorHook=false, OsAppShutdownHook=false, OsAppStartupHook=false
    CounterIsr_SystemTimer_Core0 (OsIsr):
      OsIsrInterruptPriority = 1
      OsIsrCategory = CATEGORY_2
      OsIsrInterruptType = EXTERNAL
      OsIsrInterruptSource = 768
      OsIsrStackSize = 1024
      OsIsrEnableNesting = false
      OsIsrUsesFpu = false
      OsIsrInitialEnableInterruptSource = false
      OsIsrSpecialFunctionName = Os_TimerPfrtIsr
    Default_Init_Task (OsTask):
      OsTaskActivation = 1
      OsTaskPriority = 50
      OsTaskSchedule = FULL
      OsTaskStackSharing = false
      OsTaskStackSize = 1024
      OsTaskType = BASIC
      OsTaskUsesFpu = false
      OsTaskAccessingApplication = SystemApplication_OsCore{0..2}
      OsTaskAutostart: OsTaskAppModeRef=OSDEFAULTAPPMODE
    Default_Init_Task_Trusted (OsTask):
      OsTaskActivation = 1
      OsTaskPriority = 49
      OsTaskSchedule = FULL
      OsTaskStackSharing = false
      OsTaskStackSize = 1024
      OsTaskType = BASIC
      OsTaskUsesFpu = false
      OsTaskAccessingApplication = SystemApplication_OsCore{0..2}
      OsTaskAutostart: OsTaskAppModeRef=OSDEFAULTAPPMODE
    OsResource_Core0 (OsResource): OsResourceProperty=STANDARD, OsResourceAccessingApplication=SystemApplication_OsCore0
    Core0_Bsw_Task (OsTask):
      OsTaskActivation = 1
      OsTaskPriority = 65
      OsTaskSchedule = FULL
      OsTaskStackSharing = false
      OsTaskStackSize = 1024
      OsTaskType = AUTO
      OsTaskUsesFpu = false
      OsTaskAccessingApplication = SystemApplication_OsCore0
      OsTaskResourceRef = OsResource_Core0
      OsTaskAccessingApplication = SystemApplication_OsCore1
      OsTaskAccessingApplication = SystemApplication_OsCore2
      OsTaskEventRef = Rte_Ev_Cyclic2_Core0_Bsw_Task_0_10ms
      OsTaskEventRef = Rte_Ev_Cyclic2_Core0_Bsw_Task_0_20ms
      OsTaskEventRef = Rte_Ev_Cyclic2_Core0_Bsw_Task_0_5ms
    Core0_AswTask (OsTask):
      OsTaskActivation = 1
      OsTaskPriority = 64
      OsTaskSchedule = FULL
      OsTaskStackSharing = false
      OsTaskStackSize = 1024
      OsTaskType = AUTO
      OsTaskUsesFpu = false
      OsTaskAccessingApplication = SystemApplication_OsCore0
      OsTaskResourceRef = OsResource_Core0
      OsTaskAccessingApplication = SystemApplication_OsCore1
      OsTaskAccessingApplication = SystemApplication_OsCore2
    31 x OsIsr, all with OsIsrCategory=CATEGORY_2, OsIsrInterruptType=EXTERNAL, OsIsrStackSize=1024, OsIsrEnableNesting=false, OsIsrUsesFpu=false, OsIsrInitialEnableInterruptSource=true:
      ADC1SR0_ISR: OsIsrInterruptPriority=41, OsIsrInterruptSource=1664
      ADC0SR0_ISR: OsIsrInterruptPriority=40, OsIsrInterruptSource=1648
      ADC2SR0_ISR: OsIsrInterruptPriority=42, OsIsrInterruptSource=1680
      ADC3SR0_ISR: OsIsrInterruptPriority=43, OsIsrInterruptSource=1696
      ADC11SR0_ISR: OsIsrInterruptPriority=44, OsIsrInterruptSource=1824
      ASCLIN2ERR_ISR: OsIsrInterruptPriority=52, OsIsrInterruptSource=112
      ASCLIN2RX_ISR: OsIsrInterruptPriority=51, OsIsrInterruptSource=108
      ASCLIN2TX_ISR: OsIsrInterruptPriority=50, OsIsrInterruptSource=104
      ASCLIN1ERR_ISR: OsIsrInterruptPriority=55, OsIsrInterruptSource=100
      ASCLIN1RX_ISR: OsIsrInterruptPriority=54, OsIsrInterruptSource=96
      ASCLIN1TX_ISR: OsIsrInterruptPriority=53, OsIsrInterruptSource=92
      DMACH10SR_ISR: OsIsrInterruptPriority=114, OsIsrInterruptSource=920
      DMACH11SR_ISR: OsIsrInterruptPriority=115, OsIsrInterruptSource=924
      QSPI3ERR_ISR: OsIsrInterruptPriority=102, OsIsrInterruptSource=308
      QSPI3PT_ISR: OsIsrInterruptPriority=103, OsIsrInterruptSource=312
      ADC8SR0_ISR: OsIsrInterruptPriority=45, OsIsrInterruptSource=1776
      GTMTOM1SR3_ISR: OsIsrInterruptPriority=121, OsIsrInterruptSource=3644
      GTMTOM1SR4_ISR: OsIsrInterruptPriority=122, OsIsrInterruptSource=3648
      CanIsr_3: OsIsrInterruptPriority=134, OsIsrInterruptSource=1468  # /ActiveEcuC/Can PLAIN_TEXT Can messages event (for a specific controllers)
      ASCLIN4ERR_ISR: OsIsrInterruptPriority=58, OsIsrInterruptSource=136
      ASCLIN4RX_ISR: OsIsrInterruptPriority=57, OsIsrInterruptSource=132
      ASCLIN4TX_ISR: OsIsrInterruptPriority=56, OsIsrInterruptSource=128
      GTMTOM1SR0_ISR: OsIsrInterruptPriority=123, OsIsrInterruptSource=3632
      GTMTOM1SR1_ISR: OsIsrInterruptPriority=124, OsIsrInterruptSource=3636
      CanIsr_4: OsIsrInterruptPriority=132, OsIsrInterruptSource=1520  # /ActiveEcuC/Can PLAIN_TEXT Can messages event (for a specific controllers)
      ASCLIN3ERR_ISR: OsIsrInterruptPriority=61, OsIsrInterruptSource=124
      ASCLIN3RX_ISR: OsIsrInterruptPriority=60, OsIsrInterruptSource=120
      ASCLIN3TX_ISR: OsIsrInterruptPriority=59, OsIsrInterruptSource=116
      CanIsr_1: OsIsrInterruptPriority=131, OsIsrInterruptSource=1460  # /ActiveEcuC/Can PLAIN_TEXT Can messages event (for a specific controllers)
      CanIsr_6: OsIsrInterruptPriority=133, OsIsrInterruptSource=1528  # /ActiveEcuC/Can PLAIN_TEXT Can messages event (for a specific controllers)
      CanIsr_0: OsIsrInterruptPriority=130, OsIsrInterruptSource=1456  # /ActiveEcuC/Can PLAIN_TEXT Can messages event (for a specific controllers)
    OsCore1 (OsCore):
      OsCoreIsAutostart = false
      OsCoreIsAutosar = true
      OsCoreEntrySymbol = _start_tc1_Core1
      OsCorePhysicalCoreRef = Core1
      OsCoreEcucCoreRef = EcucCore1
      OsCoreIdleTask = IdleTask_OsCore1
      OsCoreSystemApplication = SystemApplication_OsCore1
      OsCoreStacks:
        OsCoreKernelStackSize = 1024
        OsCoreStartupStackSize = 1024
        OsCoreShutdownStackSize = 1024
        OsCoreErrorStackSize = 1024
        OsCoreProtectionStackSize = 1024
        OsCoreInitStackSize = 1024
      XSignalChl_OsCore0 (OsCoreXSignalChannel): OsCoreXSignalChannelSize=1, OsCoreXSignalChannelReceiverIsr=XSignalIsr_OsCore0
      XSignalChl_OsCore2 (OsCoreXSignalChannel): OsCoreXSignalChannelSize=1, OsCoreXSignalChannelReceiverIsr=XSignalIsr_OsCore2
    OsCore2 (OsCore):
      OsCoreIsAutostart = false
      OsCoreIsAutosar = true
      OsCoreEntrySymbol = _start_tc2_Core2
      OsCorePhysicalCoreRef = Core2
      OsCoreEcucCoreRef = EcucCore2
      OsCoreIdleTask = IdleTask_OsCore2
      OsCoreSystemApplication = SystemApplication_OsCore2
      OsCoreStacks:
        OsCoreKernelStackSize = 1024
        OsCoreStartupStackSize = 1024
        OsCoreShutdownStackSize = 1024
        OsCoreErrorStackSize = 1024
        OsCoreProtectionStackSize = 1024
        OsCoreInitStackSize = 1024
      XSignalChl_OsCore0 (OsCoreXSignalChannel): OsCoreXSignalChannelSize=1, OsCoreXSignalChannelReceiverIsr=XSignalIsr_OsCore0
      XSignalChl_OsCore1 (OsCoreXSignalChannel): OsCoreXSignalChannelSize=1, OsCoreXSignalChannelReceiverIsr=XSignalIsr_OsCore1
    IdleTask_OsCore1 (OsTask):
      OsTaskActivation = 1
      OsTaskPriority = 4294967295
      OsTaskSchedule = FULL
      OsTaskStackSharing = false
      OsTaskStackSize = 1024
      OsTaskType = AUTO
      OsTaskUsesFpu = false
      OsTaskAccessingApplication = SystemApplication_OsCore{0..2}
      OsTaskAutostart: OsTaskAppModeRef=OS_APPMODE_ANY
    SystemApplication_OsCore1 (OsApplication):
      OsTrusted = true
      OsTrustedApplicationDelayTimingViolationCall = false
      OsTrustedApplicationWithProtection = false
      OsApplicationIsPrivileged = true
      OsAppUseTrustedFunctionStubs = false
      OsApplicationCoreRef = EcucCore1
      OsAppTaskRef = IdleTask_OsCore1
      OsAppTaskRef = Default_Init_Task_Core1
      OsAppTaskRef = Default_Init_Task_Core1_Trusted
      OsAppCounterRef = SystemTimer_Core1
      OsAppIsrRef = CounterIsr_SystemTimer_Core1
      OsAppTaskRef = Core1_Asw_Init
      OsAppTaskRef = Os/Core1_Bsw_Task
      OsAppTaskRef = Os/Core1_Asw_Task_Qm
      OsAppEcucPartitionRef = EcucPartition_OsCore1
      OsAppAlarmRef = Rte_Al_TE2_EcuM_EcuM_MainFunction
      OsAppIsrRef = XSignalIsr_OsCore1
      OsAppAlarmRef = Rte_Al_TE_CtAp_CANHandler_R_CANHandlerInput_Cyclic_1000ms
      OsAppAlarmRef = Rte_Al_TE_CtAp_CANHandler_R_CANHandlerInput_Cyclic_500ms
      OsAppAlarmRef = Rte_Al_TE_Core1_Asw_Task_Qm_0_100ms
      OsAppAlarmRef = Rte_Al_TE_Core1_Asw_Task_Qm_0_10ms
      OsAppAlarmRef = Rte_Al_TE_Core1_Asw_Task_Qm_0_200ms
      OsAppAlarmRef = Rte_Al_TE_Core1_Asw_Task_Qm_0_20ms
      OsAppAlarmRef = Rte_Al_TE_Core1_Asw_Task_Qm_0_50ms
      OsAppAlarmRef = Rte_Al_TE_Core1_Bsw_Task_0_100ms
      OsAppAlarmRef = Rte_Al_TE_Core1_Bsw_Task_0_10ms
      OsAppAlarmRef = Rte_Al_TE_Core1_Bsw_Task_0_20ms
      OsAppAlarmRef = Rte_Al_TE_Core1_Bsw_Task_0_50ms
      OsApplicationHooks: OsAppErrorHook=false, OsAppShutdownHook=false, OsAppStartupHook=false
    IdleTask_OsCore2 (OsTask):
      OsTaskActivation = 1
      OsTaskPriority = 4294967295
      OsTaskSchedule = FULL
      OsTaskStackSharing = false
      OsTaskStackSize = 1024
      OsTaskType = AUTO
      OsTaskUsesFpu = false
      OsTaskAccessingApplication = SystemApplication_OsCore{0..2}
      OsTaskAutostart: OsTaskAppModeRef=OS_APPMODE_ANY
    SystemApplication_OsCore2 (OsApplication):
      OsTrusted = true
      OsTrustedApplicationDelayTimingViolationCall = false
      OsTrustedApplicationWithProtection = false
      OsApplicationIsPrivileged = true
      OsAppUseTrustedFunctionStubs = false
      OsApplicationCoreRef = EcucCore2
      OsAppTaskRef = IdleTask_OsCore2
      OsAppTaskRef = Default_Init_Task_Core2
      OsAppTaskRef = Default_Init_Task_Core2_Trusted
      OsAppIsrRef = CounterIsr_SystemTimer_Core2
      OsAppCounterRef = SystemTimer_Core2
      OsAppTaskRef = Core2_Asw_Init
      OsAppTaskRef = Core2_Bsw_Task
      OsAppTaskRef = Core2_Asw_Task
      OsAppEcucPartitionRef = EcucPartition_OsCore2
      OsAppAlarmRef = Rte_Al_TE3_EcuM_EcuM_MainFunction
      OsAppIsrRef = XSignalIsr_OsCore2
      OsAppAlarmRef = Rte_Al_TE_Core2App_SWC_Core2App_SWC_Runnable_10ms
      OsApplicationHooks: OsAppErrorHook=false, OsAppShutdownHook=false, OsAppStartupHook=false
    4 x OsTask, all with OsTaskActivation=1, OsTaskSchedule=FULL, OsTaskStackSharing=false, OsTaskStackSize=1024, OsTaskType=BASIC, OsTaskUsesFpu=false, OsTaskAccessingApplication=SystemApplication_OsCore0, OsTaskAccessingApplication=SystemApplication_OsCore1, OsTaskAccessingApplication=SystemApplication_OsCore2:
      Default_Init_Task_Core1: OsTaskPriority=50
        OsTaskAutostart: OsTaskAppModeRef=OSDEFAULTAPPMODE
      Default_Init_Task_Core1_Trusted: OsTaskPriority=49
        OsTaskAutostart: OsTaskAppModeRef=OSDEFAULTAPPMODE
      Default_Init_Task_Core2: OsTaskPriority=50
        OsTaskAutostart: OsTaskAppModeRef=OSDEFAULTAPPMODE
      Default_Init_Task_Core2_Trusted: OsTaskPriority=49
        OsTaskAutostart: OsTaskAppModeRef=OSDEFAULTAPPMODE
    SystemTimer_Core1 (OsCounter):
      OsCounterMaxAllowedValue = 2147483647
      OsCounterMinCycle = 1
      OsCounterType = HARDWARE
      OsSecondsPerTick = 0.001
      OsCounterTicksPerBase = 100000
      OsCounterAccessingApplication = SystemApplication_OsCore{0..2}
      OsDriver: OsDriverHighResolution=false, OsDriverHardwareTimerChannelRef=STM0_Ch1, OsDriverIsrRef=CounterIsr_SystemTimer_Core1
    SystemTimer_Core2 (OsCounter):
      OsCounterMaxAllowedValue = 2147483647
      OsCounterMinCycle = 1
      OsCounterType = HARDWARE
      OsSecondsPerTick = 0.001
      OsCounterTicksPerBase = 100000
      OsCounterAccessingApplication = SystemApplication_OsCore{0..2}
      OsDriver: OsDriverHighResolution=false, OsDriverHardwareTimerChannelRef=STM1_Ch0, OsDriverIsrRef=CounterIsr_SystemTimer_Core2
    CounterIsr_SystemTimer_Core1 (OsIsr):
      OsIsrInterruptPriority = 1
      OsIsrCategory = CATEGORY_2
      OsIsrInterruptType = EXTERNAL
      OsIsrInterruptSource = 772
      OsIsrStackSize = 1024
      OsIsrEnableNesting = false
      OsIsrUsesFpu = false
      OsIsrInitialEnableInterruptSource = false
      OsIsrSpecialFunctionName = Os_TimerPfrtIsr
    CounterIsr_SystemTimer_Core2 (OsIsr):
      OsIsrInterruptPriority = 1
      OsIsrCategory = CATEGORY_2
      OsIsrInterruptType = EXTERNAL
      OsIsrInterruptSource = 776
      OsIsrStackSize = 1024
      OsIsrEnableNesting = false
      OsIsrUsesFpu = false
      OsIsrInitialEnableInterruptSource = false
      OsIsrSpecialFunctionName = Os_TimerPfrtIsr
    OsResource_Core1 (OsResource): OsResourceProperty=STANDARD, OsResourceAccessingApplication=SystemApplication_OsCore1
    OsResource_Core2 (OsResource): OsResourceProperty=STANDARD, OsResourceAccessingApplication=SystemApplication_OsCore2
    6 x OsTask, all with OsTaskActivation=1, OsTaskSchedule=FULL, OsTaskStackSharing=false, OsTaskStackSize=1024, OsTaskType=AUTO, OsTaskUsesFpu=false, OsTaskAccessingApplication=SystemApplication_OsCore0, OsTaskAccessingApplication=SystemApplication_OsCore1, OsTaskAccessingApplication=SystemApplication_OsCore2:
      Core1_Asw_Init: OsTaskPriority=40, OsTaskResourceRef=OsResource_Core1
      Core2_Asw_Init: OsTaskPriority=0, OsTaskResourceRef=OsResource_Core2
      Core1_Bsw_Task: OsTaskPriority=42, OsTaskResourceRef=OsResource_Core1, OsTaskEventRef=Rte_Ev_Cyclic_Core1_Bsw_Task_0_100ms, OsTaskEventRef=Rte_Ev_Cyclic_Core1_Bsw_Task_0_10ms, OsTaskEventRef=Rte_Ev_Cyclic_Core1_Bsw_Task_0_20ms, OsTaskEventRef=Rte_Ev_Cyclic_Core1_Bsw_Task_0_50ms, OsTaskEventRef=Rte_Ev_RunS2_EcuM_EcuM_MainFunction
      Core2_Bsw_Task: OsTaskPriority=0, OsTaskResourceRef=OsResource_Core2
      Core1_Asw_Task_Qm: OsTaskPriority=41, OsTaskResourceRef=OsResource_Core1, OsTaskEventRef=Rte_Ev_Run_CtAp_CANHandler_R_CANHandlerInput_Cyclic_1000ms, OsTaskEventRef=Rte_Ev_Run_CtAp_CANHandler_R_CANHandlerInput_Cyclic_500ms, OsTaskEventRef=Rte_Ev_Cyclic_Core1_Asw_Task_Qm_0_100ms, OsTaskEventRef=Rte_Ev_Cyclic_Core1_Asw_Task_Qm_0_10ms, OsTaskEventRef=Rte_Ev_Cyclic_Core1_Asw_Task_Qm_0_200ms, OsTaskEventRef=Rte_Ev_Cyclic_Core1_Asw_Task_Qm_0_20ms, OsTaskEventRef=Rte_Ev_Cyclic_Core1_Asw_Task_Qm_0_50ms
      Core2_Asw_Task: OsTaskPriority=0, OsTaskResourceRef=OsResource_Core2
    3 x OsAlarm, all with OsAlarmCounterRef=SystemTimer_Core0, OsAlarmAccessingApplication=SystemApplication_OsCore0, OsAlarmAccessingApplication=SystemApplication_OsCore1, OsAlarmAccessingApplication=SystemApplication_OsCore2:
      Rte_Al_TE2_Core0_Bsw_Task_0_10ms
        OsAlarmAction
          OsAlarmSetEvent: OsAlarmSetEventRef=Rte_Ev_Cyclic2_Core0_Bsw_Task_0_10ms, OsAlarmSetEventTaskRef=Os/Core0_Bsw_Task
      Rte_Al_TE2_Core0_Bsw_Task_0_20ms
        OsAlarmAction
          OsAlarmSetEvent: OsAlarmSetEventRef=Rte_Ev_Cyclic2_Core0_Bsw_Task_0_20ms, OsAlarmSetEventTaskRef=Os/Core0_Bsw_Task
      Rte_Al_TE2_Core0_Bsw_Task_0_5ms
        OsAlarmAction
          OsAlarmSetEvent: OsAlarmSetEventRef=Rte_Ev_Cyclic2_Core0_Bsw_Task_0_5ms, OsAlarmSetEventTaskRef=Os/Core0_Bsw_Task
    3 x OsEvent:
      Rte_Ev_Cyclic2_Core0_Bsw_Task_0_10ms
      Rte_Ev_Cyclic2_Core0_Bsw_Task_0_20ms
      Rte_Ev_Cyclic2_Core0_Bsw_Task_0_5ms
    Rte_Al_TE2_EcuM_EcuM_MainFunction (OsAlarm):
      OsAlarmCounterRef = SystemTimer_Core1
      OsAlarmAccessingApplication = SystemApplication_OsCore{0..2}
      OsAlarmAction
        OsAlarmSetEvent: OsAlarmSetEventRef=Rte_Ev_RunS2_EcuM_EcuM_MainFunction, OsAlarmSetEventTaskRef=Os/Core1_Bsw_Task
    Rte_Al_TE3_EcuM_EcuM_MainFunction (OsAlarm):
      OsAlarmCounterRef = SystemTimer_Core2
      OsAlarmAccessingApplication = SystemApplication_OsCore{0..2}
      OsAlarmAction
        OsAlarmActivateTask: OsAlarmActivateTaskRef=Core2_Bsw_Task
    3 x OsIsr, all with OsIsrInterruptPriority=2, OsIsrCategory=CATEGORY_2, OsIsrInterruptType=EXTERNAL, OsIsrStackSize=1024, OsIsrEnableNesting=false, OsIsrUsesFpu=false, OsIsrInitialEnableInterruptSource=false, OsIsrSpecialFunctionName=Os_XSigRecvIsrHandler:
      XSignalIsr_OsCore1: OsIsrInterruptSource=84
        OsIsrXSignalReceiver:
          OsIsrXSignalReceiverProvidedApis = ShutdownAllCores
          OsIsrXSignalReceiverProvidedApis = ActivateTask
          OsIsrXSignalReceiverProvidedApis = CancelAlarm
          OsIsrXSignalReceiverProvidedApis = ChainTask
          OsIsrXSignalReceiverProvidedApis = ControlIdle
          OsIsrXSignalReceiverProvidedApis = GetAlarm
          OsIsrXSignalReceiverProvidedApis = GetApplicationState
          OsIsrXSignalReceiverProvidedApis = GetCounterValue
          OsIsrXSignalReceiverProvidedApis = GetElapsedValue
          OsIsrXSignalReceiverProvidedApis = GetErrorHookStackUsage
          OsIsrXSignalReceiverProvidedApis = GetEvent
          OsIsrXSignalReceiverProvidedApis = GetISRStackUsage
          OsIsrXSignalReceiverProvidedApis = GetKernelStackUsage
          OsIsrXSignalReceiverProvidedApis = GetNonTrustedFunctionStackUsage
          OsIsrXSignalReceiverProvidedApis = GetProtectionHookStackUsage
          OsIsrXSignalReceiverProvidedApis = GetScheduleTableStatus
          OsIsrXSignalReceiverProvidedApis = GetShutdownHookStackUsage
          OsIsrXSignalReceiverProvidedApis = GetStartupHookStackUsage
          OsIsrXSignalReceiverProvidedApis = GetTaskStackUsage
          OsIsrXSignalReceiverProvidedApis = GetTaskState
          OsIsrXSignalReceiverProvidedApis = HookCallCallback
          OsIsrXSignalReceiverProvidedApis = NextScheduleTable
          OsIsrXSignalReceiverProvidedApis = SetAbsAlarm
          OsIsrXSignalReceiverProvidedApis = SetEvent
          OsIsrXSignalReceiverProvidedApis = SetRelAlarm
          OsIsrXSignalReceiverProvidedApis = StartScheduleTableAbs
          OsIsrXSignalReceiverProvidedApis = StartScheduleTableRel
          OsIsrXSignalReceiverProvidedApis = StopScheduleTable
          OsIsrXSignalReceiverProvidedApis = TerminateApplication
      XSignalIsr_OsCore2: OsIsrInterruptSource=88
        OsIsrXSignalReceiver:
          OsIsrXSignalReceiverProvidedApis = ShutdownAllCores
          OsIsrXSignalReceiverProvidedApis = ActivateTask
          OsIsrXSignalReceiverProvidedApis = CancelAlarm
          OsIsrXSignalReceiverProvidedApis = ChainTask
          OsIsrXSignalReceiverProvidedApis = ControlIdle
          OsIsrXSignalReceiverProvidedApis = GetAlarm
          OsIsrXSignalReceiverProvidedApis = GetApplicationState
          OsIsrXSignalReceiverProvidedApis = GetCounterValue
          OsIsrXSignalReceiverProvidedApis = GetElapsedValue
          OsIsrXSignalReceiverProvidedApis = GetErrorHookStackUsage
          OsIsrXSignalReceiverProvidedApis = GetEvent
          OsIsrXSignalReceiverProvidedApis = GetISRStackUsage
          OsIsrXSignalReceiverProvidedApis = GetKernelStackUsage
          OsIsrXSignalReceiverProvidedApis = GetNonTrustedFunctionStackUsage
          OsIsrXSignalReceiverProvidedApis = GetProtectionHookStackUsage
          OsIsrXSignalReceiverProvidedApis = GetScheduleTableStatus
          OsIsrXSignalReceiverProvidedApis = GetShutdownHookStackUsage
          OsIsrXSignalReceiverProvidedApis = GetStartupHookStackUsage
          OsIsrXSignalReceiverProvidedApis = GetTaskStackUsage
          OsIsrXSignalReceiverProvidedApis = GetTaskState
          OsIsrXSignalReceiverProvidedApis = HookCallCallback
          OsIsrXSignalReceiverProvidedApis = NextScheduleTable
          OsIsrXSignalReceiverProvidedApis = SetAbsAlarm
          OsIsrXSignalReceiverProvidedApis = SetEvent
          OsIsrXSignalReceiverProvidedApis = SetRelAlarm
          OsIsrXSignalReceiverProvidedApis = StartScheduleTableAbs
          OsIsrXSignalReceiverProvidedApis = StartScheduleTableRel
          OsIsrXSignalReceiverProvidedApis = StopScheduleTable
          OsIsrXSignalReceiverProvidedApis = TerminateApplication
      XSignalIsr_OsCore0: OsIsrInterruptSource=80
        OsIsrXSignalReceiver:
          OsIsrXSignalReceiverProvidedApis = ShutdownAllCores
          OsIsrXSignalReceiverProvidedApis = ActivateTask
          OsIsrXSignalReceiverProvidedApis = CancelAlarm
          OsIsrXSignalReceiverProvidedApis = ChainTask
          OsIsrXSignalReceiverProvidedApis = ControlIdle
          OsIsrXSignalReceiverProvidedApis = GetAlarm
          OsIsrXSignalReceiverProvidedApis = GetApplicationState
          OsIsrXSignalReceiverProvidedApis = GetCounterValue
          OsIsrXSignalReceiverProvidedApis = GetElapsedValue
          OsIsrXSignalReceiverProvidedApis = GetErrorHookStackUsage
          OsIsrXSignalReceiverProvidedApis = GetEvent
          OsIsrXSignalReceiverProvidedApis = GetISRStackUsage
          OsIsrXSignalReceiverProvidedApis = GetKernelStackUsage
          OsIsrXSignalReceiverProvidedApis = GetNonTrustedFunctionStackUsage
          OsIsrXSignalReceiverProvidedApis = GetProtectionHookStackUsage
          OsIsrXSignalReceiverProvidedApis = GetScheduleTableStatus
          OsIsrXSignalReceiverProvidedApis = GetShutdownHookStackUsage
          OsIsrXSignalReceiverProvidedApis = GetStartupHookStackUsage
          OsIsrXSignalReceiverProvidedApis = GetTaskStackUsage
          OsIsrXSignalReceiverProvidedApis = GetTaskState
          OsIsrXSignalReceiverProvidedApis = HookCallCallback
          OsIsrXSignalReceiverProvidedApis = NextScheduleTable
          OsIsrXSignalReceiverProvidedApis = SetAbsAlarm
          OsIsrXSignalReceiverProvidedApis = SetEvent
          OsIsrXSignalReceiverProvidedApis = SetRelAlarm
          OsIsrXSignalReceiverProvidedApis = StartScheduleTableAbs
          OsIsrXSignalReceiverProvidedApis = StartScheduleTableRel
          OsIsrXSignalReceiverProvidedApis = StopScheduleTable
          OsIsrXSignalReceiverProvidedApis = TerminateApplication
    4 x OsAlarm, all with OsAlarmAccessingApplication=SystemApplication_OsCore0, OsAlarmAccessingApplication=SystemApplication_OsCore1, OsAlarmAccessingApplication=SystemApplication_OsCore2:
      Rte_Al_TE_IoHwAb_IoHwAb_IoHwAbRunnable_10ms: OsAlarmCounterRef=SystemTimer_Core0
        OsAlarmAction
          OsAlarmSetEvent: OsAlarmSetEventRef=Rte_Ev_Run_IoHwAb_IoHwAb_IoHwAbRunnable_10ms, OsAlarmSetEventTaskRef=Os/Core0_CddTask
      Rte_Al_TE_IoHwAb_IoHwAb_IoHwAbRunnable_500ms: OsAlarmCounterRef=SystemTimer_Core0
        OsAlarmAction
          OsAlarmActivateTask: OsAlarmActivateTaskRef=Core0_AswTask
      Rte_Al_TE_CtAp_CANHandler_R_CANHandlerInput_Cyclic_1000ms: OsAlarmCounterRef=SystemTimer_Core1
        OsAlarmAction
          OsAlarmSetEvent: OsAlarmSetEventRef=Rte_Ev_Run_CtAp_CANHandler_R_CANHandlerInput_Cyclic_1000ms, OsAlarmSetEventTaskRef=Os/Core1_Asw_Task_Qm
      Rte_Al_TE_CtAp_CANHandler_R_CANHandlerInput_Cyclic_500ms: OsAlarmCounterRef=SystemTimer_Core1
        OsAlarmAction
          OsAlarmSetEvent: OsAlarmSetEventRef=Rte_Ev_Run_CtAp_CANHandler_R_CANHandlerInput_Cyclic_500ms, OsAlarmSetEventTaskRef=Os/Core1_Asw_Task_Qm
    Rte_Ev_Run_CtAp_CANHandler_R_CANHandlerInput_Cyclic_1000ms (OsEvent)
    Rte_Ev_Run_CtAp_CANHandler_R_CANHandlerInput_Cyclic_500ms (OsEvent)
    212 x OsSpinlock, all with OsSpinlockLockMethod=LOCK_CAT2_INTERRUPTS, OsSpinlockLockType=STANDARD, OsSpinlockAccessingApplication=SystemApplication_OsCore0, OsSpinlockAccessingApplication=SystemApplication_OsCore1:
      Rte_Spinlock_BCL_ChargeMode_oBCL_oJ1939_bms_2f4f0f62_Tx
      Rte_Spinlock_BCL_CurrentRequire_oBCL_oJ1939_bms_d7664f08_Tx
      Rte_Spinlock_BCL_VolltageRequire_oBCL_oJ1939_bms_425ed7b1_Tx
      Rte_Spinlock_BCP_AllowChargeVoltageMax_oBCP_oJ1939_bms_fc3dfe75_Tx
      Rte_Spinlock_BCP_AllowTempMax_oBCP_oJ1939_bms_3d5b24f4_Tx
      Rte_Spinlock_BCP_BatteryChargeVoltageMax_oBCP_oJ1939_bms_5d02e2aa_Tx
      Rte_Spinlock_BCP_BatteryNominalEnergy_oBCP_oJ1939_bms_7dc98c8b_Tx
      Rte_Spinlock_BCP_BatteryTotalVoltage_oBCP_oJ1939_bms_19a0567e_Tx
      Rte_Spinlock_BCP_ChargeCurrentMax_oBCP_oJ1939_bms_7cdaf0d4_Tx
      Rte_Spinlock_BCP_SOC_oBCP_oJ1939_bms_78e6b083_Tx
      Rte_Spinlock_BCS_BatteryVoltMaxGroup_oBCS_oJ1939_bms_196f50c9_Tx
      Rte_Spinlock_BCS_BatteryVoltMax_oBCS_oJ1939_bms_11a53a15_Tx
      Rte_Spinlock_BCS_ChargeCurrentMeasure_oBCS_oJ1939_bms_0ae65560_Tx
      Rte_Spinlock_BCS_ChargeVoltageMeasure_oBCS_oJ1939_bms_abbd1969_Tx
      Rte_Spinlock_BCS_EstimatedTimeRemaining_oBCS_oJ1939_bms_c6383d22_Tx
      Rte_Spinlock_BCS_SOC_oBCS_oJ1939_bms_7466e090_Tx
      Rte_Spinlock_BEM_ChargeAbortTimeout_oBEM_oJ1939_bms_4849b46c_Tx
      Rte_Spinlock_BEM_ChargeFinishTimeout_oBEM_oJ1939_bms_2d8e7a9e_Tx
      Rte_Spinlock_BEM_ChargeStateTimeout_oBEM_oJ1939_bms_4d32efa5_Tx
      Rte_Spinlock_BEM_ChargeStatisticsTimeout_oBEM_oJ1939_bms_d07a3692_Tx
      Rte_Spinlock_BEM_ChargerIdTimeout0_oBEM_oJ1939_bms_eb813ae3_Tx
      Rte_Spinlock_BEM_ChargerIdTimeout1_oBEM_oJ1939_bms_6c27f1a0_Tx
      Rte_Spinlock_BEM_TimesyncOrPowerTimeout_oBEM_oJ1939_bms_f132cc4f_Tx
      Rte_Spinlock_BHM_AllowChargeVoltageMax_oBHM_oJ1939_bms_5c3d4762_Tx
      Rte_Spinlock_BRM_BatteryChargeTimes_oBRM_oJ1939_bms_b699eff3_Tx
      Rte_Spinlock_BRM_BatteryProductDay_oBRM_oJ1939_bms_da11520f_Tx
      Rte_Spinlock_BRM_BatteryProductMonth_oBRM_oJ1939_bms_9ee6c732_Tx
      Rte_Spinlock_BRM_BatteryProductYear_oBRM_oJ1939_bms_4f8656a1_Tx
      Rte_Spinlock_BRM_BatteryProperty_oBRM_oJ1939_bms_1c53b5e5_Tx
      Rte_Spinlock_BRM_BatterySN_oBRM_oJ1939_bms_10b903de_Tx
      Rte_Spinlock_BRM_BatterySystemRatedCapacity_oBRM_oJ1939_bms_8c5f9fd1_Tx
      Rte_Spinlock_BRM_BatterySystemRatedVoltage_oBRM_oJ1939_bms_902f9149_Tx
      Rte_Spinlock_BRM_BatteryType_oBRM_oJ1939_bms_67affdba_Tx
      Rte_Spinlock_BRM_Manufacturer_oBRM_oJ1939_bms_1506e637_Tx
      Rte_Spinlock_BRM_ProtocolVersion_oBRM_oJ1939_bms_4595b96f_Tx
      Rte_Spinlock_BRM_VehicleIdByte17_oBRM_oJ1939_bms_3bcab298_Tx
      Rte_Spinlock_BRM_VehicleIdByte1_8_oBRM_oJ1939_bms_38f10529_Tx
      Rte_Spinlock_BRM_VehicleIdByte9_16_oBRM_oJ1939_bms_50f2ed11_Tx
      Rte_Spinlock_BRO_BMSChargeReady_oBRO_oJ1939_bms_639997bd_Tx
      Rte_Spinlock_BSD_AbortSOC_oBSD_oJ1939_bms_1bf4999e_Tx
      Rte_Spinlock_BSD_BatteryTempMax_oBSD_oJ1939_bms_0a97b3dc_Tx
      Rte_Spinlock_BSD_BatteryTempMin_oBSD_oJ1939_bms_ada333a5_Tx
      Rte_Spinlock_BSD_BatteryVoltageMax_oBSD_oJ1939_bms_7df654bd_Tx
      Rte_Spinlock_BSD_BatteryVoltageMin_oBSD_oJ1939_bms_dac2d4c4_Tx
      Rte_Spinlock_BSM_BatteryCurrentState_oBSM_oJ1939_bms_fbd112e0_Tx
      Rte_Spinlock_BSM_BatteryOutpuConnectorState_oBSM_oJ1939_bms_505480e6_Tx
      Rte_Spinlock_BSM_BatteryTempMaxNo_oBSM_oJ1939_bms_497a5c4e_Tx
      Rte_Spinlock_BSM_BatteryTempMax_oBSM_oJ1939_bms_85f0b8b3_Tx
      Rte_Spinlock_BSM_BatteryTempMinNo_oBSM_oJ1939_bms_5a3fbae5_Tx
      Rte_Spinlock_BSM_BatteryTempMin_oBSM_oJ1939_bms_22c438ca_Tx
      Rte_Spinlock_BSM_BatteryTempState_oBSM_oJ1939_bms_84506101_Tx
      Rte_Spinlock_BSM_BatteryVoltageMaxNo_oBSM_oJ1939_bms_8c4562b4_Tx
      Rte_Spinlock_BSM_BatteryVoltageState_oBSM_oJ1939_bms_416f5ffb_Tx
      Rte_Spinlock_BSM_ChargeEnable_oBSM_oJ1939_bms_a2bcc681_Tx
      Rte_Spinlock_BSM_InsulationState_oBSM_oJ1939_bms_7d927ad9_Tx
      Rte_Spinlock_BSM_SOC_oBSM_oJ1939_bms_14942cb5_Tx
      Rte_Spinlock_BST_AbortAchiveSOC_oBST_oJ1939_bms_c136b77d_Tx
      Rte_Spinlock_BST_AbortAchiveSingleVolt_oBST_oJ1939_bms_eba61cdf_Tx
      Rte_Spinlock_BST_AbortAchiveTotalVolt_oBST_oJ1939_bms_e1a7b5c9_Tx
      Rte_Spinlock_BST_AbortChargparameter_oBST_oJ1939_bms_76c05b72_Tx
      Rte_Spinlock_BST_AbortErrorCurrent_oBST_oJ1939_bms_a1621160_Tx
      Rte_Spinlock_BST_AbortErrorVoltage_oBST_oJ1939_bms_984fbd12_Tx
      Rte_Spinlock_BST_AbortFaultBMSTemp_oBST_oJ1939_bms_1f548a97_Tx
      Rte_Spinlock_BST_AbortFaultBatteryTemp_oBST_oJ1939_bms_24bc84f9_Tx
      Rte_Spinlock_BST_AbortFaultConnectorTemp_oBST_oJ1939_bms_5ac8c1a2_Tx
      Rte_Spinlock_BST_AbortFaultConnector_oBST_oJ1939_bms_c267077a_Tx
      Rte_Spinlock_BST_AbortFaultInsulation_oBST_oJ1939_bms_54f72c95_Tx
      Rte_Spinlock_BST_AbortFaultOther_oBST_oJ1939_bms_bf783560_Tx
      Rte_Spinlock_BST_AbortHVrelayfault_oBST_oJ1939_bms_dd44a377_Tx
      Rte_Spinlock_BST_Abortdet2Voltexception_oBST_oJ1939_bms_e015929e_Tx
      Rte_Spinlock_BST_Abortmanoperate_oBST_oJ1939_bms_b2432717_Tx
      Rte_Spinlock_CCS_OutputVoltage_oCCS_oJ1939_bms_e8aa6018_Rx
      Rte_Spinlock_CEM_BatteryChargeRequireTimeout_oCEM_oJ1939_bms_5fb156f4_Rx
      Rte_Spinlock_CHM_ProtocolVersion_oCHM_oJ1939_bms_0a8dbb13_Rx
      Rte_Spinlock_CML_OutpuVoltageMax_oCML_oJ1939_bms_5dd5d6c5_Rx
      Rte_Spinlock_CRM_RecognitionResult_oCRM_oJ1939_bms_dd9063d0_Rx
      Rte_Spinlock_CRO_ChargerReady_oCRO_oJ1939_bms_5ed7a56d_Rx
      Rte_Spinlock_CSD_ChargerNo_oCSD_oJ1939_bms_26864bff_Rx
      Rte_Spinlock_CST_AbortAchiveCondition_oCST_oJ1939_bms_ed49cd8a_Rx
      Rte_Spinlock_CTS_Year_oCTS_oJ1939_bms_66f2efa9_Rx
      Rte_Spinlock_ChargeCurrWU_Ena_oVCU_BS_01_oATOM_HWLIN1_d9c09dc2_Tx
      Rte_Spinlock_ChargeCurrWU_Treshold_oVCU_BS_01_oATOM_HWLIN1_5e5d12a4_Tx
      Rte_Spinlock_DisChargeCurrWU_Ena_oVCU_BS_01_oATOM_HWLIN1_b8f53272_Tx
      Rte_Spinlock_DisChargeCurrWU_Treshold_oVCU_BS_01_oATOM_HWLIN1_05d46e7e_Tx
      Rte_Spinlock_FRC_ComFtonNet_oFRC_01_oATOM_HWLIN1_9657f14b_Rx
      Rte_Spinlock_Resp_Error_oBS_01_oATOM_HWLIN1_f35fadbf_Rx
      Rte_Spinlock_SG_ACU_01_SigGroup_oACU_01_oATOM_CANFD_Matrix_CH_V600_202502_0a16dd9e_Rx
      Rte_Spinlock_SG_ACU_02_SigGroup_oACU_02_oATOM_CANFD_Matrix_CH_V600_202502_3b90e790_Rx
      Rte_Spinlock_SG_ACU_info_SigGroup_oACU_info_oATOM_CANFD_Matrix_CH_V600_202502_5b63ef23_Rx
      Rte_Spinlock_SG_ADCU_ACC_02_SigGroup_oADCU_ACC_02_oATOM_CANFD_Matrix_CH_V600_202502_1e479296_Rx
      Rte_Spinlock_SG_ADCU_AEB_01_SigGroup_oADCU_AEB_01_oATOM_CANFD_Matrix_CH_V600_202502_50a93e3a_Rx
      Rte_Spinlock_SG_ADCU_APS_01_SigGroup_oADCU_APS_01_oATOM_CANFD_Matrix_CH_V600_202502_c590572d_Rx
      Rte_Spinlock_SG_ADCU_APS_02_SigGroup_oADCU_APS_02_oATOM_CANFD_Matrix_CH_V600_202502_67bc1f98_Rx
      Rte_Spinlock_SG_ADCU_DA_SigGroup_oADCU_DA_oATOM_CANFD_Matrix_CH_V600_202502_4133b6dd_Rx
      Rte_Spinlock_SG_APTC_TCU_SigGroup_oAPTC_TCU_oATOM_CAN_Matrix_PT_V600_20250211_467c0275_Rx
      Rte_Spinlock_SG_BCM_05_SigGroup_oBCM_05_oATOM_CAN_Matrix_PT_V600_20250211_46c76b05_Rx
      Rte_Spinlock_SG_BCM_06_SigGroup_oBCM_06_oATOM_CAN_Matrix_PT_V600_20250211_7741510b_Rx
      Rte_Spinlock_SG_BMS_BatInfor_01_SigGroup_oBMS_BatInfor_01_oATOM_CAN_Matrix_PT_V600_20250211_4fef2501_Rx
      Rte_Spinlock_SG_BMS_BatInfor_02_SigGroup_oBMS_BatInfor_02_oATOM_CAN_Matrix_PT_V600_20250211_426bcc59_Rx
      Rte_Spinlock_SG_BMS_BatInfor_03_SigGroup_oBMS_BatInfor_03_oATOM_CAN_Matrix_PT_V600_20250211_f03896ae_Rx
      Rte_Spinlock_SG_BMS_CellTemp_SigGroup_oBMS_CellTemp_oATOM_CAN_Matrix_PT_V600_20250211_591a267a_Rx
      Rte_Spinlock_SG_BMS_CellVoltage_SigGroup_oBMS_CellVoltage_oATOM_CAN_Matrix_PT_V600_20250211_e26ec140_Rx
      Rte_Spinlock_SG_BMS_Charge_01_SigGroup_oBMS_Charge_01_oATOM_CAN_Matrix_PT_V600_20250211_216177cb_Rx
      Rte_Spinlock_SG_BMS_Charge_02_SigGroup_oBMS_Charge_02_oATOM_CAN_Matrix_PT_V600_20250211_116647c1_Rx
      Rte_Spinlock_SG_BMS_Charge_03_SigGroup_oBMS_Charge_03_oATOM_CAN_Matrix_PT_V600_20250211_b7b455f8_Rx
      Rte_Spinlock_SG_BMS_DIRelayState_SigGroup_oBMS_DIRelayState_oATOM_CAN_Matrix_PT_V600_20250211_ca554d8c_Rx
      Rte_Spinlock_SG_BMS_ErrorInfo_SigGroup_oBMS_ErrorInfo_oATOM_CAN_Matrix_PT_V600_20250211_0728f72e_Rx
      Rte_Spinlock_SG_BMS_PRO_SigGroup_oBMS_PRO_oATOM_CAN_Matrix_PT_V600_20250211_21a267c0_Rx
      Rte_Spinlock_SG_BMS_TCU_SigGroup_oBMS_TCU_oATOM_CAN_Matrix_PT_V600_20250211_541a46a3_Rx
      Rte_Spinlock_SG_BMS_VersionInfor_SigGroup_oBMS_VersionInfor_oATOM_CAN_Matrix_PT_V600_20250211_3c7841d8_Rx
      Rte_Spinlock_SG_BMS_status_01_SigGroup_oBMS_status_01_oATOM_CAN_Matrix_PT_V600_20250211_2f7ddbcd_Rx
      Rte_Spinlock_SG_BMS_status_02_SigGroup_oBMS_status_02_oATOM_CAN_Matrix_PT_V600_20250211_1f7aebc7_Rx
      Rte_Spinlock_SG_BMS_status_03_SigGroup_oBMS_status_03_oATOM_CAN_Matrix_PT_V600_20250211_b9a8f9fe_Rx
      Rte_Spinlock_SG_BMS_status_04_SigGroup_oBMS_status_04_oATOM_CAN_Matrix_PT_V600_20250211_7f748bd3_Rx
      Rte_Spinlock_SG_CGW_01_SigGroup_oCGW_01_oATOM_CAN_Matrix_PT_V600_20250211_9280de14_Rx
      Rte_Spinlock_SG_CGW_02_SigGroup_oCGW_02_oATOM_CAN_Matrix_PT_V600_20250211_a306e41a_Rx
      Rte_Spinlock_SG_CGW_VIN1_SigGroup_oCGW_VIN1_oATOM_CAN_Matrix_PT_V600_20250211_49910b51_Rx
      Rte_Spinlock_SG_CGW_VIN2_SigGroup_oCGW_VIN2_oATOM_CAN_Matrix_PT_V600_20250211_c0accf92_Rx
      Rte_Spinlock_SG_CGW_VIN3VER_SigGroup_oCGW_VIN3VER_oATOM_CAN_Matrix_PT_V600_20250211_7600cd71_Rx
      Rte_Spinlock_SG_DCM_FL_02_SigGroup_oDCM_FL_02_oATOM_CAN_Matrix_PT_V600_20250211_46147686_Rx
      Rte_Spinlock_SG_DCM_FR_02_SigGroup_oDCM_FR_02_oATOM_CAN_Matrix_PT_V600_20250211_f609c275_Rx
      Rte_Spinlock_SG_DCM_FR_SigGroup_oDCM_FR_oATOM_CAN_Matrix_PT_V600_20250211_eb540c93_Rx
      Rte_Spinlock_SG_DCM_RL_SigGroup_oDCM_RL_oATOM_CAN_Matrix_PT_V600_20250211_a6554e24_Rx
      Rte_Spinlock_SG_DCM_RR_SigGroup_oDCM_RR_oATOM_CAN_Matrix_PT_V600_20250211_9219ec09_Rx
      Rte_Spinlock_SG_EPS_CONV_SigGroup_oEPS_CONV_oATOM_CANFD_Matrix_CH_V600_202502_42428757_Rx
      Rte_Spinlock_SG_EVCOM_State_01_SigGroup_oEVCOM_State_01_oATOM_CAN_Matrix_PT_V600_20250211_16f3767b_Rx
      Rte_Spinlock_SG_IBS_ACC_SigGroup_oIBS_ACC_oATOM_CANFD_Matrix_CH_V600_202502_c31bc8ab_Rx
      Rte_Spinlock_SG_IBS_APS_SigGroup_oIBS_APS_oATOM_CANFD_Matrix_CH_V600_202502_91bbe9ec_Rx
      Rte_Spinlock_SG_IBS_Status_01_SigGroup_oIBS_Status_01_oATOM_CANFD_Matrix_CH_V600_202502_bdf732ba_Rx
      Rte_Spinlock_SG_IBS_Status_02_SigGroup_oIBS_Status_02_oATOM_CANFD_Matrix_CH_V600_202502_8df002b0_Rx
      Rte_Spinlock_SG_IBS_Status_03_SigGroup_oIBS_Status_03_oATOM_CANFD_Matrix_CH_V600_202502_2b221089_Rx
      Rte_Spinlock_SG_IBS_Status_04_SigGroup_oIBS_Status_04_oATOM_CANFD_Matrix_CH_V600_202502_edfe62a4_Rx
      Rte_Spinlock_SG_IBS_Status_05_SigGroup_oIBS_Status_05_oATOM_CAN_Matrix_PT_V600_20250211_7471090c_Rx
      Rte_Spinlock_SG_IBS_Status_06_SigGroup_oIBS_Status_06_oATOM_CANFD_Matrix_CH_V600_202502_7b2b4097_Rx
      Rte_Spinlock_SG_IBS_Torque_SigGroup_oIBS_Torque_oATOM_CANFD_Matrix_CH_V600_202502_5a2dd5ad_Rx
      Rte_Spinlock_SG_IBS_VCU_MotorControl_SigGroup_oIBS_VCU_MotorControl_oATOM_CANFD_Matrix_CH_V600_202502_9a811a5b_Rx
      Rte_Spinlock_SG_IBS_WheelSpeed_01_SigGroup_oIBS_WheelSpeed_01_oATOM_CANFD_Matrix_CH_V600_202502_5773aa13_Rx
      Rte_Spinlock_SG_IBS_WheelSpeed_02_SigGroup_oIBS_WheelSpeed_02_oATOM_CANFD_Matrix_CH_V600_202502_2d752b6e_Rx
      Rte_Spinlock_SG_IVI_01_SigGroup_oIVI_01_oATOM_CAN_Matrix_PT_V600_20250211_284cc0c2_Rx
      Rte_Spinlock_SG_IVI_03_SigGroup_oIVI_03_oATOM_CAN_Matrix_PT_V600_20250211_bf981109_Rx
      Rte_Spinlock_SG_IVI_OdometerInfor_SigGroup_oIVI_OdometerInfor_oATOM_CAN_Matrix_PT_V600_20250211_3516238b_Rx
      Rte_Spinlock_SG_MCU_01_SigGroup_oMCU_01_oATOM_CAN_Matrix_PT_V600_20250211_3844bc9f_Rx
      Rte_Spinlock_SG_MCU_02_SigGroup_oMCU_02_oATOM_CAN_Matrix_PT_V600_20250211_09c28691_Rx
      Rte_Spinlock_SG_MCU_DeratingStatus_SigGroup_oMCU_DeratingStatus_oATOM_CAN_Matrix_PT_V600_20250211_c60bf9ce_Rx
      Rte_Spinlock_SG_MCU_FailureCode_SigGroup_oMCU_FailureCode_oATOM_CAN_Matrix_PT_V600_20250211_bf11f7cf_Rx
      Rte_Spinlock_SG_MCU_Temperature_01_SigGroup_oMCU_Temperature_01_oATOM_CAN_Matrix_PT_V600_20250211_9ee5905c_Rx
      Rte_Spinlock_SG_MCU_Temperature_02_SigGroup_oMCU_Temperature_02_oATOM_CAN_Matrix_PT_V600_20250211_5f18debb_Rx
      Rte_Spinlock_SG_POD_DCDC_01_SigGroup_oPOD_DCDC_01_oATOM_CAN_Matrix_PT_V600_20250211_c0cfae4d_Rx
      Rte_Spinlock_SG_POD_DCDC_02_SigGroup_oPOD_DCDC_02_oATOM_CAN_Matrix_PT_V600_20250211_62e3e6f8_Rx
      Rte_Spinlock_SG_POD_OBC_CHRGSTATION_SigGroup_oPOD_OBC_CHRGSTATION_oATOM_CAN_Matrix_PT_V600_20250211_4d87b474_Rx
      Rte_Spinlock_SG_POD_OBC_STATUS_02_SigGroup_oPOD_OBC_STATUS_02_oATOM_CAN_Matrix_PT_V600_20250211_49c67a09_Rx
      Rte_Spinlock_SG_POD_OBC_STATUS_03_SigGroup_oPOD_OBC_STATUS_03_oATOM_CAN_Matrix_PT_V600_20250211_d6eb071d_Rx
      Rte_Spinlock_SG_POD_OBC_STATUS_04_SigGroup_oPOD_OBC_STATUS_04_oATOM_CAN_Matrix_PT_V600_20250211_bdcb78f3_Rx
      Rte_Spinlock_SG_POD_Status_01_SigGroup_oPOD_Status_01_oATOM_CAN_Matrix_PT_V600_20250211_880c9d5a_Rx
      Rte_Spinlock_SG_POD_Status_02_SigGroup_oPOD_Status_02_oATOM_CAN_Matrix_PT_V600_20250211_b80bad50_Rx
      Rte_Spinlock_SG_PRND_SigGroup_oPRND_oATOM_CAN_Matrix_PT_V600_20250211_ddf34a23_Rx
      Rte_Spinlock_SG_SGW_01_SigGroup_oSGW_01_oATOM_CAN_Matrix_PT_V600_20250211_37bbfdeb_Rx
      Rte_Spinlock_SG_SGW_04_SigGroup_oSGW_04_oATOM_CAN_Matrix_PT_V600_20250211_6531b3f9_Rx
      Rte_Spinlock_SG_SGW_16_SigGroup_oSGW_16_oATOM_CAN_Matrix_PT_V600_20250211_194d06e6_Rx
      Rte_Spinlock_SG_SGW_17_SigGroup_oSGW_17_oATOM_CANFD_Matrix_CH_V600_202502_804294b2_Rx
      Rte_Spinlock_SG_SGW_FVSynchronization_01_SigGrou_oSGW_FVSynchronization_01_oATOM_CAN_Matrix_PT_V600_20250211_0d3cf875_Rx
      Rte_Spinlock_SG_SGW_IBS_01_SigGroup_oSGW_IBS_01_oATOM_CAN_Matrix_PT_V600_20250211_0dec95d0_Rx
      Rte_Spinlock_SG_SGW_PT_01_SigGroup_oSGW_PT_01_oATOM_CAN_Matrix_PT_V600_20250211_d1f7f071_Rx
      Rte_Spinlock_SG_SGW_Time_SigGroup_oSGW_Time_oATOM_CAN_Matrix_PT_V600_20250211_0ca37593_Rx
      Rte_Spinlock_SG_SGW_VCU_01_SigGroup_oSGW_VCU_01_oATOM_CAN_Matrix_PT_V600_20250211_899d317b_Rx
      Rte_Spinlock_SG_TCU_01_SigGroup_oTCU_01_oATOM_CAN_Matrix_PT_V600_20250211_95b4cd9c_Rx
      Rte_Spinlock_SG_TCU_02_SigGroup_oTCU_02_oATOM_CAN_Matrix_PT_V600_20250211_a432f792_Rx
      Rte_Spinlock_SG_VCU_02_SigGroup_oVCU_02_oATOM_CANFD_Matrix_CH_V600_202502_2fc20804_Tx
      Rte_Spinlock_SG_VCU_03_SigGroup_oVCU_03_oATOM_CANFD_Matrix_CH_V600_202502_8990e3c1_Tx
      Rte_Spinlock_SG_VCU_04_SigGroup_oVCU_04_oATOM_CANFD_Matrix_CH_V600_202502_4cce7c18_Tx
      Rte_Spinlock_SG_VCU_05_SigGroup_oVCU_05_oATOM_CAN_Matrix_PT_V600_20250211_d5c1ee4c_Tx
      Rte_Spinlock_SG_VCU_06_SigGroup_oVCU_06_oATOM_CAN_Matrix_PT_V600_20250211_e447d442_Tx
      Rte_Spinlock_SG_VCU_AccPedal_SigGroup_oVCU_AccPedal_oATOM_CANFD_Matrix_CH_V600_202502_aa50ac8d_Tx
      Rte_Spinlock_SG_VCU_BMS_SigGroup_oVCU_BMS_oATOM_CANFD_Matrix_CH_V600_202502_d27feb30_Tx
      Rte_Spinlock_SG_VCU_Chassis_01_SigGroup_oVCU_Chassis_01_oATOM_CANFD_Matrix_CH_V600_202502_52963860_Tx
      Rte_Spinlock_SG_VCU_DCDC_SigGroup_oVCU_DCDC_oATOM_CAN_Matrix_PT_V600_20250211_d0a22af6_Tx
      Rte_Spinlock_SG_VCU_HMIsignals_01_SigGroup_oVCU_HMIsignals_01_oATOM_CANFD_Matrix_CH_V600_202502_c30c8d8f_Tx
      Rte_Spinlock_SG_VCU_HMIsignals_02_SigGroup_oVCU_HMIsignals_02_oATOM_CANFD_Matrix_CH_V600_202502_b90a0cf2_Tx
      Rte_Spinlock_SG_VCU_HMIsignals_03_SigGroup_oVCU_HMIsignals_03_oATOM_CAN_Matrix_PT_V600_20250211_197a0877_Tx
      Rte_Spinlock_SG_VCU_IBS_01_SigGroup_oVCU_IBS_01_oATOM_CANFD_Matrix_CH_V600_202502_f0f49d09_Tx
      Rte_Spinlock_SG_VCU_MCU_02_SigGroup_oVCU_MCU_02_oATOM_CAN_Matrix_PT_V600_20250211_2d530015_Tx
      Rte_Spinlock_SG_VCU_MCU_03_SigGroup_oVCU_MCU_03_oATOM_CANFD_Matrix_CH_V600_202502_c0057d9b_Tx
      Rte_Spinlock_SG_VCU_MCU_05_SigGroup_oVCU_MCU_05_oATOM_CAN_Matrix_PT_V600_20250211_7ef1168b_Tx
      Rte_Spinlock_SG_VCU_POD_SigGroup_oVCU_POD_oATOM_CAN_Matrix_PT_V600_20250211_c17d64e5_Tx
      Rte_Spinlock_SG_VCU_PlugInChrgInfo_SigGroup_oVCU_PlugInChrgInfo_oATOM_CANFD_Matrix_CH_V600_202502_c285d340_Tx
      Rte_Spinlock_SG_VCU_SynReq_01_SigGroup_oVCU_SynReq_01_oATOM_CAN_Matrix_PT_V600_20250211_2ec232a9_Tx
      Rte_Spinlock_SG_VCU_TCU_SigGroup_oVCU_TCU_oATOM_CAN_Matrix_PT_V600_20250211_1a98021d_Tx
      Rte_Spinlock_SOCWU_Ena_oVCU_BS_01_oATOM_HWLIN1_c1ae10c8_Tx
      Rte_Spinlock_SOCWU_Treshold_oVCU_BS_01_oATOM_HWLIN1_cb8c1a90_Tx
      Rte_Spinlock_VCU_ACU_DriverWarningLampSts_oVCU_01_oATOM_HWLIN1_42c2b0b9_Tx
      Rte_Spinlock_VCU_ACU_PassengerAirbagSts_oVCU_01_oATOM_HWLIN1_a0d9a7b9_Tx
      Rte_Spinlock_VCU_ACU_PassengerWarningLampSts_oVCU_01_oATOM_HWLIN1_76395bc4_Tx
      Rte_Spinlock_VCU_ACU_WarningLampSts_oVCU_01_oATOM_HWLIN1_7751b62b_Tx
      Rte_Spinlock_VCU_BCM_FLSeatBeltRemindReq_oVCU_01_oATOM_HWLIN1_980b8460_Tx
      Rte_Spinlock_VCU_BCM_FRSeatBeltRemindReq_oVCU_01_oATOM_HWLIN1_ce21434a_Tx
      Rte_Spinlock_VCU_BCM_RLSeatBeltRemindReq_oVCU_01_oATOM_HWLIN1_bc6dc441_Tx
      Rte_Spinlock_VCU_BCM_RRSeatBeltRemindReq_oVCU_01_oATOM_HWLIN1_ea47036b_Tx
      Rte_Spinlock_VCU_CGW_VehicleState_oVCU_01_oATOM_HWLIN1_77400d2e_Tx
      Rte_Spinlock_VCU_DCDCFail_LIN_oVCU_01_oATOM_HWLIN1_0c50ae50_Tx
      Rte_Spinlock_VCU_DCM_FL_DoorFLSts_oVCU_01_oATOM_HWLIN1_c9cb9c36_Tx
      Rte_Spinlock_VCU_DCM_FR_DoorFRSts_oVCU_01_oATOM_HWLIN1_610e09cb_Tx
      Rte_Spinlock_VCU_DCM_RL_DoorRLSts_oVCU_01_oATOM_HWLIN1_4b0c11ee_Tx
      Rte_Spinlock_VCU_DCM_RR_DoorRRSts_oVCU_01_oATOM_HWLIN1_e3c98413_Tx
      Rte_Spinlock_VCU_DriveMotOvrTemp_LIN_oVCU_01_oATOM_HWLIN1_65d20ded_Tx
      Rte_Spinlock_VCU_HVBatCriFail_LIN_oVCU_01_oATOM_HWLIN1_2bf2157d_Tx
      Rte_Spinlock_VCU_HVBatOvrTemp_LIN_oVCU_01_oATOM_HWLIN1_7c76df3a_Tx
      Rte_Spinlock_VCU_IBS_BrakeFluidWarning_oVCU_01_oATOM_HWLIN1_5bfbc2fa_Tx
      Rte_Spinlock_VCU_IBS_EBDFault_oVCU_01_oATOM_HWLIN1_7e339715_Tx
      Rte_Spinlock_VCU_IBS_RollerbenchMode_oVCU_01_oATOM_HWLIN1_91a58216_Tx
      Rte_Spinlock_VCU_IBS_SystemStatus_oVCU_01_oATOM_HWLIN1_7138be07_Tx
      Rte_Spinlock_VCU_IVI_BulbCheckSts_oVCU_01_oATOM_HWLIN1_d842011f_Tx
      Rte_Spinlock_VCU_IVI_VrState_oVCU_01_oATOM_HWLIN1_eab73730_Tx
    10 x OsAlarm, all with OsAlarmAccessingApplication=SystemApplication_OsCore0, OsAlarmAccessingApplication=SystemApplication_OsCore1, OsAlarmAccessingApplication=SystemApplication_OsCore2:
      Rte_Al_TE_Core2App_SWC_Core2App_SWC_Runnable_10ms: OsAlarmCounterRef=SystemTimer_Core2
        OsAlarmAction
          OsAlarmActivateTask: OsAlarmActivateTaskRef=Core2_Asw_Task
      Rte_Al_TE_Core1_Asw_Task_Qm_0_100ms: OsAlarmCounterRef=SystemTimer_Core1
        OsAlarmAction
          OsAlarmSetEvent: OsAlarmSetEventRef=Rte_Ev_Cyclic_Core1_Asw_Task_Qm_0_100ms, OsAlarmSetEventTaskRef=Os/Core1_Asw_Task_Qm
      Rte_Al_TE_Core1_Asw_Task_Qm_0_10ms: OsAlarmCounterRef=SystemTimer_Core1
        OsAlarmAction
          OsAlarmSetEvent: OsAlarmSetEventRef=Rte_Ev_Cyclic_Core1_Asw_Task_Qm_0_10ms, OsAlarmSetEventTaskRef=Os/Core1_Asw_Task_Qm
      Rte_Al_TE_Core1_Asw_Task_Qm_0_200ms: OsAlarmCounterRef=SystemTimer_Core1
        OsAlarmAction
          OsAlarmSetEvent: OsAlarmSetEventRef=Rte_Ev_Cyclic_Core1_Asw_Task_Qm_0_200ms, OsAlarmSetEventTaskRef=Os/Core1_Asw_Task_Qm
      Rte_Al_TE_Core1_Asw_Task_Qm_0_20ms: OsAlarmCounterRef=SystemTimer_Core1
        OsAlarmAction
          OsAlarmSetEvent: OsAlarmSetEventRef=Rte_Ev_Cyclic_Core1_Asw_Task_Qm_0_20ms, OsAlarmSetEventTaskRef=Os/Core1_Asw_Task_Qm
      Rte_Al_TE_Core1_Asw_Task_Qm_0_50ms: OsAlarmCounterRef=SystemTimer_Core1
        OsAlarmAction
          OsAlarmSetEvent: OsAlarmSetEventRef=Rte_Ev_Cyclic_Core1_Asw_Task_Qm_0_50ms, OsAlarmSetEventTaskRef=Os/Core1_Asw_Task_Qm
      Rte_Al_TE_Core1_Bsw_Task_0_100ms: OsAlarmCounterRef=SystemTimer_Core1
        OsAlarmAction
          OsAlarmSetEvent: OsAlarmSetEventRef=Rte_Ev_Cyclic_Core1_Bsw_Task_0_100ms, OsAlarmSetEventTaskRef=Os/Core1_Bsw_Task
      Rte_Al_TE_Core1_Bsw_Task_0_10ms: OsAlarmCounterRef=SystemTimer_Core1
        OsAlarmAction
          OsAlarmSetEvent: OsAlarmSetEventRef=Rte_Ev_Cyclic_Core1_Bsw_Task_0_10ms, OsAlarmSetEventTaskRef=Os/Core1_Bsw_Task
      Rte_Al_TE_Core1_Bsw_Task_0_20ms: OsAlarmCounterRef=SystemTimer_Core1
        OsAlarmAction
          OsAlarmSetEvent: OsAlarmSetEventRef=Rte_Ev_Cyclic_Core1_Bsw_Task_0_20ms, OsAlarmSetEventTaskRef=Os/Core1_Bsw_Task
      Rte_Al_TE_Core1_Bsw_Task_0_50ms: OsAlarmCounterRef=SystemTimer_Core1
        OsAlarmAction
          OsAlarmSetEvent: OsAlarmSetEventRef=Rte_Ev_Cyclic_Core1_Bsw_Task_0_50ms, OsAlarmSetEventTaskRef=Os/Core1_Bsw_Task
    10 x OsEvent:
      Rte_Ev_Cyclic_Core1_Asw_Task_Qm_0_100ms
      Rte_Ev_Cyclic_Core1_Asw_Task_Qm_0_10ms
      Rte_Ev_Cyclic_Core1_Asw_Task_Qm_0_200ms
      Rte_Ev_Cyclic_Core1_Asw_Task_Qm_0_20ms
      Rte_Ev_Cyclic_Core1_Asw_Task_Qm_0_50ms
      Rte_Ev_Cyclic_Core1_Bsw_Task_0_100ms
      Rte_Ev_Cyclic_Core1_Bsw_Task_0_10ms
      Rte_Ev_Cyclic_Core1_Bsw_Task_0_20ms
      Rte_Ev_Cyclic_Core1_Bsw_Task_0_50ms
      Rte_Ev_RunS2_EcuM_EcuM_MainFunction
    Core0_CddTask (OsTask):
      OsTaskActivation = 1
      OsTaskPriority = 60
      OsTaskSchedule = FULL
      OsTaskStackSharing = false
      OsTaskStackSize = 1024
      OsTaskType = AUTO
      OsTaskUsesFpu = false
      OsTaskAccessingApplication = SystemApplication_OsCore{0..2}
      OsTaskEventRef = Rte_Ev_Run_IoHwAb_IoHwAb_IoHwAbRunnable_10ms
      OsTaskEventRef = Rte_Ev_Run_IoHwAb_SWC_IoHwAb_SWC_Runnable_50ms
    Rte_Al_TE_IoHwAb_SWC_IoHwAb_SWC_Runnable_50ms (OsAlarm):
      OsAlarmCounterRef = SystemTimer_Core0
      OsAlarmAccessingApplication = SystemApplication_OsCore{0..2}
      OsAlarmAction
        OsAlarmSetEvent: OsAlarmSetEventRef=Rte_Ev_Run_IoHwAb_SWC_IoHwAb_SWC_Runnable_50ms, OsAlarmSetEventTaskRef=Os/Core0_CddTask
    Rte_Ev_Run_IoHwAb_IoHwAb_IoHwAbRunnable_10ms (OsEvent)
    Rte_Ev_Run_IoHwAb_SWC_IoHwAb_SWC_Runnable_50ms (OsEvent)
    GTMTOM0SR2_ISR (OsIsr):
      OsIsrInterruptPriority = 120
      OsIsrCategory = CATEGORY_2
      OsIsrInterruptType = EXTERNAL
      OsIsrInterruptSource = 3608
      OsIsrStackSize = 1024
      OsIsrEnableNesting = false
      OsIsrUsesFpu = false
      OsIsrInitialEnableInterruptSource = true
