AUTOSAR XML (schema 00048)
package /ActiveEcuC
  module config Os: implementation-config-variant=VARIANT-PRE-COMPILE, module-description=Os_Impl
    SystemTimer_Core0 (OsCounter):
      OsCounterMaxAllowedValue = 2147483647
      OsCounterMinCycle = 1
      OsCounterType = HARDWARE
      OsSecondsPerTick = 0.001
      OsCounterTicksPerBase = 100000
      OsCounterAccessingApplication = SystemApplication_OsCore{0..2}
      OsDriver: OsDriverHighResolution=false, OsDriverHardwareTimerChannelRef=STM0_Ch0, OsDriverIsrRef=CounterIsr_SystemTimer0
    OsMemoryProtection
    OsOS:
      OsStackMonitoring = true
      OsStatus = EXTENDED
      OsUseGetServiceId = false
      OsUseParameterAccess = false
      OsUseResScheduler = false
      OsForcibleTermination = false
      OsGenerateCalloutStubs = true
      OsGenerateMemMap = COMPLETE
      OsGenerateMemMapForNearAddressing = true
      OsGenerateMemMapForThreads = false
      OsServiceProtection = false
      OsStackUsageMeasurement = false
      OsUseXSignalAsyncApiCalls = false
      OsFpuUsage = NONE
      OsUseCase = STANDARD
      OsScalabilityClass = SC1
      OsNumberOfCores = 3
      OsMasterCore = OsCore0
      OsSystemTimer = SystemTimer_Core0
      OsHooks: OsErrorHook=true, OsPostTaskHook=false, OsPreTaskHook=false, OsShutdownHook=true, OsStartupHook=false
      OsStackSummary
        33 x OsStack, all with OsStackSize=1024:
          OsCore0_Kernel: OsStackType=CORE_KERNEL_STACK, OsStackCore=OsCore0, OsStackUser=OsCore0
          OsCore0_Init: OsStackType=CORE_INIT_STACK, OsStackCore=OsCore0, OsStackUser=OsCore0
          OsCore0_Error: OsStackType=CORE_ERROR_STACK, OsStackCore=OsCore0, OsStackUser=OsCore0
          OsCore0_Task_Prio4294967295: OsStackType=TASK_SHARED_PRIORITY_STACK, OsStackCore=OsCore0, OsStackUser=IdleTask_OsCore0
          OsCore0_Isr_Core: OsStackType=ISR_SHARED_CORE_STACK, OsStackCore=OsCore0, OsStackUser=CounterIsr_SystemTimer0, OsStackUser=CanIsr_0, OsStackUser=CanIsr_1, OsStackUser=ADC0SR0_ISR, OsStackUser=ADC1SR0_ISR, OsStackUser=ADC2SR0_ISR, OsStackUser=ADC3SR0_ISR, OsStackUser=ADC11SR0_ISR, OsStackUser=ASCLIN2ERR_ISR, OsStackUser=ASCLIN2RX_ISR, OsStackUser=ASCLIN2TX_ISR, OsStackUser=ASCLIN1TX_ISR, OsStackUser=ASCLIN1RX_ISR, OsStackUser=ASCLIN1ERR_ISR, OsStackUser=DMACH10SR_ISR, OsStackUser=DMACH11SR_ISR, OsStackUser=QSPI3ERR_ISR, OsStackUser=QSPI3PT_ISR, OsStackUser=CanIsr_4, OsStackUser=ADC8SR0_ISR, OsStackUser=GTMTOM1SR3_ISR, OsStackUser=GTMTOM1SR4_ISR, OsStackUser=XSignalIsr_OsCore0, OsStackUser=CanIsr_3, OsStackUser=EthIsr_EthCtrlConfig_ETHSR2_ISR, OsStackUser=EthIsr_EthCtrlConfig_ETHSR6_ISR
          OsCore0_Task_Prio49: OsStackType=TASK_SHARED_PRIORITY_STACK, OsStackCore=OsCore0, OsStackUser=Default_Init_Task_Trusted
          OsCore0_Task_Prio50: OsStackType=TASK_SHARED_PRIORITY_STACK, OsStackCore=OsCore0, OsStackUser=Default_Init_Task
          OsCore0_Shutdown: OsStackType=CORE_SHUTDOWN_STACK, OsStackCore=OsCore0, OsStackUser=OsCore0
          OsCore1_Kernel: OsStackType=CORE_KERNEL_STACK, OsStackCore=OsCore1, OsStackUser=OsCore1
          OsCore1_Init: OsStackType=CORE_INIT_STACK, OsStackCore=OsCore1, OsStackUser=OsCore1
          OsCore1_Error: OsStackType=CORE_ERROR_STACK, OsStackCore=OsCore1, OsStackUser=OsCore1
          OsCore1_Shutdown: OsStackType=CORE_SHUTDOWN_STACK, OsStackCore=OsCore1, OsStackUser=OsCore1
          OsCore1_Task_Prio4294967295: OsStackType=TASK_SHARED_PRIORITY_STACK, OsStackCore=OsCore1, OsStackUser=IdleTask_OsCore1
          OsCore2_Kernel: OsStackType=CORE_KERNEL_STACK, OsStackCore=OsCore2, OsStackUser=OsCore2
          OsCore2_Init: OsStackType=CORE_INIT_STACK, OsStackCore=OsCore2, OsStackUser=OsCore2
          OsCore2_Error: OsStackType=CORE_ERROR_STACK, OsStackCore=OsCore2, OsStackUser=OsCore2
          OsCore2_Shutdown: OsStackType=CORE_SHUTDOWN_STACK, OsStackCore=OsCore2, OsStackUser=OsCore2
          OsCore2_Task_Prio4294967295: OsStackType=TASK_SHARED_PRIORITY_STACK, OsStackCore=OsCore2, OsStackUser=IdleTask_OsCore2
          OsCore1_Task_Prio50: OsStackType=TASK_SHARED_PRIORITY_STACK, OsStackCore=OsCore1, OsStackUser=Default_Init_Task_Core1
          OsCore2_Task_Prio50: OsStackType=TASK_SHARED_PRIORITY_STACK, OsStackCore=OsCore2, OsStackUser=Default_Init_Task_Core2
          OsCore2_Task_Prio49: OsStackType=TASK_SHARED_PRIORITY_STACK, OsStackCore=OsCore2, OsStackUser=Default_Init_Task_Core2_Trusted
          OsCore1_Task_Prio49: OsStackType=TASK_SHARED_PRIORITY_STACK, OsStackCore=OsCore1, OsStackUser=Default_Init_Task_Core1_Trusted
          OsCore1_Isr_Core: OsStackType=ISR_SHARED_CORE_STACK, OsStackCore=OsCore1, OsStackUser=CounterIsr_SystemTimer1, OsStackUser=XSignalIsr_OsCore1
          OsCore2_Isr_Core: OsStackType=ISR_SHARED_CORE_STACK, OsStackCore=OsCore2, OsStackUser=CounterIsr_SystemTimer2, OsStackUser=XSignalIsr_OsCore2
          OsCore1_Task_Prio51: OsStackType=TASK_SHARED_PRIORITY_STACK, OsStackCore=OsCore1, OsStackUser=Core1_BswTask
          OsCore1_Task_Prio52: OsStackType=TASK_SHARED_PRIORITY_STACK, OsStackCore=OsCore1, OsStackUser=Core1_AswTask
          OsCore1_Task_Prio53: OsStackType=TASK_SHARED_PRIORITY_STACK, OsStackCore=OsCore1, OsStackUser=Core1_AswInit
          OsCore2_Task_Prio51: OsStackType=TASK_SHARED_PRIORITY_STACK, OsStackCore=OsCore2, OsStackUser=Core2_BswTask
          OsCore2_Task_Prio52: OsStackType=TASK_SHARED_PRIORITY_STACK, OsStackCore=OsCore2, OsStackUser=Core2_AswTask
          OsCore2_Task_Prio53: OsStackType=TASK_SHARED_PRIORITY_STACK, OsStackCore=OsCore2, OsStackUser=Core2_AswInit
          OsCore0_Task_Prio0: OsStackType=TASK_SHARED_PRIORITY_STACK, OsStackCore=OsCore0, OsStackUser=Core0_AswInit
          Core0_AswTask: OsStackType=TASK_EXTENDED_STACK, OsStackCore=OsCore0, OsStackUser=Os/Core0_AswTask
          Core0_BswTask: OsStackType=TASK_EXTENDED_STACK, OsStackCore=OsCore0, OsStackUser=Os/Core0_BswTask
    OsPublishedInformation: OsKernelVersion=7, OsPlatformName=TriCoreAurix
      TC37x (OsDerivativeInformation):
        OsMpuAlignment = 8
        OsMpuMemoryGapSize = 16
        OsMpuEndAddressAccessible = false
        OsStackAlignment = 8
        OsExceptionVectorTableAlignment = 256
        OsInterruptVectorTableAlignment = 8192
        OsHardwareManuals = User Manual: TC37X_um_appx_V1.0.0.pdf 2018.08 TC37X_ts_appx_V2.5.1.pdf 2018.04
        OsMpuPrivilegedRegionsConfigurable = false
        3 x OsPhysicalCore, all with OsPhysicalCoreType=TC1.6.2P, OsPhysicalCoreExceptionSources=8, OsPhysicalCorePrivelegedHwAccess=true:
          Core0: OsPhysicalCoreId=0, OsPhysicalCoreDefaultEntrySymbol=_start_tc0, OsPhysicalCoreMasterStartAllowed=true, OsPhysicalCoreIsAutostart=true, OsPhysicalCoreStackProtectionUnit=OsPhysicalCore0DataMpu
            OsPhysicalCore0DataMpu (OsPhysicalCoreMpu): OsPhysicalCoreMpuId=0, OsPhysicalCoreMpuMaxRegions=18, OsPhysicalCoreMpuType=DATA
            OsPhysicalCore0CodeMpu (OsPhysicalCoreMpu): OsPhysicalCoreMpuId=1, OsPhysicalCoreMpuMaxRegions=10, OsPhysicalCoreMpuType=CODE
          Core1: OsPhysicalCoreId=1, OsPhysicalCoreDefaultEntrySymbol=_start_tc1, OsPhysicalCoreMasterStartAllowed=false, OsPhysicalCoreIsAutostart=false, OsPhysicalCoreStackProtectionUnit=OsPhysicalCore1DataMpu
            OsPhysicalCore1DataMpu (OsPhysicalCoreMpu): OsPhysicalCoreMpuId=0, OsPhysicalCoreMpuMaxRegions=18, OsPhysicalCoreMpuType=DATA
            OsPhysicalCore1CodeMpu (OsPhysicalCoreMpu): OsPhysicalCoreMpuId=1, OsPhysicalCoreMpuMaxRegions=10, OsPhysicalCoreMpuType=CODE
          Core2: OsPhysicalCoreId=2, OsPhysicalCoreDefaultEntrySymbol=_start_tc2, OsPhysicalCoreMasterStartAllowed=false, OsPhysicalCoreIsAutostart=false, OsPhysicalCoreStackProtectionUnit=OsPhysicalCore2DataMpu
            OsPhysicalCore2DataMpu (OsPhysicalCoreMpu): OsPhysicalCoreMpuId=0, OsPhysicalCoreMpuMaxRegions=18, OsPhysicalCoreMpuType=DATA
            OsPhysicalCore2CodeMpu (OsPhysicalCoreMpu): OsPhysicalCoreMpuId=1, OsPhysicalCoreMpuMaxRegions=10, OsPhysicalCoreMpuType=CODE
        3 x OsHardwareTimer, all with OsHardwareTimerSize=32, OsHardwareTimerUnit=FRT, OsHardwareTimerType=STM:
          STM0: OsHardwareTimerBaseAddress=4026535936, OsHardwareTimerId=0
            STM0_Ch0 (OsHardwareTimerChannel): OsHardwareTimerChannelIntSource=768, OsHardwareTimerChannelOffset=0, OsHardwareTimerChannelId=0
            STM0_Ch1 (OsHardwareTimerChannel): OsHardwareTimerChannelIntSource=772, OsHardwareTimerChannelOffset=1, OsHardwareTimerChannelId=1
          STM1: OsHardwareTimerBaseAddress=4026536192, OsHardwareTimerId=1
            STM1_Ch0 (OsHardwareTimerChannel): OsHardwareTimerChannelIntSource=776, OsHardwareTimerChannelOffset=0, OsHardwareTimerChannelId=0
            STM1_Ch1 (OsHardwareTimerChannel): OsHardwareTimerChannelIntSource=780, OsHardwareTimerChannelOffset=1, OsHardwareTimerChannelId=1
          STM2: OsHardwareTimerBaseAddress=4026536448, OsHardwareTimerId=2
            STM2_Ch0 (OsHardwareTimerChannel): OsHardwareTimerChannelIntSource=784, OsHardwareTimerChannelOffset=0, OsHardwareTimerChannelId=0
            STM2_Ch1 (OsHardwareTimerChannel): OsHardwareTimerChannelIntSource=788, OsHardwareTimerChannelOffset=1, OsHardwareTimerChannelId=1
        AURIXTC3XX_IR (OsSystemIntCtrl): OsSystemIntCtrlMaxPrios=255, OsSystemIntCtrlPrioOrder=ASC, OsSystemIntCtrlMaxSources=8192, OsSystemIntCtrlBaseAddress=4026757120
        GPT (OsHardwareTimer): OsHardwareTimerSize=16, OsHardwareTimerUnit=PIT, OsHardwareTimerBaseAddress=4026537984, OsHardwareTimerId=0, OsHardwareTimerType=PIT
          GPT_Ch0 (OsHardwareTimerChannel): OsHardwareTimerChannelIntSource=744, OsHardwareTimerChannelOffset=0, OsHardwareTimerChannelId=0
          GPT_Ch1 (OsHardwareTimerChannel): OsHardwareTimerChannelIntSource=756, OsHardwareTimerChannelOffset=1, OsHardwareTimerChannelId=1
        OsMemoryRegionSpecifics
          18 x OsMemoryRegionAccess:
            PS0_R: OsMemoryRegionAccessRights=R, OsMemoryRegionAccessType=PROTECTION_SET0
            PS0_W: OsMemoryRegionAccessRights=W, OsMemoryRegionAccessType=PROTECTION_SET0
            PS0_X: OsMemoryRegionAccessRights=X, OsMemoryRegionAccessType=PROTECTION_SET0
            PS1_R: OsMemoryRegionAccessRights=R, OsMemoryRegionAccessType=PROTECTION_SET1
            PS1_W: OsMemoryRegionAccessRights=W, OsMemoryRegionAccessType=PROTECTION_SET1
            PS1_X: OsMemoryRegionAccessRights=X, OsMemoryRegionAccessType=PROTECTION_SET1
            PS2_R: OsMemoryRegionAccessRights=R, OsMemoryRegionAccessType=PROTECTION_SET2
            PS2_W: OsMemoryRegionAccessRights=W, OsMemoryRegionAccessType=PROTECTION_SET2
            PS2_X: OsMemoryRegionAccessRights=X, OsMemoryRegionAccessType=PROTECTION_SET2
            PS3_R: OsMemoryRegionAccessRights=R, OsMemoryRegionAccessType=PROTECTION_SET3
            PS3_W: OsMemoryRegionAccessRights=W, OsMemoryRegionAccessType=PROTECTION_SET3
            PS3_X: OsMemoryRegionAccessRights=X, OsMemoryRegionAccessType=PROTECTION_SET3
            PS4_R: OsMemoryRegionAccessRights=R, OsMemoryRegionAccessType=PROTECTION_SET4
            PS4_W: OsMemoryRegionAccessRights=W, OsMemoryRegionAccessType=PROTECTION_SET4
            PS4_X: OsMemoryRegionAccessRights=X, OsMemoryRegionAccessType=PROTECTION_SET4
            PS5_R: OsMemoryRegionAccessRights=R, OsMemoryRegionAccessType=PROTECTION_SET5
            PS5_W: OsMemoryRegionAccessRights=W, OsMemoryRegionAccessType=PROTECTION_SET5
            PS5_X: OsMemoryRegionAccessRights=X, OsMemoryRegionAccessType=PROTECTION_SET5
        DMA (OsInterruptSupportedType):
          OsInterruptSupportedTypeSeparateSources = false
          OsInterruptSupportedTypeSeparatePriority = true
          OsInterruptSupportedTypeIsMapped = false
          OsInterruptSupportedTypePostActionRequired = false
    OSDEFAULTAPPMODE (OsAppMode)
    OS_APPMODE_ANY (OsAppMode)
    OsCore0 (OsCore):
      OsCoreIsAutostart = true
      OsCoreIsAutosar = true
      OsCoreEntrySymbol = _start_tc0
      OsCorePhysicalCoreRef = Core0
      OsCoreEcucCoreRef = EcucCore0
      OsCoreIdleTask = IdleTask_OsCore0
      OsCoreSystemApplication = SystemApplication_OsCore0
      OsCoreStacks:
        OsCoreKernelStackSize = 1024
        OsCoreStartupStackSize = 1024
        OsCoreShutdownStackSize = 1024
        OsCoreErrorStackSize = 1024
        OsCoreProtectionStackSize = 1024
        OsCoreInitStackSize = 1024
      XSignalChl_OsCore2 (OsCoreXSignalChannel): OsCoreXSignalChannelSize=1, OsCoreXSignalChannelReceiverIsr=XSignalIsr_OsCore2
      XSignalChl_OsCore1 (OsCoreXSignalChannel): OsCoreXSignalChannelSize=1, OsCoreXSignalChannelReceiverIsr=XSignalIsr_OsCore1
    IdleTask_OsCore0 (OsTask):
      OsTaskActivation = 1
      OsTaskPriority = 4294967295
      OsTaskSchedule = FULL
      OsTaskStackSharing = false
      OsTaskStackSize = 1024
      OsTaskType = AUTO
      OsTaskUsesFpu = false
      OsTaskAccessingApplication = SystemApplication_OsCore{0..2}
      OsTaskAutostart: OsTaskAppModeRef=OS_APPMODE_ANY
    SystemApplication_OsCore0 (OsApplication):
      OsTrusted = true
      OsTrustedApplicationDelayTimingViolationCall = false
      OsTrustedApplicationWithProtection = false
      OsApplicationIsPrivileged = true
      OsAppUseTrustedFunctionStubs = false
      OsApplicationCoreRef = EcucCore0
      OsAppTaskRef = IdleTask_OsCore0
      OsAppCounterRef = SystemTimer_Core0
      OsAppIsrRef = CounterIsr_SystemTimer0
      OsAppTaskRef = Default_Init_Task
      OsAppTaskRef = Default_Init_Task_Trusted
      OsAppEcucPartitionRef = EcucPartition_OsCore0_Swc
      OsAppTaskRef = Os/Core0_BswTask
      OsAppAlarmRef = Rte_Al_TE2_Core0_BswTask_0_10ms
      OsAppIsrRef = XSignalIsr_OsCore0
      OsAppIsrRef = ADC{0..3}SR0_ISR
      OsAppIsrRef = ADC8SR0_ISR
      OsAppIsrRef = ADC11SR0_ISR
      OsAppIsrRef = ASCLIN1ERR_ISR
      OsAppIsrRef = ASCLIN1RX_ISR
      OsAppIsrRef = ASCLIN1TX_ISR
      OsAppIsrRef = ASCLIN2ERR_ISR
      OsAppIsrRef = ASCLIN2RX_ISR
      OsAppIsrRef = ASCLIN2TX_ISR
      OsAppIsrRef = CanIsr_0
      OsAppIsrRef = CanIsr_1
      OsAppIsrRef = CanIsr_3
      OsAppIsrRef = CanIsr_4
      OsAppIsrRef = DMACH10SR_ISR
      OsAppIsrRef = DMACH11SR_ISR
      OsAppIsrRef = GTMTOM1SR3_ISR
      OsAppIsrRef = GTMTOM1SR4_ISR
      OsAppIsrRef = QSPI3ERR_ISR
      OsAppIsrRef = QSPI3PT_ISR
      OsAppTaskRef = Os/Core0_AswTask
      OsAppTaskRef = Core0_AswInit
      OsAppAlarmRef = Rte_Al_TE_Com_SWC_Com_Runnable_2ms
      OsAppAlarmRef = Rte_Al_TE_PowerMng_SWC_Led_Runnable1000ms
      OsAppAlarmRef = Rte_Al_TE_Core0_AswTask_0_10ms
      OsAppAlarmRef = Rte_Al_TE2_Core0_BswTask_0_20ms
      OsAppAlarmRef = Rte_Al_TE2_Core0_BswTask_0_5ms
      OsAppAlarmRef = Rte_Al_TE_Com_SWC_Com_Runnable_20ms
      OsAppIsrRef = EthIsr_EthCtrlConfig_ETHSR2_ISR
      OsAppIsrRef = EthIsr_EthCtrlConfig_ETHSR6_ISR
      OsAppAlarmRef = Rte_Al_TE_EthIf_EthIf_MainFunctionState
      OsApplicationHooks: OsAppErrorHook=false, OsAppShutdownHook=false, OsAppStartupHook=false
    CounterIsr_SystemTimer0 (OsIsr):
      OsIsrInterruptPriority = 1
      OsIsrCategory = CATEGORY_2
      OsIsrInterruptType = EXTERNAL
      OsIsrInterruptSource = 768
      OsIsrStackSize = 1024
      OsIsrEnableNesting = false
      OsIsrUsesFpu = false
      OsIsrInitialEnableInterruptSource = false
      OsIsrSpecialFunctionName = Os_TimerPfrtIsr
    Default_Init_Task (OsTask):
      OsTaskActivation = 1
      OsTaskPriority = 50
      OsTaskSchedule = FULL
      OsTaskStackSharing = false
      OsTaskStackSize = 1024
      OsTaskType = BASIC
      OsTaskUsesFpu = false
      OsTaskAccessingApplication = SystemApplication_OsCore{0..2}
      OsTaskAutostart: OsTaskAppModeRef=OSDEFAULTAPPMODE
    Default_Init_Task_Trusted (OsTask):
      OsTaskActivation = 1
      OsTaskPriority = 49
      OsTaskSchedule = FULL
      OsTaskStackSharing = false
      OsTaskStackSize = 1024
      OsTaskType = BASIC
      OsTaskUsesFpu = false
      OsTaskAccessingApplication = SystemApplication_OsCore{0..2}
      OsTaskAutostart: OsTaskAppModeRef=OSDEFAULTAPPMODE
    OsResource0 (OsResource): OsResourceProperty=STANDARD, OsResourceAccessingApplication=SystemApplication_OsCore0
    CanIsr_0 (OsIsr):  # /ActiveEcuC/Can PLAIN_TEXT Can messages event (for a specific controllers)
      OsIsrInterruptPriority = 30
      OsIsrCategory = CATEGORY_2
      OsIsrInterruptType = EXTERNAL
      OsIsrInterruptSource = 1456
      OsIsrStackSize = 1024
      OsIsrEnableNesting = false
      OsIsrUsesFpu = false
      OsIsrInitialEnableInterruptSource = true
    Rte_Al_TE_PowerMng_SWC_Led_Runnable1000ms (OsAlarm):
      OsAlarmCounterRef = SystemTimer_Core0
      OsAlarmAccessingApplication = SystemApplication_OsCore{0..2}
      OsAlarmAction
        OsAlarmSetEvent: OsAlarmSetEventRef=Rte_Ev_Run_PowerMng_SWC_Led_Runnable1000ms, OsAlarmSetEventTaskRef=Os/Core0_AswTask
    Rte_Ev_Run_PowerMng_SWC_Led_Runnable1000ms (OsEvent)
    Rte_Al_TE_Com_SWC_Com_Runnable_2ms (OsAlarm):
      OsAlarmCounterRef = SystemTimer_Core0
      OsAlarmAccessingApplication = SystemApplication_OsCore{0..2}
      OsAlarmAction
        OsAlarmSetEvent: OsAlarmSetEventRef=Rte_Ev_Run_Com_SWC_Com_Runnable_2ms, OsAlarmSetEventTaskRef=Os/Core0_AswTask
    5 x OsEvent:
      Rte_Ev_Run_Com_SWC_Com_Runnable_2ms
      Rte_Ev_Run_Com_SWC_Rte_Msg200h_Rx_Notification
      Rte_Ev_Run_Com_SWC_Rte_Msg201h_Rx_Notification
      Rte_Ev_Run_NvM_SWC_NvM_SWC_UserData1_Runnable
      Rte_Ev_Run_NvM_SWC_NvM_SWC_UserData2_Runnable
    20 x OsIsr, all with OsIsrCategory=CATEGORY_2, OsIsrInterruptType=EXTERNAL, OsIsrStackSize=1024, OsIsrEnableNesting=false, OsIsrUsesFpu=false, OsIsrInitialEnableInterruptSource=true:
      CanIsr_1: OsIsrInterruptPriority=31, OsIsrInterruptSource=1460  # /ActiveEcuC/Can PLAIN_TEXT Can messages event (for a specific controllers)
      ADC1SR0_ISR: OsIsrInterruptPriority=41, OsIsrInterruptSource=1664
      ADC0SR0_ISR: OsIsrInterruptPriority=40, OsIsrInterruptSource=1648
      ADC2SR0_ISR: OsIsrInterruptPriority=42, OsIsrInterruptSource=1680
      ADC3SR0_ISR: OsIsrInterruptPriority=43, OsIsrInterruptSource=1696
      ADC11SR0_ISR: OsIsrInterruptPriority=44, OsIsrInterruptSource=1824
      ASCLIN2ERR_ISR: OsIsrInterruptPriority=52, OsIsrInterruptSource=112
      ASCLIN2RX_ISR: OsIsrInterruptPriority=51, OsIsrInterruptSource=108
      ASCLIN2TX_ISR: OsIsrInterruptPriority=50, OsIsrInterruptSource=104
      ASCLIN1ERR_ISR: OsIsrInterruptPriority=55, OsIsrInterruptSource=100
      ASCLIN1RX_ISR: OsIsrInterruptPriority=54, OsIsrInterruptSource=96
      ASCLIN1TX_ISR: OsIsrInterruptPriority=53, OsIsrInterruptSource=92
      DMACH10SR_ISR: OsIsrInterruptPriority=114, OsIsrInterruptSource=920
      DMACH11SR_ISR: OsIsrInterruptPriority=115, OsIsrInterruptSource=924
      QSPI3ERR_ISR: OsIsrInterruptPriority=102, OsIsrInterruptSource=308
      QSPI3PT_ISR: OsIsrInterruptPriority=103, OsIsrInterruptSource=312
      CanIsr_4: OsIsrInterruptPriority=32, OsIsrInterruptSource=1520  # /ActiveEcuC/Can PLAIN_TEXT Can messages event (for a specific controllers)
      ADC8SR0_ISR: OsIsrInterruptPriority=45, OsIsrInterruptSource=1776
      GTMTOM1SR3_ISR: OsIsrInterruptPriority=121, OsIsrInterruptSource=3644
      GTMTOM1SR4_ISR: OsIsrInterruptPriority=122, OsIsrInterruptSource=3648
    OsCore1 (OsCore):
      OsCoreIsAutostart = false
      OsCoreIsAutosar = true
      OsCoreEntrySymbol = _start_tc1
      OsCorePhysicalCoreRef = Core1
      OsCoreEcucCoreRef = EcucCore1
      OsCoreIdleTask = IdleTask_OsCore1
      OsCoreSystemApplication = SystemApplication_OsCore1
      OsCoreStacks:
        OsCoreKernelStackSize = 1024
        OsCoreStartupStackSize = 1024
        OsCoreShutdownStackSize = 1024
        OsCoreErrorStackSize = 1024
        OsCoreProtectionStackSize = 1024
        OsCoreInitStackSize = 1024
      XSignalChl_OsCore2 (OsCoreXSignalChannel): OsCoreXSignalChannelSize=1, OsCoreXSignalChannelReceiverIsr=XSignalIsr_OsCore2
      XSignalChl_OsCore0 (OsCoreXSignalChannel): OsCoreXSignalChannelSize=1, OsCoreXSignalChannelReceiverIsr=XSignalIsr_OsCore0
    OsCore2 (OsCore):
      OsCoreIsAutostart = false
      OsCoreIsAutosar = true
      OsCoreEntrySymbol = _start_tc2
      OsCorePhysicalCoreRef = Core2
      OsCoreEcucCoreRef = EcucCore2
      OsCoreIdleTask = IdleTask_OsCore2
      OsCoreSystemApplication = SystemApplication_OsCore2
      OsCoreStacks:
        OsCoreKernelStackSize = 1024
        OsCoreStartupStackSize = 1024
        OsCoreShutdownStackSize = 1024
        OsCoreErrorStackSize = 1024
        OsCoreProtectionStackSize = 1024
        OsCoreInitStackSize = 1024
      XSignalChl_OsCore0 (OsCoreXSignalChannel): OsCoreXSignalChannelSize=1, OsCoreXSignalChannelReceiverIsr=XSignalIsr_OsCore0
      XSignalChl_OsCore1 (OsCoreXSignalChannel): OsCoreXSignalChannelSize=1, OsCoreXSignalChannelReceiverIsr=XSignalIsr_OsCore1
    IdleTask_OsCore1 (OsTask):
      OsTaskActivation = 1
      OsTaskPriority = 4294967295
      OsTaskSchedule = FULL
      OsTaskStackSharing = false
      OsTaskStackSize = 1024
      OsTaskType = AUTO
      OsTaskUsesFpu = false
      OsTaskAccessingApplication = SystemApplication_OsCore{0..2}
      OsTaskAutostart: OsTaskAppModeRef=OS_APPMODE_ANY
    SystemApplication_OsCore1 (OsApplication):
      OsTrusted = true
      OsTrustedApplicationDelayTimingViolationCall = false
      OsTrustedApplicationWithProtection = false
      OsApplicationIsPrivileged = true
      OsAppUseTrustedFunctionStubs = false
      OsApplicationCoreRef = EcucCore1
      OsAppTaskRef = IdleTask_OsCore1
      OsAppTaskRef = Default_Init_Task_Core1
      OsAppTaskRef = Default_Init_Task_Core1_Trusted
      OsAppIsrRef = CounterIsr_SystemTimer1
      OsAppCounterRef = SystemTimer_Core1
      OsAppTaskRef = Core1_BswTask
      OsAppTaskRef = Core1_AswTask
      OsAppTaskRef = Core1_AswInit
      OsAppEcucPartitionRef = EcucPartition_OsCore1_Swc
      OsAppAlarmRef = Rte_Al_TE_Core1App_SWC_Core1App_Runnable100ms
      OsAppAlarmRef = Rte_Al_TE2_EcuM_EcuM_MainFunction
      OsAppIsrRef = XSignalIsr_OsCore1
      OsApplicationHooks: OsAppErrorHook=false, OsAppShutdownHook=false, OsAppStartupHook=false
    IdleTask_OsCore2 (OsTask):
      OsTaskActivation = 1
      OsTaskPriority = 4294967295
      OsTaskSchedule = FULL
      OsTaskStackSharing = false
      OsTaskStackSize = 1024
      OsTaskType = AUTO
      OsTaskUsesFpu = false
      OsTaskAccessingApplication = SystemApplication_OsCore{0..2}
      OsTaskAutostart: OsTaskAppModeRef=OS_APPMODE_ANY
    SystemApplication_OsCore2 (OsApplication):
      OsTrusted = true
      OsTrustedApplicationDelayTimingViolationCall = false
      OsTrustedApplicationWithProtection = false
      OsApplicationIsPrivileged = true
      OsAppUseTrustedFunctionStubs = false
      OsApplicationCoreRef = EcucCore2
      OsAppTaskRef = IdleTask_OsCore2
      OsAppTaskRef = Default_Init_Task_Core2
      OsAppTaskRef = Default_Init_Task_Core2_Trusted
      OsAppIsrRef = CounterIsr_SystemTimer2
      OsAppCounterRef = SystemTimer_Core2
      OsAppTaskRef = Core2_BswTask
      OsAppTaskRef = Core2_AswTask
      OsAppTaskRef = Core2_AswInit
      OsAppEcucPartitionRef = EcucPartition_OsCore2_Swc
      OsAppAlarmRef = Rte_Al_TE_Core2App_SWC_Core2App_Runnable100ms
      OsAppAlarmRef = Rte_Al_TE3_EcuM_EcuM_MainFunction
      OsAppIsrRef = XSignalIsr_OsCore2
      OsApplicationHooks: OsAppErrorHook=false, OsAppShutdownHook=false, OsAppStartupHook=false
    4 x OsTask, all with OsTaskActivation=1, OsTaskSchedule=FULL, OsTaskStackSharing=false, OsTaskStackSize=1024, OsTaskType=BASIC, OsTaskUsesFpu=false, OsTaskAccessingApplication=SystemApplication_OsCore0, OsTaskAccessingApplication=SystemApplication_OsCore1, OsTaskAccessingApplication=SystemApplication_OsCore2:
      Default_Init_Task_Core1: OsTaskPriority=50
        OsTaskAutostart: OsTaskAppModeRef=OSDEFAULTAPPMODE
      Default_Init_Task_Core2: OsTaskPriority=50
        OsTaskAutostart: OsTaskAppModeRef=OSDEFAULTAPPMODE
      Default_Init_Task_Core2_Trusted: OsTaskPriority=49
        OsTaskAutostart: OsTaskAppModeRef=OSDEFAULTAPPMODE
      Default_Init_Task_Core1_Trusted: OsTaskPriority=49
        OsTaskAutostart: OsTaskAppModeRef=OSDEFAULTAPPMODE
    SystemTimer_Core1 (OsCounter):
      OsCounterMaxAllowedValue = 2147483647
      OsCounterMinCycle = 1
      OsCounterType = HARDWARE
      OsSecondsPerTick = 0.001
      OsCounterTicksPerBase = 100000
      OsCounterAccessingApplication = SystemApplication_OsCore{0..2}
      OsDriver: OsDriverHighResolution=false, OsDriverHardwareTimerChannelRef=STM0_Ch1, OsDriverIsrRef=CounterIsr_SystemTimer1
    SystemTimer_Core2 (OsCounter):
      OsCounterMaxAllowedValue = 2147483647
      OsCounterMinCycle = 1
      OsCounterType = HARDWARE
      OsSecondsPerTick = 0.001
      OsCounterTicksPerBase = 100000
      OsCounterAccessingApplication = SystemApplication_OsCore{0..2}
      OsDriver: OsDriverHighResolution=false, OsDriverHardwareTimerChannelRef=STM1_Ch0, OsDriverIsrRef=CounterIsr_SystemTimer2
    CounterIsr_SystemTimer1 (OsIsr):
      OsIsrInterruptPriority = 1
      OsIsrCategory = CATEGORY_2
      OsIsrInterruptType = EXTERNAL
      OsIsrInterruptSource = 772
      OsIsrStackSize = 1024
      OsIsrEnableNesting = false
      OsIsrUsesFpu = false
      OsIsrInitialEnableInterruptSource = false
      OsIsrSpecialFunctionName = Os_TimerPfrtIsr
    CounterIsr_SystemTimer2 (OsIsr):
      OsIsrInterruptPriority = 1
      OsIsrCategory = CATEGORY_2
      OsIsrInterruptType = EXTERNAL
      OsIsrInterruptSource = 776
      OsIsrStackSize = 1024
      OsIsrEnableNesting = false
      OsIsrUsesFpu = false
      OsIsrInitialEnableInterruptSource = false
      OsIsrSpecialFunctionName = Os_TimerPfrtIsr
    6 x OsTask, all with OsTaskActivation=1, OsTaskSchedule=FULL, OsTaskStackSharing=false, OsTaskStackSize=1024, OsTaskType=AUTO, OsTaskUsesFpu=false, OsTaskAccessingApplication=SystemApplication_OsCore0, OsTaskAccessingApplication=SystemApplication_OsCore1, OsTaskAccessingApplication=SystemApplication_OsCore2:
      Core1_BswTask: OsTaskPriority=51, OsTaskResourceRef=OsResource1
      Core1_AswTask: OsTaskPriority=52, OsTaskResourceRef=OsResource1
      Core1_AswInit: OsTaskPriority=53, OsTaskResourceRef=OsResource1
      Core2_BswTask: OsTaskPriority=51, OsTaskResourceRef=OsResource2
      Core2_AswTask: OsTaskPriority=52, OsTaskResourceRef=OsResource2
      Core2_AswInit: OsTaskPriority=53, OsTaskResourceRef=OsResource2
    OsResource1 (OsResource): OsResourceProperty=STANDARD, OsResourceAccessingApplication=SystemApplication_OsCore1
    OsResource2 (OsResource): OsResourceProperty=STANDARD, OsResourceAccessingApplication=SystemApplication_OsCore2
    Rte_Al_TE_Core1App_SWC_Core1App_Runnable100ms (OsAlarm):
      OsAlarmCounterRef = SystemTimer_Core1
      OsAlarmAccessingApplication = SystemApplication_OsCore{0..2}
      OsAlarmAction
        OsAlarmActivateTask: OsAlarmActivateTaskRef=Core1_AswTask
    Rte_Al_TE_Core2App_SWC_Core2App_Runnable100ms (OsAlarm):
      OsAlarmCounterRef = SystemTimer_Core2
      OsAlarmAccessingApplication = SystemApplication_OsCore{0..2}
      OsAlarmAction
        OsAlarmActivateTask: OsAlarmActivateTaskRef=Core2_AswTask
    Core0_BswTask (OsTask):
      OsTaskActivation = 1
      OsTaskPriority = 66
      OsTaskSchedule = FULL
      OsTaskStackSharing = false
      OsTaskStackSize = 1024
      OsTaskType = AUTO
      OsTaskUsesFpu = false
      OsTaskAccessingApplication = SystemApplication_OsCore{0..2}
      OsTaskResourceRef = OsResource0
      OsTaskEventRef = Rte_Ev_Cyclic2_Core0_BswTask_0_10ms
      OsTaskEventRef = Rte_Ev_Cyclic2_Core0_BswTask_0_20ms
      OsTaskEventRef = Rte_Ev_Cyclic2_Core0_BswTask_0_5ms
      OsTaskEventRef = Rte_Ev_Run_EthIf_EthIf_MainFunctionState
    3 x OsAlarm, all with OsAlarmAccessingApplication=SystemApplication_OsCore0, OsAlarmAccessingApplication=SystemApplication_OsCore1, OsAlarmAccessingApplication=SystemApplication_OsCore2:
      Rte_Al_TE2_Core0_BswTask_0_10ms: OsAlarmCounterRef=SystemTimer_Core0
        OsAlarmAction
          OsAlarmSetEvent: OsAlarmSetEventRef=Rte_Ev_Cyclic2_Core0_BswTask_0_10ms, OsAlarmSetEventTaskRef=Os/Core0_BswTask
      Rte_Al_TE2_EcuM_EcuM_MainFunction: OsAlarmCounterRef=SystemTimer_Core1
        OsAlarmAction
          OsAlarmActivateTask: OsAlarmActivateTaskRef=Core1_BswTask
      Rte_Al_TE3_EcuM_EcuM_MainFunction: OsAlarmCounterRef=SystemTimer_Core2
        OsAlarmAction
          OsAlarmActivateTask: OsAlarmActivateTaskRef=Core2_BswTask
    4 x OsIsr, all with OsIsrCategory=CATEGORY_2, OsIsrInterruptType=EXTERNAL, OsIsrStackSize=1024, OsIsrEnableNesting=false, OsIsrUsesFpu=false:
      XSignalIsr_OsCore2: OsIsrInterruptPriority=2, OsIsrInterruptSource=1532, OsIsrInitialEnableInterruptSource=false, OsIsrSpecialFunctionName=Os_XSigRecvIsrHandler
        OsIsrXSignalReceiver:
          OsIsrXSignalReceiverProvidedApis = ShutdownAllCores
          OsIsrXSignalReceiverProvidedApis = ActivateTask
          OsIsrXSignalReceiverProvidedApis = CancelAlarm
          OsIsrXSignalReceiverProvidedApis = ChainTask
          OsIsrXSignalReceiverProvidedApis = ControlIdle
          OsIsrXSignalReceiverProvidedApis = GetAlarm
          OsIsrXSignalReceiverProvidedApis = GetApplicationState
          OsIsrXSignalReceiverProvidedApis = GetCounterValue
          OsIsrXSignalReceiverProvidedApis = GetElapsedValue
          OsIsrXSignalReceiverProvidedApis = GetErrorHookStackUsage
          OsIsrXSignalReceiverProvidedApis = GetEvent
          OsIsrXSignalReceiverProvidedApis = GetISRStackUsage
          OsIsrXSignalReceiverProvidedApis = GetKernelStackUsage
          OsIsrXSignalReceiverProvidedApis = GetNonTrustedFunctionStackUsage
          OsIsrXSignalReceiverProvidedApis = GetProtectionHookStackUsage
          OsIsrXSignalReceiverProvidedApis = GetScheduleTableStatus
          OsIsrXSignalReceiverProvidedApis = GetShutdownHookStackUsage
          OsIsrXSignalReceiverProvidedApis = GetStartupHookStackUsage
          OsIsrXSignalReceiverProvidedApis = GetTaskStackUsage
          OsIsrXSignalReceiverProvidedApis = GetTaskState
          OsIsrXSignalReceiverProvidedApis = HookCallCallback
          OsIsrXSignalReceiverProvidedApis = NextScheduleTable
          OsIsrXSignalReceiverProvidedApis = SetAbsAlarm
          OsIsrXSignalReceiverProvidedApis = SetEvent
          OsIsrXSignalReceiverProvidedApis = SetRelAlarm
          OsIsrXSignalReceiverProvidedApis = StartScheduleTableAbs
          OsIsrXSignalReceiverProvidedApis = StartScheduleTableRel
          OsIsrXSignalReceiverProvidedApis = StopScheduleTable
          OsIsrXSignalReceiverProvidedApis = TerminateApplication
      XSignalIsr_OsCore0: OsIsrInterruptPriority=2, OsIsrInterruptSource=1524, OsIsrInitialEnableInterruptSource=false, OsIsrSpecialFunctionName=Os_XSigRecvIsrHandler
        OsIsrXSignalReceiver:
          OsIsrXSignalReceiverProvidedApis = ShutdownAllCores
          OsIsrXSignalReceiverProvidedApis = ActivateTask
          OsIsrXSignalReceiverProvidedApis = CancelAlarm
          OsIsrXSignalReceiverProvidedApis = ChainTask
          OsIsrXSignalReceiverProvidedApis = ControlIdle
          OsIsrXSignalReceiverProvidedApis = GetAlarm
          OsIsrXSignalReceiverProvidedApis = GetApplicationState
          OsIsrXSignalReceiverProvidedApis = GetCounterValue
          OsIsrXSignalReceiverProvidedApis = GetElapsedValue
          OsIsrXSignalReceiverProvidedApis = GetErrorHookStackUsage
          OsIsrXSignalReceiverProvidedApis = GetEvent
          OsIsrXSignalReceiverProvidedApis = GetISRStackUsage
          OsIsrXSignalReceiverProvidedApis = GetKernelStackUsage
          OsIsrXSignalReceiverProvidedApis = GetNonTrustedFunctionStackUsage
          OsIsrXSignalReceiverProvidedApis = GetProtectionHookStackUsage
          OsIsrXSignalReceiverProvidedApis = GetScheduleTableStatus
          OsIsrXSignalReceiverProvidedApis = GetShutdownHookStackUsage
          OsIsrXSignalReceiverProvidedApis = GetStartupHookStackUsage
          OsIsrXSignalReceiverProvidedApis = GetTaskStackUsage
          OsIsrXSignalReceiverProvidedApis = GetTaskState
          OsIsrXSignalReceiverProvidedApis = HookCallCallback
          OsIsrXSignalReceiverProvidedApis = NextScheduleTable
          OsIsrXSignalReceiverProvidedApis = SetAbsAlarm
          OsIsrXSignalReceiverProvidedApis = SetEvent
          OsIsrXSignalReceiverProvidedApis = SetRelAlarm
          OsIsrXSignalReceiverProvidedApis = StartScheduleTableAbs
          OsIsrXSignalReceiverProvidedApis = StartScheduleTableRel
          OsIsrXSignalReceiverProvidedApis = StopScheduleTable
          OsIsrXSignalReceiverProvidedApis = TerminateApplication
      XSignalIsr_OsCore1: OsIsrInterruptPriority=2, OsIsrInterruptSource=1528, OsIsrInitialEnableInterruptSource=false, OsIsrSpecialFunctionName=Os_XSigRecvIsrHandler
        OsIsrXSignalReceiver:
          OsIsrXSignalReceiverProvidedApis = ShutdownAllCores
          OsIsrXSignalReceiverProvidedApis = ActivateTask
          OsIsrXSignalReceiverProvidedApis = CancelAlarm
          OsIsrXSignalReceiverProvidedApis = ChainTask
          OsIsrXSignalReceiverProvidedApis = ControlIdle
          OsIsrXSignalReceiverProvidedApis = GetAlarm
          OsIsrXSignalReceiverProvidedApis = GetApplicationState
          OsIsrXSignalReceiverProvidedApis = GetCounterValue
          OsIsrXSignalReceiverProvidedApis = GetElapsedValue
          OsIsrXSignalReceiverProvidedApis = GetErrorHookStackUsage
          OsIsrXSignalReceiverProvidedApis = GetEvent
          OsIsrXSignalReceiverProvidedApis = GetISRStackUsage
          OsIsrXSignalReceiverProvidedApis = GetKernelStackUsage
          OsIsrXSignalReceiverProvidedApis = GetNonTrustedFunctionStackUsage
          OsIsrXSignalReceiverProvidedApis = GetProtectionHookStackUsage
          OsIsrXSignalReceiverProvidedApis = GetScheduleTableStatus
          OsIsrXSignalReceiverProvidedApis = GetShutdownHookStackUsage
          OsIsrXSignalReceiverProvidedApis = GetStartupHookStackUsage
          OsIsrXSignalReceiverProvidedApis = GetTaskStackUsage
          OsIsrXSignalReceiverProvidedApis = GetTaskState
          OsIsrXSignalReceiverProvidedApis = HookCallCallback
          OsIsrXSignalReceiverProvidedApis = NextScheduleTable
          OsIsrXSignalReceiverProvidedApis = SetAbsAlarm
          OsIsrXSignalReceiverProvidedApis = SetEvent
          OsIsrXSignalReceiverProvidedApis = SetRelAlarm
          OsIsrXSignalReceiverProvidedApis = StartScheduleTableAbs
          OsIsrXSignalReceiverProvidedApis = StartScheduleTableRel
          OsIsrXSignalReceiverProvidedApis = StopScheduleTable
          OsIsrXSignalReceiverProvidedApis = TerminateApplication
      CanIsr_3: OsIsrInterruptPriority=33, OsIsrInterruptSource=1468, OsIsrInitialEnableInterruptSource=true  # /ActiveEcuC/Can PLAIN_TEXT Can messages event (for a specific controllers)
    Core0_AswTask (OsTask):
      OsTaskActivation = 1
      OsTaskPriority = 0
      OsTaskSchedule = FULL
      OsTaskStackSharing = false
      OsTaskStackSize = 1024
      OsTaskType = AUTO
      OsTaskUsesFpu = false
      OsTaskAccessingApplication = SystemApplication_OsCore{0..2}
      OsTaskEventRef = Rte_Ev_Cyclic_Core0_AswTask_0_10ms
      OsTaskEventRef = Rte_Ev_Run_Com_SWC_Com_Runnable_2ms
      OsTaskEventRef = Rte_Ev_Run_Com_SWC_Rte_Msg200h_Rx_Notification
      OsTaskEventRef = Rte_Ev_Run_Com_SWC_Rte_Msg201h_Rx_Notification
      OsTaskEventRef = Rte_Ev_Run_NvM_SWC_NvM_SWC_UserData1_Runnable
      OsTaskEventRef = Rte_Ev_Run_NvM_SWC_NvM_SWC_UserData2_Runnable
      OsTaskEventRef = Rte_Ev_Run_PowerMng_SWC_Led_Runnable1000ms
      OsTaskEventRef = Rte_Ev_Run_Com_SWC_Com_Runnable_20ms
      OsTaskEventRef = Rte_Ev_Run_DIAG_SWC_EcuReset_JumpFBL
    Core0_AswInit (OsTask):
      OsTaskActivation = 1
      OsTaskPriority = 0
      OsTaskSchedule = FULL
      OsTaskStackSharing = false
      OsTaskStackSize = 1024
      OsTaskType = AUTO
      OsTaskUsesFpu = false
      OsTaskAccessingApplication = SystemApplication_OsCore{0..2}
    3 x OsAlarm, all with OsAlarmCounterRef=SystemTimer_Core0, OsAlarmAccessingApplication=SystemApplication_OsCore0, OsAlarmAccessingApplication=SystemApplication_OsCore1, OsAlarmAccessingApplication=SystemApplication_OsCore2:
      Rte_Al_TE_Core0_AswTask_0_10ms
        OsAlarmAction
          OsAlarmSetEvent: OsAlarmSetEventRef=Rte_Ev_Cyclic_Core0_AswTask_0_10ms, OsAlarmSetEventTaskRef=Os/Core0_AswTask
      Rte_Al_TE2_Core0_BswTask_0_20ms
        OsAlarmAction
          OsAlarmSetEvent: OsAlarmSetEventRef=Rte_Ev_Cyclic2_Core0_BswTask_0_20ms, OsAlarmSetEventTaskRef=Os/Core0_BswTask
      Rte_Al_TE2_Core0_BswTask_0_5ms
        OsAlarmAction
          OsAlarmSetEvent: OsAlarmSetEventRef=Rte_Ev_Cyclic2_Core0_BswTask_0_5ms, OsAlarmSetEventTaskRef=Os/Core0_BswTask
    4 x OsEvent:
      Rte_Ev_Cyclic2_Core0_BswTask_0_10ms
      Rte_Ev_Cyclic2_Core0_BswTask_0_20ms
      Rte_Ev_Cyclic2_Core0_BswTask_0_5ms
      Rte_Ev_Cyclic_Core0_AswTask_0_10ms
    OsIoc: OsIocIncludeHeader=usrostyp.h, OsIocIncludeHeader=Rte.h
      Rte_Core1App_SWC_P_Arry8Bytes_DEP_Arry8Bytes (OsIocCommunication): OsIocSpinlock=IocSpinlock_Rte_Core1App_SWC_P_Arry8Bytes_DEP_Arry8Bytes
        OsIocReceiverProperties: OsIocReceivingOsApplicationRef=SystemApplication_OsCore1
        OsIocDataProperties0 (OsIocDataProperties):
          OsIocDataType = IDT_Arry8Bytes
          OsIocDataTypeIsAtomic = false
          OsIocInitValue = Rte_IocInitValue_Core1App_SWC_P_Arry8Bytes_DEP_Arry8Bytes
          OsIocDataPropertyIndex = 0
        OsIocSenderProperties0 (OsIocSenderProperties): OsIocSendingOsApplicationRef=SystemApplication_OsCore0
    IocSpinlock_Rte_Core1App_SWC_P_Arry8Bytes_DEP_Arry8Bytes (OsSpinlock):
      OsSpinlockLockMethod = LOCK_NOTHING
      OsSpinlockLockType = OPTIMIZED
      OsSpinlockAccessingApplication = SystemApplication_OsCore1
      OsSpinlockAccessingApplication = SystemApplication_OsCore0
    Rte_Al_TE_Com_SWC_Com_Runnable_20ms (OsAlarm):
      OsAlarmCounterRef = SystemTimer_Core0
      OsAlarmAccessingApplication = SystemApplication_OsCore{0..2}
      OsAlarmAction
        OsAlarmSetEvent: OsAlarmSetEventRef=Rte_Ev_Run_Com_SWC_Com_Runnable_20ms, OsAlarmSetEventTaskRef=Os/Core0_AswTask
    Rte_Ev_Run_Com_SWC_Com_Runnable_20ms (OsEvent)
    Rte_Ev_Run_DIAG_SWC_EcuReset_JumpFBL (OsEvent)
    EthIsr_EthCtrlConfig_ETHSR2_ISR (OsIsr):  # /ActiveEcuC/Eth PLAIN_TEXT ISR for Ethernet Module (EthCtrlConfig).
      OsIsrInterruptPriority = 60
      OsIsrCategory = CATEGORY_2
      OsIsrInterruptType = EXTERNAL
      OsIsrInterruptSource = 1416
      OsIsrStackSize = 1024
      OsIsrEnableNesting = false
      OsIsrUsesFpu = false
      OsIsrInitialEnableInterruptSource = true
    EthIsr_EthCtrlConfig_ETHSR6_ISR (OsIsr):  # /ActiveEcuC/Eth PLAIN_TEXT ISR for Ethernet Module (EthCtrlConfig).
      OsIsrInterruptPriority = 61
      OsIsrCategory = CATEGORY_2
      OsIsrInterruptType = EXTERNAL
      OsIsrInterruptSource = 1432
      OsIsrStackSize = 1024
      OsIsrEnableNesting = false
      OsIsrUsesFpu = false
      OsIsrInitialEnableInterruptSource = true
    Rte_Al_TE_EthIf_EthIf_MainFunctionState (OsAlarm):
      OsAlarmCounterRef = SystemTimer_Core0
      OsAlarmAccessingApplication = SystemApplication_OsCore{0..2}
      OsAlarmAction
        OsAlarmSetEvent: OsAlarmSetEventRef=Rte_Ev_Run_EthIf_EthIf_MainFunctionState, OsAlarmSetEventTaskRef=Os/Core0_BswTask
    Rte_Ev_Run_EthIf_EthIf_MainFunctionState (OsEvent)
