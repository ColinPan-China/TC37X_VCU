AUTOSAR XML (schema 00048)
package /ActiveEcuC
  module config Os: implementation-config-variant=VARIANT-PRE-COMPILE, module-description=Os_Impl
    SystemTimer (OsCounter):
      OsCounterMaxAllowedValue = 2147483647
      OsCounterMinCycle = 1
      OsCounterType = HARDWARE
      OsSecondsPerTick = 0.001
      OsCounterTicksPerBase = 100000
      OsCounterAccessingApplication = SystemApplication_OsCore0
      OsDriver: OsDriverHighResolution=false, OsDriverHardwareTimerChannelRef=STM0_Ch0, OsDriverIsrRef=CounterIsr_SystemTimer
    OsMemoryProtection
    OsOS:
      OsStackMonitoring = true
      OsStatus = EXTENDED
      OsUseGetServiceId = false
      OsUseParameterAccess = false
      OsUseResScheduler = false
      OsForcibleTermination = false
      OsGenerateCalloutStubs = true
      OsGenerateMemMap = COMPLETE
      OsGenerateMemMapForNearAddressing = true
      OsGenerateMemMapForThreads = false
      OsServiceProtection = false
      OsStackUsageMeasurement = false
      OsUseXSignalAsyncApiCalls = false
      OsFpuUsage = NONE
      OsUseCase = STANDARD
      OsScalabilityClass = SC1
      OsNumberOfCores = 1
      OsMasterCore = OsCore0
      OsSystemTimer = SystemTimer
      OsHooks: OsErrorHook=true, OsPostTaskHook=false, OsPreTaskHook=false, OsShutdownHook=true, OsStartupHook=false
      OsStackSummary
        11 x OsStack, all with OsStackSize=1024, OsStackCore=OsCore0:
          OsCore0_Kernel: OsStackType=CORE_KERNEL_STACK, OsStackUser=OsCore0
          OsCore0_Init: OsStackType=CORE_INIT_STACK, OsStackUser=OsCore0
          OsCore0_Error: OsStackType=CORE_ERROR_STACK, OsStackUser=OsCore0
          OsCore0_Task_Prio4294967295: OsStackType=TASK_SHARED_PRIORITY_STACK, OsStackUser=IdleTask_OsCore0
          OsCore0_Isr_Core: OsStackType=ISR_SHARED_CORE_STACK, OsStackUser=CounterIsr_SystemTimer, OsStackUser=CanIsr_0, OsStackUser=ADC0SR0_ISR, OsStackUser=ADC1SR0_ISR, OsStackUser=ADC2SR0_ISR, OsStackUser=ADC3SR0_ISR, OsStackUser=ADC11SR0_ISR, OsStackUser=ASCLIN2ERR_ISR, OsStackUser=ASCLIN2RX_ISR, OsStackUser=ASCLIN2TX_ISR, OsStackUser=ASCLIN1TX_ISR, OsStackUser=ASCLIN1RX_ISR, OsStackUser=ASCLIN1ERR_ISR, OsStackUser=DMACH10SR_ISR, OsStackUser=DMACH11SR_ISR, OsStackUser=QSPI3ERR_ISR, OsStackUser=QSPI3PT_ISR, OsStackUser=ADC8SR0_ISR, OsStackUser=GTMTOM1SR3_ISR, OsStackUser=GTMTOM1SR4_ISR, OsStackUser=CanIsr_3, OsStackUser=ASCLIN4TX_ISR, OsStackUser=ASCLIN4RX_ISR, OsStackUser=ASCLIN4ERR_ISR, OsStackUser=GTMTOM1SR0_ISR, OsStackUser=GTMTOM1SR1_ISR, OsStackUser=CanIsr_4, OsStackUser=ASCLIN3ERR_ISR, OsStackUser=ASCLIN3RX_ISR, OsStackUser=ASCLIN3TX_ISR, OsStackUser=CanIsr_1, OsStackUser=CanIsr_6, OsStackUser=CanIsr_2
          OsCore0_Task_Prio49: OsStackType=TASK_SHARED_PRIORITY_STACK, OsStackUser=Default_Init_Task_Trusted
          OsCore0_Task_Prio50: OsStackType=TASK_SHARED_PRIORITY_STACK, OsStackUser=Default_Init_Task
          OsCore0_Task_Prio63: OsStackType=TASK_SHARED_PRIORITY_STACK, OsStackUser=Asw_Init
          Bsw_Task: OsStackType=TASK_EXTENDED_STACK, OsStackUser=Os/Bsw_Task
          AswTask: OsStackType=TASK_EXTENDED_STACK, OsStackUser=Os/AswTask
          OsCore0_Shutdown: OsStackType=CORE_SHUTDOWN_STACK, OsStackUser=OsCore0
    OsPublishedInformation: OsKernelVersion=7, OsPlatformName=TriCoreAurix
      TC37x (OsDerivativeInformation):
        OsMpuAlignment = 8
        OsMpuMemoryGapSize = 16
        OsMpuEndAddressAccessible = false
        OsStackAlignment = 8
        OsExceptionVectorTableAlignment = 256
        OsInterruptVectorTableAlignment = 8192
        OsHardwareManuals = User Manual: TC37X_um_appx_V1.0.0.pdf 2018.08 TC37X_ts_appx_V2.5.1.pdf 2018.04
        OsMpuPrivilegedRegionsConfigurable = false
        3 x OsPhysicalCore, all with OsPhysicalCoreType=TC1.6.2P, OsPhysicalCoreExceptionSources=8, OsPhysicalCorePrivelegedHwAccess=true:
          Core0: OsPhysicalCoreId=0, OsPhysicalCoreDefaultEntrySymbol=_start_tc0, OsPhysicalCoreMasterStartAllowed=true, OsPhysicalCoreIsAutostart=true, OsPhysicalCoreStackProtectionUnit=OsPhysicalCore0DataMpu
            OsPhysicalCore0DataMpu (OsPhysicalCoreMpu): OsPhysicalCoreMpuId=0, OsPhysicalCoreMpuMaxRegions=18, OsPhysicalCoreMpuType=DATA
            OsPhysicalCore0CodeMpu (OsPhysicalCoreMpu): OsPhysicalCoreMpuId=1, OsPhysicalCoreMpuMaxRegions=10, OsPhysicalCoreMpuType=CODE
          Core1: OsPhysicalCoreId=1, OsPhysicalCoreDefaultEntrySymbol=_start_tc1, OsPhysicalCoreMasterStartAllowed=false, OsPhysicalCoreIsAutostart=false, OsPhysicalCoreStackProtectionUnit=OsPhysicalCore1DataMpu
            OsPhysicalCore1DataMpu (OsPhysicalCoreMpu): OsPhysicalCoreMpuId=0, OsPhysicalCoreMpuMaxRegions=18, OsPhysicalCoreMpuType=DATA
            OsPhysicalCore1CodeMpu (OsPhysicalCoreMpu): OsPhysicalCoreMpuId=1, OsPhysicalCoreMpuMaxRegions=10, OsPhysicalCoreMpuType=CODE
          Core2: OsPhysicalCoreId=2, OsPhysicalCoreDefaultEntrySymbol=_start_tc2, OsPhysicalCoreMasterStartAllowed=false, OsPhysicalCoreIsAutostart=false, OsPhysicalCoreStackProtectionUnit=OsPhysicalCore2DataMpu
            OsPhysicalCore2DataMpu (OsPhysicalCoreMpu): OsPhysicalCoreMpuId=0, OsPhysicalCoreMpuMaxRegions=18, OsPhysicalCoreMpuType=DATA
            OsPhysicalCore2CodeMpu (OsPhysicalCoreMpu): OsPhysicalCoreMpuId=1, OsPhysicalCoreMpuMaxRegions=10, OsPhysicalCoreMpuType=CODE
        3 x OsHardwareTimer, all with OsHardwareTimerSize=32, OsHardwareTimerUnit=FRT, OsHardwareTimerType=STM:
          STM0: OsHardwareTimerBaseAddress=4026535936, OsHardwareTimerId=0
            STM0_Ch0 (OsHardwareTimerChannel): OsHardwareTimerChannelIntSource=768, OsHardwareTimerChannelOffset=0, OsHardwareTimerChannelId=0
            STM0_Ch1 (OsHardwareTimerChannel): OsHardwareTimerChannelIntSource=772, OsHardwareTimerChannelOffset=1, OsHardwareTimerChannelId=1
          STM1: OsHardwareTimerBaseAddress=4026536192, OsHardwareTimerId=1
            STM1_Ch0 (OsHardwareTimerChannel): OsHardwareTimerChannelIntSource=776, OsHardwareTimerChannelOffset=0, OsHardwareTimerChannelId=0
            STM1_Ch1 (OsHardwareTimerChannel): OsHardwareTimerChannelIntSource=780, OsHardwareTimerChannelOffset=1, OsHardwareTimerChannelId=1
          STM2: OsHardwareTimerBaseAddress=4026536448, OsHardwareTimerId=2
            STM2_Ch0 (OsHardwareTimerChannel): OsHardwareTimerChannelIntSource=784, OsHardwareTimerChannelOffset=0, OsHardwareTimerChannelId=0
            STM2_Ch1 (OsHardwareTimerChannel): OsHardwareTimerChannelIntSource=788, OsHardwareTimerChannelOffset=1, OsHardwareTimerChannelId=1
        AURIXTC3XX_IR (OsSystemIntCtrl): OsSystemIntCtrlMaxPrios=255, OsSystemIntCtrlPrioOrder=ASC, OsSystemIntCtrlMaxSources=8192, OsSystemIntCtrlBaseAddress=4026757120
        GPT (OsHardwareTimer): OsHardwareTimerSize=16, OsHardwareTimerUnit=PIT, OsHardwareTimerBaseAddress=4026537984, OsHardwareTimerId=0, OsHardwareTimerType=PIT
          GPT_Ch0 (OsHardwareTimerChannel): OsHardwareTimerChannelIntSource=744, OsHardwareTimerChannelOffset=0, OsHardwareTimerChannelId=0
          GPT_Ch1 (OsHardwareTimerChannel): OsHardwareTimerChannelIntSource=756, OsHardwareTimerChannelOffset=1, OsHardwareTimerChannelId=1
        OsMemoryRegionSpecifics
          18 x OsMemoryRegionAccess:
            PS0_R: OsMemoryRegionAccessRights=R, OsMemoryRegionAccessType=PROTECTION_SET0
            PS0_W: OsMemoryRegionAccessRights=W, OsMemoryRegionAccessType=PROTECTION_SET0
            PS0_X: OsMemoryRegionAccessRights=X, OsMemoryRegionAccessType=PROTECTION_SET0
            PS1_R: OsMemoryRegionAccessRights=R, OsMemoryRegionAccessType=PROTECTION_SET1
            PS1_W: OsMemoryRegionAccessRights=W, OsMemoryRegionAccessType=PROTECTION_SET1
            PS1_X: OsMemoryRegionAccessRights=X, OsMemoryRegionAccessType=PROTECTION_SET1
            PS2_R: OsMemoryRegionAccessRights=R, OsMemoryRegionAccessType=PROTECTION_SET2
            PS2_W: OsMemoryRegionAccessRights=W, OsMemoryRegionAccessType=PROTECTION_SET2
            PS2_X: OsMemoryRegionAccessRights=X, OsMemoryRegionAccessType=PROTECTION_SET2
            PS3_R: OsMemoryRegionAccessRights=R, OsMemoryRegionAccessType=PROTECTION_SET3
            PS3_W: OsMemoryRegionAccessRights=W, OsMemoryRegionAccessType=PROTECTION_SET3
            PS3_X: OsMemoryRegionAccessRights=X, OsMemoryRegionAccessType=PROTECTION_SET3
            PS4_R: OsMemoryRegionAccessRights=R, OsMemoryRegionAccessType=PROTECTION_SET4
            PS4_W: OsMemoryRegionAccessRights=W, OsMemoryRegionAccessType=PROTECTION_SET4
            PS4_X: OsMemoryRegionAccessRights=X, OsMemoryRegionAccessType=PROTECTION_SET4
            PS5_R: OsMemoryRegionAccessRights=R, OsMemoryRegionAccessType=PROTECTION_SET5
            PS5_W: OsMemoryRegionAccessRights=W, OsMemoryRegionAccessType=PROTECTION_SET5
            PS5_X: OsMemoryRegionAccessRights=X, OsMemoryRegionAccessType=PROTECTION_SET5
        DMA (OsInterruptSupportedType):
          OsInterruptSupportedTypeSeparateSources = false
          OsInterruptSupportedTypeSeparatePriority = true
          OsInterruptSupportedTypeIsMapped = false
          OsInterruptSupportedTypePostActionRequired = false
    OSDEFAULTAPPMODE (OsAppMode)
    OS_APPMODE_ANY (OsAppMode)
    OsCore0 (OsCore):
      OsCoreIsAutostart = true
      OsCoreIsAutosar = true
      OsCoreEntrySymbol = _start_tc0
      OsCorePhysicalCoreRef = Core0
      OsCoreEcucCoreRef = EcucCoreDefinition
      OsCoreIdleTask = IdleTask_OsCore0
      OsCoreSystemApplication = SystemApplication_OsCore0
      OsCoreStacks:
        OsCoreKernelStackSize = 1024
        OsCoreStartupStackSize = 1024
        OsCoreShutdownStackSize = 1024
        OsCoreErrorStackSize = 1024
        OsCoreProtectionStackSize = 1024
        OsCoreInitStackSize = 1024
    IdleTask_OsCore0 (OsTask):
      OsTaskActivation = 1
      OsTaskPriority = 4294967295
      OsTaskSchedule = FULL
      OsTaskStackSharing = false
      OsTaskStackSize = 1024
      OsTaskType = AUTO
      OsTaskUsesFpu = false
      OsTaskAccessingApplication = SystemApplication_OsCore0
      OsTaskAutostart: OsTaskAppModeRef=OS_APPMODE_ANY
    SystemApplication_OsCore0 (OsApplication):
      OsTrusted = true
      OsTrustedApplicationDelayTimingViolationCall = false
      OsTrustedApplicationWithProtection = false
      OsApplicationIsPrivileged = true
      OsAppUseTrustedFunctionStubs = false
      OsApplicationCoreRef = EcucCoreDefinition
      OsAppTaskRef = IdleTask_OsCore0
      OsAppCounterRef = SystemTimer
      OsAppIsrRef = CounterIsr_SystemTimer
      OsAppTaskRef = Default_Init_Task
      OsAppTaskRef = Default_Init_Task_Trusted
      OsApplicationHooks: OsAppErrorHook=false, OsAppShutdownHook=false, OsAppStartupHook=false
    CounterIsr_SystemTimer (OsIsr):
      OsIsrInterruptPriority = 1
      OsIsrCategory = CATEGORY_2
      OsIsrInterruptType = EXTERNAL
      OsIsrInterruptSource = 768
      OsIsrStackSize = 1024
      OsIsrEnableNesting = false
      OsIsrUsesFpu = false
      OsIsrInitialEnableInterruptSource = false
      OsIsrSpecialFunctionName = Os_TimerPfrtIsr
    Default_Init_Task (OsTask):
      OsTaskActivation = 1
      OsTaskPriority = 50
      OsTaskSchedule = FULL
      OsTaskStackSharing = false
      OsTaskStackSize = 1024
      OsTaskType = BASIC
      OsTaskUsesFpu = false
      OsTaskAccessingApplication = SystemApplication_OsCore0
      OsTaskAutostart: OsTaskAppModeRef=OSDEFAULTAPPMODE
    Default_Init_Task_Trusted (OsTask):
      OsTaskActivation = 1
      OsTaskPriority = 49
      OsTaskSchedule = FULL
      OsTaskStackSharing = false
      OsTaskStackSize = 1024
      OsTaskType = BASIC
      OsTaskUsesFpu = false
      OsTaskAccessingApplication = SystemApplication_OsCore0
      OsTaskAutostart: OsTaskAppModeRef=OSDEFAULTAPPMODE
    OsResource: OsResourceProperty=STANDARD, OsResourceAccessingApplication=OsApplication, OsResourceAccessingApplication=SystemApplication_OsCore0
    OsApplication:
      OsTrusted = true
      OsTrustedApplicationDelayTimingViolationCall = false
      OsTrustedApplicationWithProtection = false
      OsApplicationIsPrivileged = true
      OsAppUseTrustedFunctionStubs = false
      OsApplicationCoreRef = EcucCoreDefinition
      OsAppTaskRef = Os/Bsw_Task
      OsAppAlarmRef = Rte_Al_TE2_Bsw_Task_0_10ms
      OsAppTaskRef = Os/AswTask
      OsAppTaskRef = Asw_Init
      OsAppAlarmRef = Rte_Al_TE2_Bsw_Task_0_20ms
      OsAppIsrRef = CanIsr_0
      OsAppAlarmRef = Rte_Al_TE_PowerMng_SWC_Led_Runnable1000ms
      OsAppAlarmRef = Rte_Al_TE_Com_SWC_Com_Runnable_2ms
      OsAppAlarmRef = Rte_Al_TE2_Bsw_Task_0_5ms
      OsAppIsrRef = ADC{0..3}SR0_ISR
      OsAppIsrRef = ADC11SR0_ISR
      OsAppAlarmRef = Rte_Al_TE_AswTask_0_10ms
      OsAppIsrRef = ASCLIN2ERR_ISR
      OsAppIsrRef = ASCLIN2RX_ISR
      OsAppIsrRef = ASCLIN2TX_ISR
      OsAppIsrRef = ASCLIN1TX_ISR
      OsAppIsrRef = ASCLIN1RX_ISR
      OsAppIsrRef = ASCLIN1ERR_ISR
      OsAppIsrRef = DMACH10SR_ISR
      OsAppIsrRef = DMACH11SR_ISR
      OsAppIsrRef = QSPI3ERR_ISR
      OsAppIsrRef = QSPI3PT_ISR
      OsAppIsrRef = ADC8SR0_ISR
      OsAppIsrRef = GTMTOM1SR3_ISR
      OsAppIsrRef = GTMTOM1SR4_ISR
      OsAppIsrRef = CanIsr_3
      OsAppIsrRef = ASCLIN4TX_ISR
      OsAppIsrRef = ASCLIN4RX_ISR
      OsAppIsrRef = ASCLIN4ERR_ISR
      OsAppIsrRef = GTMTOM1SR0_ISR
      OsAppIsrRef = GTMTOM1SR1_ISR
      OsAppIsrRef = CanIsr_4
      OsAppAlarmRef = Rte_Al_TE_Com_SWC_Com_Runnable_500ms
      OsAppIsrRef = ASCLIN3ERR_ISR
      OsAppIsrRef = ASCLIN3RX_ISR
      OsAppIsrRef = ASCLIN3TX_ISR
      OsAppIsrRef = CanIsr_1
      OsAppIsrRef = CanIsr_6
      OsAppIsrRef = CanIsr_2
      OsApplicationHooks: OsAppErrorHook=false, OsAppShutdownHook=false, OsAppStartupHook=false
    Bsw_Task (OsTask):
      OsTaskActivation = 1
      OsTaskPriority = 65
      OsTaskSchedule = FULL
      OsTaskStackSharing = false
      OsTaskStackSize = 1024
      OsTaskType = AUTO
      OsTaskUsesFpu = false
      OsTaskAccessingApplication = SystemApplication_OsCore0
      OsTaskResourceRef = OsResource
      OsTaskEventRef = Rte_Ev_Cyclic2_Bsw_Task_0_10ms
      OsTaskEventRef = Rte_Ev_Cyclic2_Bsw_Task_0_20ms
      OsTaskEventRef = Rte_Ev_Cyclic2_Bsw_Task_0_5ms
    Rte_Al_TE2_Bsw_Task_0_10ms (OsAlarm): OsAlarmCounterRef=SystemTimer, OsAlarmAccessingApplication=SystemApplication_OsCore0
      OsAlarmAction
        OsAlarmSetEvent: OsAlarmSetEventRef=Rte_Ev_Cyclic2_Bsw_Task_0_10ms, OsAlarmSetEventTaskRef=Os/Bsw_Task
    AswTask (OsTask):
      OsTaskActivation = 1
      OsTaskPriority = 64
      OsTaskSchedule = FULL
      OsTaskStackSharing = false
      OsTaskStackSize = 1024
      OsTaskType = AUTO
      OsTaskUsesFpu = false
      OsTaskAccessingApplication = SystemApplication_OsCore0
      OsTaskResourceRef = OsResource
      OsTaskEventRef = Rte_Ev_Run_PowerMng_SWC_Led_Runnable1000ms
      OsTaskEventRef = Rte_Ev_Run_Com_SWC_Com_Runnable_2ms
      OsTaskEventRef = Rte_Ev_Run_Com_SWC_Rte_Msg200h_Rx_Notification
      OsTaskEventRef = Rte_Ev_Run_Com_SWC_Rte_Msg201h_Rx_Notification
      OsTaskEventRef = Rte_Ev_Run_NvM_SWC_NvM_SWC_UserData1_Runnable
      OsTaskEventRef = Rte_Ev_Run_NvM_SWC_NvM_SWC_UserData2_Runnable
      OsTaskEventRef = Rte_Ev_Cyclic_AswTask_0_10ms
      OsTaskEventRef = Rte_Ev_Run_Com_SWC_Com_Runnable_500ms
      OsTaskEventRef = Rte_Ev_Run_Com_SWC_Rte_Msg10Eh_Rx_Notification
      OsTaskEventRef = Rte_Ev_Run_Com_SWC_Rte_Msg10Fh_Rx_Notification
      OsTaskEventRef = Rte_Ev_Run_Com_SWC_Rte_Msg110h_Rx_Notification
    Asw_Init (OsTask):
      OsTaskActivation = 1
      OsTaskPriority = 63
      OsTaskSchedule = FULL
      OsTaskStackSharing = false
      OsTaskStackSize = 1024
      OsTaskType = AUTO
      OsTaskUsesFpu = false
      OsTaskAccessingApplication = SystemApplication_OsCore0
      OsTaskResourceRef = OsResource
    Rte_Al_TE2_Bsw_Task_0_20ms (OsAlarm): OsAlarmCounterRef=SystemTimer, OsAlarmAccessingApplication=SystemApplication_OsCore0
      OsAlarmAction
        OsAlarmSetEvent: OsAlarmSetEventRef=Rte_Ev_Cyclic2_Bsw_Task_0_20ms, OsAlarmSetEventTaskRef=Os/Bsw_Task
    Rte_Ev_Cyclic2_Bsw_Task_0_10ms (OsEvent)
    Rte_Ev_Cyclic2_Bsw_Task_0_20ms (OsEvent)
    CanIsr_0 (OsIsr):  # /ActiveEcuC/Can PLAIN_TEXT Can messages event (for a specific controllers)
      OsIsrInterruptPriority = 30
      OsIsrCategory = CATEGORY_2
      OsIsrInterruptType = EXTERNAL
      OsIsrInterruptSource = 1456
      OsIsrStackSize = 1024
      OsIsrEnableNesting = false
      OsIsrUsesFpu = false
      OsIsrInitialEnableInterruptSource = true
    Rte_Al_TE_PowerMng_SWC_Led_Runnable1000ms (OsAlarm): OsAlarmCounterRef=SystemTimer, OsAlarmAccessingApplication=SystemApplication_OsCore0
      OsAlarmAction
        OsAlarmSetEvent: OsAlarmSetEventRef=Rte_Ev_Run_PowerMng_SWC_Led_Runnable1000ms, OsAlarmSetEventTaskRef=Os/AswTask
    Rte_Ev_Run_PowerMng_SWC_Led_Runnable1000ms (OsEvent)
    Rte_Al_TE_Com_SWC_Com_Runnable_2ms (OsAlarm): OsAlarmCounterRef=SystemTimer, OsAlarmAccessingApplication=SystemApplication_OsCore0
      OsAlarmAction
        OsAlarmSetEvent: OsAlarmSetEventRef=Rte_Ev_Run_Com_SWC_Com_Runnable_2ms, OsAlarmSetEventTaskRef=Os/AswTask
    5 x OsEvent:
      Rte_Ev_Run_Com_SWC_Com_Runnable_2ms
      Rte_Ev_Run_Com_SWC_Rte_Msg200h_Rx_Notification
      Rte_Ev_Run_Com_SWC_Rte_Msg201h_Rx_Notification
      Rte_Ev_Run_NvM_SWC_NvM_SWC_UserData1_Runnable
      Rte_Ev_Run_NvM_SWC_NvM_SWC_UserData2_Runnable
    Rte_Al_TE2_Bsw_Task_0_5ms (OsAlarm): OsAlarmCounterRef=SystemTimer, OsAlarmAccessingApplication=SystemApplication_OsCore0
      OsAlarmAction
        OsAlarmSetEvent: OsAlarmSetEventRef=Rte_Ev_Cyclic2_Bsw_Task_0_5ms, OsAlarmSetEventTaskRef=Os/Bsw_Task
    Rte_Ev_Cyclic2_Bsw_Task_0_5ms (OsEvent)
    5 x OsIsr, all with OsIsrCategory=CATEGORY_2, OsIsrInterruptType=EXTERNAL, OsIsrStackSize=1024, OsIsrEnableNesting=false, OsIsrUsesFpu=false, OsIsrInitialEnableInterruptSource=true:
      ADC1SR0_ISR: OsIsrInterruptPriority=41, OsIsrInterruptSource=1664
      ADC0SR0_ISR: OsIsrInterruptPriority=40, OsIsrInterruptSource=1648
      ADC2SR0_ISR: OsIsrInterruptPriority=42, OsIsrInterruptSource=1680
      ADC3SR0_ISR: OsIsrInterruptPriority=43, OsIsrInterruptSource=1696
      ADC11SR0_ISR: OsIsrInterruptPriority=44, OsIsrInterruptSource=1824
    Rte_Al_TE_AswTask_0_10ms (OsAlarm): OsAlarmCounterRef=SystemTimer, OsAlarmAccessingApplication=SystemApplication_OsCore0
      OsAlarmAction
        OsAlarmSetEvent: OsAlarmSetEventRef=Rte_Ev_Cyclic_AswTask_0_10ms, OsAlarmSetEventTaskRef=Os/AswTask
    Rte_Ev_Cyclic_AswTask_0_10ms (OsEvent)
    20 x OsIsr, all with OsIsrCategory=CATEGORY_2, OsIsrInterruptType=EXTERNAL, OsIsrStackSize=1024, OsIsrEnableNesting=false, OsIsrUsesFpu=false, OsIsrInitialEnableInterruptSource=true:
      ASCLIN2ERR_ISR: OsIsrInterruptPriority=52, OsIsrInterruptSource=112
      ASCLIN2RX_ISR: OsIsrInterruptPriority=51, OsIsrInterruptSource=108
      ASCLIN2TX_ISR: OsIsrInterruptPriority=50, OsIsrInterruptSource=104
      ASCLIN1ERR_ISR: OsIsrInterruptPriority=55, OsIsrInterruptSource=100
      ASCLIN1RX_ISR: OsIsrInterruptPriority=54, OsIsrInterruptSource=96
      ASCLIN1TX_ISR: OsIsrInterruptPriority=53, OsIsrInterruptSource=92
      DMACH10SR_ISR: OsIsrInterruptPriority=114, OsIsrInterruptSource=920
      DMACH11SR_ISR: OsIsrInterruptPriority=115, OsIsrInterruptSource=924
      QSPI3ERR_ISR: OsIsrInterruptPriority=102, OsIsrInterruptSource=308
      QSPI3PT_ISR: OsIsrInterruptPriority=103, OsIsrInterruptSource=312
      ADC8SR0_ISR: OsIsrInterruptPriority=45, OsIsrInterruptSource=1776
      GTMTOM1SR3_ISR: OsIsrInterruptPriority=121, OsIsrInterruptSource=3644
      GTMTOM1SR4_ISR: OsIsrInterruptPriority=122, OsIsrInterruptSource=3648
      CanIsr_3: OsIsrInterruptPriority=24, OsIsrInterruptSource=1468  # /ActiveEcuC/Can PLAIN_TEXT Can messages event (for a specific controllers)
      ASCLIN4ERR_ISR: OsIsrInterruptPriority=58, OsIsrInterruptSource=136
      ASCLIN4RX_ISR: OsIsrInterruptPriority=57, OsIsrInterruptSource=132
      ASCLIN4TX_ISR: OsIsrInterruptPriority=56, OsIsrInterruptSource=128
      GTMTOM1SR0_ISR: OsIsrInterruptPriority=123, OsIsrInterruptSource=3632
      GTMTOM1SR1_ISR: OsIsrInterruptPriority=124, OsIsrInterruptSource=3636
      CanIsr_4: OsIsrInterruptPriority=32, OsIsrInterruptSource=1520  # /ActiveEcuC/Can PLAIN_TEXT Can messages event (for a specific controllers)
    Rte_Al_TE_Com_SWC_Com_Runnable_500ms (OsAlarm): OsAlarmCounterRef=SystemTimer, OsAlarmAccessingApplication=SystemApplication_OsCore0
      OsAlarmAction
        OsAlarmSetEvent: OsAlarmSetEventRef=Rte_Ev_Run_Com_SWC_Com_Runnable_500ms, OsAlarmSetEventTaskRef=Os/AswTask
    4 x OsEvent:
      Rte_Ev_Run_Com_SWC_Com_Runnable_500ms
      Rte_Ev_Run_Com_SWC_Rte_Msg10Eh_Rx_Notification
      Rte_Ev_Run_Com_SWC_Rte_Msg10Fh_Rx_Notification
      Rte_Ev_Run_Com_SWC_Rte_Msg110h_Rx_Notification
    6 x OsIsr, all with OsIsrCategory=CATEGORY_2, OsIsrInterruptType=EXTERNAL, OsIsrStackSize=1024, OsIsrEnableNesting=false, OsIsrUsesFpu=false, OsIsrInitialEnableInterruptSource=true:
      ASCLIN3ERR_ISR: OsIsrInterruptPriority=61, OsIsrInterruptSource=124
      ASCLIN3RX_ISR: OsIsrInterruptPriority=60, OsIsrInterruptSource=120
      ASCLIN3TX_ISR: OsIsrInterruptPriority=59, OsIsrInterruptSource=116
      CanIsr_1: OsIsrInterruptPriority=31, OsIsrInterruptSource=1460  # /ActiveEcuC/Can PLAIN_TEXT Can messages event (for a specific controllers)
      CanIsr_6: OsIsrInterruptPriority=33, OsIsrInterruptSource=1528  # /ActiveEcuC/Can PLAIN_TEXT Can messages event (for a specific controllers)
      CanIsr_2: OsIsrInterruptPriority=39, OsIsrInterruptSource=1464  # /ActiveEcuC/Can PLAIN_TEXT Can messages event (for a specific controllers)
