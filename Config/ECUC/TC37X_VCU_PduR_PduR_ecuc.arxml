AUTOSAR XML (schema 00048)
package /ActiveEcuC
  module config PduR: implementation-config-variant=VARIANT-PRE-COMPILE, module-description=PduR_Impl
    PduRGeneral:
      PduRDevErrorDetect = true
      PduRVersionInfoApi = false
      PduRMetaDataSupport = false
      PduRPduCallback = false
      PduRSwitching = false
      PduRSafeBswChecks = false
      PduREnableDeferredTransmission = false
      PduREnableDeferredReception = false
      PduRSupportMulticore = false
      PduRRoutingTypeGateway = false
      PduRSpinlockRetryCounter = 4294967295
      PduRExtendedErrorChecks = false
      PduRGeneration:
        PduROutOfBoundsWriteProtectionStrategy = NONE
        PduROutOfBoundsWriteSanitizer = false
        PduROutOfBoundsReadSanitizer = false
        PduRNumericalDataTypeMinimizationStrategy = WITH_CAST
        PduRReduceConstantData2Define = false
        PduRBoolDataInArrayOfStructStrategy = BITMASKING
        PduRDeduplicateIndirectedData = true
        PduRDataDeduplicationStrategy = WITH_CAST
        PduRReduceBoolDataByNegationThreshold = 2
        PduRReduceBoolDataByNumericalComparisonThreshold = 2
        PduRReduceBoolDataByNumericalRelationThreshold = 2
        PduRReduceBoolDataByNumericalOperandStrategy = WITH_ANY_VALUE
        PduRReduceNumericalDataByOffsetThreshold = 2
        PduRReduceNumericalDataByArraySubtractionThreshold = 2
        PduRReduceDataByStreaming = false
        PduRShortSymbols = false
        PduRInterfacesForDeactivatedData = false
        PduRReferringKeysInComments = false
    PduRRoutingTables: PduRConfigurationId=0
      PduRRoutingTable
        94 x PduRRoutingPath, all with PduRMulticoreRoutingPath=false, PduRLockRef=PduRLock_PduRExclusiveArea:
          VcuRxMsg1_oTC37X_VCU_CAN00_4589bbed_Rx: PduRRoutingPathCommunicationType=COMMUNICATION_INTERFACE
            VcuRxMsg1_oTC37X_VCU_CAN00_4589bbed_Rx_6711bd67_Rx (PduRDestPdu):
              PduRDestPduHandleId = 35
              PduRDestPduDirection = RECEIVE
              PduRDestPduRoutingType = API_FORWARDING
              PduRDestPduDataProcessing = IMMEDIATE
              PduRPduLengthHandlingStrategy = IGNORE
              PduRDestPduCrossPartitionDestination = false
              PduRTransmissionConfirmation = false
              PduRDestPduRef = VcuRxMsg1_oTC37X_VCU_CAN00_78805594_Rx
              PduRDestPduPduRBswModulesRef = Com
            PduRSrcPdu_6711bd67 (PduRSrcPdu): PduRSourcePduHandleId=35, PduRSrcPduDirection=RECEIVE, PduRSrcPduRef=VcuRxMsg1_oTC37X_VCU_CAN00_4589bbed_Rx, PduRSrcPduPduRBswModulesRef=CanIf
          VcuTxMsg1_oTC37X_VCU_CAN00_954a27ee_Tx: PduRRoutingPathCommunicationType=COMMUNICATION_INTERFACE
            PduRSrcPdu_91d52164 (PduRSrcPdu): PduRSourcePduHandleId=42, PduRSrcPduDirection=TRANSMIT, PduRSrcPduRef=VcuTxMsg1_oTC37X_VCU_CAN00_954a27ee_Tx, PduRSrcPduPduRBswModulesRef=Com
            VcuTxMsg1_oTC37X_VCU_CAN00_c82dd125_Tx (PduRDestPdu):
              PduRDestPduHandleId = 42
              PduRDestPduDirection = TRANSMIT
              PduRDestPduRoutingType = API_FORWARDING
              PduRDestPduDataProcessing = IMMEDIATE
              PduRPduLengthHandlingStrategy = IGNORE
              PduRDestPduCrossPartitionDestination = false
              PduRTransmissionConfirmation = false
              PduRDestPduDataProvision = PDUR_DIRECT
              PduRDestPduRef = VcuTxMsg1_oTC37X_VCU_CAN00_c82dd125_Tx
              PduRDestPduPduRBswModulesRef = CanIf
          VcuTxMsg2_oTC37X_VCU_CAN00_7fccfa8c_Tx: PduRRoutingPathCommunicationType=COMMUNICATION_INTERFACE
            PduRSrcPdu_69924b1b (PduRSrcPdu): PduRSourcePduHandleId=43, PduRSrcPduDirection=TRANSMIT, PduRSrcPduRef=VcuTxMsg2_oTC37X_VCU_CAN00_7fccfa8c_Tx, PduRSrcPduPduRBswModulesRef=Com
            VcuTxMsg2_oTC37X_VCU_CAN00_0119ca28_Tx (PduRDestPdu):
              PduRDestPduHandleId = 43
              PduRDestPduDirection = TRANSMIT
              PduRDestPduRoutingType = API_FORWARDING
              PduRDestPduDataProcessing = IMMEDIATE
              PduRPduLengthHandlingStrategy = IGNORE
              PduRDestPduCrossPartitionDestination = false
              PduRTransmissionConfirmation = false
              PduRDestPduDataProvision = PDUR_DIRECT
              PduRDestPduRef = VcuTxMsg2_oTC37X_VCU_CAN00_0119ca28_Tx
              PduRDestPduPduRBswModulesRef = CanIf
          VcuRxMsg2_oTC37X_VCU_CAN00_8cbda0e0_Rx: PduRRoutingPathCommunicationType=COMMUNICATION_INTERFACE
            PduRSrcPdu_803efadc (PduRSrcPdu): PduRSourcePduHandleId=36, PduRSrcPduDirection=RECEIVE, PduRSrcPduRef=VcuRxMsg2_oTC37X_VCU_CAN00_8cbda0e0_Rx, PduRSrcPduPduRBswModulesRef=CanIf
            VcuRxMsg2_oTC37X_VCU_CAN00_8cbda0e0_Rx_803efadc_Rx (PduRDestPdu):
              PduRDestPduHandleId = 36
              PduRDestPduDirection = RECEIVE
              PduRDestPduRoutingType = API_FORWARDING
              PduRDestPduDataProcessing = IMMEDIATE
              PduRPduLengthHandlingStrategy = IGNORE
              PduRDestPduCrossPartitionDestination = false
              PduRTransmissionConfirmation = false
              PduRDestPduRef = VcuRxMsg2_oTC37X_VCU_CAN00_920688f6_Rx
              PduRDestPduPduRBswModulesRef = Com
          Vcu_Uds_Func_Request_oTC37X_VCU_CAN00_455d4346_Rx: PduRRoutingPathCommunicationType=TRANSPORT_PROTOCOL
            PduRSrcPdu_4bac36fb (PduRSrcPdu):
              PduRSourcePduHandleId = 0
              PduRSrcPduDirection = RECEIVE
              PduRSrcPduRef = Vcu_Uds_Func_Request_oTC37X_VCU_CAN00_455d4346_Rx
              PduRSrcPduPduRBswModulesRef = CanTp
            Vcu_Uds_Func_Request_oTC37X_VCU_CAN00_455d4346_Rx_4bac36fb_Rx (PduRDestPdu):
              PduRDestPduHandleId = 0
              PduRDestPduDirection = RECEIVE
              PduRDestPduRoutingType = API_FORWARDING
              PduRDestPduDataProcessing = IMMEDIATE
              PduRPduLengthHandlingStrategy = UNUSED
              PduRDestPduCrossPartitionDestination = false
              PduRDestPduRef = Vcu_Uds_Func_Request_oTC37X_VCU_CAN00_21e26bac_Rx
              PduRDestPduPduRBswModulesRef = Dcm
          Vcu_Uds_Phy_Request_oTC37X_VCU_CAN00_16119f6f_Rx: PduRRoutingPathCommunicationType=TRANSPORT_PROTOCOL
            PduRSrcPdu_925fbf89 (PduRSrcPdu):
              PduRSourcePduHandleId = 1
              PduRSrcPduDirection = RECEIVE
              PduRSrcPduRef = Vcu_Uds_Phy_Request_oTC37X_VCU_CAN00_16119f6f_Rx
              PduRSrcPduPduRBswModulesRef = CanTp
            Vcu_Uds_Phy_Request_oTC37X_VCU_CAN00_16119f6f_Rx_925fbf89_Rx (PduRDestPdu):
              PduRDestPduHandleId = 1
              PduRDestPduDirection = RECEIVE
              PduRDestPduRoutingType = API_FORWARDING
              PduRDestPduDataProcessing = IMMEDIATE
              PduRPduLengthHandlingStrategy = UNUSED
              PduRDestPduCrossPartitionDestination = false
              PduRDestPduRef = Vcu_Uds_Phy_Request_oTC37X_VCU_CAN00_d561dcee_Rx
              PduRDestPduPduRBswModulesRef = Dcm
          Vcu_Uds_Response_oTC37X_VCU_CAN00_4d111be6_Tx: PduRRoutingPathCommunicationType=TRANSPORT_PROTOCOL
            Vcu_Uds_Response_oTC37X_VCU_CAN00_39638a1a_Tx (PduRDestPdu):
              PduRDestPduHandleId = 0
              PduRDestPduDirection = TRANSMIT
              PduRDestPduRoutingType = API_FORWARDING
              PduRDestPduDataProcessing = IMMEDIATE
              PduRPduLengthHandlingStrategy = UNUSED
              PduRDestPduCrossPartitionDestination = false
              PduRDestPduRef = Vcu_Uds_Response_oTC37X_VCU_CAN00_39638a1a_Tx
              PduRDestPduPduRBswModulesRef = CanTp
            PduRSrcPdu_1a8748e9 (PduRSrcPdu):
              PduRSourcePduHandleId = 48
              PduRSrcPduDirection = TRANSMIT
              PduRSrcPduRef = Vcu_Uds_Response_oTC37X_VCU_CAN00_4d111be6_Tx
              PduRSrcPduPduRBswModulesRef = Dcm
          VcuRxMsg4_oTC37X_VCU_CAN01_55be06ba_Rx: PduRRoutingPathCommunicationType=COMMUNICATION_INTERFACE
            VcuRxMsg4_oTC37X_VCU_CAN01_55be06ba_Rx_f5b46736_Rx (PduRDestPdu):
              PduRDestPduHandleId = 38
              PduRDestPduDirection = RECEIVE
              PduRDestPduRoutingType = API_FORWARDING
              PduRDestPduDataProcessing = IMMEDIATE
              PduRPduLengthHandlingStrategy = IGNORE
              PduRDestPduCrossPartitionDestination = false
              PduRTransmissionConfirmation = false
              PduRDestPduRef = VcuRxMsg4_oTC37X_VCU_CAN01_eb7d04e5_Rx
              PduRDestPduPduRBswModulesRef = Com
            PduRSrcPdu_f5b46736 (PduRSrcPdu): PduRSourcePduHandleId=38, PduRSrcPduDirection=RECEIVE, PduRSrcPduRef=VcuRxMsg4_oTC37X_VCU_CAN01_55be06ba_Rx, PduRSrcPduPduRBswModulesRef=CanIf
          VcuRxMsg3_oTC37X_VCU_CAN01_5bb4c01a_Rx: PduRRoutingPathCommunicationType=COMMUNICATION_INTERFACE
            PduRSrcPdu_3905054b (PduRSrcPdu): PduRSourcePduHandleId=37, PduRSrcPduDirection=RECEIVE, PduRSrcPduRef=VcuRxMsg3_oTC37X_VCU_CAN01_5bb4c01a_Rx, PduRSrcPduPduRBswModulesRef=CanIf
            VcuRxMsg3_oTC37X_VCU_CAN01_5bb4c01a_Rx_3905054b_Rx (PduRDestPdu):
              PduRDestPduHandleId = 37
              PduRDestPduDirection = RECEIVE
              PduRDestPduRoutingType = API_FORWARDING
              PduRDestPduDataProcessing = IMMEDIATE
              PduRPduLengthHandlingStrategy = IGNORE
              PduRDestPduCrossPartitionDestination = false
              PduRTransmissionConfirmation = false
              PduRDestPduRef = VcuRxMsg3_oTC37X_VCU_CAN01_0a530e81_Rx
              PduRDestPduPduRBswModulesRef = Com
          VcuTxIoMsg1_oTC37X_VCU_CAN00_54884add_Tx: PduRRoutingPathCommunicationType=COMMUNICATION_INTERFACE
            PduRSrcPdu_96b222db (PduRSrcPdu): PduRSourcePduHandleId=34, PduRSrcPduDirection=TRANSMIT, PduRSrcPduRef=VcuTxIoMsg1_oTC37X_VCU_CAN00_54884add_Tx, PduRSrcPduPduRBswModulesRef=Com
            VcuTxIoMsg1_oTC37X_VCU_CAN00_869e33bc_Tx (PduRDestPdu):
              PduRDestPduHandleId = 34
              PduRDestPduDirection = TRANSMIT
              PduRDestPduRoutingType = API_FORWARDING
              PduRDestPduDataProcessing = IMMEDIATE
              PduRPduLengthHandlingStrategy = IGNORE
              PduRDestPduCrossPartitionDestination = false
              PduRDestPduDataProvision = PDUR_DIRECT
              PduRTransmissionConfirmation = false
              PduRDestPduRef = VcuTxIoMsg1_oTC37X_VCU_CAN00_869e33bc_Tx
              PduRDestPduPduRBswModulesRef = CanIf
          VcuTxIoMsg2_oTC37X_VCU_CAN00_be0e97bf_Tx: PduRRoutingPathCommunicationType=COMMUNICATION_INTERFACE
            VcuTxIoMsg2_oTC37X_VCU_CAN00_4faa28b1_Tx (PduRDestPdu):
              PduRDestPduHandleId = 35
              PduRDestPduDirection = TRANSMIT
              PduRDestPduRoutingType = API_FORWARDING
              PduRDestPduDataProcessing = IMMEDIATE
              PduRPduLengthHandlingStrategy = IGNORE
              PduRDestPduCrossPartitionDestination = false
              PduRTransmissionConfirmation = false
              PduRDestPduDataProvision = PDUR_DIRECT
              PduRDestPduRef = VcuTxIoMsg2_oTC37X_VCU_CAN00_4faa28b1_Tx
              PduRDestPduPduRBswModulesRef = CanIf
            PduRSrcPdu_3ef2d11c (PduRSrcPdu): PduRSourcePduHandleId=35, PduRSrcPduDirection=TRANSMIT, PduRSrcPduRef=VcuTxIoMsg2_oTC37X_VCU_CAN00_be0e97bf_Tx, PduRSrcPduPduRBswModulesRef=Com
          VcuTxIoMsg4_oTC37X_VCU_CAN00_b0722b3a_Tx: PduRRoutingPathCommunicationType=COMMUNICATION_INTERFACE
            VcuTxIoMsg4_oTC37X_VCU_CAN00_06b318ea_Tx (PduRDestPdu):
              PduRDestPduHandleId = 37
              PduRDestPduDirection = TRANSMIT
              PduRDestPduRoutingType = API_FORWARDING
              PduRDestPduDataProcessing = IMMEDIATE
              PduRPduLengthHandlingStrategy = IGNORE
              PduRDestPduCrossPartitionDestination = false
              PduRDestPduDataProvision = PDUR_DIRECT
              PduRTransmissionConfirmation = false
              PduRDestPduRef = VcuTxIoMsg4_oTC37X_VCU_CAN00_06b318ea_Tx
              PduRDestPduPduRBswModulesRef = CanIf
            PduRSrcPdu_15ef524a (PduRSrcPdu): PduRSourcePduHandleId=37, PduRSrcPduDirection=TRANSMIT, PduRSrcPduRef=VcuTxIoMsg4_oTC37X_VCU_CAN00_b0722b3a_Tx, PduRSrcPduPduRBswModulesRef=Com
          VcuTxIoMsg6_oTC37X_VCU_CAN00_b5a640b9_Tx: PduRRoutingPathCommunicationType=COMMUNICATION_INTERFACE
            VcuTxIoMsg6_oTC37X_VCU_CAN00_8894f51c_Tx (PduRDestPdu):
              PduRDestPduHandleId = 39
              PduRDestPduDirection = TRANSMIT
              PduRDestPduRoutingType = API_FORWARDING
              PduRDestPduDataProcessing = IMMEDIATE
              PduRPduLengthHandlingStrategy = IGNORE
              PduRDestPduCrossPartitionDestination = false
              PduRTransmissionConfirmation = false
              PduRDestPduDataProvision = PDUR_DIRECT
              PduRDestPduRef = VcuTxIoMsg6_oTC37X_VCU_CAN00_8894f51c_Tx
              PduRDestPduPduRBswModulesRef = CanIf
            PduRSrcPdu_275934e8 (PduRSrcPdu): PduRSourcePduHandleId=39, PduRSrcPduDirection=TRANSMIT, PduRSrcPduRef=VcuTxIoMsg6_oTC37X_VCU_CAN00_b5a640b9_Tx, PduRSrcPduPduRBswModulesRef=Com
          VcuTxIoMsg5_oTC37X_VCU_CAN00_5f209ddb_Tx: PduRRoutingPathCommunicationType=COMMUNICATION_INTERFACE
            VcuTxIoMsg5_oTC37X_VCU_CAN00_41a0ee11_Tx (PduRDestPdu):
              PduRDestPduHandleId = 38
              PduRDestPduDirection = TRANSMIT
              PduRDestPduRoutingType = API_FORWARDING
              PduRDestPduDataProcessing = IMMEDIATE
              PduRPduLengthHandlingStrategy = IGNORE
              PduRDestPduCrossPartitionDestination = false
              PduRDestPduDataProvision = PDUR_DIRECT
              PduRTransmissionConfirmation = false
              PduRDestPduRef = VcuTxIoMsg5_oTC37X_VCU_CAN00_41a0ee11_Tx
              PduRDestPduPduRBswModulesRef = CanIf
            PduRSrcPdu_886ac60a (PduRSrcPdu): PduRSourcePduHandleId=38, PduRSrcPduDirection=TRANSMIT, PduRSrcPduRef=VcuTxIoMsg5_oTC37X_VCU_CAN00_5f209ddb_Tx, PduRSrcPduPduRBswModulesRef=Com
          VcuTxIoMsg3_oTC37X_VCU_CAN00_515c215e_Tx: PduRRoutingPathCommunicationType=COMMUNICATION_INTERFACE
            PduRSrcPdu_23c89b9b (PduRSrcPdu): PduRSourcePduHandleId=36, PduRSrcPduDirection=TRANSMIT, PduRSrcPduRef=VcuTxIoMsg3_oTC37X_VCU_CAN00_515c215e_Tx, PduRSrcPduPduRBswModulesRef=Com
            VcuTxIoMsg3_oTC37X_VCU_CAN00_08b9de4a_Tx (PduRDestPdu):
              PduRDestPduHandleId = 36
              PduRDestPduDirection = TRANSMIT
              PduRDestPduRoutingType = API_FORWARDING
              PduRDestPduDataProcessing = IMMEDIATE
              PduRPduLengthHandlingStrategy = IGNORE
              PduRDestPduCrossPartitionDestination = false
              PduRDestPduDataProvision = PDUR_DIRECT
              PduRTransmissionConfirmation = false
              PduRDestPduRef = VcuTxIoMsg3_oTC37X_VCU_CAN00_08b9de4a_Tx
              PduRDestPduPduRBswModulesRef = CanIf
          VcuTxIoMsg8_oTC37X_VCU_CAN00_ac8b5230_Tx: PduRRoutingPathCommunicationType=COMMUNICATION_INTERFACE
            PduRSrcPdu_27dcf988 (PduRSrcPdu): PduRSourcePduHandleId=41, PduRSrcPduDirection=TRANSMIT, PduRSrcPduRef=VcuTxIoMsg8_oTC37X_VCU_CAN00_ac8b5230_Tx, PduRSrcPduPduRBswModulesRef=Com
            VcuTxIoMsg8_oTC37X_VCU_CAN00_9481785c_Tx (PduRDestPdu):
              PduRDestPduHandleId = 41
              PduRDestPduDirection = TRANSMIT
              PduRDestPduRoutingType = API_FORWARDING
              PduRDestPduDataProcessing = IMMEDIATE
              PduRPduLengthHandlingStrategy = IGNORE
              PduRDestPduCrossPartitionDestination = false
              PduRDestPduDataProvision = PDUR_DIRECT
              PduRTransmissionConfirmation = false
              PduRDestPduRef = VcuTxIoMsg8_oTC37X_VCU_CAN00_9481785c_Tx
              PduRDestPduPduRBswModulesRef = CanIf
          VcuTxIoMsg7_oTC37X_VCU_CAN00_5af4f658_Tx: PduRRoutingPathCommunicationType=COMMUNICATION_INTERFACE
            VcuTxIoMsg7_oTC37X_VCU_CAN00_cf8703e7_Tx (PduRDestPdu):
              PduRDestPduHandleId = 40
              PduRDestPduDirection = TRANSMIT
              PduRDestPduRoutingType = API_FORWARDING
              PduRDestPduDataProcessing = IMMEDIATE
              PduRPduLengthHandlingStrategy = IGNORE
              PduRDestPduCrossPartitionDestination = false
              PduRDestPduDataProvision = PDUR_DIRECT
              PduRTransmissionConfirmation = false
              PduRDestPduRef = VcuTxIoMsg7_oTC37X_VCU_CAN00_cf8703e7_Tx
              PduRDestPduPduRBswModulesRef = CanIf
            PduRSrcPdu_8c9b3cfc (PduRSrcPdu): PduRSourcePduHandleId=40, PduRSrcPduDirection=TRANSMIT, PduRSrcPduRef=VcuTxIoMsg7_oTC37X_VCU_CAN00_5af4f658_Tx, PduRSrcPduPduRBswModulesRef=Com
          PMP3_Sts_oLIN00_4e808b3d_Rx: PduRRoutingPathCommunicationType=COMMUNICATION_INTERFACE
            PMP3_Sts_oLIN00_4e808b3d_Rx_43cea622_Rx (PduRDestPdu):
              PduRDestPduHandleId = 25
              PduRDestPduDirection = RECEIVE
              PduRDestPduRoutingType = API_FORWARDING
              PduRDestPduDataProcessing = IMMEDIATE
              PduRPduLengthHandlingStrategy = IGNORE
              PduRDestPduCrossPartitionDestination = false
              PduRTransmissionConfirmation = false
              PduRDestPduRef = PMP3_Sts_oLIN00_511c4704_Rx
              PduRDestPduPduRBswModulesRef = Com
            PduRSrcPdu_43cea622 (PduRSrcPdu): PduRSourcePduHandleId=25, PduRSrcPduDirection=RECEIVE, PduRSrcPduRef=PMP3_Sts_oLIN00_4e808b3d_Rx, PduRSrcPduPduRBswModulesRef=LinIf
          EXV_2_VCU_oLIN00_85f64a15_Rx: PduRRoutingPathCommunicationType=COMMUNICATION_INTERFACE
            PduRSrcPdu_b894d38e (PduRSrcPdu): PduRSourcePduHandleId=10, PduRSrcPduDirection=RECEIVE, PduRSrcPduRef=EXV_2_VCU_oLIN00_85f64a15_Rx, PduRSrcPduPduRBswModulesRef=LinIf
            EXV_2_VCU_oLIN00_85f64a15_Rx_b894d38e_Rx (PduRDestPdu):
              PduRDestPduHandleId = 10
              PduRDestPduDirection = RECEIVE
              PduRDestPduRoutingType = API_FORWARDING
              PduRDestPduDataProcessing = IMMEDIATE
              PduRPduLengthHandlingStrategy = IGNORE
              PduRDestPduCrossPartitionDestination = false
              PduRTransmissionConfirmation = false
              PduRDestPduRef = EXV_2_VCU_oLIN00_1e4a3daf_Rx
              PduRDestPduPduRBswModulesRef = Com
          PMP_Cmd_oLIN00_3912b28b_Tx: PduRRoutingPathCommunicationType=COMMUNICATION_INTERFACE
            PduRSrcPdu_4bd8719a (PduRSrcPdu): PduRSourcePduHandleId=1, PduRSrcPduDirection=TRANSMIT, PduRSrcPduRef=PMP_Cmd_oLIN00_3912b28b_Tx, PduRSrcPduPduRBswModulesRef=Com
            PMP_Cmd_oLIN00_6d889c97_Tx (PduRDestPdu):
              PduRDestPduHandleId = 1
              PduRDestPduDirection = TRANSMIT
              PduRDestPduRoutingType = API_FORWARDING
              PduRDestPduDataProcessing = IMMEDIATE
              PduRPduLengthHandlingStrategy = IGNORE
              PduRDestPduCrossPartitionDestination = false
              PduRDestPduDataProvision = PDUR_TRIGGERTRANSMIT
              PduRTransmissionConfirmation = false
              PduRDestPduRef = PMP_Cmd_oLIN00_6d889c97_Tx
              PduRDestPduPduRBswModulesRef = LinIf
          EXV2_Status_oLIN00_7fcf9f75_Rx: PduRRoutingPathCommunicationType=COMMUNICATION_INTERFACE
            EXV2_Status_oLIN00_7fcf9f75_Rx_c3f2be6b_Rx (PduRDestPdu):
              PduRDestPduHandleId = 8
              PduRDestPduDirection = RECEIVE
              PduRDestPduRoutingType = API_FORWARDING
              PduRDestPduDataProcessing = IMMEDIATE
              PduRPduLengthHandlingStrategy = IGNORE
              PduRDestPduCrossPartitionDestination = false
              PduRTransmissionConfirmation = false
              PduRDestPduRef = EXV2_Status_oLIN00_d5e93929_Rx
              PduRDestPduPduRBswModulesRef = Com
            PduRSrcPdu_c3f2be6b (PduRSrcPdu): PduRSourcePduHandleId=8, PduRSrcPduDirection=RECEIVE, PduRSrcPduRef=EXV2_Status_oLIN00_7fcf9f75_Rx, PduRSrcPduPduRBswModulesRef=LinIf
          SVA_VCU_STD_oLIN00_4f0795ef_Rx: PduRRoutingPathCommunicationType=COMMUNICATION_INTERFACE
            PduRSrcPdu_166cd16c (PduRSrcPdu): PduRSourcePduHandleId=27, PduRSrcPduDirection=RECEIVE, PduRSrcPduRef=SVA_VCU_STD_oLIN00_4f0795ef_Rx, PduRSrcPduPduRBswModulesRef=LinIf
            SVA_VCU_STD_oLIN00_4f0795ef_Rx_166cd16c_Rx (PduRDestPdu):
              PduRDestPduHandleId = 27
              PduRDestPduDirection = RECEIVE
              PduRDestPduRoutingType = API_FORWARDING
              PduRDestPduDataProcessing = IMMEDIATE
              PduRPduLengthHandlingStrategy = IGNORE
              PduRDestPduCrossPartitionDestination = false
              PduRTransmissionConfirmation = false
              PduRDestPduRef = SVA_VCU_STD_oLIN00_4526aa1c_Rx
              PduRDestPduPduRBswModulesRef = Com
          HVCH_Rsp02_oLIN00_a3ea669e_Rx: PduRRoutingPathCommunicationType=COMMUNICATION_INTERFACE
            HVCH_Rsp02_oLIN00_a3ea669e_Rx_90a9658c_Rx (PduRDestPdu):
              PduRDestPduHandleId = 12
              PduRDestPduDirection = RECEIVE
              PduRDestPduRoutingType = API_FORWARDING
              PduRDestPduDataProcessing = IMMEDIATE
              PduRPduLengthHandlingStrategy = IGNORE
              PduRDestPduCrossPartitionDestination = false
              PduRTransmissionConfirmation = false
              PduRDestPduRef = HVCH_Rsp02_oLIN00_286c390c_Rx
              PduRDestPduPduRBswModulesRef = Com
            PduRSrcPdu_90a9658c (PduRSrcPdu): PduRSourcePduHandleId=12, PduRSrcPduDirection=RECEIVE, PduRSrcPduRef=HVCH_Rsp02_oLIN00_a3ea669e_Rx, PduRSrcPduPduRBswModulesRef=LinIf
          VCU_EXV_1_oLIN00_50eec975_Tx: PduRRoutingPathCommunicationType=COMMUNICATION_INTERFACE
            PduRSrcPdu_91ca29f5 (PduRSrcPdu): PduRSourcePduHandleId=9, PduRSrcPduDirection=TRANSMIT, PduRSrcPduRef=VCU_EXV_1_oLIN00_50eec975_Tx, PduRSrcPduPduRBswModulesRef=Com
            VCU_EXV_1_oLIN00_58a890ac_Tx (PduRDestPdu):
              PduRDestPduHandleId = 9
              PduRDestPduDirection = TRANSMIT
              PduRDestPduRoutingType = API_FORWARDING
              PduRDestPduDataProcessing = IMMEDIATE
              PduRPduLengthHandlingStrategy = IGNORE
              PduRDestPduCrossPartitionDestination = false
              PduRDestPduDataProvision = PDUR_TRIGGERTRANSMIT
              PduRTransmissionConfirmation = false
              PduRDestPduRef = VCU_EXV_1_oLIN00_58a890ac_Tx
              PduRDestPduPduRBswModulesRef = LinIf
          VCU_SVA_CMD_oLIN00_756d14f6_Tx: PduRRoutingPathCommunicationType=COMMUNICATION_INTERFACE
            PduRSrcPdu_b06eca36 (PduRSrcPdu): PduRSourcePduHandleId=16, PduRSrcPduDirection=TRANSMIT, PduRSrcPduRef=VCU_SVA_CMD_oLIN00_756d14f6_Tx, PduRSrcPduPduRBswModulesRef=Com
            VCU_SVA_CMD_oLIN00_89e2bb7b_Tx (PduRDestPdu):
              PduRDestPduHandleId = 16
              PduRDestPduDirection = TRANSMIT
              PduRDestPduRoutingType = API_FORWARDING
              PduRDestPduDataProcessing = IMMEDIATE
              PduRPduLengthHandlingStrategy = IGNORE
              PduRDestPduCrossPartitionDestination = false
              PduRDestPduDataProvision = PDUR_TRIGGERTRANSMIT
              PduRTransmissionConfirmation = false
              PduRDestPduRef = VCU_SVA_CMD_oLIN00_89e2bb7b_Tx
              PduRDestPduPduRBswModulesRef = LinIf
          HVCH_Rsp01_oLIN00_d50f5fa3_Rx: PduRRoutingPathCommunicationType=COMMUNICATION_INTERFACE
            HVCH_Rsp01_oLIN00_d50f5fa3_Rx_aa2a3f7d_Rx (PduRDestPdu):
              PduRDestPduHandleId = 11
              PduRDestPduDirection = RECEIVE
              PduRDestPduRoutingType = API_FORWARDING
              PduRDestPduDataProcessing = IMMEDIATE
              PduRPduLengthHandlingStrategy = IGNORE
              PduRDestPduCrossPartitionDestination = false
              PduRTransmissionConfirmation = false
              PduRDestPduRef = HVCH_Rsp01_oLIN00_a6e33eef_Rx
              PduRDestPduPduRBswModulesRef = Com
            PduRSrcPdu_aa2a3f7d (PduRSrcPdu): PduRSourcePduHandleId=11, PduRSrcPduDirection=RECEIVE, PduRSrcPduRef=HVCH_Rsp01_oLIN00_d50f5fa3_Rx, PduRSrcPduPduRBswModulesRef=LinIf
          EXV_1_VCU_oLIN00_366267d6_Rx: PduRRoutingPathCommunicationType=COMMUNICATION_INTERFACE
            EXV_1_VCU_oLIN00_366267d6_Rx_718a1cfb_Rx (PduRDestPdu):
              PduRDestPduHandleId = 9
              PduRDestPduDirection = RECEIVE
              PduRDestPduRoutingType = API_FORWARDING
              PduRDestPduDataProcessing = IMMEDIATE
              PduRPduLengthHandlingStrategy = IGNORE
              PduRDestPduCrossPartitionDestination = false
              PduRTransmissionConfirmation = false
              PduRDestPduRef = EXV_1_VCU_oLIN00_69d4ef5f_Rx
              PduRDestPduPduRBswModulesRef = Com
            PduRSrcPdu_718a1cfb (PduRSrcPdu): PduRSourcePduHandleId=9, PduRSrcPduDirection=RECEIVE, PduRSrcPduRef=EXV_1_VCU_oLIN00_366267d6_Rx, PduRSrcPduPduRBswModulesRef=LinIf
          PMP2_Sts_oLIN00_200c907c_Rx: PduRRoutingPathCommunicationType=COMMUNICATION_INTERFACE
            PduRSrcPdu_9a742e46 (PduRSrcPdu): PduRSourcePduHandleId=24, PduRSrcPduDirection=RECEIVE, PduRSrcPduRef=PMP2_Sts_oLIN00_200c907c_Rx, PduRSrcPduPduRBswModulesRef=LinIf
            PMP2_Sts_oLIN00_200c907c_Rx_9a742e46_Rx (PduRDestPdu):
              PduRDestPduHandleId = 24
              PduRDestPduDirection = RECEIVE
              PduRDestPduRoutingType = API_FORWARDING
              PduRDestPduDataProcessing = IMMEDIATE
              PduRPduLengthHandlingStrategy = IGNORE
              PduRDestPduCrossPartitionDestination = false
              PduRTransmissionConfirmation = false
              PduRDestPduRef = PMP2_Sts_oLIN00_cab90b6b_Rx
              PduRDestPduPduRBswModulesRef = Com
          TCU_HVCH_Cmd_oLIN00_385d5651_Tx: PduRRoutingPathCommunicationType=COMMUNICATION_INTERFACE
            TCU_HVCH_Cmd_oLIN00_ddc31229_Tx (PduRDestPdu):
              PduRDestPduHandleId = 2
              PduRDestPduDirection = TRANSMIT
              PduRDestPduRoutingType = API_FORWARDING
              PduRDestPduDataProcessing = IMMEDIATE
              PduRPduLengthHandlingStrategy = IGNORE
              PduRDestPduCrossPartitionDestination = false
              PduRDestPduDataProvision = PDUR_TRIGGERTRANSMIT
              PduRTransmissionConfirmation = false
              PduRDestPduRef = TCU_HVCH_Cmd_oLIN00_ddc31229_Tx
              PduRDestPduPduRBswModulesRef = LinIf
            PduRSrcPdu_6a17111c (PduRSrcPdu): PduRSourcePduHandleId=2, PduRSrcPduDirection=TRANSMIT, PduRSrcPduRef=TCU_HVCH_Cmd_oLIN00_385d5651_Tx, PduRSrcPduPduRBswModulesRef=Com
          EDCU_EXV2_oLIN00_1f8750a5_Tx: PduRRoutingPathCommunicationType=COMMUNICATION_INTERFACE
            EDCU_EXV2_oLIN00_18b050dc_Tx (PduRDestPdu):
              PduRDestPduHandleId = 0
              PduRDestPduDirection = TRANSMIT
              PduRDestPduRoutingType = API_FORWARDING
              PduRDestPduDataProcessing = IMMEDIATE
              PduRPduLengthHandlingStrategy = IGNORE
              PduRDestPduCrossPartitionDestination = false
              PduRDestPduDataProvision = PDUR_TRIGGERTRANSMIT
              PduRTransmissionConfirmation = false
              PduRDestPduRef = EDCU_EXV2_oLIN00_18b050dc_Tx
              PduRDestPduPduRBswModulesRef = LinIf
            PduRSrcPdu_0361509d (PduRSrcPdu): PduRSourcePduHandleId=0, PduRSrcPduDirection=TRANSMIT, PduRSrcPduRef=EDCU_EXV2_oLIN00_1f8750a5_Tx, PduRSrcPduPduRBswModulesRef=Com
          VCU_EXV_2_oLIN00_de61ce96_Tx: PduRRoutingPathCommunicationType=COMMUNICATION_INTERFACE
            PduRSrcPdu_9414725b (PduRSrcPdu): PduRSourcePduHandleId=10, PduRSrcPduDirection=TRANSMIT, PduRSrcPduRef=VCU_EXV_2_oLIN00_de61ce96_Tx, PduRSrcPduPduRBswModulesRef=Com
            VCU_EXV_2_oLIN00_2e4da991_Tx (PduRDestPdu):
              PduRDestPduHandleId = 10
              PduRDestPduDirection = TRANSMIT
              PduRDestPduRoutingType = API_FORWARDING
              PduRDestPduDataProcessing = IMMEDIATE
              PduRPduLengthHandlingStrategy = IGNORE
              PduRDestPduCrossPartitionDestination = false
              PduRDestPduDataProvision = PDUR_TRIGGERTRANSMIT
              PduRTransmissionConfirmation = false
              PduRDestPduRef = VCU_EXV_2_oLIN00_2e4da991_Tx
              PduRDestPduPduRBswModulesRef = LinIf
          VcuCan12TxMsg2_oTC37X_VCU_CAN12_3a1dfcb9_Tx: PduRRoutingPathCommunicationType=COMMUNICATION_INTERFACE
            VcuCan12TxMsg2_oTC37X_VCU_CAN12_e5a6e89d_Tx (PduRDestPdu):
              PduRDestPduHandleId = 32
              PduRDestPduDirection = TRANSMIT
              PduRDestPduRoutingType = API_FORWARDING
              PduRDestPduDataProcessing = IMMEDIATE
              PduRPduLengthHandlingStrategy = IGNORE
              PduRDestPduCrossPartitionDestination = false
              PduRDestPduDataProvision = PDUR_DIRECT
              PduRTransmissionConfirmation = false
              PduRDestPduRef = VcuCan12TxMsg2_oTC37X_VCU_CAN12_e5a6e89d_Tx
              PduRDestPduPduRBswModulesRef = CanIf
            PduRSrcPdu_573a7055 (PduRSrcPdu): PduRSourcePduHandleId=32, PduRSrcPduDirection=TRANSMIT, PduRSrcPduRef=VcuCan12TxMsg2_oTC37X_VCU_CAN12_3a1dfcb9_Tx, PduRSrcPduPduRBswModulesRef=Com
          VcuCan12RxMsg3_oTC37X_VCU_CAN12_2f1174ae_Rx: PduRRoutingPathCommunicationType=COMMUNICATION_INTERFACE
            PduRSrcPdu_9d116735 (PduRSrcPdu):
              PduRSourcePduHandleId = 30
              PduRSrcPduDirection = RECEIVE
              PduRSrcPduRef = VcuCan12RxMsg3_oTC37X_VCU_CAN12_2f1174ae_Rx
              PduRSrcPduPduRBswModulesRef = CanIf
            VcuCan12RxMsg3_oTC37X_VCU_CAN12_2f1174ae_Rx_9d116735_Rx (PduRDestPdu):
              PduRDestPduHandleId = 30
              PduRDestPduDirection = RECEIVE
              PduRDestPduRoutingType = API_FORWARDING
              PduRDestPduDataProcessing = IMMEDIATE
              PduRPduLengthHandlingStrategy = IGNORE
              PduRDestPduCrossPartitionDestination = false
              PduRTransmissionConfirmation = false
              PduRDestPduRef = VcuCan12RxMsg3_oTC37X_VCU_CAN12_38853822_Rx
              PduRDestPduPduRBswModulesRef = Com
          VcuCan12RxMsg4_oTC37X_VCU_CAN12_211bb20e_Rx: PduRRoutingPathCommunicationType=COMMUNICATION_INTERFACE
            PduRSrcPdu_0a95646f (PduRSrcPdu):
              PduRSourcePduHandleId = 31
              PduRSrcPduDirection = RECEIVE
              PduRSrcPduRef = VcuCan12RxMsg4_oTC37X_VCU_CAN12_211bb20e_Rx
              PduRSrcPduPduRBswModulesRef = CanIf
            VcuCan12RxMsg4_oTC37X_VCU_CAN12_211bb20e_Rx_0a95646f_Rx (PduRDestPdu):
              PduRDestPduHandleId = 31
              PduRDestPduDirection = RECEIVE
              PduRDestPduRoutingType = API_FORWARDING
              PduRDestPduDataProcessing = IMMEDIATE
              PduRPduLengthHandlingStrategy = IGNORE
              PduRDestPduCrossPartitionDestination = false
              PduRTransmissionConfirmation = false
              PduRDestPduRef = VcuCan12RxMsg4_oTC37X_VCU_CAN12_d9ab3246_Rx
              PduRDestPduPduRBswModulesRef = Com
          VcuCan12TxMsg1_oTC37X_VCU_CAN12_d09b21db_Tx: PduRRoutingPathCommunicationType=COMMUNICATION_INTERFACE
            VcuCan12TxMsg1_oTC37X_VCU_CAN12_2c92f390_Tx (PduRDestPdu):
              PduRDestPduHandleId = 31
              PduRDestPduDirection = TRANSMIT
              PduRDestPduRoutingType = API_FORWARDING
              PduRDestPduDataProcessing = IMMEDIATE
              PduRPduLengthHandlingStrategy = IGNORE
              PduRDestPduCrossPartitionDestination = false
              PduRTransmissionConfirmation = false
              PduRDestPduDataProvision = PDUR_DIRECT
              PduRDestPduRef = VcuCan12TxMsg1_oTC37X_VCU_CAN12_2c92f390_Tx
              PduRDestPduPduRBswModulesRef = CanIf
            PduRSrcPdu_6cefc258 (PduRSrcPdu): PduRSourcePduHandleId=31, PduRSrcPduDirection=TRANSMIT, PduRSrcPduRef=VcuCan12TxMsg1_oTC37X_VCU_CAN12_d09b21db_Tx, PduRSrcPduPduRBswModulesRef=Com
          VcuCan03RxMsg2_oTC37X_VCU_CAN03_84e608b6_Rx: PduRRoutingPathCommunicationType=COMMUNICATION_INTERFACE
            VcuCan03RxMsg2_oTC37X_VCU_CAN03_84e608b6_Rx_a2204cbf_Rx (PduRDestPdu):
              PduRDestPduHandleId = 29
              PduRDestPduDirection = RECEIVE
              PduRDestPduRoutingType = API_FORWARDING
              PduRDestPduDataProcessing = IMMEDIATE
              PduRPduLengthHandlingStrategy = IGNORE
              PduRDestPduCrossPartitionDestination = false
              PduRTransmissionConfirmation = false
              PduRDestPduRef = VcuCan03RxMsg2_oTC37X_VCU_CAN03_9d657a3d_Rx
              PduRDestPduPduRBswModulesRef = Com
            PduRSrcPdu_a2204cbf (PduRSrcPdu):
              PduRSourcePduHandleId = 29
              PduRSrcPduDirection = RECEIVE
              PduRSrcPduRef = VcuCan03RxMsg2_oTC37X_VCU_CAN03_84e608b6_Rx
              PduRSrcPduPduRBswModulesRef = CanIf
          VcuCan03TxMsg2_oTC37X_VCU_CAN03_70af0847_Tx: PduRRoutingPathCommunicationType=COMMUNICATION_INTERFACE
            PduRSrcPdu_a59b3a32 (PduRSrcPdu): PduRSourcePduHandleId=30, PduRSrcPduDirection=TRANSMIT, PduRSrcPduRef=VcuCan03TxMsg2_oTC37X_VCU_CAN03_70af0847_Tx, PduRSrcPduPduRBswModulesRef=Com
            VcuCan03TxMsg2_oTC37X_VCU_CAN03_0942627e_Tx (PduRDestPdu):
              PduRDestPduHandleId = 30
              PduRDestPduDirection = TRANSMIT
              PduRDestPduRoutingType = API_FORWARDING
              PduRDestPduDataProcessing = IMMEDIATE
              PduRPduLengthHandlingStrategy = IGNORE
              PduRDestPduCrossPartitionDestination = false
              PduRDestPduDataProvision = PDUR_DIRECT
              PduRTransmissionConfirmation = false
              PduRDestPduRef = VcuCan03TxMsg2_oTC37X_VCU_CAN03_0942627e_Tx
              PduRDestPduPduRBswModulesRef = CanIf
          VcuCan03RxMsg1_oTC37X_VCU_CAN03_4dd213bb_Rx: PduRRoutingPathCommunicationType=COMMUNICATION_INTERFACE
            PduRSrcPdu_4e610413 (PduRSrcPdu):
              PduRSourcePduHandleId = 28
              PduRSrcPduDirection = RECEIVE
              PduRSrcPduRef = VcuCan03RxMsg1_oTC37X_VCU_CAN03_4dd213bb_Rx
              PduRSrcPduPduRBswModulesRef = CanIf
            VcuCan03RxMsg1_oTC37X_VCU_CAN03_4dd213bb_Rx_4e610413_Rx (PduRDestPdu):
              PduRDestPduHandleId = 28
              PduRDestPduDirection = RECEIVE
              PduRDestPduRoutingType = API_FORWARDING
              PduRDestPduDataProcessing = IMMEDIATE
              PduRPduLengthHandlingStrategy = IGNORE
              PduRDestPduCrossPartitionDestination = false
              PduRTransmissionConfirmation = false
              PduRDestPduRef = VcuCan03RxMsg1_oTC37X_VCU_CAN03_77e3a75f_Rx
              PduRDestPduPduRBswModulesRef = Com
          VcuCan03TxMsg1_oTC37X_VCU_CAN03_9a29d525_Tx: PduRRoutingPathCommunicationType=COMMUNICATION_INTERFACE
            VcuCan03TxMsg1_oTC37X_VCU_CAN03_c0767973_Tx (PduRDestPdu):
              PduRDestPduHandleId = 29
              PduRDestPduDirection = TRANSMIT
              PduRDestPduRoutingType = API_FORWARDING
              PduRDestPduDataProcessing = IMMEDIATE
              PduRPduLengthHandlingStrategy = IGNORE
              PduRDestPduCrossPartitionDestination = false
              PduRDestPduDataProvision = PDUR_DIRECT
              PduRTransmissionConfirmation = false
              PduRDestPduRef = VcuCan03TxMsg1_oTC37X_VCU_CAN03_c0767973_Tx
              PduRDestPduPduRBswModulesRef = CanIf
            PduRSrcPdu_6c0ea6d2 (PduRSrcPdu): PduRSourcePduHandleId=29, PduRSrcPduDirection=TRANSMIT, PduRSrcPduRef=VcuCan03TxMsg1_oTC37X_VCU_CAN03_9a29d525_Tx, PduRSrcPduPduRBswModulesRef=Com
          Vcu_Lin0_RxMsg2_oLIN01_717e4d45_Rx: PduRRoutingPathCommunicationType=COMMUNICATION_INTERFACE
            PduRSrcPdu_d314568e (PduRSrcPdu): PduRSourcePduHandleId=40, PduRSrcPduDirection=RECEIVE, PduRSrcPduRef=Vcu_Lin0_RxMsg2_oLIN01_717e4d45_Rx, PduRSrcPduPduRBswModulesRef=LinIf
            Vcu_Lin0_RxMsg2_oLIN01_717e4d45_Rx_d314568e_Rx (PduRDestPdu):
              PduRDestPduHandleId = 40
              PduRDestPduDirection = RECEIVE
              PduRDestPduRoutingType = API_FORWARDING
              PduRDestPduDataProcessing = IMMEDIATE
              PduRPduLengthHandlingStrategy = IGNORE
              PduRDestPduCrossPartitionDestination = false
              PduRTransmissionConfirmation = false
              PduRDestPduRef = Vcu_Lin0_RxMsg2_oLIN01_aaf70b87_Rx
              PduRDestPduPduRBswModulesRef = Com
          Vcu_Lin0_TxMsg2_oLIN01_0a12d45a_Tx: PduRRoutingPathCommunicationType=COMMUNICATION_INTERFACE
            Vcu_Lin0_TxMsg2_oLIN01_74c2430b_Tx (PduRDestPdu):
              PduRDestPduHandleId = 45
              PduRDestPduDirection = TRANSMIT
              PduRDestPduRoutingType = API_FORWARDING
              PduRDestPduDataProcessing = IMMEDIATE
              PduRPduLengthHandlingStrategy = IGNORE
              PduRDestPduCrossPartitionDestination = false
              PduRDestPduDataProvision = PDUR_TRIGGERTRANSMIT
              PduRTransmissionConfirmation = false
              PduRDestPduRef = Vcu_Lin0_TxMsg2_oLIN01_74c2430b_Tx
              PduRDestPduPduRBswModulesRef = LinIf
            PduRSrcPdu_0417dd35 (PduRSrcPdu): PduRSourcePduHandleId=45, PduRSrcPduDirection=TRANSMIT, PduRSrcPduRef=Vcu_Lin0_TxMsg2_oLIN01_0a12d45a_Tx, PduRSrcPduPduRBswModulesRef=Com
          Vcu_Lin0_TxMsg1_oLIN01_849dd3b9_Tx: PduRRoutingPathCommunicationType=COMMUNICATION_INTERFACE
            PduRSrcPdu_ff5e60c1 (PduRSrcPdu): PduRSourcePduHandleId=44, PduRSrcPduDirection=TRANSMIT, PduRSrcPduRef=Vcu_Lin0_TxMsg1_oLIN01_849dd3b9_Tx, PduRSrcPduPduRBswModulesRef=Com
            Vcu_Lin0_TxMsg1_oLIN01_02277a36_Tx (PduRDestPdu):
              PduRDestPduHandleId = 44
              PduRDestPduDirection = TRANSMIT
              PduRDestPduRoutingType = API_FORWARDING
              PduRDestPduDataProcessing = IMMEDIATE
              PduRPduLengthHandlingStrategy = IGNORE
              PduRDestPduCrossPartitionDestination = false
              PduRTransmissionConfirmation = false
              PduRDestPduDataProvision = PDUR_TRIGGERTRANSMIT
              PduRDestPduRef = Vcu_Lin0_TxMsg1_oLIN01_02277a36_Tx
              PduRDestPduPduRBswModulesRef = LinIf
          Vcu_Lin0_RxMsg1_oLIN01_079b7478_Rx: PduRRoutingPathCommunicationType=COMMUNICATION_INTERFACE
            Vcu_Lin0_RxMsg1_oLIN01_079b7478_Rx_12331c6c_Rx (PduRDestPdu):
              PduRDestPduHandleId = 39
              PduRDestPduDirection = RECEIVE
              PduRDestPduRoutingType = API_FORWARDING
              PduRDestPduDataProcessing = IMMEDIATE
              PduRPduLengthHandlingStrategy = IGNORE
              PduRDestPduCrossPartitionDestination = false
              PduRTransmissionConfirmation = false
              PduRDestPduRef = Vcu_Lin0_RxMsg1_oLIN01_24780c64_Rx
              PduRDestPduPduRBswModulesRef = Com
            PduRSrcPdu_12331c6c (PduRSrcPdu): PduRSourcePduHandleId=39, PduRSrcPduDirection=RECEIVE, PduRSrcPduRef=Vcu_Lin0_RxMsg1_oLIN01_079b7478_Rx, PduRSrcPduPduRBswModulesRef=LinIf
          VCU_HMIsignals_02_oATOM_CANFD_Matrix_CH_V600_202502_7949a1d5_Tx: PduRRoutingPathCommunicationType=COMMUNICATION_INTERFACE
            PduRSrcPdu_108c7515 (PduRSrcPdu):
              PduRSourcePduHandleId = 12
              PduRSrcPduDirection = TRANSMIT
              PduRSrcPduRef = VCU_HMIsignals_02_oATOM_CANFD_Matrix_CH_V600_202502_7949a1d5_Tx
              PduRSrcPduPduRBswModulesRef = Com
            VCU_HMIsignals_02_oATOM_CANFD_Matrix_CH_V600_202502_343b3975_Tx (PduRDestPdu):
              PduRDestPduHandleId = 12
              PduRDestPduDirection = TRANSMIT
              PduRDestPduRoutingType = API_FORWARDING
              PduRDestPduDataProcessing = IMMEDIATE
              PduRPduLengthHandlingStrategy = IGNORE
              PduRDestPduCrossPartitionDestination = false
              PduRDestPduDataProvision = PDUR_DIRECT
              PduRTransmissionConfirmation = false
              PduRDestPduRef = VCU_HMIsignals_02_oATOM_CANFD_Matrix_CH_V600_202502_343b3975_Tx
              PduRDestPduPduRBswModulesRef = CanIf
          VCU_Chassis_01_oATOM_CANFD_Matrix_CH_V600_202502_d7fdb34f_Tx: PduRRoutingPathCommunicationType=COMMUNICATION_INTERFACE
            VCU_Chassis_01_oATOM_CANFD_Matrix_CH_V600_202502_e79830d3_Tx (PduRDestPdu):
              PduRDestPduHandleId = 8
              PduRDestPduDirection = TRANSMIT
              PduRDestPduRoutingType = API_FORWARDING
              PduRDestPduDataProcessing = IMMEDIATE
              PduRPduLengthHandlingStrategy = IGNORE
              PduRDestPduCrossPartitionDestination = false
              PduRDestPduDataProvision = PDUR_DIRECT
              PduRTransmissionConfirmation = false
              PduRDestPduRef = VCU_Chassis_01_oATOM_CANFD_Matrix_CH_V600_202502_e79830d3_Tx
              PduRDestPduPduRBswModulesRef = CanIf
            PduRSrcPdu_49c8436f (PduRSrcPdu):
              PduRSourcePduHandleId = 8
              PduRSrcPduDirection = TRANSMIT
              PduRSrcPduRef = VCU_Chassis_01_oATOM_CANFD_Matrix_CH_V600_202502_d7fdb34f_Tx
              PduRSrcPduPduRBswModulesRef = Com
          VCU_02_oATOM_CANFD_Matrix_CH_V600_202502_17bac731_Tx: PduRRoutingPathCommunicationType=COMMUNICATION_INTERFACE
            VCU_02_oATOM_CANFD_Matrix_CH_V600_202502_b9b0de03_Tx (PduRDestPdu):
              PduRDestPduHandleId = 3
              PduRDestPduDirection = TRANSMIT
              PduRDestPduRoutingType = API_FORWARDING
              PduRDestPduDataProcessing = IMMEDIATE
              PduRPduLengthHandlingStrategy = IGNORE
              PduRDestPduCrossPartitionDestination = false
              PduRDestPduDataProvision = PDUR_DIRECT
              PduRTransmissionConfirmation = false
              PduRDestPduRef = VCU_02_oATOM_CANFD_Matrix_CH_V600_202502_b9b0de03_Tx
              PduRDestPduPduRBswModulesRef = CanIf
            PduRSrcPdu_fd46d90f (PduRSrcPdu):
              PduRSourcePduHandleId = 3
              PduRSrcPduDirection = TRANSMIT
              PduRSrcPduRef = VCU_02_oATOM_CANFD_Matrix_CH_V600_202502_17bac731_Tx
              PduRSrcPduPduRBswModulesRef = Com
          VCU_IBS_01_oATOM_CANFD_Matrix_CH_V600_202502_4c086bc0_Tx: PduRRoutingPathCommunicationType=COMMUNICATION_INTERFACE
            VCU_IBS_01_oATOM_CANFD_Matrix_CH_V600_202502_72f519e8_Tx (PduRDestPdu):
              PduRDestPduHandleId = 13
              PduRDestPduDirection = TRANSMIT
              PduRDestPduRoutingType = API_FORWARDING
              PduRDestPduDataProcessing = IMMEDIATE
              PduRPduLengthHandlingStrategy = IGNORE
              PduRDestPduCrossPartitionDestination = false
              PduRDestPduDataProvision = PDUR_DIRECT
              PduRTransmissionConfirmation = false
              PduRDestPduRef = VCU_IBS_01_oATOM_CANFD_Matrix_CH_V600_202502_72f519e8_Tx
              PduRDestPduPduRBswModulesRef = CanIf
            PduRSrcPdu_17f11187 (PduRSrcPdu):
              PduRSourcePduHandleId = 13
              PduRSrcPduDirection = TRANSMIT
              PduRSrcPduRef = VCU_IBS_01_oATOM_CANFD_Matrix_CH_V600_202502_4c086bc0_Tx
              PduRSrcPduPduRBswModulesRef = Com
          IBS_VCU_MotorControl_oATOM_CANFD_Matrix_CH_V600_202502_df4c437b_Rx: PduRRoutingPathCommunicationType=COMMUNICATION_INTERFACE
            IBS_VCU_MotorControl_oATOM_CANFD_Matrix_CH_V600_202502_df4c437b_Rx_4e239512_Rx (PduRDestPdu):
              PduRDestPduHandleId = 21
              PduRDestPduDirection = RECEIVE
              PduRDestPduRoutingType = API_FORWARDING
              PduRDestPduDataProcessing = IMMEDIATE
              PduRPduLengthHandlingStrategy = IGNORE
              PduRDestPduCrossPartitionDestination = false
              PduRTransmissionConfirmation = false
              PduRDestPduRef = IBS_VCU_MotorControl_oATOM_CANFD_Matrix_CH_V600_202502_d229d0d9_Rx
              PduRDestPduPduRBswModulesRef = Com
            PduRSrcPdu_4e239512 (PduRSrcPdu):
              PduRSourcePduHandleId = 21
              PduRSrcPduDirection = RECEIVE
              PduRSrcPduRef = IBS_VCU_MotorControl_oATOM_CANFD_Matrix_CH_V600_202502_df4c437b_Rx
              PduRSrcPduPduRBswModulesRef = CanIf
          IBS_Status_03_oATOM_CANFD_Matrix_CH_V600_202502_f451ac97_Rx: PduRRoutingPathCommunicationType=COMMUNICATION_INTERFACE
            IBS_Status_03_oATOM_CANFD_Matrix_CH_V600_202502_f451ac97_Rx_12481f07_Rx (PduRDestPdu):
              PduRDestPduHandleId = 17
              PduRDestPduDirection = RECEIVE
              PduRDestPduRoutingType = API_FORWARDING
              PduRDestPduDataProcessing = IMMEDIATE
              PduRPduLengthHandlingStrategy = IGNORE
              PduRDestPduCrossPartitionDestination = false
              PduRTransmissionConfirmation = false
              PduRDestPduRef = IBS_Status_03_oATOM_CANFD_Matrix_CH_V600_202502_f4245e85_Rx
              PduRDestPduPduRBswModulesRef = Com
            PduRSrcPdu_12481f07 (PduRSrcPdu):
              PduRSourcePduHandleId = 17
              PduRSrcPduDirection = RECEIVE
              PduRSrcPduRef = IBS_Status_03_oATOM_CANFD_Matrix_CH_V600_202502_f451ac97_Rx
              PduRSrcPduPduRBswModulesRef = CanIf
          ACU_info_oATOM_CANFD_Matrix_CH_V600_202502_83006605_Rx: PduRRoutingPathCommunicationType=COMMUNICATION_INTERFACE
            PduRSrcPdu_f767588b (PduRSrcPdu):
              PduRSourcePduHandleId = 2
              PduRSrcPduDirection = RECEIVE
              PduRSrcPduRef = ACU_info_oATOM_CANFD_Matrix_CH_V600_202502_83006605_Rx
              PduRSrcPduPduRBswModulesRef = CanIf
            ACU_info_oATOM_CANFD_Matrix_CH_V600_202502_83006605_Rx_f767588b_Rx (PduRDestPdu):
              PduRDestPduHandleId = 2
              PduRDestPduDirection = RECEIVE
              PduRDestPduRoutingType = API_FORWARDING
              PduRDestPduDataProcessing = IMMEDIATE
              PduRPduLengthHandlingStrategy = IGNORE
              PduRDestPduCrossPartitionDestination = false
              PduRTransmissionConfirmation = false
              PduRDestPduRef = ACU_info_oATOM_CANFD_Matrix_CH_V600_202502_c3757d77_Rx
              PduRDestPduPduRBswModulesRef = Com
          ADCU_APS_01_oATOM_CANFD_Matrix_CH_V600_202502_c0dbb601_Rx: PduRRoutingPathCommunicationType=COMMUNICATION_INTERFACE
            PduRSrcPdu_d84c121b (PduRSrcPdu):
              PduRSourcePduHandleId = 5
              PduRSrcPduDirection = RECEIVE
              PduRSrcPduRef = ADCU_APS_01_oATOM_CANFD_Matrix_CH_V600_202502_c0dbb601_Rx
              PduRSrcPduPduRBswModulesRef = CanIf
            ADCU_APS_01_oATOM_CANFD_Matrix_CH_V600_202502_c0dbb601_Rx_d84c121b_Rx (PduRDestPdu):
              PduRDestPduHandleId = 5
              PduRDestPduDirection = RECEIVE
              PduRDestPduRoutingType = API_FORWARDING
              PduRDestPduDataProcessing = IMMEDIATE
              PduRPduLengthHandlingStrategy = IGNORE
              PduRDestPduCrossPartitionDestination = false
              PduRTransmissionConfirmation = false
              PduRDestPduRef = ADCU_APS_01_oATOM_CANFD_Matrix_CH_V600_202502_d7aca41b_Rx
              PduRDestPduPduRBswModulesRef = Com
          VCU_HMIsignals_01_oATOM_CANFD_Matrix_CH_V600_202502_f29a9fcc_Tx: PduRRoutingPathCommunicationType=COMMUNICATION_INTERFACE
            VCU_HMIsignals_01_oATOM_CANFD_Matrix_CH_V600_202502_ad7bde1a_Tx (PduRDestPdu):
              PduRDestPduHandleId = 11
              PduRDestPduDirection = TRANSMIT
              PduRDestPduRoutingType = API_FORWARDING
              PduRDestPduDataProcessing = IMMEDIATE
              PduRPduLengthHandlingStrategy = IGNORE
              PduRDestPduCrossPartitionDestination = false
              PduRDestPduDataProvision = PDUR_DIRECT
              PduRTransmissionConfirmation = false
              PduRDestPduRef = VCU_HMIsignals_01_oATOM_CANFD_Matrix_CH_V600_202502_ad7bde1a_Tx
              PduRDestPduPduRBswModulesRef = CanIf
            PduRSrcPdu_c0ac8d7c (PduRSrcPdu):
              PduRSourcePduHandleId = 11
              PduRSrcPduDirection = TRANSMIT
              PduRSrcPduRef = VCU_HMIsignals_01_oATOM_CANFD_Matrix_CH_V600_202502_f29a9fcc_Tx
              PduRSrcPduPduRBswModulesRef = Com
          IBS_ACC_oATOM_CANFD_Matrix_CH_V600_202502_205c1446_Rx: PduRRoutingPathCommunicationType=COMMUNICATION_INTERFACE
            IBS_ACC_oATOM_CANFD_Matrix_CH_V600_202502_205c1446_Rx_ca3eaa8a_Rx (PduRDestPdu):
              PduRDestPduHandleId = 13
              PduRDestPduDirection = RECEIVE
              PduRDestPduRoutingType = API_FORWARDING
              PduRDestPduDataProcessing = IMMEDIATE
              PduRPduLengthHandlingStrategy = IGNORE
              PduRDestPduCrossPartitionDestination = false
              PduRTransmissionConfirmation = false
              PduRDestPduRef = IBS_ACC_oATOM_CANFD_Matrix_CH_V600_202502_ef8c28ba_Rx
              PduRDestPduPduRBswModulesRef = Com
            PduRSrcPdu_ca3eaa8a (PduRSrcPdu):
              PduRSourcePduHandleId = 13
              PduRSrcPduDirection = RECEIVE
              PduRSrcPduRef = IBS_ACC_oATOM_CANFD_Matrix_CH_V600_202502_205c1446_Rx
              PduRSrcPduPduRBswModulesRef = CanIf
          IBS_Status_02_oATOM_CANFD_Matrix_CH_V600_202502_35bef38d_Rx: PduRRoutingPathCommunicationType=COMMUNICATION_INTERFACE
            PduRSrcPdu_77b4603c (PduRSrcPdu):
              PduRSourcePduHandleId = 16
              PduRSrcPduDirection = RECEIVE
              PduRSrcPduRef = IBS_Status_02_oATOM_CANFD_Matrix_CH_V600_202502_35bef38d_Rx
              PduRSrcPduPduRBswModulesRef = CanIf
            IBS_Status_02_oATOM_CANFD_Matrix_CH_V600_202502_35bef38d_Rx_77b4603c_Rx (PduRDestPdu):
              PduRDestPduHandleId = 16
              PduRDestPduDirection = RECEIVE
              PduRDestPduRoutingType = API_FORWARDING
              PduRDestPduDataProcessing = IMMEDIATE
              PduRPduLengthHandlingStrategy = IGNORE
              PduRDestPduCrossPartitionDestination = false
              PduRTransmissionConfirmation = false
              PduRDestPduRef = IBS_Status_02_oATOM_CANFD_Matrix_CH_V600_202502_3bba494d_Rx
              PduRDestPduPduRBswModulesRef = Com
          IBS_Status_04_oATOM_CANFD_Matrix_CH_V600_202502_dc4e3b12_Rx: PduRRoutingPathCommunicationType=COMMUNICATION_INTERFACE
            IBS_Status_04_oATOM_CANFD_Matrix_CH_V600_202502_dc4e3b12_Rx_6a5d743a_Rx (PduRDestPdu):
              PduRDestPduHandleId = 18
              PduRDestPduDirection = RECEIVE
              PduRDestPduRoutingType = API_FORWARDING
              PduRDestPduDataProcessing = IMMEDIATE
              PduRPduLengthHandlingStrategy = IGNORE
              PduRDestPduCrossPartitionDestination = false
              PduRTransmissionConfirmation = false
              PduRDestPduRef = IBS_Status_04_oATOM_CANFD_Matrix_CH_V600_202502_f76d333e_Rx
              PduRDestPduPduRBswModulesRef = Com
            PduRSrcPdu_6a5d743a (PduRSrcPdu):
              PduRSourcePduHandleId = 18
              PduRSrcPduDirection = RECEIVE
              PduRSrcPduRef = IBS_Status_04_oATOM_CANFD_Matrix_CH_V600_202502_dc4e3b12_Rx
              PduRSrcPduPduRBswModulesRef = CanIf
          VCU_04_oATOM_CANFD_Matrix_CH_V600_202502_db6dbd42_Tx: PduRRoutingPathCommunicationType=COMMUNICATION_INTERFACE
            VCU_04_oATOM_CANFD_Matrix_CH_V600_202502_5040169c_Tx (PduRDestPdu):
              PduRDestPduHandleId = 5
              PduRDestPduDirection = TRANSMIT
              PduRDestPduRoutingType = API_FORWARDING
              PduRDestPduDataProcessing = IMMEDIATE
              PduRPduLengthHandlingStrategy = IGNORE
              PduRDestPduCrossPartitionDestination = false
              PduRDestPduDataProvision = PDUR_DIRECT
              PduRTransmissionConfirmation = false
              PduRDestPduRef = VCU_04_oATOM_CANFD_Matrix_CH_V600_202502_5040169c_Tx
              PduRDestPduPduRBswModulesRef = CanIf
            PduRSrcPdu_ec53c477 (PduRSrcPdu):
              PduRSourcePduHandleId = 5
              PduRSrcPduDirection = TRANSMIT
              PduRSrcPduRef = VCU_04_oATOM_CANFD_Matrix_CH_V600_202502_db6dbd42_Tx
              PduRSrcPduPduRBswModulesRef = Com
          VCU_BMS_oATOM_CANFD_Matrix_CH_V600_202502_1208e503_Tx: PduRRoutingPathCommunicationType=COMMUNICATION_INTERFACE
            VCU_BMS_oATOM_CANFD_Matrix_CH_V600_202502_8dd4382b_Tx (PduRDestPdu):
              PduRDestPduHandleId = 7
              PduRDestPduDirection = TRANSMIT
              PduRDestPduRoutingType = API_FORWARDING
              PduRDestPduDataProcessing = IMMEDIATE
              PduRPduLengthHandlingStrategy = IGNORE
              PduRDestPduCrossPartitionDestination = false
              PduRDestPduDataProvision = PDUR_DIRECT
              PduRTransmissionConfirmation = false
              PduRDestPduRef = VCU_BMS_oATOM_CANFD_Matrix_CH_V600_202502_8dd4382b_Tx
              PduRDestPduPduRBswModulesRef = CanIf
            PduRSrcPdu_961dd6a8 (PduRSrcPdu):
              PduRSourcePduHandleId = 7
              PduRSrcPduDirection = TRANSMIT
              PduRSrcPduRef = VCU_BMS_oATOM_CANFD_Matrix_CH_V600_202502_1208e503_Tx
              PduRSrcPduPduRBswModulesRef = Com
          VCU_AccPedal_oATOM_CANFD_Matrix_CH_V600_202502_0d0df7a0_Tx: PduRRoutingPathCommunicationType=COMMUNICATION_INTERFACE
            VCU_AccPedal_oATOM_CANFD_Matrix_CH_V600_202502_3cf928f4_Tx (PduRDestPdu):
              PduRDestPduHandleId = 6
              PduRDestPduDirection = TRANSMIT
              PduRDestPduRoutingType = API_FORWARDING
              PduRDestPduDataProcessing = IMMEDIATE
              PduRPduLengthHandlingStrategy = IGNORE
              PduRDestPduCrossPartitionDestination = false
              PduRDestPduDataProvision = PDUR_DIRECT
              PduRTransmissionConfirmation = false
              PduRDestPduRef = VCU_AccPedal_oATOM_CANFD_Matrix_CH_V600_202502_3cf928f4_Tx
              PduRDestPduPduRBswModulesRef = CanIf
            PduRSrcPdu_319663fb (PduRSrcPdu):
              PduRSourcePduHandleId = 6
              PduRSrcPduDirection = TRANSMIT
              PduRSrcPduRef = VCU_AccPedal_oATOM_CANFD_Matrix_CH_V600_202502_0d0df7a0_Tx
              PduRSrcPduPduRBswModulesRef = Com
          ACU_01_oATOM_CANFD_Matrix_CH_V600_202502_1343b9ef_Rx: PduRRoutingPathCommunicationType=COMMUNICATION_INTERFACE
            ACU_01_oATOM_CANFD_Matrix_CH_V600_202502_1343b9ef_Rx_9eae4558_Rx (PduRDestPdu):
              PduRDestPduHandleId = 0
              PduRDestPduDirection = RECEIVE
              PduRDestPduRoutingType = API_FORWARDING
              PduRDestPduDataProcessing = IMMEDIATE
              PduRPduLengthHandlingStrategy = IGNORE
              PduRDestPduCrossPartitionDestination = false
              PduRTransmissionConfirmation = false
              PduRDestPduRef = ACU_01_oATOM_CANFD_Matrix_CH_V600_202502_92b30981_Rx
              PduRDestPduPduRBswModulesRef = Com
            PduRSrcPdu_9eae4558 (PduRSrcPdu):
              PduRSourcePduHandleId = 0
              PduRSrcPduDirection = RECEIVE
              PduRSrcPduRef = ACU_01_oATOM_CANFD_Matrix_CH_V600_202502_1343b9ef_Rx
              PduRSrcPduPduRBswModulesRef = CanIf
          IBS_Status_06_oATOM_CANFD_Matrix_CH_V600_202502_84e18367_Rx: PduRRoutingPathCommunicationType=COMMUNICATION_INTERFACE
            IBS_Status_06_oATOM_CANFD_Matrix_CH_V600_202502_84e18367_Rx_65adbba1_Rx (PduRDestPdu):
              PduRDestPduHandleId = 19
              PduRDestPduDirection = RECEIVE
              PduRDestPduRoutingType = API_FORWARDING
              PduRDestPduDataProcessing = IMMEDIATE
              PduRPduLengthHandlingStrategy = IGNORE
              PduRDestPduCrossPartitionDestination = false
              PduRTransmissionConfirmation = false
              PduRDestPduRef = IBS_Status_06_oATOM_CANFD_Matrix_CH_V600_202502_b3201aef_Rx
              PduRDestPduPduRBswModulesRef = Com
            PduRSrcPdu_65adbba1 (PduRSrcPdu):
              PduRSourcePduHandleId = 19
              PduRSrcPduDirection = RECEIVE
              PduRSrcPduRef = IBS_Status_06_oATOM_CANFD_Matrix_CH_V600_202502_84e18367_Rx
              PduRSrcPduPduRBswModulesRef = CanIf
          IBS_Status_01_oATOM_CANFD_Matrix_CH_V600_202502_acfe14e2_Rx: PduRRoutingPathCommunicationType=COMMUNICATION_INTERFACE
            IBS_Status_01_oATOM_CANFD_Matrix_CH_V600_202502_acfe14e2_Rx_d09902f0_Rx (PduRDestPdu):
              PduRDestPduHandleId = 15
              PduRDestPduDirection = RECEIVE
              PduRDestPduRoutingType = API_FORWARDING
              PduRDestPduDataProcessing = IMMEDIATE
              PduRPduLengthHandlingStrategy = IGNORE
              PduRDestPduCrossPartitionDestination = false
              PduRTransmissionConfirmation = false
              PduRDestPduRef = IBS_Status_01_oATOM_CANFD_Matrix_CH_V600_202502_b0697754_Rx
              PduRDestPduPduRBswModulesRef = Com
            PduRSrcPdu_d09902f0 (PduRSrcPdu):
              PduRSourcePduHandleId = 15
              PduRSrcPduDirection = RECEIVE
              PduRSrcPduRef = IBS_Status_01_oATOM_CANFD_Matrix_CH_V600_202502_acfe14e2_Rx
              PduRSrcPduPduRBswModulesRef = CanIf
          VCU_PlugInChrgInfo_oATOM_CANFD_Matrix_CH_V600_202502_20405e82_Tx: PduRRoutingPathCommunicationType=COMMUNICATION_INTERFACE
            PduRSrcPdu_a60cff81 (PduRSrcPdu):
              PduRSourcePduHandleId = 15
              PduRSrcPduDirection = TRANSMIT
              PduRSrcPduRef = VCU_PlugInChrgInfo_oATOM_CANFD_Matrix_CH_V600_202502_20405e82_Tx
              PduRSrcPduPduRBswModulesRef = Com
            VCU_PlugInChrgInfo_oATOM_CANFD_Matrix_CH_V600_202502_f8a23add_Tx (PduRDestPdu):
              PduRDestPduHandleId = 15
              PduRDestPduDirection = TRANSMIT
              PduRDestPduRoutingType = API_FORWARDING
              PduRDestPduDataProcessing = IMMEDIATE
              PduRPduLengthHandlingStrategy = IGNORE
              PduRDestPduCrossPartitionDestination = false
              PduRDestPduDataProvision = PDUR_DIRECT
              PduRTransmissionConfirmation = false
              PduRDestPduRef = VCU_PlugInChrgInfo_oATOM_CANFD_Matrix_CH_V600_202502_f8a23add_Tx
              PduRDestPduPduRBswModulesRef = CanIf
          SGW_17_oATOM_CANFD_Matrix_CH_V600_202502_3a9eb4a2_Rx: PduRRoutingPathCommunicationType=COMMUNICATION_INTERFACE
            PduRSrcPdu_316b9b30 (PduRSrcPdu):
              PduRSourcePduHandleId = 26
              PduRSrcPduDirection = RECEIVE
              PduRSrcPduRef = SGW_17_oATOM_CANFD_Matrix_CH_V600_202502_3a9eb4a2_Rx
              PduRSrcPduPduRBswModulesRef = CanIf
            SGW_17_oATOM_CANFD_Matrix_CH_V600_202502_3a9eb4a2_Rx_316b9b30_Rx (PduRDestPdu):
              PduRDestPduHandleId = 26
              PduRDestPduDirection = RECEIVE
              PduRDestPduRoutingType = API_FORWARDING
              PduRDestPduDataProcessing = IMMEDIATE
              PduRPduLengthHandlingStrategy = IGNORE
              PduRDestPduCrossPartitionDestination = false
              PduRTransmissionConfirmation = false
              PduRDestPduRef = SGW_17_oATOM_CANFD_Matrix_CH_V600_202502_9b3e5336_Rx
              PduRDestPduPduRBswModulesRef = Com
          ADCU_APS_02_oATOM_CANFD_Matrix_CH_V600_202502_599b516e_Rx: PduRRoutingPathCommunicationType=COMMUNICATION_INTERFACE
            ADCU_APS_02_oATOM_CANFD_Matrix_CH_V600_202502_599b516e_Rx_bc9c1fec_Rx (PduRDestPdu):
              PduRDestPduHandleId = 6
              PduRDestPduDirection = RECEIVE
              PduRDestPduRoutingType = API_FORWARDING
              PduRDestPduDataProcessing = IMMEDIATE
              PduRPduLengthHandlingStrategy = IGNORE
              PduRDestPduCrossPartitionDestination = false
              PduRTransmissionConfirmation = false
              PduRDestPduRef = ADCU_APS_02_oATOM_CANFD_Matrix_CH_V600_202502_5c7f9a02_Rx
              PduRDestPduPduRBswModulesRef = Com
            PduRSrcPdu_bc9c1fec (PduRSrcPdu):
              PduRSourcePduHandleId = 6
              PduRSrcPduDirection = RECEIVE
              PduRSrcPduRef = ADCU_APS_02_oATOM_CANFD_Matrix_CH_V600_202502_599b516e_Rx
              PduRSrcPduPduRBswModulesRef = CanIf
          ADCU_DA_oATOM_CANFD_Matrix_CH_V600_202502_8a75132b_Rx: PduRRoutingPathCommunicationType=COMMUNICATION_INTERFACE
            PduRSrcPdu_08ea31b4 (PduRSrcPdu):
              PduRSourcePduHandleId = 7
              PduRSrcPduDirection = RECEIVE
              PduRSrcPduRef = ADCU_DA_oATOM_CANFD_Matrix_CH_V600_202502_8a75132b_Rx
              PduRSrcPduPduRBswModulesRef = CanIf
            ADCU_DA_oATOM_CANFD_Matrix_CH_V600_202502_8a75132b_Rx_08ea31b4_Rx (PduRDestPdu):
              PduRDestPduHandleId = 7
              PduRDestPduDirection = RECEIVE
              PduRDestPduRoutingType = API_FORWARDING
              PduRDestPduDataProcessing = IMMEDIATE
              PduRPduLengthHandlingStrategy = IGNORE
              PduRDestPduCrossPartitionDestination = false
              PduRTransmissionConfirmation = false
              PduRDestPduRef = ADCU_DA_oATOM_CANFD_Matrix_CH_V600_202502_c19ff818_Rx
              PduRDestPduPduRBswModulesRef = Com
          IBS_Torque_oATOM_CANFD_Matrix_CH_V600_202502_94259583_Rx: PduRRoutingPathCommunicationType=COMMUNICATION_INTERFACE
            IBS_Torque_oATOM_CANFD_Matrix_CH_V600_202502_94259583_Rx_629168fc_Rx (PduRDestPdu):
              PduRDestPduHandleId = 20
              PduRDestPduDirection = RECEIVE
              PduRDestPduRoutingType = API_FORWARDING
              PduRDestPduDataProcessing = IMMEDIATE
              PduRPduLengthHandlingStrategy = IGNORE
              PduRDestPduCrossPartitionDestination = false
              PduRTransmissionConfirmation = false
              PduRDestPduRef = IBS_Torque_oATOM_CANFD_Matrix_CH_V600_202502_e4106cfa_Rx
              PduRDestPduPduRBswModulesRef = Com
            PduRSrcPdu_629168fc (PduRSrcPdu):
              PduRSourcePduHandleId = 20
              PduRSrcPduDirection = RECEIVE
              PduRSrcPduRef = IBS_Torque_oATOM_CANFD_Matrix_CH_V600_202502_94259583_Rx
              PduRSrcPduPduRBswModulesRef = CanIf
          ADCU_AEB_01_oATOM_CANFD_Matrix_CH_V600_202502_aeea498e_Rx: PduRRoutingPathCommunicationType=COMMUNICATION_INTERFACE
            PduRSrcPdu_686bd310 (PduRSrcPdu):
              PduRSourcePduHandleId = 4
              PduRSrcPduDirection = RECEIVE
              PduRSrcPduRef = ADCU_AEB_01_oATOM_CANFD_Matrix_CH_V600_202502_aeea498e_Rx
              PduRSrcPduPduRBswModulesRef = CanIf
            ADCU_AEB_01_oATOM_CANFD_Matrix_CH_V600_202502_aeea498e_Rx_686bd310_Rx (PduRDestPdu):
              PduRDestPduHandleId = 4
              PduRDestPduDirection = RECEIVE
              PduRDestPduRoutingType = API_FORWARDING
              PduRDestPduDataProcessing = IMMEDIATE
              PduRPduLengthHandlingStrategy = IGNORE
              PduRDestPduCrossPartitionDestination = false
              PduRTransmissionConfirmation = false
              PduRDestPduRef = ADCU_AEB_01_oATOM_CANFD_Matrix_CH_V600_202502_73fc26ce_Rx
              PduRDestPduPduRBswModulesRef = Com
          VCU_MCU_03_oATOM_CANFD_Matrix_CH_V600_202502_0d9d0aa9_Tx: PduRRoutingPathCommunicationType=COMMUNICATION_INTERFACE
            VCU_MCU_03_oATOM_CANFD_Matrix_CH_V600_202502_9c2fbb06_Tx (PduRDestPdu):
              PduRDestPduHandleId = 14
              PduRDestPduDirection = TRANSMIT
              PduRDestPduRoutingType = API_FORWARDING
              PduRDestPduDataProcessing = IMMEDIATE
              PduRPduLengthHandlingStrategy = IGNORE
              PduRDestPduCrossPartitionDestination = false
              PduRDestPduDataProvision = PDUR_DIRECT
              PduRTransmissionConfirmation = false
              PduRDestPduRef = VCU_MCU_03_oATOM_CANFD_Matrix_CH_V600_202502_9c2fbb06_Tx
              PduRDestPduPduRBswModulesRef = CanIf
            PduRSrcPdu_c3983958 (PduRSrcPdu):
              PduRSourcePduHandleId = 14
              PduRSrcPduDirection = TRANSMIT
              PduRSrcPduRef = VCU_MCU_03_oATOM_CANFD_Matrix_CH_V600_202502_0d9d0aa9_Tx
              PduRSrcPduPduRBswModulesRef = Com
          ADCU_ACC_02_oATOM_CANFD_Matrix_CH_V600_202502_9c78bb9f_Rx: PduRRoutingPathCommunicationType=COMMUNICATION_INTERFACE
            ADCU_ACC_02_oATOM_CANFD_Matrix_CH_V600_202502_9c78bb9f_Rx_56f39b3b_Rx (PduRDestPdu):
              PduRDestPduHandleId = 3
              PduRDestPduDirection = RECEIVE
              PduRDestPduRoutingType = API_FORWARDING
              PduRDestPduDataProcessing = IMMEDIATE
              PduRPduLengthHandlingStrategy = IGNORE
              PduRDestPduCrossPartitionDestination = false
              PduRTransmissionConfirmation = false
              PduRDestPduRef = ADCU_ACC_02_oATOM_CANFD_Matrix_CH_V600_202502_09e0da82_Rx
              PduRDestPduPduRBswModulesRef = Com
            PduRSrcPdu_56f39b3b (PduRSrcPdu):
              PduRSourcePduHandleId = 3
              PduRSrcPduDirection = RECEIVE
              PduRSrcPduRef = ADCU_ACC_02_oATOM_CANFD_Matrix_CH_V600_202502_9c78bb9f_Rx
              PduRSrcPduPduRBswModulesRef = CanIf
          IBS_APS_oATOM_CANFD_Matrix_CH_V600_202502_8feeb71a_Rx: PduRRoutingPathCommunicationType=COMMUNICATION_INTERFACE
            PduRSrcPdu_283e282c (PduRSrcPdu):
              PduRSourcePduHandleId = 14
              PduRSrcPduDirection = RECEIVE
              PduRSrcPduRef = IBS_APS_oATOM_CANFD_Matrix_CH_V600_202502_8feeb71a_Rx
              PduRSrcPduPduRBswModulesRef = CanIf
            IBS_APS_oATOM_CANFD_Matrix_CH_V600_202502_8feeb71a_Rx_283e282c_Rx (PduRDestPdu):
              PduRDestPduHandleId = 14
              PduRDestPduDirection = RECEIVE
              PduRDestPduRoutingType = API_FORWARDING
              PduRDestPduDataProcessing = IMMEDIATE
              PduRPduLengthHandlingStrategy = IGNORE
              PduRDestPduCrossPartitionDestination = false
              PduRTransmissionConfirmation = false
              PduRDestPduRef = IBS_APS_oATOM_CANFD_Matrix_CH_V600_202502_25d77553_Rx
              PduRDestPduPduRBswModulesRef = Com
          IBS_WheelSpeed_01_oATOM_CANFD_Matrix_CH_V600_202502_cdf72100_Rx: PduRRoutingPathCommunicationType=COMMUNICATION_INTERFACE
            IBS_WheelSpeed_01_oATOM_CANFD_Matrix_CH_V600_202502_cdf72100_Rx_fcecab79_Rx (PduRDestPdu):
              PduRDestPduHandleId = 22
              PduRDestPduDirection = RECEIVE
              PduRDestPduRoutingType = API_FORWARDING
              PduRDestPduDataProcessing = IMMEDIATE
              PduRPduLengthHandlingStrategy = IGNORE
              PduRDestPduCrossPartitionDestination = false
              PduRTransmissionConfirmation = false
              PduRDestPduRef = IBS_WheelSpeed_01_oATOM_CANFD_Matrix_CH_V600_202502_1c45b3ee_Rx
              PduRDestPduPduRBswModulesRef = Com
            PduRSrcPdu_fcecab79 (PduRSrcPdu):
              PduRSourcePduHandleId = 22
              PduRSrcPduDirection = RECEIVE
              PduRSrcPduRef = IBS_WheelSpeed_01_oATOM_CANFD_Matrix_CH_V600_202502_cdf72100_Rx
              PduRSrcPduPduRBswModulesRef = CanIf
          VCU_03_oATOM_CANFD_Matrix_CH_V600_202502_d824d0f9_Tx: PduRRoutingPathCommunicationType=COMMUNICATION_INTERFACE
            PduRSrcPdu_eeac2237 (PduRSrcPdu):
              PduRSourcePduHandleId = 4
              PduRSrcPduDirection = TRANSMIT
              PduRSrcPduRef = VCU_03_oATOM_CANFD_Matrix_CH_V600_202502_d824d0f9_Tx
              PduRSrcPduPduRBswModulesRef = Com
            VCU_03_oATOM_CANFD_Matrix_CH_V600_202502_785f8119_Tx (PduRDestPdu):
              PduRDestPduHandleId = 4
              PduRDestPduDirection = TRANSMIT
              PduRDestPduRoutingType = API_FORWARDING
              PduRDestPduDataProcessing = IMMEDIATE
              PduRPduLengthHandlingStrategy = IGNORE
              PduRDestPduCrossPartitionDestination = false
              PduRDestPduDataProvision = PDUR_DIRECT
              PduRTransmissionConfirmation = false
              PduRDestPduRef = VCU_03_oATOM_CANFD_Matrix_CH_V600_202502_785f8119_Tx
              PduRDestPduPduRBswModulesRef = CanIf
          IBS_WheelSpeed_02_oATOM_CANFD_Matrix_CH_V600_202502_54b7c66f_Rx: PduRRoutingPathCommunicationType=COMMUNICATION_INTERFACE
            PduRSrcPdu_ca150190 (PduRSrcPdu):
              PduRSourcePduHandleId = 23
              PduRSrcPduDirection = RECEIVE
              PduRSrcPduRef = IBS_WheelSpeed_02_oATOM_CANFD_Matrix_CH_V600_202502_54b7c66f_Rx
              PduRSrcPduPduRBswModulesRef = CanIf
            IBS_WheelSpeed_02_oATOM_CANFD_Matrix_CH_V600_202502_54b7c66f_Rx_ca150190_Rx (PduRDestPdu):
              PduRDestPduHandleId = 23
              PduRDestPduDirection = RECEIVE
              PduRDestPduRoutingType = API_FORWARDING
              PduRDestPduDataProcessing = IMMEDIATE
              PduRPduLengthHandlingStrategy = IGNORE
              PduRDestPduCrossPartitionDestination = false
              PduRTransmissionConfirmation = false
              PduRDestPduRef = IBS_WheelSpeed_02_oATOM_CANFD_Matrix_CH_V600_202502_97968df7_Rx
              PduRDestPduPduRBswModulesRef = Com
          ACU_02_oATOM_CANFD_Matrix_CH_V600_202502_8a035e80_Rx: PduRRoutingPathCommunicationType=COMMUNICATION_INTERFACE
            PduRSrcPdu_0dbe25ba (PduRSrcPdu):
              PduRSourcePduHandleId = 1
              PduRSrcPduDirection = RECEIVE
              PduRSrcPduRef = ACU_02_oATOM_CANFD_Matrix_CH_V600_202502_8a035e80_Rx
              PduRSrcPduPduRBswModulesRef = CanIf
            ACU_02_oATOM_CANFD_Matrix_CH_V600_202502_8a035e80_Rx_0dbe25ba_Rx (PduRDestPdu):
              PduRDestPduHandleId = 1
              PduRDestPduDirection = RECEIVE
              PduRDestPduRoutingType = API_FORWARDING
              PduRDestPduDataProcessing = IMMEDIATE
              PduRPduLengthHandlingStrategy = IGNORE
              PduRDestPduCrossPartitionDestination = false
              PduRTransmissionConfirmation = false
              PduRDestPduRef = ACU_02_oATOM_CANFD_Matrix_CH_V600_202502_19603798_Rx
              PduRDestPduPduRBswModulesRef = Com
          VcuAdcTxG0Msg1_oTC37X_VCU_CAN01_b8ca6989_Tx: PduRRoutingPathCommunicationType=COMMUNICATION_INTERFACE
            PduRSrcPdu_0a2b7a00 (PduRSrcPdu): PduRSourcePduHandleId=18, PduRSrcPduDirection=TRANSMIT, PduRSrcPduRef=VcuAdcTxG0Msg1_oTC37X_VCU_CAN01_b8ca6989_Tx, PduRSrcPduPduRBswModulesRef=Com
            VcuAdcTxG0Msg1_oTC37X_VCU_CAN01_4f542d06_Tx (PduRDestPdu):
              PduRDestPduHandleId = 18
              PduRDestPduDirection = TRANSMIT
              PduRDestPduRoutingType = API_FORWARDING
              PduRDestPduDataProcessing = IMMEDIATE
              PduRPduLengthHandlingStrategy = IGNORE
              PduRDestPduCrossPartitionDestination = false
              PduRDestPduDataProvision = PDUR_DIRECT
              PduRTransmissionConfirmation = false
              PduRDestPduRef = VcuAdcTxG0Msg1_oTC37X_VCU_CAN01_4f542d06_Tx
              PduRDestPduPduRBswModulesRef = CanIf
          VcuAdcTxG8Msg2_oTC37X_VCU_CAN01_eb0f92eb_Tx: PduRRoutingPathCommunicationType=COMMUNICATION_INTERFACE
            PduRSrcPdu_37fea4b2 (PduRSrcPdu): PduRSourcePduHandleId=27, PduRSrcPduDirection=TRANSMIT, PduRSrcPduRef=VcuAdcTxG8Msg2_oTC37X_VCU_CAN01_eb0f92eb_Tx, PduRSrcPduPduRBswModulesRef=Com
            VcuAdcTxG8Msg2_oTC37X_VCU_CAN01_7b4a61a1_Tx (PduRDestPdu):
              PduRDestPduHandleId = 27
              PduRDestPduDirection = TRANSMIT
              PduRDestPduRoutingType = API_FORWARDING
              PduRDestPduDataProcessing = IMMEDIATE
              PduRPduLengthHandlingStrategy = IGNORE
              PduRDestPduCrossPartitionDestination = false
              PduRDestPduDataProvision = PDUR_DIRECT
              PduRTransmissionConfirmation = false
              PduRDestPduRef = VcuAdcTxG8Msg2_oTC37X_VCU_CAN01_7b4a61a1_Tx
              PduRDestPduPduRBswModulesRef = CanIf
          VcuAdcTxG0Msg0_oTC37X_VCU_CAN01_5798df68_Tx: PduRRoutingPathCommunicationType=COMMUNICATION_INTERFACE
            VcuAdcTxG0Msg0_oTC37X_VCU_CAN01_0847dbfd_Tx (PduRDestPdu):
              PduRDestPduHandleId = 17
              PduRDestPduDirection = TRANSMIT
              PduRDestPduRoutingType = API_FORWARDING
              PduRDestPduDataProcessing = IMMEDIATE
              PduRPduLengthHandlingStrategy = IGNORE
              PduRDestPduCrossPartitionDestination = false
              PduRDestPduDataProvision = PDUR_DIRECT
              PduRTransmissionConfirmation = false
              PduRDestPduRef = VcuAdcTxG0Msg0_oTC37X_VCU_CAN01_0847dbfd_Tx
              PduRDestPduPduRBswModulesRef = CanIf
            PduRSrcPdu_75ceb29f (PduRSrcPdu): PduRSourcePduHandleId=17, PduRSrcPduDirection=TRANSMIT, PduRSrcPduRef=VcuAdcTxG0Msg0_oTC37X_VCU_CAN01_5798df68_Tx, PduRSrcPduPduRBswModulesRef=Com
          VcuAdcTxG8Msg0_oTC37X_VCU_CAN01_eedbf968_Tx: PduRRoutingPathCommunicationType=COMMUNICATION_INTERFACE
            VcuAdcTxG8Msg0_oTC37X_VCU_CAN01_f56d8c57_Tx (PduRDestPdu):
              PduRDestPduHandleId = 25
              PduRDestPduDirection = TRANSMIT
              PduRDestPduRoutingType = API_FORWARDING
              PduRDestPduDataProcessing = IMMEDIATE
              PduRPduLengthHandlingStrategy = IGNORE
              PduRDestPduCrossPartitionDestination = false
              PduRDestPduDataProvision = PDUR_DIRECT
              PduRTransmissionConfirmation = false
              PduRDestPduRef = VcuAdcTxG8Msg0_oTC37X_VCU_CAN01_f56d8c57_Tx
              PduRDestPduPduRBswModulesRef = CanIf
            PduRSrcPdu_624e541b (PduRSrcPdu): PduRSourcePduHandleId=25, PduRSrcPduDirection=TRANSMIT, PduRSrcPduRef=VcuAdcTxG8Msg0_oTC37X_VCU_CAN01_eedbf968_Tx, PduRSrcPduPduRBswModulesRef=Com
          VcuAdcTxG2Msg0_oTC37X_VCU_CAN01_79c816e8_Tx: PduRRoutingPathCommunicationType=COMMUNICATION_INTERFACE
            VcuAdcTxG2Msg0_oTC37X_VCU_CAN01_dab5cd37_Tx (PduRDestPdu):
              PduRDestPduHandleId = 21
              PduRDestPduDirection = TRANSMIT
              PduRDestPduRoutingType = API_FORWARDING
              PduRDestPduDataProcessing = IMMEDIATE
              PduRPduLengthHandlingStrategy = IGNORE
              PduRDestPduCrossPartitionDestination = false
              PduRDestPduDataProvision = PDUR_DIRECT
              PduRTransmissionConfirmation = false
              PduRDestPduRef = VcuAdcTxG2Msg0_oTC37X_VCU_CAN01_dab5cd37_Tx
              PduRDestPduPduRBswModulesRef = CanIf
            PduRSrcPdu_9fc32995 (PduRSrcPdu): PduRSourcePduHandleId=21, PduRSrcPduDirection=TRANSMIT, PduRSrcPduRef=VcuAdcTxG2Msg0_oTC37X_VCU_CAN01_79c816e8_Tx, PduRSrcPduPduRBswModulesRef=Com
          VcuAdcTxG2Msg1_oTC37X_VCU_CAN01_969aa009_Tx: PduRRoutingPathCommunicationType=COMMUNICATION_INTERFACE
            PduRSrcPdu_1008b467 (PduRSrcPdu): PduRSourcePduHandleId=22, PduRSrcPduDirection=TRANSMIT, PduRSrcPduRef=VcuAdcTxG2Msg1_oTC37X_VCU_CAN01_969aa009_Tx, PduRSrcPduPduRBswModulesRef=Com
            VcuAdcTxG2Msg1_oTC37X_VCU_CAN01_9da63bcc_Tx (PduRDestPdu):
              PduRDestPduHandleId = 22
              PduRDestPduDirection = TRANSMIT
              PduRDestPduRoutingType = API_FORWARDING
              PduRDestPduDataProcessing = IMMEDIATE
              PduRPduLengthHandlingStrategy = IGNORE
              PduRDestPduCrossPartitionDestination = false
              PduRDestPduDataProvision = PDUR_DIRECT
              PduRTransmissionConfirmation = false
              PduRDestPduRef = VcuAdcTxG2Msg1_oTC37X_VCU_CAN01_9da63bcc_Tx
              PduRDestPduPduRBswModulesRef = CanIf
          VcuAdcTxG1Msg0_oTC37X_VCU_CAN01_40b0bba8_Tx: PduRRoutingPathCommunicationType=COMMUNICATION_INTERFACE
            VcuAdcTxG1Msg0_oTC37X_VCU_CAN01_613ed098_Tx (PduRDestPdu):
              PduRDestPduHandleId = 19
              PduRDestPduDirection = TRANSMIT
              PduRDestPduRoutingType = API_FORWARDING
              PduRDestPduDataProcessing = IMMEDIATE
              PduRPduLengthHandlingStrategy = IGNORE
              PduRDestPduCrossPartitionDestination = false
              PduRTransmissionConfirmation = false
              PduRDestPduDataProvision = PDUR_DIRECT
              PduRDestPduRef = VcuAdcTxG1Msg0_oTC37X_VCU_CAN01_613ed098_Tx
              PduRDestPduPduRBswModulesRef = CanIf
            PduRSrcPdu_238e87f9 (PduRSrcPdu): PduRSourcePduHandleId=19, PduRSrcPduDirection=TRANSMIT, PduRSrcPduRef=VcuAdcTxG1Msg0_oTC37X_VCU_CAN01_40b0bba8_Tx, PduRSrcPduPduRBswModulesRef=Com
          VcuAdcTxG3Msg0_oTC37X_VCU_CAN01_6ee07228_Tx: PduRRoutingPathCommunicationType=COMMUNICATION_INTERFACE
            PduRSrcPdu_0b6ac76d (PduRSrcPdu): PduRSourcePduHandleId=23, PduRSrcPduDirection=TRANSMIT, PduRSrcPduRef=VcuAdcTxG3Msg0_oTC37X_VCU_CAN01_6ee07228_Tx, PduRSrcPduPduRBswModulesRef=Com
            VcuAdcTxG3Msg0_oTC37X_VCU_CAN01_b3ccc652_Tx (PduRDestPdu):
              PduRDestPduHandleId = 23
              PduRDestPduDirection = TRANSMIT
              PduRDestPduRoutingType = API_FORWARDING
              PduRDestPduDataProcessing = IMMEDIATE
              PduRPduLengthHandlingStrategy = IGNORE
              PduRDestPduCrossPartitionDestination = false
              PduRDestPduDataProvision = PDUR_DIRECT
              PduRTransmissionConfirmation = false
              PduRDestPduRef = VcuAdcTxG3Msg0_oTC37X_VCU_CAN01_b3ccc652_Tx
              PduRDestPduPduRBswModulesRef = CanIf
          VcuAdcTxG8Msg3_oTC37X_VCU_CAN01_045d240a_Tx: PduRRoutingPathCommunicationType=COMMUNICATION_INTERFACE
            VcuAdcTxG8Msg3_oTC37X_VCU_CAN01_3c59975a_Tx (PduRDestPdu):
              PduRDestPduHandleId = 28
              PduRDestPduDirection = TRANSMIT
              PduRDestPduRoutingType = API_FORWARDING
              PduRDestPduDataProcessing = IMMEDIATE
              PduRPduLengthHandlingStrategy = IGNORE
              PduRDestPduCrossPartitionDestination = false
              PduRDestPduDataProvision = PDUR_DIRECT
              PduRTransmissionConfirmation = false
              PduRDestPduRef = VcuAdcTxG8Msg3_oTC37X_VCU_CAN01_3c59975a_Tx
              PduRDestPduPduRBswModulesRef = CanIf
            PduRSrcPdu_88d7da53 (PduRSrcPdu): PduRSourcePduHandleId=28, PduRSrcPduDirection=TRANSMIT, PduRSrcPduRef=VcuAdcTxG8Msg3_oTC37X_VCU_CAN01_045d240a_Tx, PduRSrcPduPduRBswModulesRef=Com
          VcuAdcTxG1Msg1_oTC37X_VCU_CAN01_afe20d49_Tx: PduRRoutingPathCommunicationType=COMMUNICATION_INTERFACE
            PduRSrcPdu_ae15b571 (PduRSrcPdu): PduRSourcePduHandleId=20, PduRSrcPduDirection=TRANSMIT, PduRSrcPduRef=VcuAdcTxG1Msg1_oTC37X_VCU_CAN01_afe20d49_Tx, PduRSrcPduPduRBswModulesRef=Com
            VcuAdcTxG1Msg1_oTC37X_VCU_CAN01_262d2663_Tx (PduRDestPdu):
              PduRDestPduHandleId = 20
              PduRDestPduDirection = TRANSMIT
              PduRDestPduRoutingType = API_FORWARDING
              PduRDestPduDataProcessing = IMMEDIATE
              PduRPduLengthHandlingStrategy = IGNORE
              PduRDestPduCrossPartitionDestination = false
              PduRDestPduDataProvision = PDUR_DIRECT
              PduRTransmissionConfirmation = false
              PduRDestPduRef = VcuAdcTxG1Msg1_oTC37X_VCU_CAN01_262d2663_Tx
              PduRDestPduPduRBswModulesRef = CanIf
          VcuAdcTxG8Msg1_oTC37X_VCU_CAN01_01894f89_Tx: PduRRoutingPathCommunicationType=COMMUNICATION_INTERFACE
            VcuAdcTxG8Msg1_oTC37X_VCU_CAN01_b27e7aac_Tx (PduRDestPdu):
              PduRDestPduHandleId = 26
              PduRDestPduDirection = TRANSMIT
              PduRDestPduRoutingType = API_FORWARDING
              PduRDestPduDataProcessing = IMMEDIATE
              PduRPduLengthHandlingStrategy = IGNORE
              PduRDestPduCrossPartitionDestination = false
              PduRDestPduDataProvision = PDUR_DIRECT
              PduRTransmissionConfirmation = false
              PduRDestPduRef = VcuAdcTxG8Msg1_oTC37X_VCU_CAN01_b27e7aac_Tx
              PduRDestPduPduRBswModulesRef = CanIf
            PduRSrcPdu_350c260d (PduRSrcPdu): PduRSourcePduHandleId=26, PduRSrcPduDirection=TRANSMIT, PduRSrcPduRef=VcuAdcTxG8Msg1_oTC37X_VCU_CAN01_01894f89_Tx, PduRSrcPduPduRBswModulesRef=Com
          VcuAdcTxG3Msg1_oTC37X_VCU_CAN01_81b2c4c9_Tx: PduRRoutingPathCommunicationType=COMMUNICATION_INTERFACE
            VcuAdcTxG3Msg1_oTC37X_VCU_CAN01_f4df30a9_Tx (PduRDestPdu):
              PduRDestPduHandleId = 24
              PduRDestPduDirection = TRANSMIT
              PduRDestPduRoutingType = API_FORWARDING
              PduRDestPduDataProcessing = IMMEDIATE
              PduRPduLengthHandlingStrategy = IGNORE
              PduRDestPduCrossPartitionDestination = false
              PduRDestPduDataProvision = PDUR_DIRECT
              PduRTransmissionConfirmation = false
              PduRDestPduRef = VcuAdcTxG3Msg1_oTC37X_VCU_CAN01_f4df30a9_Tx
              PduRDestPduPduRBswModulesRef = CanIf
            PduRSrcPdu_4fcbec42 (PduRSrcPdu): PduRSourcePduHandleId=24, PduRSrcPduDirection=TRANSMIT, PduRSrcPduRef=VcuAdcTxG3Msg1_oTC37X_VCU_CAN01_81b2c4c9_Tx, PduRSrcPduPduRBswModulesRef=Com
          VcuRxCtrlMsg0_oTC37X_VCU_CAN01_3715838b_Rx: PduRRoutingPathCommunicationType=COMMUNICATION_INTERFACE
            VcuRxCtrlMsg0_oTC37X_VCU_CAN01_3715838b_Rx_01131484_Rx (PduRDestPdu):
              PduRDestPduHandleId = 32
              PduRDestPduDirection = RECEIVE
              PduRDestPduRoutingType = API_FORWARDING
              PduRDestPduDataProcessing = IMMEDIATE
              PduRPduLengthHandlingStrategy = IGNORE
              PduRDestPduCrossPartitionDestination = false
              PduRTransmissionConfirmation = false
              PduRDestPduRef = VcuRxCtrlMsg0_oTC37X_VCU_CAN01_b24a2ab4_Rx
              PduRDestPduPduRBswModulesRef = Com
            PduRSrcPdu_01131484 (PduRSrcPdu): PduRSourcePduHandleId=32, PduRSrcPduDirection=RECEIVE, PduRSrcPduRef=VcuRxCtrlMsg0_oTC37X_VCU_CAN01_3715838b_Rx, PduRSrcPduPduRBswModulesRef=CanIf
          VcuRxCtrlMsg1_oTC37X_VCU_CAN01_70067570_Rx: PduRRoutingPathCommunicationType=COMMUNICATION_INTERFACE
            VcuRxCtrlMsg1_oTC37X_VCU_CAN01_70067570_Rx_35c74fdb_Rx (PduRDestPdu):
              PduRDestPduHandleId = 33
              PduRDestPduDirection = RECEIVE
              PduRDestPduRoutingType = API_FORWARDING
              PduRDestPduDataProcessing = IMMEDIATE
              PduRPduLengthHandlingStrategy = IGNORE
              PduRDestPduCrossPartitionDestination = false
              PduRTransmissionConfirmation = false
              PduRDestPduRef = VcuRxCtrlMsg1_oTC37X_VCU_CAN01_5d189c55_Rx
              PduRDestPduPduRBswModulesRef = Com
            PduRSrcPdu_35c74fdb (PduRSrcPdu): PduRSourcePduHandleId=33, PduRSrcPduDirection=RECEIVE, PduRSrcPduRef=VcuRxCtrlMsg1_oTC37X_VCU_CAN01_70067570_Rx, PduRSrcPduPduRBswModulesRef=CanIf
          VcuMeasurementMsg0_oTC37X_VCU_CAN01_0deb23c3_Tx: PduRRoutingPathCommunicationType=COMMUNICATION_INTERFACE
            VcuMeasurementMsg0_oTC37X_VCU_CAN01_d96481d0_Tx (PduRDestPdu):
              PduRDestPduHandleId = 33
              PduRDestPduDirection = TRANSMIT
              PduRDestPduRoutingType = API_FORWARDING
              PduRDestPduDataProcessing = IMMEDIATE
              PduRPduLengthHandlingStrategy = IGNORE
              PduRDestPduCrossPartitionDestination = false
              PduRDestPduDataProvision = PDUR_DIRECT
              PduRTransmissionConfirmation = false
              PduRDestPduRef = VcuMeasurementMsg0_oTC37X_VCU_CAN01_d96481d0_Tx
              PduRDestPduPduRBswModulesRef = CanIf
            PduRSrcPdu_9fbb06ad (PduRSrcPdu):
              PduRSourcePduHandleId = 33
              PduRSrcPduDirection = TRANSMIT
              PduRSrcPduRef = VcuMeasurementMsg0_oTC37X_VCU_CAN01_0deb23c3_Tx
              PduRSrcPduPduRBswModulesRef = Com
          VcuRxCtrlMsg2_oTC37X_VCU_CAN01_b9326e7d_Rx: PduRRoutingPathCommunicationType=COMMUNICATION_INTERFACE
            PduRSrcPdu_d7cb99e6 (PduRSrcPdu): PduRSourcePduHandleId=34, PduRSrcPduDirection=RECEIVE, PduRSrcPduRef=VcuRxCtrlMsg2_oTC37X_VCU_CAN01_b9326e7d_Rx, PduRSrcPduPduRBswModulesRef=CanIf
            VcuRxCtrlMsg2_oTC37X_VCU_CAN01_b9326e7d_Rx_d7cb99e6_Rx (PduRDestPdu):
              PduRDestPduHandleId = 34
              PduRDestPduDirection = RECEIVE
              PduRDestPduRoutingType = API_FORWARDING
              PduRDestPduDataProcessing = IMMEDIATE
              PduRPduLengthHandlingStrategy = IGNORE
              PduRDestPduCrossPartitionDestination = false
              PduRTransmissionConfirmation = false
              PduRDestPduRef = VcuRxCtrlMsg2_oTC37X_VCU_CAN01_b79e4137_Rx
              PduRDestPduPduRBswModulesRef = Com
          Vcu_Lin3_TxMsg2_oLIN02_8266ef99_Tx: PduRRoutingPathCommunicationType=COMMUNICATION_INTERFACE
            PduRSrcPdu_2efa4b01 (PduRSrcPdu): PduRSourcePduHandleId=47, PduRSrcPduDirection=TRANSMIT, PduRSrcPduRef=Vcu_Lin3_TxMsg2_oLIN02_8266ef99_Tx, PduRSrcPduPduRBswModulesRef=Com
            Vcu_Lin3_TxMsg2_oLIN02_80a2835b_Tx (PduRDestPdu):
              PduRDestPduHandleId = 47
              PduRDestPduDirection = TRANSMIT
              PduRDestPduRoutingType = API_FORWARDING
              PduRDestPduDataProcessing = IMMEDIATE
              PduRPduLengthHandlingStrategy = IGNORE
              PduRDestPduCrossPartitionDestination = false
              PduRDestPduDataProvision = PDUR_TRIGGERTRANSMIT
              PduRTransmissionConfirmation = false
              PduRDestPduRef = Vcu_Lin3_TxMsg2_oLIN02_80a2835b_Tx
              PduRDestPduPduRBswModulesRef = LinIf
          Vcu_Lin3_RxMsg2_oLIN02_851e8d15_Rx: PduRRoutingPathCommunicationType=COMMUNICATION_INTERFACE
            Vcu_Lin3_RxMsg2_oLIN02_851e8d15_Rx_3b03dfb1_Rx (PduRDestPdu):
              PduRDestPduHandleId = 42
              PduRDestPduDirection = RECEIVE
              PduRDestPduRoutingType = API_FORWARDING
              PduRDestPduDataProcessing = IMMEDIATE
              PduRPduLengthHandlingStrategy = IGNORE
              PduRDestPduCrossPartitionDestination = false
              PduRTransmissionConfirmation = false
              PduRDestPduRef = Vcu_Lin3_RxMsg2_oLIN02_22833044_Rx
              PduRDestPduPduRBswModulesRef = Com
            PduRSrcPdu_3b03dfb1 (PduRSrcPdu): PduRSourcePduHandleId=42, PduRSrcPduDirection=RECEIVE, PduRSrcPduRef=Vcu_Lin3_RxMsg2_oLIN02_851e8d15_Rx, PduRSrcPduPduRBswModulesRef=LinIf
          Vcu_Lin3_RxMsg1_oLIN02_f3fbb428_Rx: PduRRoutingPathCommunicationType=COMMUNICATION_INTERFACE
            Vcu_Lin3_RxMsg1_oLIN02_f3fbb428_Rx_916b2dbb_Rx (PduRDestPdu):
              PduRDestPduHandleId = 41
              PduRDestPduDirection = RECEIVE
              PduRDestPduRoutingType = API_FORWARDING
              PduRDestPduDataProcessing = IMMEDIATE
              PduRPduLengthHandlingStrategy = IGNORE
              PduRDestPduCrossPartitionDestination = false
              PduRTransmissionConfirmation = false
              PduRDestPduRef = Vcu_Lin3_RxMsg1_oLIN02_ac0c37a7_Rx
              PduRDestPduPduRBswModulesRef = Com
            PduRSrcPdu_916b2dbb (PduRSrcPdu): PduRSourcePduHandleId=41, PduRSrcPduDirection=RECEIVE, PduRSrcPduRef=Vcu_Lin3_RxMsg1_oLIN02_f3fbb428_Rx, PduRSrcPduPduRBswModulesRef=LinIf
          Vcu_Lin3_TxMsg1_oLIN02_0ce9e87a_Tx: PduRRoutingPathCommunicationType=COMMUNICATION_INTERFACE
            Vcu_Lin3_TxMsg1_oLIN02_f647ba66_Tx (PduRDestPdu):
              PduRDestPduHandleId = 46
              PduRDestPduDirection = TRANSMIT
              PduRDestPduRoutingType = API_FORWARDING
              PduRDestPduDataProcessing = IMMEDIATE
              PduRPduLengthHandlingStrategy = IGNORE
              PduRDestPduCrossPartitionDestination = false
              PduRDestPduDataProvision = PDUR_TRIGGERTRANSMIT
              PduRTransmissionConfirmation = false
              PduRDestPduRef = Vcu_Lin3_TxMsg1_oLIN02_f647ba66_Tx
              PduRDestPduPduRBswModulesRef = LinIf
            PduRSrcPdu_78b4954c (PduRSrcPdu): PduRSourcePduHandleId=46, PduRSrcPduDirection=TRANSMIT, PduRSrcPduRef=Vcu_Lin3_TxMsg1_oLIN02_0ce9e87a_Tx, PduRSrcPduPduRBswModulesRef=Com
      PduRLock_PduRExclusiveArea (PduRLock)
        PduRExclusiveArea: PduRExclusiveAreaId=0
    5 x PduRBswModules, all with PduRCancelReceive=false, PduRChangeParameterRequestApi=false:
      CanIf: PduRCancelTransmit=false, PduRCommunicationInterface=true, PduRLowerModule=true, PduRTransportProtocol=false, PduRTriggertransmit=false, PduRTxConfirmation=false, PduRUpperModule=false, PduRUseTag=false, PduRBswModuleRef=CanIf
      Com: PduRCancelTransmit=false, PduRCommunicationInterface=true, PduRLowerModule=false, PduRTransportProtocol=false, PduRTriggertransmit=true, PduRTxConfirmation=false, PduRUpperModule=true, PduRUseTag=false, PduRBswModuleRef=Com
      Dcm: PduRCancelTransmit=true, PduRCommunicationInterface=false, PduRLowerModule=false, PduRTransportProtocol=true, PduRTriggertransmit=false, PduRTxConfirmation=false, PduRUpperModule=true, PduRUseTag=true, PduRBswModuleRef=Dcm
      CanTp: PduRCancelTransmit=true, PduRCommunicationInterface=false, PduRLowerModule=true, PduRTransportProtocol=true, PduRTriggertransmit=false, PduRTxConfirmation=false, PduRUpperModule=false, PduRUseTag=false, PduRBswModuleRef=CanTp
      LinIf: PduRCancelTransmit=false, PduRCommunicationInterface=true, PduRLowerModule=true, PduRTransportProtocol=false, PduRTriggertransmit=true, PduRTxConfirmation=true, PduRUpperModule=false, PduRUseTag=false, PduRBswModuleRef=LinIf
