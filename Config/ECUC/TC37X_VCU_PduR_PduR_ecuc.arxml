AUTOSAR XML (schema 00048)
package /ActiveEcuC
  module config PduR: implementation-config-variant=VARIANT-PRE-COMPILE, module-description=PduR_Impl
    PduRGeneral:
      PduRDevErrorDetect = true
      PduRVersionInfoApi = false
      PduRMetaDataSupport = false
      PduRPduCallback = false
      PduRSwitching = false
      PduRSafeBswChecks = false
      PduREnableDeferredTransmission = false
      PduREnableDeferredReception = false
      PduRSupportMulticore = false
      PduRRoutingTypeGateway = false
      PduRSpinlockRetryCounter = 4294967295
      PduRExtendedErrorChecks = false
      PduRGeneration:
        PduROutOfBoundsWriteProtectionStrategy = NONE
        PduROutOfBoundsWriteSanitizer = false
        PduROutOfBoundsReadSanitizer = false
        PduRNumericalDataTypeMinimizationStrategy = WITH_CAST
        PduRReduceConstantData2Define = false
        PduRBoolDataInArrayOfStructStrategy = BITMASKING
        PduRDeduplicateIndirectedData = true
        PduRDataDeduplicationStrategy = WITH_CAST
        PduRReduceBoolDataByNegationThreshold = 2
        PduRReduceBoolDataByNumericalComparisonThreshold = 2
        PduRReduceBoolDataByNumericalRelationThreshold = 2
        PduRReduceBoolDataByNumericalOperandStrategy = WITH_ANY_VALUE
        PduRReduceNumericalDataByOffsetThreshold = 2
        PduRReduceNumericalDataByArraySubtractionThreshold = 2
        PduRReduceDataByStreaming = false
        PduRShortSymbols = false
        PduRInterfacesForDeactivatedData = false
        PduRReferringKeysInComments = false
    PduRRoutingTables: PduRConfigurationId=0
      PduRRoutingTable
        185 x PduRRoutingPath, all with PduRMulticoreRoutingPath=false, PduRLockRef=PduRLock_PduRExclusiveArea:
          VcuRxMsg4_oTC37X_VCU_CAN01_55be06ba_Rx: PduRRoutingPathCommunicationType=COMMUNICATION_INTERFACE
            VcuRxMsg4_oTC37X_VCU_CAN01_55be06ba_Rx_f5b46736_Rx (PduRDestPdu):
              PduRDestPduHandleId = 106
              PduRDestPduDirection = RECEIVE
              PduRDestPduRoutingType = API_FORWARDING
              PduRDestPduDataProcessing = IMMEDIATE
              PduRPduLengthHandlingStrategy = IGNORE
              PduRDestPduCrossPartitionDestination = false
              PduRTransmissionConfirmation = false
              PduRDestPduRef = VcuRxMsg4_oTC37X_VCU_CAN01_eb7d04e5_Rx
              PduRDestPduPduRBswModulesRef = Com
            PduRSrcPdu_f5b46736 (PduRSrcPdu): PduRSourcePduHandleId=106, PduRSrcPduDirection=RECEIVE, PduRSrcPduRef=VcuRxMsg4_oTC37X_VCU_CAN01_55be06ba_Rx, PduRSrcPduPduRBswModulesRef=CanIf
          VcuRxMsg3_oTC37X_VCU_CAN01_5bb4c01a_Rx: PduRRoutingPathCommunicationType=COMMUNICATION_INTERFACE
            PduRSrcPdu_3905054b (PduRSrcPdu): PduRSourcePduHandleId=105, PduRSrcPduDirection=RECEIVE, PduRSrcPduRef=VcuRxMsg3_oTC37X_VCU_CAN01_5bb4c01a_Rx, PduRSrcPduPduRBswModulesRef=CanIf
            VcuRxMsg3_oTC37X_VCU_CAN01_5bb4c01a_Rx_3905054b_Rx (PduRDestPdu):
              PduRDestPduHandleId = 105
              PduRDestPduDirection = RECEIVE
              PduRDestPduRoutingType = API_FORWARDING
              PduRDestPduDataProcessing = IMMEDIATE
              PduRPduLengthHandlingStrategy = IGNORE
              PduRDestPduCrossPartitionDestination = false
              PduRTransmissionConfirmation = false
              PduRDestPduRef = VcuRxMsg3_oTC37X_VCU_CAN01_0a530e81_Rx
              PduRDestPduPduRBswModulesRef = Com
          PMP3_Sts_oLIN00_4e808b3d_Rx: PduRRoutingPathCommunicationType=COMMUNICATION_INTERFACE
            PMP3_Sts_oLIN00_4e808b3d_Rx_43cea622_Rx (PduRDestPdu):
              PduRDestPduHandleId = 77
              PduRDestPduDirection = RECEIVE
              PduRDestPduRoutingType = API_FORWARDING
              PduRDestPduDataProcessing = IMMEDIATE
              PduRPduLengthHandlingStrategy = IGNORE
              PduRDestPduCrossPartitionDestination = false
              PduRTransmissionConfirmation = false
              PduRDestPduRef = PMP3_Sts_oLIN00_511c4704_Rx
              PduRDestPduPduRBswModulesRef = Com
            PduRSrcPdu_43cea622 (PduRSrcPdu): PduRSourcePduHandleId=77, PduRSrcPduDirection=RECEIVE, PduRSrcPduRef=PMP3_Sts_oLIN00_4e808b3d_Rx, PduRSrcPduPduRBswModulesRef=LinIf
          EXV_2_VCU_oLIN00_85f64a15_Rx: PduRRoutingPathCommunicationType=COMMUNICATION_INTERFACE
            PduRSrcPdu_b894d38e (PduRSrcPdu): PduRSourcePduHandleId=52, PduRSrcPduDirection=RECEIVE, PduRSrcPduRef=EXV_2_VCU_oLIN00_85f64a15_Rx, PduRSrcPduPduRBswModulesRef=LinIf
            EXV_2_VCU_oLIN00_85f64a15_Rx_b894d38e_Rx (PduRDestPdu):
              PduRDestPduHandleId = 52
              PduRDestPduDirection = RECEIVE
              PduRDestPduRoutingType = API_FORWARDING
              PduRDestPduDataProcessing = IMMEDIATE
              PduRPduLengthHandlingStrategy = IGNORE
              PduRDestPduCrossPartitionDestination = false
              PduRTransmissionConfirmation = false
              PduRDestPduRef = EXV_2_VCU_oLIN00_1e4a3daf_Rx
              PduRDestPduPduRBswModulesRef = Com
          PMP_Cmd_oLIN00_3912b28b_Tx: PduRRoutingPathCommunicationType=COMMUNICATION_INTERFACE
            PduRSrcPdu_4bd8719a (PduRSrcPdu): PduRSourcePduHandleId=16, PduRSrcPduDirection=TRANSMIT, PduRSrcPduRef=PMP_Cmd_oLIN00_3912b28b_Tx, PduRSrcPduPduRBswModulesRef=Com
            PMP_Cmd_oLIN00_6d889c97_Tx (PduRDestPdu):
              PduRDestPduHandleId = 8
              PduRDestPduDirection = TRANSMIT
              PduRDestPduRoutingType = API_FORWARDING
              PduRDestPduDataProcessing = IMMEDIATE
              PduRPduLengthHandlingStrategy = IGNORE
              PduRDestPduCrossPartitionDestination = false
              PduRDestPduDataProvision = PDUR_TRIGGERTRANSMIT
              PduRTransmissionConfirmation = false
              PduRDestPduRef = PMP_Cmd_oLIN00_6d889c97_Tx
              PduRDestPduPduRBswModulesRef = LinIf
          EXV2_Status_oLIN00_7fcf9f75_Rx: PduRRoutingPathCommunicationType=COMMUNICATION_INTERFACE
            EXV2_Status_oLIN00_7fcf9f75_Rx_c3f2be6b_Rx (PduRDestPdu):
              PduRDestPduHandleId = 50
              PduRDestPduDirection = RECEIVE
              PduRDestPduRoutingType = API_FORWARDING
              PduRDestPduDataProcessing = IMMEDIATE
              PduRPduLengthHandlingStrategy = IGNORE
              PduRDestPduCrossPartitionDestination = false
              PduRTransmissionConfirmation = false
              PduRDestPduRef = EXV2_Status_oLIN00_d5e93929_Rx
              PduRDestPduPduRBswModulesRef = Com
            PduRSrcPdu_c3f2be6b (PduRSrcPdu): PduRSourcePduHandleId=50, PduRSrcPduDirection=RECEIVE, PduRSrcPduRef=EXV2_Status_oLIN00_7fcf9f75_Rx, PduRSrcPduPduRBswModulesRef=LinIf
          SVA_VCU_STD_oLIN00_4f0795ef_Rx: PduRRoutingPathCommunicationType=COMMUNICATION_INTERFACE
            PduRSrcPdu_166cd16c (PduRSrcPdu): PduRSourcePduHandleId=96, PduRSrcPduDirection=RECEIVE, PduRSrcPduRef=SVA_VCU_STD_oLIN00_4f0795ef_Rx, PduRSrcPduPduRBswModulesRef=LinIf
            SVA_VCU_STD_oLIN00_4f0795ef_Rx_166cd16c_Rx (PduRDestPdu):
              PduRDestPduHandleId = 96
              PduRDestPduDirection = RECEIVE
              PduRDestPduRoutingType = API_FORWARDING
              PduRDestPduDataProcessing = IMMEDIATE
              PduRPduLengthHandlingStrategy = IGNORE
              PduRDestPduCrossPartitionDestination = false
              PduRTransmissionConfirmation = false
              PduRDestPduRef = SVA_VCU_STD_oLIN00_4526aa1c_Rx
              PduRDestPduPduRBswModulesRef = Com
          HVCH_Rsp02_oLIN00_a3ea669e_Rx: PduRRoutingPathCommunicationType=COMMUNICATION_INTERFACE
            HVCH_Rsp02_oLIN00_a3ea669e_Rx_90a9658c_Rx (PduRDestPdu):
              PduRDestPduHandleId = 54
              PduRDestPduDirection = RECEIVE
              PduRDestPduRoutingType = API_FORWARDING
              PduRDestPduDataProcessing = IMMEDIATE
              PduRPduLengthHandlingStrategy = IGNORE
              PduRDestPduCrossPartitionDestination = false
              PduRTransmissionConfirmation = false
              PduRDestPduRef = HVCH_Rsp02_oLIN00_286c390c_Rx
              PduRDestPduPduRBswModulesRef = Com
            PduRSrcPdu_90a9658c (PduRSrcPdu): PduRSourcePduHandleId=54, PduRSrcPduDirection=RECEIVE, PduRSrcPduRef=HVCH_Rsp02_oLIN00_a3ea669e_Rx, PduRSrcPduPduRBswModulesRef=LinIf
          VCU_EXV_1_oLIN00_50eec975_Tx: PduRRoutingPathCommunicationType=COMMUNICATION_INTERFACE
            PduRSrcPdu_91ca29f5 (PduRSrcPdu): PduRSourcePduHandleId=32, PduRSrcPduDirection=TRANSMIT, PduRSrcPduRef=VCU_EXV_1_oLIN00_50eec975_Tx, PduRSrcPduPduRBswModulesRef=Com
            VCU_EXV_1_oLIN00_58a890ac_Tx (PduRDestPdu):
              PduRDestPduHandleId = 24
              PduRDestPduDirection = TRANSMIT
              PduRDestPduRoutingType = API_FORWARDING
              PduRDestPduDataProcessing = IMMEDIATE
              PduRPduLengthHandlingStrategy = IGNORE
              PduRDestPduCrossPartitionDestination = false
              PduRDestPduDataProvision = PDUR_TRIGGERTRANSMIT
              PduRTransmissionConfirmation = false
              PduRDestPduRef = VCU_EXV_1_oLIN00_58a890ac_Tx
              PduRDestPduPduRBswModulesRef = LinIf
          VCU_SVA_CMD_oLIN00_756d14f6_Tx: PduRRoutingPathCommunicationType=COMMUNICATION_INTERFACE
            PduRSrcPdu_b06eca36 (PduRSrcPdu): PduRSourcePduHandleId=45, PduRSrcPduDirection=TRANSMIT, PduRSrcPduRef=VCU_SVA_CMD_oLIN00_756d14f6_Tx, PduRSrcPduPduRBswModulesRef=Com
            VCU_SVA_CMD_oLIN00_89e2bb7b_Tx (PduRDestPdu):
              PduRDestPduHandleId = 37
              PduRDestPduDirection = TRANSMIT
              PduRDestPduRoutingType = API_FORWARDING
              PduRDestPduDataProcessing = IMMEDIATE
              PduRPduLengthHandlingStrategy = IGNORE
              PduRDestPduCrossPartitionDestination = false
              PduRDestPduDataProvision = PDUR_TRIGGERTRANSMIT
              PduRTransmissionConfirmation = false
              PduRDestPduRef = VCU_SVA_CMD_oLIN00_89e2bb7b_Tx
              PduRDestPduPduRBswModulesRef = LinIf
          HVCH_Rsp01_oLIN00_d50f5fa3_Rx: PduRRoutingPathCommunicationType=COMMUNICATION_INTERFACE
            HVCH_Rsp01_oLIN00_d50f5fa3_Rx_aa2a3f7d_Rx (PduRDestPdu):
              PduRDestPduHandleId = 53
              PduRDestPduDirection = RECEIVE
              PduRDestPduRoutingType = API_FORWARDING
              PduRDestPduDataProcessing = IMMEDIATE
              PduRPduLengthHandlingStrategy = IGNORE
              PduRDestPduCrossPartitionDestination = false
              PduRTransmissionConfirmation = false
              PduRDestPduRef = HVCH_Rsp01_oLIN00_a6e33eef_Rx
              PduRDestPduPduRBswModulesRef = Com
            PduRSrcPdu_aa2a3f7d (PduRSrcPdu): PduRSourcePduHandleId=53, PduRSrcPduDirection=RECEIVE, PduRSrcPduRef=HVCH_Rsp01_oLIN00_d50f5fa3_Rx, PduRSrcPduPduRBswModulesRef=LinIf
          EXV_1_VCU_oLIN00_366267d6_Rx: PduRRoutingPathCommunicationType=COMMUNICATION_INTERFACE
            EXV_1_VCU_oLIN00_366267d6_Rx_718a1cfb_Rx (PduRDestPdu):
              PduRDestPduHandleId = 51
              PduRDestPduDirection = RECEIVE
              PduRDestPduRoutingType = API_FORWARDING
              PduRDestPduDataProcessing = IMMEDIATE
              PduRPduLengthHandlingStrategy = IGNORE
              PduRDestPduCrossPartitionDestination = false
              PduRTransmissionConfirmation = false
              PduRDestPduRef = EXV_1_VCU_oLIN00_69d4ef5f_Rx
              PduRDestPduPduRBswModulesRef = Com
            PduRSrcPdu_718a1cfb (PduRSrcPdu): PduRSourcePduHandleId=51, PduRSrcPduDirection=RECEIVE, PduRSrcPduRef=EXV_1_VCU_oLIN00_366267d6_Rx, PduRSrcPduPduRBswModulesRef=LinIf
          PMP2_Sts_oLIN00_200c907c_Rx: PduRRoutingPathCommunicationType=COMMUNICATION_INTERFACE
            PduRSrcPdu_9a742e46 (PduRSrcPdu): PduRSourcePduHandleId=76, PduRSrcPduDirection=RECEIVE, PduRSrcPduRef=PMP2_Sts_oLIN00_200c907c_Rx, PduRSrcPduPduRBswModulesRef=LinIf
            PMP2_Sts_oLIN00_200c907c_Rx_9a742e46_Rx (PduRDestPdu):
              PduRDestPduHandleId = 76
              PduRDestPduDirection = RECEIVE
              PduRDestPduRoutingType = API_FORWARDING
              PduRDestPduDataProcessing = IMMEDIATE
              PduRPduLengthHandlingStrategy = IGNORE
              PduRDestPduCrossPartitionDestination = false
              PduRTransmissionConfirmation = false
              PduRDestPduRef = PMP2_Sts_oLIN00_cab90b6b_Rx
              PduRDestPduPduRBswModulesRef = Com
          TCU_HVCH_Cmd_oLIN00_385d5651_Tx: PduRRoutingPathCommunicationType=COMMUNICATION_INTERFACE
            TCU_HVCH_Cmd_oLIN00_ddc31229_Tx (PduRDestPdu):
              PduRDestPduHandleId = 9
              PduRDestPduDirection = TRANSMIT
              PduRDestPduRoutingType = API_FORWARDING
              PduRDestPduDataProcessing = IMMEDIATE
              PduRPduLengthHandlingStrategy = IGNORE
              PduRDestPduCrossPartitionDestination = false
              PduRDestPduDataProvision = PDUR_TRIGGERTRANSMIT
              PduRTransmissionConfirmation = false
              PduRDestPduRef = TCU_HVCH_Cmd_oLIN00_ddc31229_Tx
              PduRDestPduPduRBswModulesRef = LinIf
            PduRSrcPdu_6a17111c (PduRSrcPdu): PduRSourcePduHandleId=17, PduRSrcPduDirection=TRANSMIT, PduRSrcPduRef=TCU_HVCH_Cmd_oLIN00_385d5651_Tx, PduRSrcPduPduRBswModulesRef=Com
          EDCU_EXV2_oLIN00_1f8750a5_Tx: PduRRoutingPathCommunicationType=COMMUNICATION_INTERFACE
            EDCU_EXV2_oLIN00_18b050dc_Tx (PduRDestPdu):
              PduRDestPduHandleId = 7
              PduRDestPduDirection = TRANSMIT
              PduRDestPduRoutingType = API_FORWARDING
              PduRDestPduDataProcessing = IMMEDIATE
              PduRPduLengthHandlingStrategy = IGNORE
              PduRDestPduCrossPartitionDestination = false
              PduRDestPduDataProvision = PDUR_TRIGGERTRANSMIT
              PduRTransmissionConfirmation = false
              PduRDestPduRef = EDCU_EXV2_oLIN00_18b050dc_Tx
              PduRDestPduPduRBswModulesRef = LinIf
            PduRSrcPdu_0361509d (PduRSrcPdu): PduRSourcePduHandleId=15, PduRSrcPduDirection=TRANSMIT, PduRSrcPduRef=EDCU_EXV2_oLIN00_1f8750a5_Tx, PduRSrcPduPduRBswModulesRef=Com
          VCU_EXV_2_oLIN00_de61ce96_Tx: PduRRoutingPathCommunicationType=COMMUNICATION_INTERFACE
            PduRSrcPdu_9414725b (PduRSrcPdu): PduRSourcePduHandleId=33, PduRSrcPduDirection=TRANSMIT, PduRSrcPduRef=VCU_EXV_2_oLIN00_de61ce96_Tx, PduRSrcPduPduRBswModulesRef=Com
            VCU_EXV_2_oLIN00_2e4da991_Tx (PduRDestPdu):
              PduRDestPduHandleId = 25
              PduRDestPduDirection = TRANSMIT
              PduRDestPduRoutingType = API_FORWARDING
              PduRDestPduDataProcessing = IMMEDIATE
              PduRPduLengthHandlingStrategy = IGNORE
              PduRDestPduCrossPartitionDestination = false
              PduRDestPduDataProvision = PDUR_TRIGGERTRANSMIT
              PduRTransmissionConfirmation = false
              PduRDestPduRef = VCU_EXV_2_oLIN00_2e4da991_Tx
              PduRDestPduPduRBswModulesRef = LinIf
          VcuCan03RxMsg2_oTC37X_VCU_CAN03_84e608b6_Rx: PduRRoutingPathCommunicationType=COMMUNICATION_INTERFACE
            VcuCan03RxMsg2_oTC37X_VCU_CAN03_84e608b6_Rx_a2204cbf_Rx (PduRDestPdu):
              PduRDestPduHandleId = 101
              PduRDestPduDirection = RECEIVE
              PduRDestPduRoutingType = API_FORWARDING
              PduRDestPduDataProcessing = IMMEDIATE
              PduRPduLengthHandlingStrategy = IGNORE
              PduRDestPduCrossPartitionDestination = false
              PduRTransmissionConfirmation = false
              PduRDestPduRef = VcuCan03RxMsg2_oTC37X_VCU_CAN03_9d657a3d_Rx
              PduRDestPduPduRBswModulesRef = Com
            PduRSrcPdu_a2204cbf (PduRSrcPdu):
              PduRSourcePduHandleId = 101
              PduRSrcPduDirection = RECEIVE
              PduRSrcPduRef = VcuCan03RxMsg2_oTC37X_VCU_CAN03_84e608b6_Rx
              PduRSrcPduPduRBswModulesRef = CanIf
          VcuCan03TxMsg2_oTC37X_VCU_CAN03_70af0847_Tx: PduRRoutingPathCommunicationType=COMMUNICATION_INTERFACE
            PduRSrcPdu_a59b3a32 (PduRSrcPdu): PduRSourcePduHandleId=61, PduRSrcPduDirection=TRANSMIT, PduRSrcPduRef=VcuCan03TxMsg2_oTC37X_VCU_CAN03_70af0847_Tx, PduRSrcPduPduRBswModulesRef=Com
            VcuCan03TxMsg2_oTC37X_VCU_CAN03_0942627e_Tx (PduRDestPdu):
              PduRDestPduHandleId = 53
              PduRDestPduDirection = TRANSMIT
              PduRDestPduRoutingType = API_FORWARDING
              PduRDestPduDataProcessing = IMMEDIATE
              PduRPduLengthHandlingStrategy = IGNORE
              PduRDestPduCrossPartitionDestination = false
              PduRDestPduDataProvision = PDUR_DIRECT
              PduRTransmissionConfirmation = false
              PduRDestPduRef = VcuCan03TxMsg2_oTC37X_VCU_CAN03_0942627e_Tx
              PduRDestPduPduRBswModulesRef = CanIf
          VcuCan03RxMsg1_oTC37X_VCU_CAN03_4dd213bb_Rx: PduRRoutingPathCommunicationType=COMMUNICATION_INTERFACE
            PduRSrcPdu_4e610413 (PduRSrcPdu):
              PduRSourcePduHandleId = 100
              PduRSrcPduDirection = RECEIVE
              PduRSrcPduRef = VcuCan03RxMsg1_oTC37X_VCU_CAN03_4dd213bb_Rx
              PduRSrcPduPduRBswModulesRef = CanIf
            VcuCan03RxMsg1_oTC37X_VCU_CAN03_4dd213bb_Rx_4e610413_Rx (PduRDestPdu):
              PduRDestPduHandleId = 100
              PduRDestPduDirection = RECEIVE
              PduRDestPduRoutingType = API_FORWARDING
              PduRDestPduDataProcessing = IMMEDIATE
              PduRPduLengthHandlingStrategy = IGNORE
              PduRDestPduCrossPartitionDestination = false
              PduRTransmissionConfirmation = false
              PduRDestPduRef = VcuCan03RxMsg1_oTC37X_VCU_CAN03_77e3a75f_Rx
              PduRDestPduPduRBswModulesRef = Com
          VcuCan03TxMsg1_oTC37X_VCU_CAN03_9a29d525_Tx: PduRRoutingPathCommunicationType=COMMUNICATION_INTERFACE
            VcuCan03TxMsg1_oTC37X_VCU_CAN03_c0767973_Tx (PduRDestPdu):
              PduRDestPduHandleId = 52
              PduRDestPduDirection = TRANSMIT
              PduRDestPduRoutingType = API_FORWARDING
              PduRDestPduDataProcessing = IMMEDIATE
              PduRPduLengthHandlingStrategy = IGNORE
              PduRDestPduCrossPartitionDestination = false
              PduRDestPduDataProvision = PDUR_DIRECT
              PduRTransmissionConfirmation = false
              PduRDestPduRef = VcuCan03TxMsg1_oTC37X_VCU_CAN03_c0767973_Tx
              PduRDestPduPduRBswModulesRef = CanIf
            PduRSrcPdu_6c0ea6d2 (PduRSrcPdu): PduRSourcePduHandleId=60, PduRSrcPduDirection=TRANSMIT, PduRSrcPduRef=VcuCan03TxMsg1_oTC37X_VCU_CAN03_9a29d525_Tx, PduRSrcPduPduRBswModulesRef=Com
          Vcu_Lin0_RxMsg2_oLIN01_717e4d45_Rx: PduRRoutingPathCommunicationType=COMMUNICATION_INTERFACE
            PduRSrcPdu_d314568e (PduRSrcPdu): PduRSourcePduHandleId=108, PduRSrcPduDirection=RECEIVE, PduRSrcPduRef=Vcu_Lin0_RxMsg2_oLIN01_717e4d45_Rx, PduRSrcPduPduRBswModulesRef=LinIf
            Vcu_Lin0_RxMsg2_oLIN01_717e4d45_Rx_d314568e_Rx (PduRDestPdu):
              PduRDestPduHandleId = 108
              PduRDestPduDirection = RECEIVE
              PduRDestPduRoutingType = API_FORWARDING
              PduRDestPduDataProcessing = IMMEDIATE
              PduRPduLengthHandlingStrategy = IGNORE
              PduRDestPduCrossPartitionDestination = false
              PduRTransmissionConfirmation = false
              PduRDestPduRef = Vcu_Lin0_RxMsg2_oLIN01_aaf70b87_Rx
              PduRDestPduPduRBswModulesRef = Com
          Vcu_Lin0_TxMsg2_oLIN01_0a12d45a_Tx: PduRRoutingPathCommunicationType=COMMUNICATION_INTERFACE
            Vcu_Lin0_TxMsg2_oLIN01_74c2430b_Tx (PduRDestPdu):
              PduRDestPduHandleId = 57
              PduRDestPduDirection = TRANSMIT
              PduRDestPduRoutingType = API_FORWARDING
              PduRDestPduDataProcessing = IMMEDIATE
              PduRPduLengthHandlingStrategy = IGNORE
              PduRDestPduCrossPartitionDestination = false
              PduRDestPduDataProvision = PDUR_TRIGGERTRANSMIT
              PduRTransmissionConfirmation = false
              PduRDestPduRef = Vcu_Lin0_TxMsg2_oLIN01_74c2430b_Tx
              PduRDestPduPduRBswModulesRef = LinIf
            PduRSrcPdu_0417dd35 (PduRSrcPdu): PduRSourcePduHandleId=65, PduRSrcPduDirection=TRANSMIT, PduRSrcPduRef=Vcu_Lin0_TxMsg2_oLIN01_0a12d45a_Tx, PduRSrcPduPduRBswModulesRef=Com
          Vcu_Lin0_TxMsg1_oLIN01_849dd3b9_Tx: PduRRoutingPathCommunicationType=COMMUNICATION_INTERFACE
            PduRSrcPdu_ff5e60c1 (PduRSrcPdu): PduRSourcePduHandleId=64, PduRSrcPduDirection=TRANSMIT, PduRSrcPduRef=Vcu_Lin0_TxMsg1_oLIN01_849dd3b9_Tx, PduRSrcPduPduRBswModulesRef=Com
            Vcu_Lin0_TxMsg1_oLIN01_02277a36_Tx (PduRDestPdu):
              PduRDestPduHandleId = 56
              PduRDestPduDirection = TRANSMIT
              PduRDestPduRoutingType = API_FORWARDING
              PduRDestPduDataProcessing = IMMEDIATE
              PduRPduLengthHandlingStrategy = IGNORE
              PduRDestPduCrossPartitionDestination = false
              PduRTransmissionConfirmation = false
              PduRDestPduDataProvision = PDUR_TRIGGERTRANSMIT
              PduRDestPduRef = Vcu_Lin0_TxMsg1_oLIN01_02277a36_Tx
              PduRDestPduPduRBswModulesRef = LinIf
          Vcu_Lin0_RxMsg1_oLIN01_079b7478_Rx: PduRRoutingPathCommunicationType=COMMUNICATION_INTERFACE
            Vcu_Lin0_RxMsg1_oLIN01_079b7478_Rx_12331c6c_Rx (PduRDestPdu):
              PduRDestPduHandleId = 107
              PduRDestPduDirection = RECEIVE
              PduRDestPduRoutingType = API_FORWARDING
              PduRDestPduDataProcessing = IMMEDIATE
              PduRPduLengthHandlingStrategy = IGNORE
              PduRDestPduCrossPartitionDestination = false
              PduRTransmissionConfirmation = false
              PduRDestPduRef = Vcu_Lin0_RxMsg1_oLIN01_24780c64_Rx
              PduRDestPduPduRBswModulesRef = Com
            PduRSrcPdu_12331c6c (PduRSrcPdu): PduRSourcePduHandleId=107, PduRSrcPduDirection=RECEIVE, PduRSrcPduRef=Vcu_Lin0_RxMsg1_oLIN01_079b7478_Rx, PduRSrcPduPduRBswModulesRef=LinIf
          VCU_HMIsignals_02_oATOM_CANFD_Matrix_CH_V600_202502_7949a1d5_Tx: PduRRoutingPathCommunicationType=COMMUNICATION_INTERFACE
            PduRSrcPdu_108c7515 (PduRSrcPdu):
              PduRSourcePduHandleId = 35
              PduRSrcPduDirection = TRANSMIT
              PduRSrcPduRef = VCU_HMIsignals_02_oATOM_CANFD_Matrix_CH_V600_202502_7949a1d5_Tx
              PduRSrcPduPduRBswModulesRef = Com
            VCU_HMIsignals_02_oATOM_CANFD_Matrix_CH_V600_202502_343b3975_Tx (PduRDestPdu):
              PduRDestPduHandleId = 27
              PduRDestPduDirection = TRANSMIT
              PduRDestPduRoutingType = API_FORWARDING
              PduRDestPduDataProcessing = IMMEDIATE
              PduRPduLengthHandlingStrategy = IGNORE
              PduRDestPduCrossPartitionDestination = false
              PduRDestPduDataProvision = PDUR_DIRECT
              PduRTransmissionConfirmation = false
              PduRDestPduRef = VCU_HMIsignals_02_oATOM_CANFD_Matrix_CH_V600_202502_343b3975_Tx
              PduRDestPduPduRBswModulesRef = CanIf
          VCU_Chassis_01_oATOM_CANFD_Matrix_CH_V600_202502_d7fdb34f_Tx: PduRRoutingPathCommunicationType=COMMUNICATION_INTERFACE
            VCU_Chassis_01_oATOM_CANFD_Matrix_CH_V600_202502_e79830d3_Tx (PduRDestPdu):
              PduRDestPduHandleId = 21
              PduRDestPduDirection = TRANSMIT
              PduRDestPduRoutingType = API_FORWARDING
              PduRDestPduDataProcessing = IMMEDIATE
              PduRPduLengthHandlingStrategy = IGNORE
              PduRDestPduCrossPartitionDestination = false
              PduRDestPduDataProvision = PDUR_DIRECT
              PduRTransmissionConfirmation = false
              PduRDestPduRef = VCU_Chassis_01_oATOM_CANFD_Matrix_CH_V600_202502_e79830d3_Tx
              PduRDestPduPduRBswModulesRef = CanIf
            PduRSrcPdu_49c8436f (PduRSrcPdu):
              PduRSourcePduHandleId = 29
              PduRSrcPduDirection = TRANSMIT
              PduRSrcPduRef = VCU_Chassis_01_oATOM_CANFD_Matrix_CH_V600_202502_d7fdb34f_Tx
              PduRSrcPduPduRBswModulesRef = Com
          VCU_02_oATOM_CANFD_Matrix_CH_V600_202502_17bac731_Tx: PduRRoutingPathCommunicationType=COMMUNICATION_INTERFACE
            VCU_02_oATOM_CANFD_Matrix_CH_V600_202502_b9b0de03_Tx (PduRDestPdu):
              PduRDestPduHandleId = 11
              PduRDestPduDirection = TRANSMIT
              PduRDestPduRoutingType = API_FORWARDING
              PduRDestPduDataProcessing = IMMEDIATE
              PduRPduLengthHandlingStrategy = IGNORE
              PduRDestPduCrossPartitionDestination = false
              PduRDestPduDataProvision = PDUR_DIRECT
              PduRTransmissionConfirmation = false
              PduRDestPduRef = VCU_02_oATOM_CANFD_Matrix_CH_V600_202502_b9b0de03_Tx
              PduRDestPduPduRBswModulesRef = CanIf
            PduRSrcPdu_fd46d90f (PduRSrcPdu):
              PduRSourcePduHandleId = 19
              PduRSrcPduDirection = TRANSMIT
              PduRSrcPduRef = VCU_02_oATOM_CANFD_Matrix_CH_V600_202502_17bac731_Tx
              PduRSrcPduPduRBswModulesRef = Com
          VCU_IBS_01_oATOM_CANFD_Matrix_CH_V600_202502_4c086bc0_Tx: PduRRoutingPathCommunicationType=COMMUNICATION_INTERFACE
            VCU_IBS_01_oATOM_CANFD_Matrix_CH_V600_202502_72f519e8_Tx (PduRDestPdu):
              PduRDestPduHandleId = 30
              PduRDestPduDirection = TRANSMIT
              PduRDestPduRoutingType = API_FORWARDING
              PduRDestPduDataProcessing = IMMEDIATE
              PduRPduLengthHandlingStrategy = IGNORE
              PduRDestPduCrossPartitionDestination = false
              PduRDestPduDataProvision = PDUR_DIRECT
              PduRTransmissionConfirmation = false
              PduRDestPduRef = VCU_IBS_01_oATOM_CANFD_Matrix_CH_V600_202502_72f519e8_Tx
              PduRDestPduPduRBswModulesRef = CanIf
            PduRSrcPdu_17f11187 (PduRSrcPdu):
              PduRSourcePduHandleId = 38
              PduRSrcPduDirection = TRANSMIT
              PduRSrcPduRef = VCU_IBS_01_oATOM_CANFD_Matrix_CH_V600_202502_4c086bc0_Tx
              PduRSrcPduPduRBswModulesRef = Com
          IBS_VCU_MotorControl_oATOM_CANFD_Matrix_CH_V600_202502_df4c437b_Rx: PduRRoutingPathCommunicationType=COMMUNICATION_INTERFACE
            IBS_VCU_MotorControl_oATOM_CANFD_Matrix_CH_V600_202502_df4c437b_Rx_4e239512_Rx (PduRDestPdu):
              PduRDestPduHandleId = 64
              PduRDestPduDirection = RECEIVE
              PduRDestPduRoutingType = API_FORWARDING
              PduRDestPduDataProcessing = IMMEDIATE
              PduRPduLengthHandlingStrategy = IGNORE
              PduRDestPduCrossPartitionDestination = false
              PduRTransmissionConfirmation = false
              PduRDestPduRef = IBS_VCU_MotorControl_oATOM_CANFD_Matrix_CH_V600_202502_d229d0d9_Rx
              PduRDestPduPduRBswModulesRef = Com
            PduRSrcPdu_4e239512 (PduRSrcPdu):
              PduRSourcePduHandleId = 64
              PduRSrcPduDirection = RECEIVE
              PduRSrcPduRef = IBS_VCU_MotorControl_oATOM_CANFD_Matrix_CH_V600_202502_df4c437b_Rx
              PduRSrcPduPduRBswModulesRef = CanIf
          IBS_Status_03_oATOM_CANFD_Matrix_CH_V600_202502_f451ac97_Rx: PduRRoutingPathCommunicationType=COMMUNICATION_INTERFACE
            IBS_Status_03_oATOM_CANFD_Matrix_CH_V600_202502_f451ac97_Rx_12481f07_Rx (PduRDestPdu):
              PduRDestPduHandleId = 59
              PduRDestPduDirection = RECEIVE
              PduRDestPduRoutingType = API_FORWARDING
              PduRDestPduDataProcessing = IMMEDIATE
              PduRPduLengthHandlingStrategy = IGNORE
              PduRDestPduCrossPartitionDestination = false
              PduRTransmissionConfirmation = false
              PduRDestPduRef = IBS_Status_03_oATOM_CANFD_Matrix_CH_V600_202502_f4245e85_Rx
              PduRDestPduPduRBswModulesRef = Com
            PduRSrcPdu_12481f07 (PduRSrcPdu):
              PduRSourcePduHandleId = 59
              PduRSrcPduDirection = RECEIVE
              PduRSrcPduRef = IBS_Status_03_oATOM_CANFD_Matrix_CH_V600_202502_f451ac97_Rx
              PduRSrcPduPduRBswModulesRef = CanIf
          ACU_info_oATOM_CANFD_Matrix_CH_V600_202502_83006605_Rx: PduRRoutingPathCommunicationType=COMMUNICATION_INTERFACE
            PduRSrcPdu_f767588b (PduRSrcPdu):
              PduRSourcePduHandleId = 2
              PduRSrcPduDirection = RECEIVE
              PduRSrcPduRef = ACU_info_oATOM_CANFD_Matrix_CH_V600_202502_83006605_Rx
              PduRSrcPduPduRBswModulesRef = CanIf
            ACU_info_oATOM_CANFD_Matrix_CH_V600_202502_83006605_Rx_f767588b_Rx (PduRDestPdu):
              PduRDestPduHandleId = 2
              PduRDestPduDirection = RECEIVE
              PduRDestPduRoutingType = API_FORWARDING
              PduRDestPduDataProcessing = IMMEDIATE
              PduRPduLengthHandlingStrategy = IGNORE
              PduRDestPduCrossPartitionDestination = false
              PduRTransmissionConfirmation = false
              PduRDestPduRef = ACU_info_oATOM_CANFD_Matrix_CH_V600_202502_c3757d77_Rx
              PduRDestPduPduRBswModulesRef = Com
          ADCU_APS_01_oATOM_CANFD_Matrix_CH_V600_202502_c0dbb601_Rx: PduRRoutingPathCommunicationType=COMMUNICATION_INTERFACE
            PduRSrcPdu_d84c121b (PduRSrcPdu):
              PduRSourcePduHandleId = 5
              PduRSrcPduDirection = RECEIVE
              PduRSrcPduRef = ADCU_APS_01_oATOM_CANFD_Matrix_CH_V600_202502_c0dbb601_Rx
              PduRSrcPduPduRBswModulesRef = CanIf
            ADCU_APS_01_oATOM_CANFD_Matrix_CH_V600_202502_c0dbb601_Rx_d84c121b_Rx (PduRDestPdu):
              PduRDestPduHandleId = 5
              PduRDestPduDirection = RECEIVE
              PduRDestPduRoutingType = API_FORWARDING
              PduRDestPduDataProcessing = IMMEDIATE
              PduRPduLengthHandlingStrategy = IGNORE
              PduRDestPduCrossPartitionDestination = false
              PduRTransmissionConfirmation = false
              PduRDestPduRef = ADCU_APS_01_oATOM_CANFD_Matrix_CH_V600_202502_d7aca41b_Rx
              PduRDestPduPduRBswModulesRef = Com
          VCU_HMIsignals_01_oATOM_CANFD_Matrix_CH_V600_202502_f29a9fcc_Tx: PduRRoutingPathCommunicationType=COMMUNICATION_INTERFACE
            VCU_HMIsignals_01_oATOM_CANFD_Matrix_CH_V600_202502_ad7bde1a_Tx (PduRDestPdu):
              PduRDestPduHandleId = 26
              PduRDestPduDirection = TRANSMIT
              PduRDestPduRoutingType = API_FORWARDING
              PduRDestPduDataProcessing = IMMEDIATE
              PduRPduLengthHandlingStrategy = IGNORE
              PduRDestPduCrossPartitionDestination = false
              PduRDestPduDataProvision = PDUR_DIRECT
              PduRTransmissionConfirmation = false
              PduRDestPduRef = VCU_HMIsignals_01_oATOM_CANFD_Matrix_CH_V600_202502_ad7bde1a_Tx
              PduRDestPduPduRBswModulesRef = CanIf
            PduRSrcPdu_c0ac8d7c (PduRSrcPdu):
              PduRSourcePduHandleId = 34
              PduRSrcPduDirection = TRANSMIT
              PduRSrcPduRef = VCU_HMIsignals_01_oATOM_CANFD_Matrix_CH_V600_202502_f29a9fcc_Tx
              PduRSrcPduPduRBswModulesRef = Com
          IBS_ACC_oATOM_CANFD_Matrix_CH_V600_202502_205c1446_Rx: PduRRoutingPathCommunicationType=COMMUNICATION_INTERFACE
            IBS_ACC_oATOM_CANFD_Matrix_CH_V600_202502_205c1446_Rx_ca3eaa8a_Rx (PduRDestPdu):
              PduRDestPduHandleId = 55
              PduRDestPduDirection = RECEIVE
              PduRDestPduRoutingType = API_FORWARDING
              PduRDestPduDataProcessing = IMMEDIATE
              PduRPduLengthHandlingStrategy = IGNORE
              PduRDestPduCrossPartitionDestination = false
              PduRTransmissionConfirmation = false
              PduRDestPduRef = IBS_ACC_oATOM_CANFD_Matrix_CH_V600_202502_ef8c28ba_Rx
              PduRDestPduPduRBswModulesRef = Com
            PduRSrcPdu_ca3eaa8a (PduRSrcPdu):
              PduRSourcePduHandleId = 55
              PduRSrcPduDirection = RECEIVE
              PduRSrcPduRef = IBS_ACC_oATOM_CANFD_Matrix_CH_V600_202502_205c1446_Rx
              PduRSrcPduPduRBswModulesRef = CanIf
          IBS_Status_02_oATOM_CANFD_Matrix_CH_V600_202502_35bef38d_Rx: PduRRoutingPathCommunicationType=COMMUNICATION_INTERFACE
            PduRSrcPdu_77b4603c (PduRSrcPdu):
              PduRSourcePduHandleId = 58
              PduRSrcPduDirection = RECEIVE
              PduRSrcPduRef = IBS_Status_02_oATOM_CANFD_Matrix_CH_V600_202502_35bef38d_Rx
              PduRSrcPduPduRBswModulesRef = CanIf
            IBS_Status_02_oATOM_CANFD_Matrix_CH_V600_202502_35bef38d_Rx_77b4603c_Rx (PduRDestPdu):
              PduRDestPduHandleId = 58
              PduRDestPduDirection = RECEIVE
              PduRDestPduRoutingType = API_FORWARDING
              PduRDestPduDataProcessing = IMMEDIATE
              PduRPduLengthHandlingStrategy = IGNORE
              PduRDestPduCrossPartitionDestination = false
              PduRTransmissionConfirmation = false
              PduRDestPduRef = IBS_Status_02_oATOM_CANFD_Matrix_CH_V600_202502_3bba494d_Rx
              PduRDestPduPduRBswModulesRef = Com
          IBS_Status_04_oATOM_CANFD_Matrix_CH_V600_202502_dc4e3b12_Rx: PduRRoutingPathCommunicationType=COMMUNICATION_INTERFACE
            IBS_Status_04_oATOM_CANFD_Matrix_CH_V600_202502_dc4e3b12_Rx_6a5d743a_Rx (PduRDestPdu):
              PduRDestPduHandleId = 60
              PduRDestPduDirection = RECEIVE
              PduRDestPduRoutingType = API_FORWARDING
              PduRDestPduDataProcessing = IMMEDIATE
              PduRPduLengthHandlingStrategy = IGNORE
              PduRDestPduCrossPartitionDestination = false
              PduRTransmissionConfirmation = false
              PduRDestPduRef = IBS_Status_04_oATOM_CANFD_Matrix_CH_V600_202502_f76d333e_Rx
              PduRDestPduPduRBswModulesRef = Com
            PduRSrcPdu_6a5d743a (PduRSrcPdu):
              PduRSourcePduHandleId = 60
              PduRSrcPduDirection = RECEIVE
              PduRSrcPduRef = IBS_Status_04_oATOM_CANFD_Matrix_CH_V600_202502_dc4e3b12_Rx
              PduRSrcPduPduRBswModulesRef = CanIf
          VCU_04_oATOM_CANFD_Matrix_CH_V600_202502_db6dbd42_Tx: PduRRoutingPathCommunicationType=COMMUNICATION_INTERFACE
            VCU_04_oATOM_CANFD_Matrix_CH_V600_202502_5040169c_Tx (PduRDestPdu):
              PduRDestPduHandleId = 14
              PduRDestPduDirection = TRANSMIT
              PduRDestPduRoutingType = API_FORWARDING
              PduRDestPduDataProcessing = IMMEDIATE
              PduRPduLengthHandlingStrategy = IGNORE
              PduRDestPduCrossPartitionDestination = false
              PduRDestPduDataProvision = PDUR_DIRECT
              PduRTransmissionConfirmation = false
              PduRDestPduRef = VCU_04_oATOM_CANFD_Matrix_CH_V600_202502_5040169c_Tx
              PduRDestPduPduRBswModulesRef = CanIf
            PduRSrcPdu_ec53c477 (PduRSrcPdu):
              PduRSourcePduHandleId = 22
              PduRSrcPduDirection = TRANSMIT
              PduRSrcPduRef = VCU_04_oATOM_CANFD_Matrix_CH_V600_202502_db6dbd42_Tx
              PduRSrcPduPduRBswModulesRef = Com
          VCU_BMS_oATOM_CANFD_Matrix_CH_V600_202502_1208e503_Tx: PduRRoutingPathCommunicationType=COMMUNICATION_INTERFACE
            VCU_BMS_oATOM_CANFD_Matrix_CH_V600_202502_8dd4382b_Tx (PduRDestPdu):
              PduRDestPduHandleId = 19
              PduRDestPduDirection = TRANSMIT
              PduRDestPduRoutingType = API_FORWARDING
              PduRDestPduDataProcessing = IMMEDIATE
              PduRPduLengthHandlingStrategy = IGNORE
              PduRDestPduCrossPartitionDestination = false
              PduRDestPduDataProvision = PDUR_DIRECT
              PduRTransmissionConfirmation = false
              PduRDestPduRef = VCU_BMS_oATOM_CANFD_Matrix_CH_V600_202502_8dd4382b_Tx
              PduRDestPduPduRBswModulesRef = CanIf
            PduRSrcPdu_961dd6a8 (PduRSrcPdu):
              PduRSourcePduHandleId = 27
              PduRSrcPduDirection = TRANSMIT
              PduRSrcPduRef = VCU_BMS_oATOM_CANFD_Matrix_CH_V600_202502_1208e503_Tx
              PduRSrcPduPduRBswModulesRef = Com
          VCU_AccPedal_oATOM_CANFD_Matrix_CH_V600_202502_0d0df7a0_Tx: PduRRoutingPathCommunicationType=COMMUNICATION_INTERFACE
            VCU_AccPedal_oATOM_CANFD_Matrix_CH_V600_202502_3cf928f4_Tx (PduRDestPdu):
              PduRDestPduHandleId = 17
              PduRDestPduDirection = TRANSMIT
              PduRDestPduRoutingType = API_FORWARDING
              PduRDestPduDataProcessing = IMMEDIATE
              PduRPduLengthHandlingStrategy = IGNORE
              PduRDestPduCrossPartitionDestination = false
              PduRDestPduDataProvision = PDUR_DIRECT
              PduRTransmissionConfirmation = false
              PduRDestPduRef = VCU_AccPedal_oATOM_CANFD_Matrix_CH_V600_202502_3cf928f4_Tx
              PduRDestPduPduRBswModulesRef = CanIf
            PduRSrcPdu_319663fb (PduRSrcPdu):
              PduRSourcePduHandleId = 25
              PduRSrcPduDirection = TRANSMIT
              PduRSrcPduRef = VCU_AccPedal_oATOM_CANFD_Matrix_CH_V600_202502_0d0df7a0_Tx
              PduRSrcPduPduRBswModulesRef = Com
          ACU_01_oATOM_CANFD_Matrix_CH_V600_202502_1343b9ef_Rx: PduRRoutingPathCommunicationType=COMMUNICATION_INTERFACE
            ACU_01_oATOM_CANFD_Matrix_CH_V600_202502_1343b9ef_Rx_9eae4558_Rx (PduRDestPdu):
              PduRDestPduHandleId = 0
              PduRDestPduDirection = RECEIVE
              PduRDestPduRoutingType = API_FORWARDING
              PduRDestPduDataProcessing = IMMEDIATE
              PduRPduLengthHandlingStrategy = IGNORE
              PduRDestPduCrossPartitionDestination = false
              PduRTransmissionConfirmation = false
              PduRDestPduRef = ACU_01_oATOM_CANFD_Matrix_CH_V600_202502_92b30981_Rx
              PduRDestPduPduRBswModulesRef = Com
            PduRSrcPdu_9eae4558 (PduRSrcPdu):
              PduRSourcePduHandleId = 0
              PduRSrcPduDirection = RECEIVE
              PduRSrcPduRef = ACU_01_oATOM_CANFD_Matrix_CH_V600_202502_1343b9ef_Rx
              PduRSrcPduPduRBswModulesRef = CanIf
          IBS_Status_06_oATOM_CANFD_Matrix_CH_V600_202502_84e18367_Rx: PduRRoutingPathCommunicationType=COMMUNICATION_INTERFACE
            IBS_Status_06_oATOM_CANFD_Matrix_CH_V600_202502_84e18367_Rx_65adbba1_Rx (PduRDestPdu):
              PduRDestPduHandleId = 62
              PduRDestPduDirection = RECEIVE
              PduRDestPduRoutingType = API_FORWARDING
              PduRDestPduDataProcessing = IMMEDIATE
              PduRPduLengthHandlingStrategy = IGNORE
              PduRDestPduCrossPartitionDestination = false
              PduRTransmissionConfirmation = false
              PduRDestPduRef = IBS_Status_06_oATOM_CANFD_Matrix_CH_V600_202502_b3201aef_Rx
              PduRDestPduPduRBswModulesRef = Com
            PduRSrcPdu_65adbba1 (PduRSrcPdu):
              PduRSourcePduHandleId = 62
              PduRSrcPduDirection = RECEIVE
              PduRSrcPduRef = IBS_Status_06_oATOM_CANFD_Matrix_CH_V600_202502_84e18367_Rx
              PduRSrcPduPduRBswModulesRef = CanIf
          IBS_Status_01_oATOM_CANFD_Matrix_CH_V600_202502_acfe14e2_Rx: PduRRoutingPathCommunicationType=COMMUNICATION_INTERFACE
            IBS_Status_01_oATOM_CANFD_Matrix_CH_V600_202502_acfe14e2_Rx_d09902f0_Rx (PduRDestPdu):
              PduRDestPduHandleId = 57
              PduRDestPduDirection = RECEIVE
              PduRDestPduRoutingType = API_FORWARDING
              PduRDestPduDataProcessing = IMMEDIATE
              PduRPduLengthHandlingStrategy = IGNORE
              PduRDestPduCrossPartitionDestination = false
              PduRTransmissionConfirmation = false
              PduRDestPduRef = IBS_Status_01_oATOM_CANFD_Matrix_CH_V600_202502_b0697754_Rx
              PduRDestPduPduRBswModulesRef = Com
            PduRSrcPdu_d09902f0 (PduRSrcPdu):
              PduRSourcePduHandleId = 57
              PduRSrcPduDirection = RECEIVE
              PduRSrcPduRef = IBS_Status_01_oATOM_CANFD_Matrix_CH_V600_202502_acfe14e2_Rx
              PduRSrcPduPduRBswModulesRef = CanIf
          VCU_PlugInChrgInfo_oATOM_CANFD_Matrix_CH_V600_202502_20405e82_Tx: PduRRoutingPathCommunicationType=COMMUNICATION_INTERFACE
            PduRSrcPdu_a60cff81 (PduRSrcPdu):
              PduRSourcePduHandleId = 44
              PduRSrcPduDirection = TRANSMIT
              PduRSrcPduRef = VCU_PlugInChrgInfo_oATOM_CANFD_Matrix_CH_V600_202502_20405e82_Tx
              PduRSrcPduPduRBswModulesRef = Com
            VCU_PlugInChrgInfo_oATOM_CANFD_Matrix_CH_V600_202502_f8a23add_Tx (PduRDestPdu):
              PduRDestPduHandleId = 36
              PduRDestPduDirection = TRANSMIT
              PduRDestPduRoutingType = API_FORWARDING
              PduRDestPduDataProcessing = IMMEDIATE
              PduRPduLengthHandlingStrategy = IGNORE
              PduRDestPduCrossPartitionDestination = false
              PduRDestPduDataProvision = PDUR_DIRECT
              PduRTransmissionConfirmation = false
              PduRDestPduRef = VCU_PlugInChrgInfo_oATOM_CANFD_Matrix_CH_V600_202502_f8a23add_Tx
              PduRDestPduPduRBswModulesRef = CanIf
          SGW_17_oATOM_CANFD_Matrix_CH_V600_202502_3a9eb4a2_Rx: PduRRoutingPathCommunicationType=COMMUNICATION_INTERFACE
            PduRSrcPdu_316b9b30 (PduRSrcPdu):
              PduRSourcePduHandleId = 90
              PduRSrcPduDirection = RECEIVE
              PduRSrcPduRef = SGW_17_oATOM_CANFD_Matrix_CH_V600_202502_3a9eb4a2_Rx
              PduRSrcPduPduRBswModulesRef = CanIf
            SGW_17_oATOM_CANFD_Matrix_CH_V600_202502_3a9eb4a2_Rx_316b9b30_Rx (PduRDestPdu):
              PduRDestPduHandleId = 90
              PduRDestPduDirection = RECEIVE
              PduRDestPduRoutingType = API_FORWARDING
              PduRDestPduDataProcessing = IMMEDIATE
              PduRPduLengthHandlingStrategy = IGNORE
              PduRDestPduCrossPartitionDestination = false
              PduRTransmissionConfirmation = false
              PduRDestPduRef = SGW_17_oATOM_CANFD_Matrix_CH_V600_202502_9b3e5336_Rx
              PduRDestPduPduRBswModulesRef = Com
          ADCU_APS_02_oATOM_CANFD_Matrix_CH_V600_202502_599b516e_Rx: PduRRoutingPathCommunicationType=COMMUNICATION_INTERFACE
            ADCU_APS_02_oATOM_CANFD_Matrix_CH_V600_202502_599b516e_Rx_bc9c1fec_Rx (PduRDestPdu):
              PduRDestPduHandleId = 6
              PduRDestPduDirection = RECEIVE
              PduRDestPduRoutingType = API_FORWARDING
              PduRDestPduDataProcessing = IMMEDIATE
              PduRPduLengthHandlingStrategy = IGNORE
              PduRDestPduCrossPartitionDestination = false
              PduRTransmissionConfirmation = false
              PduRDestPduRef = ADCU_APS_02_oATOM_CANFD_Matrix_CH_V600_202502_5c7f9a02_Rx
              PduRDestPduPduRBswModulesRef = Com
            PduRSrcPdu_bc9c1fec (PduRSrcPdu):
              PduRSourcePduHandleId = 6
              PduRSrcPduDirection = RECEIVE
              PduRSrcPduRef = ADCU_APS_02_oATOM_CANFD_Matrix_CH_V600_202502_599b516e_Rx
              PduRSrcPduPduRBswModulesRef = CanIf
          ADCU_DA_oATOM_CANFD_Matrix_CH_V600_202502_8a75132b_Rx: PduRRoutingPathCommunicationType=COMMUNICATION_INTERFACE
            PduRSrcPdu_08ea31b4 (PduRSrcPdu):
              PduRSourcePduHandleId = 7
              PduRSrcPduDirection = RECEIVE
              PduRSrcPduRef = ADCU_DA_oATOM_CANFD_Matrix_CH_V600_202502_8a75132b_Rx
              PduRSrcPduPduRBswModulesRef = CanIf
            ADCU_DA_oATOM_CANFD_Matrix_CH_V600_202502_8a75132b_Rx_08ea31b4_Rx (PduRDestPdu):
              PduRDestPduHandleId = 7
              PduRDestPduDirection = RECEIVE
              PduRDestPduRoutingType = API_FORWARDING
              PduRDestPduDataProcessing = IMMEDIATE
              PduRPduLengthHandlingStrategy = IGNORE
              PduRDestPduCrossPartitionDestination = false
              PduRTransmissionConfirmation = false
              PduRDestPduRef = ADCU_DA_oATOM_CANFD_Matrix_CH_V600_202502_c19ff818_Rx
              PduRDestPduPduRBswModulesRef = Com
          IBS_Torque_oATOM_CANFD_Matrix_CH_V600_202502_94259583_Rx: PduRRoutingPathCommunicationType=COMMUNICATION_INTERFACE
            IBS_Torque_oATOM_CANFD_Matrix_CH_V600_202502_94259583_Rx_629168fc_Rx (PduRDestPdu):
              PduRDestPduHandleId = 63
              PduRDestPduDirection = RECEIVE
              PduRDestPduRoutingType = API_FORWARDING
              PduRDestPduDataProcessing = IMMEDIATE
              PduRPduLengthHandlingStrategy = IGNORE
              PduRDestPduCrossPartitionDestination = false
              PduRTransmissionConfirmation = false
              PduRDestPduRef = IBS_Torque_oATOM_CANFD_Matrix_CH_V600_202502_e4106cfa_Rx
              PduRDestPduPduRBswModulesRef = Com
            PduRSrcPdu_629168fc (PduRSrcPdu):
              PduRSourcePduHandleId = 63
              PduRSrcPduDirection = RECEIVE
              PduRSrcPduRef = IBS_Torque_oATOM_CANFD_Matrix_CH_V600_202502_94259583_Rx
              PduRSrcPduPduRBswModulesRef = CanIf
          ADCU_AEB_01_oATOM_CANFD_Matrix_CH_V600_202502_aeea498e_Rx: PduRRoutingPathCommunicationType=COMMUNICATION_INTERFACE
            PduRSrcPdu_686bd310 (PduRSrcPdu):
              PduRSourcePduHandleId = 4
              PduRSrcPduDirection = RECEIVE
              PduRSrcPduRef = ADCU_AEB_01_oATOM_CANFD_Matrix_CH_V600_202502_aeea498e_Rx
              PduRSrcPduPduRBswModulesRef = CanIf
            ADCU_AEB_01_oATOM_CANFD_Matrix_CH_V600_202502_aeea498e_Rx_686bd310_Rx (PduRDestPdu):
              PduRDestPduHandleId = 4
              PduRDestPduDirection = RECEIVE
              PduRDestPduRoutingType = API_FORWARDING
              PduRDestPduDataProcessing = IMMEDIATE
              PduRPduLengthHandlingStrategy = IGNORE
              PduRDestPduCrossPartitionDestination = false
              PduRTransmissionConfirmation = false
              PduRDestPduRef = ADCU_AEB_01_oATOM_CANFD_Matrix_CH_V600_202502_73fc26ce_Rx
              PduRDestPduPduRBswModulesRef = Com
          VCU_MCU_03_oATOM_CANFD_Matrix_CH_V600_202502_0d9d0aa9_Tx: PduRRoutingPathCommunicationType=COMMUNICATION_INTERFACE
            VCU_MCU_03_oATOM_CANFD_Matrix_CH_V600_202502_9c2fbb06_Tx (PduRDestPdu):
              PduRDestPduHandleId = 32
              PduRDestPduDirection = TRANSMIT
              PduRDestPduRoutingType = API_FORWARDING
              PduRDestPduDataProcessing = IMMEDIATE
              PduRPduLengthHandlingStrategy = IGNORE
              PduRDestPduCrossPartitionDestination = false
              PduRDestPduDataProvision = PDUR_DIRECT
              PduRTransmissionConfirmation = false
              PduRDestPduRef = VCU_MCU_03_oATOM_CANFD_Matrix_CH_V600_202502_9c2fbb06_Tx
              PduRDestPduPduRBswModulesRef = CanIf
            PduRSrcPdu_c3983958 (PduRSrcPdu):
              PduRSourcePduHandleId = 40
              PduRSrcPduDirection = TRANSMIT
              PduRSrcPduRef = VCU_MCU_03_oATOM_CANFD_Matrix_CH_V600_202502_0d9d0aa9_Tx
              PduRSrcPduPduRBswModulesRef = Com
          ADCU_ACC_02_oATOM_CANFD_Matrix_CH_V600_202502_9c78bb9f_Rx: PduRRoutingPathCommunicationType=COMMUNICATION_INTERFACE
            ADCU_ACC_02_oATOM_CANFD_Matrix_CH_V600_202502_9c78bb9f_Rx_56f39b3b_Rx (PduRDestPdu):
              PduRDestPduHandleId = 3
              PduRDestPduDirection = RECEIVE
              PduRDestPduRoutingType = API_FORWARDING
              PduRDestPduDataProcessing = IMMEDIATE
              PduRPduLengthHandlingStrategy = IGNORE
              PduRDestPduCrossPartitionDestination = false
              PduRTransmissionConfirmation = false
              PduRDestPduRef = ADCU_ACC_02_oATOM_CANFD_Matrix_CH_V600_202502_09e0da82_Rx
              PduRDestPduPduRBswModulesRef = Com
            PduRSrcPdu_56f39b3b (PduRSrcPdu):
              PduRSourcePduHandleId = 3
              PduRSrcPduDirection = RECEIVE
              PduRSrcPduRef = ADCU_ACC_02_oATOM_CANFD_Matrix_CH_V600_202502_9c78bb9f_Rx
              PduRSrcPduPduRBswModulesRef = CanIf
          IBS_APS_oATOM_CANFD_Matrix_CH_V600_202502_8feeb71a_Rx: PduRRoutingPathCommunicationType=COMMUNICATION_INTERFACE
            PduRSrcPdu_283e282c (PduRSrcPdu):
              PduRSourcePduHandleId = 56
              PduRSrcPduDirection = RECEIVE
              PduRSrcPduRef = IBS_APS_oATOM_CANFD_Matrix_CH_V600_202502_8feeb71a_Rx
              PduRSrcPduPduRBswModulesRef = CanIf
            IBS_APS_oATOM_CANFD_Matrix_CH_V600_202502_8feeb71a_Rx_283e282c_Rx (PduRDestPdu):
              PduRDestPduHandleId = 56
              PduRDestPduDirection = RECEIVE
              PduRDestPduRoutingType = API_FORWARDING
              PduRDestPduDataProcessing = IMMEDIATE
              PduRPduLengthHandlingStrategy = IGNORE
              PduRDestPduCrossPartitionDestination = false
              PduRTransmissionConfirmation = false
              PduRDestPduRef = IBS_APS_oATOM_CANFD_Matrix_CH_V600_202502_25d77553_Rx
              PduRDestPduPduRBswModulesRef = Com
          IBS_WheelSpeed_01_oATOM_CANFD_Matrix_CH_V600_202502_cdf72100_Rx: PduRRoutingPathCommunicationType=COMMUNICATION_INTERFACE
            IBS_WheelSpeed_01_oATOM_CANFD_Matrix_CH_V600_202502_cdf72100_Rx_fcecab79_Rx (PduRDestPdu):
              PduRDestPduHandleId = 65
              PduRDestPduDirection = RECEIVE
              PduRDestPduRoutingType = API_FORWARDING
              PduRDestPduDataProcessing = IMMEDIATE
              PduRPduLengthHandlingStrategy = IGNORE
              PduRDestPduCrossPartitionDestination = false
              PduRTransmissionConfirmation = false
              PduRDestPduRef = IBS_WheelSpeed_01_oATOM_CANFD_Matrix_CH_V600_202502_1c45b3ee_Rx
              PduRDestPduPduRBswModulesRef = Com
            PduRSrcPdu_fcecab79 (PduRSrcPdu):
              PduRSourcePduHandleId = 65
              PduRSrcPduDirection = RECEIVE
              PduRSrcPduRef = IBS_WheelSpeed_01_oATOM_CANFD_Matrix_CH_V600_202502_cdf72100_Rx
              PduRSrcPduPduRBswModulesRef = CanIf
          VCU_03_oATOM_CANFD_Matrix_CH_V600_202502_d824d0f9_Tx: PduRRoutingPathCommunicationType=COMMUNICATION_INTERFACE
            PduRSrcPdu_eeac2237 (PduRSrcPdu):
              PduRSourcePduHandleId = 21
              PduRSrcPduDirection = TRANSMIT
              PduRSrcPduRef = VCU_03_oATOM_CANFD_Matrix_CH_V600_202502_d824d0f9_Tx
              PduRSrcPduPduRBswModulesRef = Com
            VCU_03_oATOM_CANFD_Matrix_CH_V600_202502_785f8119_Tx (PduRDestPdu):
              PduRDestPduHandleId = 13
              PduRDestPduDirection = TRANSMIT
              PduRDestPduRoutingType = API_FORWARDING
              PduRDestPduDataProcessing = IMMEDIATE
              PduRPduLengthHandlingStrategy = IGNORE
              PduRDestPduCrossPartitionDestination = false
              PduRDestPduDataProvision = PDUR_DIRECT
              PduRTransmissionConfirmation = false
              PduRDestPduRef = VCU_03_oATOM_CANFD_Matrix_CH_V600_202502_785f8119_Tx
              PduRDestPduPduRBswModulesRef = CanIf
          IBS_WheelSpeed_02_oATOM_CANFD_Matrix_CH_V600_202502_54b7c66f_Rx: PduRRoutingPathCommunicationType=COMMUNICATION_INTERFACE
            PduRSrcPdu_ca150190 (PduRSrcPdu):
              PduRSourcePduHandleId = 66
              PduRSrcPduDirection = RECEIVE
              PduRSrcPduRef = IBS_WheelSpeed_02_oATOM_CANFD_Matrix_CH_V600_202502_54b7c66f_Rx
              PduRSrcPduPduRBswModulesRef = CanIf
            IBS_WheelSpeed_02_oATOM_CANFD_Matrix_CH_V600_202502_54b7c66f_Rx_ca150190_Rx (PduRDestPdu):
              PduRDestPduHandleId = 66
              PduRDestPduDirection = RECEIVE
              PduRDestPduRoutingType = API_FORWARDING
              PduRDestPduDataProcessing = IMMEDIATE
              PduRPduLengthHandlingStrategy = IGNORE
              PduRDestPduCrossPartitionDestination = false
              PduRTransmissionConfirmation = false
              PduRDestPduRef = IBS_WheelSpeed_02_oATOM_CANFD_Matrix_CH_V600_202502_97968df7_Rx
              PduRDestPduPduRBswModulesRef = Com
          ACU_02_oATOM_CANFD_Matrix_CH_V600_202502_8a035e80_Rx: PduRRoutingPathCommunicationType=COMMUNICATION_INTERFACE
            PduRSrcPdu_0dbe25ba (PduRSrcPdu):
              PduRSourcePduHandleId = 1
              PduRSrcPduDirection = RECEIVE
              PduRSrcPduRef = ACU_02_oATOM_CANFD_Matrix_CH_V600_202502_8a035e80_Rx
              PduRSrcPduPduRBswModulesRef = CanIf
            ACU_02_oATOM_CANFD_Matrix_CH_V600_202502_8a035e80_Rx_0dbe25ba_Rx (PduRDestPdu):
              PduRDestPduHandleId = 1
              PduRDestPduDirection = RECEIVE
              PduRDestPduRoutingType = API_FORWARDING
              PduRDestPduDataProcessing = IMMEDIATE
              PduRPduLengthHandlingStrategy = IGNORE
              PduRDestPduCrossPartitionDestination = false
              PduRTransmissionConfirmation = false
              PduRDestPduRef = ACU_02_oATOM_CANFD_Matrix_CH_V600_202502_19603798_Rx
              PduRDestPduPduRBswModulesRef = Com
          VcuAdcTxG0Msg1_oTC37X_VCU_CAN01_b8ca6989_Tx: PduRRoutingPathCommunicationType=COMMUNICATION_INTERFACE
            PduRSrcPdu_0a2b7a00 (PduRSrcPdu): PduRSourcePduHandleId=49, PduRSrcPduDirection=TRANSMIT, PduRSrcPduRef=VcuAdcTxG0Msg1_oTC37X_VCU_CAN01_b8ca6989_Tx, PduRSrcPduPduRBswModulesRef=Com
            VcuAdcTxG0Msg1_oTC37X_VCU_CAN01_4f542d06_Tx (PduRDestPdu):
              PduRDestPduHandleId = 41
              PduRDestPduDirection = TRANSMIT
              PduRDestPduRoutingType = API_FORWARDING
              PduRDestPduDataProcessing = IMMEDIATE
              PduRPduLengthHandlingStrategy = IGNORE
              PduRDestPduCrossPartitionDestination = false
              PduRDestPduDataProvision = PDUR_DIRECT
              PduRTransmissionConfirmation = false
              PduRDestPduRef = VcuAdcTxG0Msg1_oTC37X_VCU_CAN01_4f542d06_Tx
              PduRDestPduPduRBswModulesRef = CanIf
          VcuAdcTxG8Msg2_oTC37X_VCU_CAN01_eb0f92eb_Tx: PduRRoutingPathCommunicationType=COMMUNICATION_INTERFACE
            PduRSrcPdu_37fea4b2 (PduRSrcPdu): PduRSourcePduHandleId=58, PduRSrcPduDirection=TRANSMIT, PduRSrcPduRef=VcuAdcTxG8Msg2_oTC37X_VCU_CAN01_eb0f92eb_Tx, PduRSrcPduPduRBswModulesRef=Com
            VcuAdcTxG8Msg2_oTC37X_VCU_CAN01_7b4a61a1_Tx (PduRDestPdu):
              PduRDestPduHandleId = 50
              PduRDestPduDirection = TRANSMIT
              PduRDestPduRoutingType = API_FORWARDING
              PduRDestPduDataProcessing = IMMEDIATE
              PduRPduLengthHandlingStrategy = IGNORE
              PduRDestPduCrossPartitionDestination = false
              PduRDestPduDataProvision = PDUR_DIRECT
              PduRTransmissionConfirmation = false
              PduRDestPduRef = VcuAdcTxG8Msg2_oTC37X_VCU_CAN01_7b4a61a1_Tx
              PduRDestPduPduRBswModulesRef = CanIf
          VcuAdcTxG0Msg0_oTC37X_VCU_CAN01_5798df68_Tx: PduRRoutingPathCommunicationType=COMMUNICATION_INTERFACE
            VcuAdcTxG0Msg0_oTC37X_VCU_CAN01_0847dbfd_Tx (PduRDestPdu):
              PduRDestPduHandleId = 40
              PduRDestPduDirection = TRANSMIT
              PduRDestPduRoutingType = API_FORWARDING
              PduRDestPduDataProcessing = IMMEDIATE
              PduRPduLengthHandlingStrategy = IGNORE
              PduRDestPduCrossPartitionDestination = false
              PduRDestPduDataProvision = PDUR_DIRECT
              PduRTransmissionConfirmation = false
              PduRDestPduRef = VcuAdcTxG0Msg0_oTC37X_VCU_CAN01_0847dbfd_Tx
              PduRDestPduPduRBswModulesRef = CanIf
            PduRSrcPdu_75ceb29f (PduRSrcPdu): PduRSourcePduHandleId=48, PduRSrcPduDirection=TRANSMIT, PduRSrcPduRef=VcuAdcTxG0Msg0_oTC37X_VCU_CAN01_5798df68_Tx, PduRSrcPduPduRBswModulesRef=Com
          VcuAdcTxG8Msg0_oTC37X_VCU_CAN01_eedbf968_Tx: PduRRoutingPathCommunicationType=COMMUNICATION_INTERFACE
            VcuAdcTxG8Msg0_oTC37X_VCU_CAN01_f56d8c57_Tx (PduRDestPdu):
              PduRDestPduHandleId = 48
              PduRDestPduDirection = TRANSMIT
              PduRDestPduRoutingType = API_FORWARDING
              PduRDestPduDataProcessing = IMMEDIATE
              PduRPduLengthHandlingStrategy = IGNORE
              PduRDestPduCrossPartitionDestination = false
              PduRDestPduDataProvision = PDUR_DIRECT
              PduRTransmissionConfirmation = false
              PduRDestPduRef = VcuAdcTxG8Msg0_oTC37X_VCU_CAN01_f56d8c57_Tx
              PduRDestPduPduRBswModulesRef = CanIf
            PduRSrcPdu_624e541b (PduRSrcPdu): PduRSourcePduHandleId=56, PduRSrcPduDirection=TRANSMIT, PduRSrcPduRef=VcuAdcTxG8Msg0_oTC37X_VCU_CAN01_eedbf968_Tx, PduRSrcPduPduRBswModulesRef=Com
          VcuAdcTxG2Msg0_oTC37X_VCU_CAN01_79c816e8_Tx: PduRRoutingPathCommunicationType=COMMUNICATION_INTERFACE
            VcuAdcTxG2Msg0_oTC37X_VCU_CAN01_dab5cd37_Tx (PduRDestPdu):
              PduRDestPduHandleId = 44
              PduRDestPduDirection = TRANSMIT
              PduRDestPduRoutingType = API_FORWARDING
              PduRDestPduDataProcessing = IMMEDIATE
              PduRPduLengthHandlingStrategy = IGNORE
              PduRDestPduCrossPartitionDestination = false
              PduRDestPduDataProvision = PDUR_DIRECT
              PduRTransmissionConfirmation = false
              PduRDestPduRef = VcuAdcTxG2Msg0_oTC37X_VCU_CAN01_dab5cd37_Tx
              PduRDestPduPduRBswModulesRef = CanIf
            PduRSrcPdu_9fc32995 (PduRSrcPdu): PduRSourcePduHandleId=52, PduRSrcPduDirection=TRANSMIT, PduRSrcPduRef=VcuAdcTxG2Msg0_oTC37X_VCU_CAN01_79c816e8_Tx, PduRSrcPduPduRBswModulesRef=Com
          VcuAdcTxG2Msg1_oTC37X_VCU_CAN01_969aa009_Tx: PduRRoutingPathCommunicationType=COMMUNICATION_INTERFACE
            PduRSrcPdu_1008b467 (PduRSrcPdu): PduRSourcePduHandleId=53, PduRSrcPduDirection=TRANSMIT, PduRSrcPduRef=VcuAdcTxG2Msg1_oTC37X_VCU_CAN01_969aa009_Tx, PduRSrcPduPduRBswModulesRef=Com
            VcuAdcTxG2Msg1_oTC37X_VCU_CAN01_9da63bcc_Tx (PduRDestPdu):
              PduRDestPduHandleId = 45
              PduRDestPduDirection = TRANSMIT
              PduRDestPduRoutingType = API_FORWARDING
              PduRDestPduDataProcessing = IMMEDIATE
              PduRPduLengthHandlingStrategy = IGNORE
              PduRDestPduCrossPartitionDestination = false
              PduRDestPduDataProvision = PDUR_DIRECT
              PduRTransmissionConfirmation = false
              PduRDestPduRef = VcuAdcTxG2Msg1_oTC37X_VCU_CAN01_9da63bcc_Tx
              PduRDestPduPduRBswModulesRef = CanIf
          VcuAdcTxG1Msg0_oTC37X_VCU_CAN01_40b0bba8_Tx: PduRRoutingPathCommunicationType=COMMUNICATION_INTERFACE
            VcuAdcTxG1Msg0_oTC37X_VCU_CAN01_613ed098_Tx (PduRDestPdu):
              PduRDestPduHandleId = 42
              PduRDestPduDirection = TRANSMIT
              PduRDestPduRoutingType = API_FORWARDING
              PduRDestPduDataProcessing = IMMEDIATE
              PduRPduLengthHandlingStrategy = IGNORE
              PduRDestPduCrossPartitionDestination = false
              PduRTransmissionConfirmation = false
              PduRDestPduDataProvision = PDUR_DIRECT
              PduRDestPduRef = VcuAdcTxG1Msg0_oTC37X_VCU_CAN01_613ed098_Tx
              PduRDestPduPduRBswModulesRef = CanIf
            PduRSrcPdu_238e87f9 (PduRSrcPdu): PduRSourcePduHandleId=50, PduRSrcPduDirection=TRANSMIT, PduRSrcPduRef=VcuAdcTxG1Msg0_oTC37X_VCU_CAN01_40b0bba8_Tx, PduRSrcPduPduRBswModulesRef=Com
          VcuAdcTxG3Msg0_oTC37X_VCU_CAN01_6ee07228_Tx: PduRRoutingPathCommunicationType=COMMUNICATION_INTERFACE
            PduRSrcPdu_0b6ac76d (PduRSrcPdu): PduRSourcePduHandleId=54, PduRSrcPduDirection=TRANSMIT, PduRSrcPduRef=VcuAdcTxG3Msg0_oTC37X_VCU_CAN01_6ee07228_Tx, PduRSrcPduPduRBswModulesRef=Com
            VcuAdcTxG3Msg0_oTC37X_VCU_CAN01_b3ccc652_Tx (PduRDestPdu):
              PduRDestPduHandleId = 46
              PduRDestPduDirection = TRANSMIT
              PduRDestPduRoutingType = API_FORWARDING
              PduRDestPduDataProcessing = IMMEDIATE
              PduRPduLengthHandlingStrategy = IGNORE
              PduRDestPduCrossPartitionDestination = false
              PduRDestPduDataProvision = PDUR_DIRECT
              PduRTransmissionConfirmation = false
              PduRDestPduRef = VcuAdcTxG3Msg0_oTC37X_VCU_CAN01_b3ccc652_Tx
              PduRDestPduPduRBswModulesRef = CanIf
          VcuAdcTxG8Msg3_oTC37X_VCU_CAN01_045d240a_Tx: PduRRoutingPathCommunicationType=COMMUNICATION_INTERFACE
            VcuAdcTxG8Msg3_oTC37X_VCU_CAN01_3c59975a_Tx (PduRDestPdu):
              PduRDestPduHandleId = 51
              PduRDestPduDirection = TRANSMIT
              PduRDestPduRoutingType = API_FORWARDING
              PduRDestPduDataProcessing = IMMEDIATE
              PduRPduLengthHandlingStrategy = IGNORE
              PduRDestPduCrossPartitionDestination = false
              PduRDestPduDataProvision = PDUR_DIRECT
              PduRTransmissionConfirmation = false
              PduRDestPduRef = VcuAdcTxG8Msg3_oTC37X_VCU_CAN01_3c59975a_Tx
              PduRDestPduPduRBswModulesRef = CanIf
            PduRSrcPdu_88d7da53 (PduRSrcPdu): PduRSourcePduHandleId=59, PduRSrcPduDirection=TRANSMIT, PduRSrcPduRef=VcuAdcTxG8Msg3_oTC37X_VCU_CAN01_045d240a_Tx, PduRSrcPduPduRBswModulesRef=Com
          VcuAdcTxG1Msg1_oTC37X_VCU_CAN01_afe20d49_Tx: PduRRoutingPathCommunicationType=COMMUNICATION_INTERFACE
            PduRSrcPdu_ae15b571 (PduRSrcPdu): PduRSourcePduHandleId=51, PduRSrcPduDirection=TRANSMIT, PduRSrcPduRef=VcuAdcTxG1Msg1_oTC37X_VCU_CAN01_afe20d49_Tx, PduRSrcPduPduRBswModulesRef=Com
            VcuAdcTxG1Msg1_oTC37X_VCU_CAN01_262d2663_Tx (PduRDestPdu):
              PduRDestPduHandleId = 43
              PduRDestPduDirection = TRANSMIT
              PduRDestPduRoutingType = API_FORWARDING
              PduRDestPduDataProcessing = IMMEDIATE
              PduRPduLengthHandlingStrategy = IGNORE
              PduRDestPduCrossPartitionDestination = false
              PduRDestPduDataProvision = PDUR_DIRECT
              PduRTransmissionConfirmation = false
              PduRDestPduRef = VcuAdcTxG1Msg1_oTC37X_VCU_CAN01_262d2663_Tx
              PduRDestPduPduRBswModulesRef = CanIf
          VcuAdcTxG8Msg1_oTC37X_VCU_CAN01_01894f89_Tx: PduRRoutingPathCommunicationType=COMMUNICATION_INTERFACE
            VcuAdcTxG8Msg1_oTC37X_VCU_CAN01_b27e7aac_Tx (PduRDestPdu):
              PduRDestPduHandleId = 49
              PduRDestPduDirection = TRANSMIT
              PduRDestPduRoutingType = API_FORWARDING
              PduRDestPduDataProcessing = IMMEDIATE
              PduRPduLengthHandlingStrategy = IGNORE
              PduRDestPduCrossPartitionDestination = false
              PduRDestPduDataProvision = PDUR_DIRECT
              PduRTransmissionConfirmation = false
              PduRDestPduRef = VcuAdcTxG8Msg1_oTC37X_VCU_CAN01_b27e7aac_Tx
              PduRDestPduPduRBswModulesRef = CanIf
            PduRSrcPdu_350c260d (PduRSrcPdu): PduRSourcePduHandleId=57, PduRSrcPduDirection=TRANSMIT, PduRSrcPduRef=VcuAdcTxG8Msg1_oTC37X_VCU_CAN01_01894f89_Tx, PduRSrcPduPduRBswModulesRef=Com
          VcuAdcTxG3Msg1_oTC37X_VCU_CAN01_81b2c4c9_Tx: PduRRoutingPathCommunicationType=COMMUNICATION_INTERFACE
            VcuAdcTxG3Msg1_oTC37X_VCU_CAN01_f4df30a9_Tx (PduRDestPdu):
              PduRDestPduHandleId = 47
              PduRDestPduDirection = TRANSMIT
              PduRDestPduRoutingType = API_FORWARDING
              PduRDestPduDataProcessing = IMMEDIATE
              PduRPduLengthHandlingStrategy = IGNORE
              PduRDestPduCrossPartitionDestination = false
              PduRDestPduDataProvision = PDUR_DIRECT
              PduRTransmissionConfirmation = false
              PduRDestPduRef = VcuAdcTxG3Msg1_oTC37X_VCU_CAN01_f4df30a9_Tx
              PduRDestPduPduRBswModulesRef = CanIf
            PduRSrcPdu_4fcbec42 (PduRSrcPdu): PduRSourcePduHandleId=55, PduRSrcPduDirection=TRANSMIT, PduRSrcPduRef=VcuAdcTxG3Msg1_oTC37X_VCU_CAN01_81b2c4c9_Tx, PduRSrcPduPduRBswModulesRef=Com
          VcuRxCtrlMsg0_oTC37X_VCU_CAN01_3715838b_Rx: PduRRoutingPathCommunicationType=COMMUNICATION_INTERFACE
            VcuRxCtrlMsg0_oTC37X_VCU_CAN01_3715838b_Rx_01131484_Rx (PduRDestPdu):
              PduRDestPduHandleId = 102
              PduRDestPduDirection = RECEIVE
              PduRDestPduRoutingType = API_FORWARDING
              PduRDestPduDataProcessing = IMMEDIATE
              PduRPduLengthHandlingStrategy = IGNORE
              PduRDestPduCrossPartitionDestination = false
              PduRTransmissionConfirmation = false
              PduRDestPduRef = VcuRxCtrlMsg0_oTC37X_VCU_CAN01_b24a2ab4_Rx
              PduRDestPduPduRBswModulesRef = Com
            PduRSrcPdu_01131484 (PduRSrcPdu):
              PduRSourcePduHandleId = 102
              PduRSrcPduDirection = RECEIVE
              PduRSrcPduRef = VcuRxCtrlMsg0_oTC37X_VCU_CAN01_3715838b_Rx
              PduRSrcPduPduRBswModulesRef = CanIf
          VcuRxCtrlMsg1_oTC37X_VCU_CAN01_70067570_Rx: PduRRoutingPathCommunicationType=COMMUNICATION_INTERFACE
            VcuRxCtrlMsg1_oTC37X_VCU_CAN01_70067570_Rx_35c74fdb_Rx (PduRDestPdu):
              PduRDestPduHandleId = 103
              PduRDestPduDirection = RECEIVE
              PduRDestPduRoutingType = API_FORWARDING
              PduRDestPduDataProcessing = IMMEDIATE
              PduRPduLengthHandlingStrategy = IGNORE
              PduRDestPduCrossPartitionDestination = false
              PduRTransmissionConfirmation = false
              PduRDestPduRef = VcuRxCtrlMsg1_oTC37X_VCU_CAN01_5d189c55_Rx
              PduRDestPduPduRBswModulesRef = Com
            PduRSrcPdu_35c74fdb (PduRSrcPdu):
              PduRSourcePduHandleId = 103
              PduRSrcPduDirection = RECEIVE
              PduRSrcPduRef = VcuRxCtrlMsg1_oTC37X_VCU_CAN01_70067570_Rx
              PduRSrcPduPduRBswModulesRef = CanIf
          VcuMeasurementMsg0_oTC37X_VCU_CAN01_0deb23c3_Tx: PduRRoutingPathCommunicationType=COMMUNICATION_INTERFACE
            VcuMeasurementMsg0_oTC37X_VCU_CAN01_d96481d0_Tx (PduRDestPdu):
              PduRDestPduHandleId = 55
              PduRDestPduDirection = TRANSMIT
              PduRDestPduRoutingType = API_FORWARDING
              PduRDestPduDataProcessing = IMMEDIATE
              PduRPduLengthHandlingStrategy = IGNORE
              PduRDestPduCrossPartitionDestination = false
              PduRDestPduDataProvision = PDUR_DIRECT
              PduRTransmissionConfirmation = false
              PduRDestPduRef = VcuMeasurementMsg0_oTC37X_VCU_CAN01_d96481d0_Tx
              PduRDestPduPduRBswModulesRef = CanIf
            PduRSrcPdu_9fbb06ad (PduRSrcPdu):
              PduRSourcePduHandleId = 63
              PduRSrcPduDirection = TRANSMIT
              PduRSrcPduRef = VcuMeasurementMsg0_oTC37X_VCU_CAN01_0deb23c3_Tx
              PduRSrcPduPduRBswModulesRef = Com
          VcuRxCtrlMsg2_oTC37X_VCU_CAN01_b9326e7d_Rx: PduRRoutingPathCommunicationType=COMMUNICATION_INTERFACE
            PduRSrcPdu_d7cb99e6 (PduRSrcPdu):
              PduRSourcePduHandleId = 104
              PduRSrcPduDirection = RECEIVE
              PduRSrcPduRef = VcuRxCtrlMsg2_oTC37X_VCU_CAN01_b9326e7d_Rx
              PduRSrcPduPduRBswModulesRef = CanIf
            VcuRxCtrlMsg2_oTC37X_VCU_CAN01_b9326e7d_Rx_d7cb99e6_Rx (PduRDestPdu):
              PduRDestPduHandleId = 104
              PduRDestPduDirection = RECEIVE
              PduRDestPduRoutingType = API_FORWARDING
              PduRDestPduDataProcessing = IMMEDIATE
              PduRPduLengthHandlingStrategy = IGNORE
              PduRDestPduCrossPartitionDestination = false
              PduRTransmissionConfirmation = false
              PduRDestPduRef = VcuRxCtrlMsg2_oTC37X_VCU_CAN01_b79e4137_Rx
              PduRDestPduPduRBswModulesRef = Com
          Vcu_Lin3_TxMsg2_oLIN02_8266ef99_Tx: PduRRoutingPathCommunicationType=COMMUNICATION_INTERFACE
            PduRSrcPdu_2efa4b01 (PduRSrcPdu): PduRSourcePduHandleId=67, PduRSrcPduDirection=TRANSMIT, PduRSrcPduRef=Vcu_Lin3_TxMsg2_oLIN02_8266ef99_Tx, PduRSrcPduPduRBswModulesRef=Com
            Vcu_Lin3_TxMsg2_oLIN02_80a2835b_Tx (PduRDestPdu):
              PduRDestPduHandleId = 59
              PduRDestPduDirection = TRANSMIT
              PduRDestPduRoutingType = API_FORWARDING
              PduRDestPduDataProcessing = IMMEDIATE
              PduRPduLengthHandlingStrategy = IGNORE
              PduRDestPduCrossPartitionDestination = false
              PduRDestPduDataProvision = PDUR_TRIGGERTRANSMIT
              PduRTransmissionConfirmation = false
              PduRDestPduRef = Vcu_Lin3_TxMsg2_oLIN02_80a2835b_Tx
              PduRDestPduPduRBswModulesRef = LinIf
          Vcu_Lin3_RxMsg2_oLIN02_851e8d15_Rx: PduRRoutingPathCommunicationType=COMMUNICATION_INTERFACE
            Vcu_Lin3_RxMsg2_oLIN02_851e8d15_Rx_3b03dfb1_Rx (PduRDestPdu):
              PduRDestPduHandleId = 110
              PduRDestPduDirection = RECEIVE
              PduRDestPduRoutingType = API_FORWARDING
              PduRDestPduDataProcessing = IMMEDIATE
              PduRPduLengthHandlingStrategy = IGNORE
              PduRDestPduCrossPartitionDestination = false
              PduRTransmissionConfirmation = false
              PduRDestPduRef = Vcu_Lin3_RxMsg2_oLIN02_22833044_Rx
              PduRDestPduPduRBswModulesRef = Com
            PduRSrcPdu_3b03dfb1 (PduRSrcPdu): PduRSourcePduHandleId=110, PduRSrcPduDirection=RECEIVE, PduRSrcPduRef=Vcu_Lin3_RxMsg2_oLIN02_851e8d15_Rx, PduRSrcPduPduRBswModulesRef=LinIf
          Vcu_Lin3_RxMsg1_oLIN02_f3fbb428_Rx: PduRRoutingPathCommunicationType=COMMUNICATION_INTERFACE
            Vcu_Lin3_RxMsg1_oLIN02_f3fbb428_Rx_916b2dbb_Rx (PduRDestPdu):
              PduRDestPduHandleId = 109
              PduRDestPduDirection = RECEIVE
              PduRDestPduRoutingType = API_FORWARDING
              PduRDestPduDataProcessing = IMMEDIATE
              PduRPduLengthHandlingStrategy = IGNORE
              PduRDestPduCrossPartitionDestination = false
              PduRTransmissionConfirmation = false
              PduRDestPduRef = Vcu_Lin3_RxMsg1_oLIN02_ac0c37a7_Rx
              PduRDestPduPduRBswModulesRef = Com
            PduRSrcPdu_916b2dbb (PduRSrcPdu): PduRSourcePduHandleId=109, PduRSrcPduDirection=RECEIVE, PduRSrcPduRef=Vcu_Lin3_RxMsg1_oLIN02_f3fbb428_Rx, PduRSrcPduPduRBswModulesRef=LinIf
          Vcu_Lin3_TxMsg1_oLIN02_0ce9e87a_Tx: PduRRoutingPathCommunicationType=COMMUNICATION_INTERFACE
            Vcu_Lin3_TxMsg1_oLIN02_f647ba66_Tx (PduRDestPdu):
              PduRDestPduHandleId = 58
              PduRDestPduDirection = TRANSMIT
              PduRDestPduRoutingType = API_FORWARDING
              PduRDestPduDataProcessing = IMMEDIATE
              PduRPduLengthHandlingStrategy = IGNORE
              PduRDestPduCrossPartitionDestination = false
              PduRDestPduDataProvision = PDUR_TRIGGERTRANSMIT
              PduRTransmissionConfirmation = false
              PduRDestPduRef = Vcu_Lin3_TxMsg1_oLIN02_f647ba66_Tx
              PduRDestPduPduRBswModulesRef = LinIf
            PduRSrcPdu_78b4954c (PduRSrcPdu): PduRSourcePduHandleId=66, PduRSrcPduDirection=TRANSMIT, PduRSrcPduRef=Vcu_Lin3_TxMsg1_oLIN02_0ce9e87a_Tx, PduRSrcPduPduRBswModulesRef=Com
          BCM_11_oATOM_CAN_Matrix_PT_V600_20250211_f3ce7274_Rx: PduRRoutingPathCommunicationType=COMMUNICATION_INTERFACE
            PduRSrcPdu_eebd1636 (PduRSrcPdu):
              PduRSourcePduHandleId = 11
              PduRSrcPduDirection = RECEIVE
              PduRSrcPduRef = BCM_11_oATOM_CAN_Matrix_PT_V600_20250211_f3ce7274_Rx
              PduRSrcPduPduRBswModulesRef = CanIf
            BCM_11_oATOM_CAN_Matrix_PT_V600_20250211_f3ce7274_Rx_eebd1636_Rx (PduRDestPdu):
              PduRDestPduHandleId = 11
              PduRDestPduDirection = RECEIVE
              PduRDestPduRoutingType = API_FORWARDING
              PduRDestPduDataProcessing = IMMEDIATE
              PduRPduLengthHandlingStrategy = IGNORE
              PduRDestPduCrossPartitionDestination = false
              PduRTransmissionConfirmation = false
              PduRDestPduRef = BCM_11_oATOM_CAN_Matrix_PT_V600_20250211_10f11df6_Rx
              PduRDestPduPduRBswModulesRef = Com
          MCU_Temperature_01_oATOM_CAN_Matrix_PT_V600_20250211_ea16780f_Rx: PduRRoutingPathCommunicationType=COMMUNICATION_INTERFACE
            PduRSrcPdu_51994caa (PduRSrcPdu):
              PduRSourcePduHandleId = 74
              PduRSrcPduDirection = RECEIVE
              PduRSrcPduRef = MCU_Temperature_01_oATOM_CAN_Matrix_PT_V600_20250211_ea16780f_Rx
              PduRSrcPduPduRBswModulesRef = CanIf
            MCU_Temperature_01_oATOM_CAN_Matrix_PT_V600_20250211_ea16780f_Rx_51994caa_Rx (PduRDestPdu):
              PduRDestPduHandleId = 74
              PduRDestPduDirection = RECEIVE
              PduRDestPduRoutingType = API_FORWARDING
              PduRDestPduDataProcessing = IMMEDIATE
              PduRPduLengthHandlingStrategy = IGNORE
              PduRDestPduCrossPartitionDestination = false
              PduRTransmissionConfirmation = false
              PduRDestPduRef = MCU_Temperature_01_oATOM_CAN_Matrix_PT_V600_20250211_021c1dde_Rx
              PduRDestPduPduRBswModulesRef = Com
          BMS_status_04_oATOM_CAN_Matrix_PT_V600_20250211_861a70a5_Rx: PduRRoutingPathCommunicationType=COMMUNICATION_INTERFACE
            BMS_status_04_oATOM_CAN_Matrix_PT_V600_20250211_861a70a5_Rx_9e2ae37f_Rx (PduRDestPdu):
              PduRDestPduHandleId = 29
              PduRDestPduDirection = RECEIVE
              PduRDestPduRoutingType = API_FORWARDING
              PduRDestPduDataProcessing = IMMEDIATE
              PduRPduLengthHandlingStrategy = IGNORE
              PduRDestPduCrossPartitionDestination = false
              PduRTransmissionConfirmation = false
              PduRDestPduRef = BMS_status_04_oATOM_CAN_Matrix_PT_V600_20250211_ed71e625_Rx
              PduRDestPduPduRBswModulesRef = Com
            PduRSrcPdu_9e2ae37f (PduRSrcPdu):
              PduRSourcePduHandleId = 29
              PduRSrcPduDirection = RECEIVE
              PduRSrcPduRef = BMS_status_04_oATOM_CAN_Matrix_PT_V600_20250211_861a70a5_Rx
              PduRSrcPduPduRBswModulesRef = CanIf
          Uds_EPT_Boot_Response_oATOM_CAN_Matrix_PT_V600_20250211_8bdda24d_Tx: PduRRoutingPathCommunicationType=COMMUNICATION_INTERFACE
            PduRSrcPdu_3797127c (PduRSrcPdu):
              PduRSourcePduHandleId = 18
              PduRSrcPduDirection = TRANSMIT
              PduRSrcPduRef = Uds_EPT_Boot_Response_oATOM_CAN_Matrix_PT_V600_20250211_8bdda24d_Tx
              PduRSrcPduPduRBswModulesRef = Com
            Uds_EPT_Boot_Response_oATOM_CAN_Matrix_PT_V600_20250211_c47c83fb_Tx (PduRDestPdu):
              PduRDestPduHandleId = 10
              PduRDestPduDirection = TRANSMIT
              PduRDestPduRoutingType = API_FORWARDING
              PduRDestPduDataProcessing = IMMEDIATE
              PduRPduLengthHandlingStrategy = IGNORE
              PduRDestPduCrossPartitionDestination = false
              PduRTransmissionConfirmation = true
              PduRDestPduDataProvision = PDUR_DIRECT
              PduRDestPduRef = Uds_EPT_Boot_Response_oATOM_CAN_Matrix_PT_V600_20250211_c47c83fb_Tx
              PduRDestPduPduRBswModulesRef = CanIf
          MCU_FailureCode_oATOM_CAN_Matrix_PT_V600_20250211_51b3e171_Rx: PduRRoutingPathCommunicationType=COMMUNICATION_INTERFACE
            MCU_FailureCode_oATOM_CAN_Matrix_PT_V600_20250211_51b3e171_Rx_fa5a6015_Rx (PduRDestPdu):
              PduRDestPduHandleId = 73
              PduRDestPduDirection = RECEIVE
              PduRDestPduRoutingType = API_FORWARDING
              PduRDestPduDataProcessing = IMMEDIATE
              PduRPduLengthHandlingStrategy = IGNORE
              PduRDestPduCrossPartitionDestination = false
              PduRTransmissionConfirmation = false
              PduRDestPduRef = MCU_FailureCode_oATOM_CAN_Matrix_PT_V600_20250211_4a7c4da7_Rx
              PduRDestPduPduRBswModulesRef = Com
            PduRSrcPdu_fa5a6015 (PduRSrcPdu):
              PduRSourcePduHandleId = 73
              PduRSrcPduDirection = RECEIVE
              PduRSrcPduRef = MCU_FailureCode_oATOM_CAN_Matrix_PT_V600_20250211_51b3e171_Rx
              PduRSrcPduPduRBswModulesRef = CanIf
          POD_DCDC_01_oATOM_CAN_Matrix_PT_V600_20250211_9e52ac89_Rx: PduRRoutingPathCommunicationType=COMMUNICATION_INTERFACE
            POD_DCDC_01_oATOM_CAN_Matrix_PT_V600_20250211_9e52ac89_Rx_2c23a96a_Rx (PduRDestPdu):
              PduRDestPduHandleId = 78
              PduRDestPduDirection = RECEIVE
              PduRDestPduRoutingType = API_FORWARDING
              PduRDestPduDataProcessing = IMMEDIATE
              PduRPduLengthHandlingStrategy = IGNORE
              PduRDestPduCrossPartitionDestination = false
              PduRTransmissionConfirmation = false
              PduRDestPduRef = POD_DCDC_01_oATOM_CAN_Matrix_PT_V600_20250211_6e196312_Rx
              PduRDestPduPduRBswModulesRef = Com
            PduRSrcPdu_2c23a96a (PduRSrcPdu):
              PduRSourcePduHandleId = 78
              PduRSrcPduDirection = RECEIVE
              PduRSrcPduRef = POD_DCDC_01_oATOM_CAN_Matrix_PT_V600_20250211_9e52ac89_Rx
              PduRSrcPduPduRBswModulesRef = CanIf
          CGW_VIN2_oATOM_CAN_Matrix_PT_V600_20250211_3c292135_Rx: PduRRoutingPathCommunicationType=COMMUNICATION_INTERFACE
            CGW_VIN2_oATOM_CAN_Matrix_PT_V600_20250211_3c292135_Rx_3d0f621e_Rx (PduRDestPdu):
              PduRDestPduHandleId = 35
              PduRDestPduDirection = RECEIVE
              PduRDestPduRoutingType = API_FORWARDING
              PduRDestPduDataProcessing = IMMEDIATE
              PduRPduLengthHandlingStrategy = IGNORE
              PduRDestPduCrossPartitionDestination = false
              PduRTransmissionConfirmation = false
              PduRDestPduRef = CGW_VIN2_oATOM_CAN_Matrix_PT_V600_20250211_edcb66c5_Rx
              PduRDestPduPduRBswModulesRef = Com
            PduRSrcPdu_3d0f621e (PduRSrcPdu):
              PduRSourcePduHandleId = 35
              PduRSrcPduDirection = RECEIVE
              PduRSrcPduRef = CGW_VIN2_oATOM_CAN_Matrix_PT_V600_20250211_3c292135_Rx
              PduRSrcPduPduRBswModulesRef = CanIf
          DCM_RL_oATOM_CAN_Matrix_PT_V600_20250211_62ba4764_Rx: PduRRoutingPathCommunicationType=COMMUNICATION_INTERFACE
            DCM_RL_oATOM_CAN_Matrix_PT_V600_20250211_62ba4764_Rx_e5f98abc_Rx (PduRDestPdu):
              PduRDestPduHandleId = 47
              PduRDestPduDirection = RECEIVE
              PduRDestPduRoutingType = API_FORWARDING
              PduRDestPduDataProcessing = IMMEDIATE
              PduRPduLengthHandlingStrategy = IGNORE
              PduRDestPduCrossPartitionDestination = false
              PduRTransmissionConfirmation = false
              PduRDestPduRef = DCM_RL_oATOM_CAN_Matrix_PT_V600_20250211_b2ab7ecc_Rx
              PduRDestPduPduRBswModulesRef = Com
            PduRSrcPdu_e5f98abc (PduRSrcPdu):
              PduRSourcePduHandleId = 47
              PduRSrcPduDirection = RECEIVE
              PduRSrcPduRef = DCM_RL_oATOM_CAN_Matrix_PT_V600_20250211_62ba4764_Rx
              PduRSrcPduPduRBswModulesRef = CanIf
          MCU_DeratingStatus_oATOM_CAN_Matrix_PT_V600_20250211_de507b38_Rx: PduRRoutingPathCommunicationType=COMMUNICATION_INTERFACE
            MCU_DeratingStatus_oATOM_CAN_Matrix_PT_V600_20250211_de507b38_Rx_a01ee3b0_Rx (PduRDestPdu):
              PduRDestPduHandleId = 72
              PduRDestPduDirection = RECEIVE
              PduRDestPduRoutingType = API_FORWARDING
              PduRDestPduDataProcessing = IMMEDIATE
              PduRPduLengthHandlingStrategy = IGNORE
              PduRDestPduCrossPartitionDestination = false
              PduRTransmissionConfirmation = false
              PduRDestPduRef = MCU_DeratingStatus_oATOM_CAN_Matrix_PT_V600_20250211_06ac1cd5_Rx
              PduRDestPduPduRBswModulesRef = Com
            PduRSrcPdu_a01ee3b0 (PduRSrcPdu):
              PduRSourcePduHandleId = 72
              PduRSrcPduDirection = RECEIVE
              PduRSrcPduRef = MCU_DeratingStatus_oATOM_CAN_Matrix_PT_V600_20250211_de507b38_Rx
              PduRSrcPduPduRBswModulesRef = CanIf
          VCU_06_oATOM_CAN_Matrix_PT_V600_20250211_a07ded02_Tx: PduRRoutingPathCommunicationType=COMMUNICATION_INTERFACE
            VCU_06_oATOM_CAN_Matrix_PT_V600_20250211_6d261160_Tx (PduRDestPdu):
              PduRDestPduHandleId = 16
              PduRDestPduDirection = TRANSMIT
              PduRDestPduRoutingType = API_FORWARDING
              PduRDestPduDataProcessing = IMMEDIATE
              PduRPduLengthHandlingStrategy = IGNORE
              PduRDestPduCrossPartitionDestination = false
              PduRDestPduDataProvision = PDUR_DIRECT
              PduRTransmissionConfirmation = true
              PduRDestPduRef = VCU_06_oATOM_CAN_Matrix_PT_V600_20250211_6d261160_Tx
              PduRDestPduPduRBswModulesRef = CanIf
            PduRSrcPdu_1a3c0479 (PduRSrcPdu):
              PduRSourcePduHandleId = 24
              PduRSrcPduDirection = TRANSMIT
              PduRSrcPduRef = VCU_06_oATOM_CAN_Matrix_PT_V600_20250211_a07ded02_Tx
              PduRSrcPduPduRBswModulesRef = Com
          VCU_MCU_05_oATOM_CAN_Matrix_PT_V600_20250211_fe17094b_Tx: PduRRoutingPathCommunicationType=COMMUNICATION_INTERFACE
            PduRSrcPdu_b312cc5f (PduRSrcPdu):
              PduRSourcePduHandleId = 42
              PduRSrcPduDirection = TRANSMIT
              PduRSrcPduRef = VCU_MCU_05_oATOM_CAN_Matrix_PT_V600_20250211_fe17094b_Tx
              PduRSrcPduPduRBswModulesRef = Com
            VCU_MCU_05_oATOM_CAN_Matrix_PT_V600_20250211_1016cc10_Tx (PduRDestPdu):
              PduRDestPduHandleId = 34
              PduRDestPduDirection = TRANSMIT
              PduRDestPduRoutingType = API_FORWARDING
              PduRDestPduDataProcessing = IMMEDIATE
              PduRPduLengthHandlingStrategy = IGNORE
              PduRDestPduCrossPartitionDestination = false
              PduRDestPduDataProvision = PDUR_DIRECT
              PduRTransmissionConfirmation = true
              PduRDestPduRef = VCU_MCU_05_oATOM_CAN_Matrix_PT_V600_20250211_1016cc10_Tx
              PduRDestPduPduRBswModulesRef = CanIf
          POD_Status_02_oATOM_CAN_Matrix_PT_V600_20250211_7e4dfbbc_Rx: PduRRoutingPathCommunicationType=COMMUNICATION_INTERFACE
            POD_Status_02_oATOM_CAN_Matrix_PT_V600_20250211_7e4dfbbc_Rx_787801bd_Rx (PduRDestPdu):
              PduRDestPduHandleId = 85
              PduRDestPduDirection = RECEIVE
              PduRDestPduRoutingType = API_FORWARDING
              PduRDestPduDataProcessing = IMMEDIATE
              PduRPduLengthHandlingStrategy = IGNORE
              PduRDestPduCrossPartitionDestination = false
              PduRTransmissionConfirmation = false
              PduRDestPduRef = POD_Status_02_oATOM_CAN_Matrix_PT_V600_20250211_476d90aa_Rx
              PduRDestPduPduRBswModulesRef = Com
            PduRSrcPdu_787801bd (PduRSrcPdu):
              PduRSourcePduHandleId = 85
              PduRSrcPduDirection = RECEIVE
              PduRSrcPduRef = POD_Status_02_oATOM_CAN_Matrix_PT_V600_20250211_7e4dfbbc_Rx
              PduRSrcPduPduRBswModulesRef = CanIf
          POD_DCDC_02_oATOM_CAN_Matrix_PT_V600_20250211_07124be6_Rx: PduRRoutingPathCommunicationType=COMMUNICATION_INTERFACE
            POD_DCDC_02_oATOM_CAN_Matrix_PT_V600_20250211_07124be6_Rx_2eb983a0_Rx (PduRDestPdu):
              PduRDestPduHandleId = 79
              PduRDestPduDirection = RECEIVE
              PduRDestPduRoutingType = API_FORWARDING
              PduRDestPduDataProcessing = IMMEDIATE
              PduRPduLengthHandlingStrategy = IGNORE
              PduRDestPduCrossPartitionDestination = false
              PduRTransmissionConfirmation = false
              PduRDestPduRef = POD_DCDC_02_oATOM_CAN_Matrix_PT_V600_20250211_e5ca5d0b_Rx
              PduRDestPduPduRBswModulesRef = Com
            PduRSrcPdu_2eb983a0 (PduRSrcPdu):
              PduRSourcePduHandleId = 79
              PduRSrcPduDirection = RECEIVE
              PduRSrcPduRef = POD_DCDC_02_oATOM_CAN_Matrix_PT_V600_20250211_07124be6_Rx
              PduRSrcPduPduRBswModulesRef = CanIf
          DCM_FL_02_oATOM_CAN_Matrix_PT_V600_20250211_e178006a_Rx: PduRRoutingPathCommunicationType=COMMUNICATION_INTERFACE
            DCM_FL_02_oATOM_CAN_Matrix_PT_V600_20250211_e178006a_Rx_f6cb4db3_Rx (PduRDestPdu):
              PduRDestPduHandleId = 44
              PduRDestPduDirection = RECEIVE
              PduRDestPduRoutingType = API_FORWARDING
              PduRDestPduDataProcessing = IMMEDIATE
              PduRPduLengthHandlingStrategy = IGNORE
              PduRDestPduCrossPartitionDestination = false
              PduRTransmissionConfirmation = false
              PduRDestPduRef = DCM_FL_02_oATOM_CAN_Matrix_PT_V600_20250211_01d0b409_Rx
              PduRDestPduPduRBswModulesRef = Com
            PduRSrcPdu_f6cb4db3 (PduRSrcPdu):
              PduRSourcePduHandleId = 44
              PduRSrcPduDirection = RECEIVE
              PduRSrcPduRef = DCM_FL_02_oATOM_CAN_Matrix_PT_V600_20250211_e178006a_Rx
              PduRSrcPduPduRBswModulesRef = CanIf
          VCU_SynReq_01_oATOM_CAN_Matrix_PT_V600_20250211_9b305e0d_Tx: PduRRoutingPathCommunicationType=COMMUNICATION_INTERFACE
            PduRSrcPdu_bad18405 (PduRSrcPdu):
              PduRSourcePduHandleId = 46
              PduRSrcPduDirection = TRANSMIT
              PduRSrcPduRef = VCU_SynReq_01_oATOM_CAN_Matrix_PT_V600_20250211_9b305e0d_Tx
              PduRSrcPduPduRBswModulesRef = Com
            VCU_SynReq_01_oATOM_CAN_Matrix_PT_V600_20250211_fde06b01_Tx (PduRDestPdu):
              PduRDestPduHandleId = 38
              PduRDestPduDirection = TRANSMIT
              PduRDestPduRoutingType = API_FORWARDING
              PduRDestPduDataProcessing = IMMEDIATE
              PduRPduLengthHandlingStrategy = IGNORE
              PduRDestPduCrossPartitionDestination = false
              PduRTransmissionConfirmation = true
              PduRDestPduDataProvision = PDUR_DIRECT
              PduRDestPduRef = VCU_SynReq_01_oATOM_CAN_Matrix_PT_V600_20250211_fde06b01_Tx
              PduRDestPduPduRBswModulesRef = CanIf
          BMS_Charge_01_oATOM_CAN_Matrix_PT_V600_20250211_7145a374_Rx: PduRRoutingPathCommunicationType=COMMUNICATION_INTERFACE
            PduRSrcPdu_18355f69 (PduRSrcPdu):
              PduRSourcePduHandleId = 18
              PduRSrcPduDirection = RECEIVE
              PduRSrcPduRef = BMS_Charge_01_oATOM_CAN_Matrix_PT_V600_20250211_7145a374_Rx
              PduRSrcPduPduRBswModulesRef = CanIf
            BMS_Charge_01_oATOM_CAN_Matrix_PT_V600_20250211_7145a374_Rx_18355f69_Rx (PduRDestPdu):
              PduRDestPduHandleId = 18
              PduRDestPduDirection = RECEIVE
              PduRDestPduRoutingType = API_FORWARDING
              PduRDestPduDataProcessing = IMMEDIATE
              PduRPduLengthHandlingStrategy = IGNORE
              PduRDestPduCrossPartitionDestination = false
              PduRTransmissionConfirmation = false
              PduRDestPduRef = BMS_Charge_01_oATOM_CAN_Matrix_PT_V600_20250211_a9484401_Rx
              PduRDestPduPduRBswModulesRef = Com
          VCU_DCDC_oATOM_CAN_Matrix_PT_V600_20250211_2c28a723_Tx: PduRRoutingPathCommunicationType=COMMUNICATION_INTERFACE
            PduRSrcPdu_0ef8885c (PduRSrcPdu):
              PduRSourcePduHandleId = 30
              PduRSrcPduDirection = TRANSMIT
              PduRSrcPduRef = VCU_DCDC_oATOM_CAN_Matrix_PT_V600_20250211_2c28a723_Tx
              PduRSrcPduPduRBswModulesRef = Com
            VCU_DCDC_oATOM_CAN_Matrix_PT_V600_20250211_2cf6caff_Tx (PduRDestPdu):
              PduRDestPduHandleId = 22
              PduRDestPduDirection = TRANSMIT
              PduRDestPduRoutingType = API_FORWARDING
              PduRDestPduDataProcessing = IMMEDIATE
              PduRPduLengthHandlingStrategy = IGNORE
              PduRDestPduCrossPartitionDestination = false
              PduRTransmissionConfirmation = true
              PduRDestPduDataProvision = PDUR_DIRECT
              PduRDestPduRef = VCU_DCDC_oATOM_CAN_Matrix_PT_V600_20250211_2cf6caff_Tx
              PduRDestPduPduRBswModulesRef = CanIf
          BMS_ErrorInfo_oATOM_CAN_Matrix_PT_V600_20250211_744f74f5_Rx: PduRRoutingPathCommunicationType=COMMUNICATION_INTERFACE
            PduRSrcPdu_c6a6b7d8 (PduRSrcPdu):
              PduRSourcePduHandleId = 22
              PduRSrcPduDirection = RECEIVE
              PduRSrcPduRef = BMS_ErrorInfo_oATOM_CAN_Matrix_PT_V600_20250211_744f74f5_Rx
              PduRSrcPduPduRBswModulesRef = CanIf
            BMS_ErrorInfo_oATOM_CAN_Matrix_PT_V600_20250211_744f74f5_Rx_c6a6b7d8_Rx (PduRDestPdu):
              PduRDestPduHandleId = 22
              PduRDestPduDirection = RECEIVE
              PduRDestPduRoutingType = API_FORWARDING
              PduRDestPduDataProcessing = IMMEDIATE
              PduRPduLengthHandlingStrategy = IGNORE
              PduRDestPduCrossPartitionDestination = false
              PduRTransmissionConfirmation = false
              PduRDestPduRef = BMS_ErrorInfo_oATOM_CAN_Matrix_PT_V600_20250211_7b9afbfb_Rx
              PduRDestPduPduRBswModulesRef = Com
          BMS_status_01_oATOM_CAN_Matrix_PT_V600_20250211_f6aa5f55_Rx: PduRRoutingPathCommunicationType=COMMUNICATION_INTERFACE
            PduRSrcPdu_5187e753 (PduRSrcPdu):
              PduRSourcePduHandleId = 26
              PduRSrcPduDirection = RECEIVE
              PduRSrcPduRef = BMS_status_01_oATOM_CAN_Matrix_PT_V600_20250211_f6aa5f55_Rx
              PduRSrcPduPduRBswModulesRef = CanIf
            BMS_status_01_oATOM_CAN_Matrix_PT_V600_20250211_f6aa5f55_Rx_5187e753_Rx (PduRDestPdu):
              PduRDestPduHandleId = 26
              PduRDestPduDirection = RECEIVE
              PduRDestPduRoutingType = API_FORWARDING
              PduRDestPduDataProcessing = IMMEDIATE
              PduRPduLengthHandlingStrategy = IGNORE
              PduRDestPduCrossPartitionDestination = false
              PduRTransmissionConfirmation = false
              PduRDestPduRef = BMS_status_01_oATOM_CAN_Matrix_PT_V600_20250211_aa75a24f_Rx
              PduRDestPduPduRBswModulesRef = Com
          VCU_02_oATOM_CAN_Matrix_PT_V600_20250211_28e7bea0_Tx: PduRRoutingPathCommunicationType=COMMUNICATION_INTERFACE
            PduRSrcPdu_b0ae8a73 (PduRSrcPdu):
              PduRSourcePduHandleId = 20
              PduRSrcPduDirection = TRANSMIT
              PduRSrcPduRef = VCU_02_oATOM_CAN_Matrix_PT_V600_20250211_28e7bea0_Tx
              PduRSrcPduPduRBswModulesRef = Com
            VCU_02_oATOM_CAN_Matrix_PT_V600_20250211_dc79618a_Tx (PduRDestPdu):
              PduRDestPduHandleId = 12
              PduRDestPduDirection = TRANSMIT
              PduRDestPduRoutingType = API_FORWARDING
              PduRDestPduDataProcessing = IMMEDIATE
              PduRPduLengthHandlingStrategy = IGNORE
              PduRDestPduCrossPartitionDestination = false
              PduRDestPduDataProvision = PDUR_DIRECT
              PduRTransmissionConfirmation = true
              PduRDestPduRef = VCU_02_oATOM_CAN_Matrix_PT_V600_20250211_dc79618a_Tx
              PduRDestPduPduRBswModulesRef = CanIf
          DiagReq_VCU_OBD_oATOM_CAN_Matrix_PT_V600_20250211_7d1d4961_Rx: PduRRoutingPathCommunicationType=TRANSPORT_PROTOCOL
            DiagReq_VCU_OBD_oATOM_CAN_Matrix_PT_V600_20250211_7d1d4961_Rx_1a5e9c8c_Rx (PduRDestPdu):
              PduRDestPduHandleId = 4
              PduRDestPduDirection = RECEIVE
              PduRDestPduRoutingType = API_FORWARDING
              PduRDestPduDataProcessing = IMMEDIATE
              PduRPduLengthHandlingStrategy = UNUSED
              PduRDestPduCrossPartitionDestination = false
              PduRDestPduRef = DiagReq_VCU_OBD_oATOM_CAN_Matrix_PT_V600_20250211_39988d3e_Rx
              PduRDestPduPduRBswModulesRef = Dcm
            PduRSrcPdu_1a5e9c8c (PduRSrcPdu):
              PduRSourcePduHandleId = 4
              PduRSrcPduDirection = RECEIVE
              PduRSrcPduRef = DiagReq_VCU_OBD_oATOM_CAN_Matrix_PT_V600_20250211_7d1d4961_Rx
              PduRSrcPduPduRBswModulesRef = CanTp
          BMS_BatInfor_03_oATOM_CAN_Matrix_PT_V600_20250211_cd43c7b3_Rx: PduRRoutingPathCommunicationType=COMMUNICATION_INTERFACE
            PduRSrcPdu_0c4dce36 (PduRSrcPdu):
              PduRSourcePduHandleId = 15
              PduRSrcPduDirection = RECEIVE
              PduRSrcPduRef = BMS_BatInfor_03_oATOM_CAN_Matrix_PT_V600_20250211_cd43c7b3_Rx
              PduRSrcPduPduRBswModulesRef = CanIf
            BMS_BatInfor_03_oATOM_CAN_Matrix_PT_V600_20250211_cd43c7b3_Rx_0c4dce36_Rx (PduRDestPdu):
              PduRDestPduHandleId = 15
              PduRDestPduDirection = RECEIVE
              PduRDestPduRoutingType = API_FORWARDING
              PduRDestPduDataProcessing = IMMEDIATE
              PduRPduLengthHandlingStrategy = IGNORE
              PduRDestPduCrossPartitionDestination = false
              PduRTransmissionConfirmation = false
              PduRDestPduRef = BMS_BatInfor_03_oATOM_CAN_Matrix_PT_V600_20250211_83595004_Rx
              PduRDestPduPduRBswModulesRef = Com
          BMS_TCU_oATOM_CAN_Matrix_PT_V600_20250211_0825057e_Rx: PduRRoutingPathCommunicationType=COMMUNICATION_INTERFACE
            BMS_TCU_oATOM_CAN_Matrix_PT_V600_20250211_0825057e_Rx_7d63f76e_Rx (PduRDestPdu):
              PduRDestPduHandleId = 24
              PduRDestPduDirection = RECEIVE
              PduRDestPduRoutingType = API_FORWARDING
              PduRDestPduDataProcessing = IMMEDIATE
              PduRPduLengthHandlingStrategy = IGNORE
              PduRDestPduCrossPartitionDestination = false
              PduRTransmissionConfirmation = false
              PduRDestPduRef = BMS_TCU_oATOM_CAN_Matrix_PT_V600_20250211_911c2b08_Rx
              PduRDestPduPduRBswModulesRef = Com
            PduRSrcPdu_7d63f76e (PduRSrcPdu):
              PduRSourcePduHandleId = 24
              PduRSrcPduDirection = RECEIVE
              PduRSrcPduRef = BMS_TCU_oATOM_CAN_Matrix_PT_V600_20250211_0825057e_Rx
              PduRSrcPduPduRBswModulesRef = CanIf
          POD_OBC_STATUS_02_oATOM_CAN_Matrix_PT_V600_20250211_29dcadd3_Rx: PduRRoutingPathCommunicationType=COMMUNICATION_INTERFACE
            PduRSrcPdu_14a43957 (PduRSrcPdu):
              PduRSourcePduHandleId = 81
              PduRSrcPduDirection = RECEIVE
              PduRSrcPduRef = POD_OBC_STATUS_02_oATOM_CAN_Matrix_PT_V600_20250211_29dcadd3_Rx
              PduRSrcPduPduRBswModulesRef = CanIf
            POD_OBC_STATUS_02_oATOM_CAN_Matrix_PT_V600_20250211_29dcadd3_Rx_14a43957_Rx (PduRDestPdu):
              PduRDestPduHandleId = 81
              PduRDestPduDirection = RECEIVE
              PduRDestPduRoutingType = API_FORWARDING
              PduRDestPduDataProcessing = IMMEDIATE
              PduRPduLengthHandlingStrategy = IGNORE
              PduRDestPduCrossPartitionDestination = false
              PduRTransmissionConfirmation = false
              PduRDestPduRef = POD_OBC_STATUS_02_oATOM_CAN_Matrix_PT_V600_20250211_5da6c285_Rx
              PduRDestPduPduRBswModulesRef = Com
          IVI_OdometerInfor_oATOM_CAN_Matrix_PT_V600_20250211_41b50bfd_Rx: PduRRoutingPathCommunicationType=COMMUNICATION_INTERFACE
            IVI_OdometerInfor_oATOM_CAN_Matrix_PT_V600_20250211_41b50bfd_Rx_a8951de4_Rx (PduRDestPdu):
              PduRDestPduHandleId = 69
              PduRDestPduDirection = RECEIVE
              PduRDestPduRoutingType = API_FORWARDING
              PduRDestPduDataProcessing = IMMEDIATE
              PduRPduLengthHandlingStrategy = IGNORE
              PduRDestPduCrossPartitionDestination = false
              PduRTransmissionConfirmation = false
              PduRDestPduRef = IVI_OdometerInfor_oATOM_CAN_Matrix_PT_V600_20250211_fa3740ee_Rx
              PduRDestPduPduRBswModulesRef = Com
            PduRSrcPdu_a8951de4 (PduRSrcPdu):
              PduRSourcePduHandleId = 69
              PduRSrcPduDirection = RECEIVE
              PduRSrcPduRef = IVI_OdometerInfor_oATOM_CAN_Matrix_PT_V600_20250211_41b50bfd_Rx
              PduRSrcPduPduRBswModulesRef = CanIf
          SGW_Time_oATOM_CAN_Matrix_PT_V600_20250211_90c528d8_Rx: PduRRoutingPathCommunicationType=COMMUNICATION_INTERFACE
            SGW_Time_oATOM_CAN_Matrix_PT_V600_20250211_90c528d8_Rx_3e9241c6_Rx (PduRDestPdu):
              PduRDestPduHandleId = 94
              PduRDestPduDirection = RECEIVE
              PduRDestPduRoutingType = API_FORWARDING
              PduRDestPduDataProcessing = IMMEDIATE
              PduRPduLengthHandlingStrategy = IGNORE
              PduRDestPduCrossPartitionDestination = false
              PduRTransmissionConfirmation = false
              PduRDestPduRef = SGW_Time_oATOM_CAN_Matrix_PT_V600_20250211_2fddccce_Rx
              PduRDestPduPduRBswModulesRef = Com
            PduRSrcPdu_3e9241c6 (PduRSrcPdu):
              PduRSourcePduHandleId = 94
              PduRSrcPduDirection = RECEIVE
              PduRSrcPduRef = SGW_Time_oATOM_CAN_Matrix_PT_V600_20250211_90c528d8_Rx
              PduRSrcPduPduRBswModulesRef = CanIf
          DiagReq_ALL_oATOM_CAN_Matrix_PT_V600_20250211_278c238c_Rx: PduRRoutingPathCommunicationType=TRANSPORT_PROTOCOL
            DiagReq_ALL_oATOM_CAN_Matrix_PT_V600_20250211_278c238c_Rx_d6323ebe_Rx (PduRDestPdu):
              PduRDestPduHandleId = 0
              PduRDestPduDirection = RECEIVE
              PduRDestPduRoutingType = API_FORWARDING
              PduRDestPduDataProcessing = IMMEDIATE
              PduRPduLengthHandlingStrategy = UNUSED
              PduRDestPduCrossPartitionDestination = false
              PduRDestPduRef = DiagReq_ALL_oATOM_CAN_Matrix_PT_V600_20250211_8c8ad95e_Rx
              PduRDestPduPduRBswModulesRef = Dcm
            PduRSrcPdu_d6323ebe (PduRSrcPdu):
              PduRSourcePduHandleId = 0
              PduRSrcPduDirection = RECEIVE
              PduRSrcPduRef = DiagReq_ALL_oATOM_CAN_Matrix_PT_V600_20250211_278c238c_Rx
              PduRSrcPduPduRBswModulesRef = CanTp
          SGW_VCU_01_oATOM_CAN_Matrix_PT_V600_20250211_fbd26219_Rx: PduRRoutingPathCommunicationType=COMMUNICATION_INTERFACE
            PduRSrcPdu_5cf167cd (PduRSrcPdu):
              PduRSourcePduHandleId = 95
              PduRSrcPduDirection = RECEIVE
              PduRSrcPduRef = SGW_VCU_01_oATOM_CAN_Matrix_PT_V600_20250211_fbd26219_Rx
              PduRSrcPduPduRBswModulesRef = CanIf
            SGW_VCU_01_oATOM_CAN_Matrix_PT_V600_20250211_fbd26219_Rx_5cf167cd_Rx (PduRDestPdu):
              PduRDestPduHandleId = 95
              PduRDestPduDirection = RECEIVE
              PduRDestPduRoutingType = API_FORWARDING
              PduRDestPduDataProcessing = IMMEDIATE
              PduRPduLengthHandlingStrategy = IGNORE
              PduRDestPduCrossPartitionDestination = false
              PduRTransmissionConfirmation = false
              PduRDestPduRef = SGW_VCU_01_oATOM_CAN_Matrix_PT_V600_20250211_0e1163ba_Rx
              PduRDestPduPduRBswModulesRef = Com
          MCU_02_oATOM_CAN_Matrix_PT_V600_20250211_81157df2_Rx: PduRRoutingPathCommunicationType=COMMUNICATION_INTERFACE
            MCU_02_oATOM_CAN_Matrix_PT_V600_20250211_81157df2_Rx_5fe77ffa_Rx (PduRDestPdu):
              PduRDestPduHandleId = 71
              PduRDestPduDirection = RECEIVE
              PduRDestPduRoutingType = API_FORWARDING
              PduRDestPduDataProcessing = IMMEDIATE
              PduRPduLengthHandlingStrategy = IGNORE
              PduRDestPduCrossPartitionDestination = false
              PduRTransmissionConfirmation = false
              PduRDestPduRef = MCU_02_oATOM_CAN_Matrix_PT_V600_20250211_8ccf8c29_Rx
              PduRDestPduPduRBswModulesRef = Com
            PduRSrcPdu_5fe77ffa (PduRSrcPdu):
              PduRSourcePduHandleId = 71
              PduRSrcPduDirection = RECEIVE
              PduRSrcPduRef = MCU_02_oATOM_CAN_Matrix_PT_V600_20250211_81157df2_Rx
              PduRSrcPduPduRBswModulesRef = CanIf
          VCU_TCU_oATOM_CAN_Matrix_PT_V600_20250211_8e1c824e_Tx: PduRRoutingPathCommunicationType=COMMUNICATION_INTERFACE
            PduRSrcPdu_388965a3 (PduRSrcPdu):
              PduRSourcePduHandleId = 47
              PduRSrcPduDirection = TRANSMIT
              PduRSrcPduRef = VCU_TCU_oATOM_CAN_Matrix_PT_V600_20250211_8e1c824e_Tx
              PduRSrcPduPduRBswModulesRef = Com
            VCU_TCU_oATOM_CAN_Matrix_PT_V600_20250211_e6bfcc3d_Tx (PduRDestPdu):
              PduRDestPduHandleId = 39
              PduRDestPduDirection = TRANSMIT
              PduRDestPduRoutingType = API_FORWARDING
              PduRDestPduDataProcessing = IMMEDIATE
              PduRPduLengthHandlingStrategy = IGNORE
              PduRDestPduCrossPartitionDestination = false
              PduRTransmissionConfirmation = true
              PduRDestPduDataProvision = PDUR_DIRECT
              PduRDestPduRef = VCU_TCU_oATOM_CAN_Matrix_PT_V600_20250211_e6bfcc3d_Tx
              PduRDestPduPduRBswModulesRef = CanIf
          DiagReq_OBD_oATOM_CAN_Matrix_PT_V600_20250211_2ff897c4_Rx: PduRRoutingPathCommunicationType=TRANSPORT_PROTOCOL
            PduRSrcPdu_c012a7a4 (PduRSrcPdu):
              PduRSourcePduHandleId = 2
              PduRSrcPduDirection = RECEIVE
              PduRSrcPduRef = DiagReq_OBD_oATOM_CAN_Matrix_PT_V600_20250211_2ff897c4_Rx
              PduRSrcPduPduRBswModulesRef = CanTp
            DiagReq_OBD_oATOM_CAN_Matrix_PT_V600_20250211_2ff897c4_Rx_c012a7a4_Rx (PduRDestPdu):
              PduRDestPduHandleId = 2
              PduRDestPduDirection = RECEIVE
              PduRDestPduRoutingType = API_FORWARDING
              PduRDestPduDataProcessing = IMMEDIATE
              PduRPduLengthHandlingStrategy = UNUSED
              PduRDestPduCrossPartitionDestination = false
              PduRDestPduRef = DiagReq_OBD_oATOM_CAN_Matrix_PT_V600_20250211_97cbed37_Rx
              PduRDestPduPduRBswModulesRef = Dcm
          DiagReq_VCU_oATOM_CAN_Matrix_PT_V600_20250211_a64ab01c_Rx: PduRRoutingPathCommunicationType=TRANSPORT_PROTOCOL
            DiagReq_VCU_oATOM_CAN_Matrix_PT_V600_20250211_a64ab01c_Rx_65a4ed4d_Rx (PduRDestPdu):
              PduRDestPduHandleId = 5
              PduRDestPduDirection = RECEIVE
              PduRDestPduRoutingType = API_FORWARDING
              PduRDestPduDataProcessing = IMMEDIATE
              PduRPduLengthHandlingStrategy = UNUSED
              PduRDestPduCrossPartitionDestination = false
              PduRDestPduRef = DiagReq_VCU_oATOM_CAN_Matrix_PT_V600_20250211_bcb58cfd_Rx
              PduRDestPduPduRBswModulesRef = Dcm
            PduRSrcPdu_65a4ed4d (PduRSrcPdu):
              PduRSourcePduHandleId = 5
              PduRSrcPduDirection = RECEIVE
              PduRSrcPduRef = DiagReq_VCU_oATOM_CAN_Matrix_PT_V600_20250211_a64ab01c_Rx
              PduRSrcPduPduRBswModulesRef = CanTp
          MCU_01_oATOM_CAN_Matrix_PT_V600_20250211_18559a9d_Rx: PduRRoutingPathCommunicationType=COMMUNICATION_INTERFACE
            MCU_01_oATOM_CAN_Matrix_PT_V600_20250211_18559a9d_Rx_6a0fc49c_Rx (PduRDestPdu):
              PduRDestPduHandleId = 70
              PduRDestPduDirection = RECEIVE
              PduRDestPduRoutingType = API_FORWARDING
              PduRDestPduDataProcessing = IMMEDIATE
              PduRPduLengthHandlingStrategy = IGNORE
              PduRDestPduCrossPartitionDestination = false
              PduRTransmissionConfirmation = false
              PduRDestPduRef = MCU_01_oATOM_CAN_Matrix_PT_V600_20250211_071cb230_Rx
              PduRDestPduPduRBswModulesRef = Com
            PduRSrcPdu_6a0fc49c (PduRSrcPdu):
              PduRSourcePduHandleId = 70
              PduRSrcPduDirection = RECEIVE
              PduRSrcPduRef = MCU_01_oATOM_CAN_Matrix_PT_V600_20250211_18559a9d_Rx
              PduRSrcPduPduRBswModulesRef = CanIf
          VCU_BMS_oATOM_CAN_Matrix_PT_V600_20250211_2d559c92_Tx: PduRRoutingPathCommunicationType=COMMUNICATION_INTERFACE
            VCU_BMS_oATOM_CAN_Matrix_PT_V600_20250211_e81d87a2_Tx (PduRDestPdu):
              PduRDestPduHandleId = 20
              PduRDestPduDirection = TRANSMIT
              PduRDestPduRoutingType = API_FORWARDING
              PduRDestPduDataProcessing = IMMEDIATE
              PduRPduLengthHandlingStrategy = IGNORE
              PduRDestPduCrossPartitionDestination = false
              PduRDestPduDataProvision = PDUR_DIRECT
              PduRTransmissionConfirmation = true
              PduRDestPduRef = VCU_BMS_oATOM_CAN_Matrix_PT_V600_20250211_e81d87a2_Tx
              PduRDestPduPduRBswModulesRef = CanIf
            PduRSrcPdu_2e1edbfb (PduRSrcPdu):
              PduRSourcePduHandleId = 28
              PduRSrcPduDirection = TRANSMIT
              PduRSrcPduRef = VCU_BMS_oATOM_CAN_Matrix_PT_V600_20250211_2d559c92_Tx
              PduRSrcPduPduRBswModulesRef = Com
          PRND_oATOM_CAN_Matrix_PT_V600_20250211_7ae8f154_Rx: PduRRoutingPathCommunicationType=COMMUNICATION_INTERFACE
            PRND_oATOM_CAN_Matrix_PT_V600_20250211_7ae8f154_Rx_27fe156b_Rx (PduRDestPdu):
              PduRDestPduHandleId = 86
              PduRDestPduDirection = RECEIVE
              PduRDestPduRoutingType = API_FORWARDING
              PduRDestPduDataProcessing = IMMEDIATE
              PduRPduLengthHandlingStrategy = IGNORE
              PduRDestPduCrossPartitionDestination = false
              PduRTransmissionConfirmation = false
              PduRDestPduRef = PRND_oATOM_CAN_Matrix_PT_V600_20250211_a04a662c_Rx
              PduRDestPduPduRBswModulesRef = Com
            PduRSrcPdu_27fe156b (PduRSrcPdu):
              PduRSourcePduHandleId = 86
              PduRSrcPduDirection = RECEIVE
              PduRSrcPduRef = PRND_oATOM_CAN_Matrix_PT_V600_20250211_7ae8f154_Rx
              PduRSrcPduPduRBswModulesRef = CanIf
          Uds_EPT_Boot_Request_oATOM_CAN_Matrix_PT_V600_20250211_5ef4d74d_Rx: PduRRoutingPathCommunicationType=COMMUNICATION_INTERFACE
            Uds_EPT_Boot_Request_oATOM_CAN_Matrix_PT_V600_20250211_5ef4d74d_Rx_0a6cd4f7_Rx (PduRDestPdu):
              PduRDestPduHandleId = 99
              PduRDestPduDirection = RECEIVE
              PduRDestPduRoutingType = API_FORWARDING
              PduRDestPduDataProcessing = IMMEDIATE
              PduRPduLengthHandlingStrategy = IGNORE
              PduRDestPduCrossPartitionDestination = false
              PduRTransmissionConfirmation = false
              PduRDestPduRef = Uds_EPT_Boot_Request_oATOM_CAN_Matrix_PT_V600_20250211_1c93f757_Rx
              PduRDestPduPduRBswModulesRef = Com
            PduRSrcPdu_0a6cd4f7 (PduRSrcPdu):
              PduRSourcePduHandleId = 99
              PduRSrcPduDirection = RECEIVE
              PduRSrcPduRef = Uds_EPT_Boot_Request_oATOM_CAN_Matrix_PT_V600_20250211_5ef4d74d_Rx
              PduRSrcPduPduRBswModulesRef = CanIf
          BCM_06_oATOM_CAN_Matrix_PT_V600_20250211_2672f3d4_Rx: PduRRoutingPathCommunicationType=COMMUNICATION_INTERFACE
            PduRSrcPdu_794cc76a (PduRSrcPdu):
              PduRSourcePduHandleId = 10
              PduRSrcPduDirection = RECEIVE
              PduRSrcPduRef = BCM_06_oATOM_CAN_Matrix_PT_V600_20250211_2672f3d4_Rx
              PduRSrcPduPduRBswModulesRef = CanIf
            BCM_06_oATOM_CAN_Matrix_PT_V600_20250211_2672f3d4_Rx_794cc76a_Rx (PduRDestPdu):
              PduRDestPduHandleId = 10
              PduRDestPduDirection = RECEIVE
              PduRDestPduRoutingType = API_FORWARDING
              PduRDestPduDataProcessing = IMMEDIATE
              PduRPduLengthHandlingStrategy = IGNORE
              PduRDestPduCrossPartitionDestination = false
              PduRTransmissionConfirmation = false
              PduRDestPduRef = BCM_06_oATOM_CAN_Matrix_PT_V600_20250211_86c8a4d8_Rx
              PduRDestPduPduRBswModulesRef = Com
          VCU_POD_oATOM_CAN_Matrix_PT_V600_20250211_28db6ecb_Tx: PduRRoutingPathCommunicationType=COMMUNICATION_INTERFACE
            PduRSrcPdu_ec659b26 (PduRSrcPdu):
              PduRSourcePduHandleId = 43
              PduRSrcPduDirection = TRANSMIT
              PduRSrcPduRef = VCU_POD_oATOM_CAN_Matrix_PT_V600_20250211_28db6ecb_Tx
              PduRSrcPduPduRBswModulesRef = Com
            VCU_POD_oATOM_CAN_Matrix_PT_V600_20250211_bb987d73_Tx (PduRDestPdu):
              PduRDestPduHandleId = 35
              PduRDestPduDirection = TRANSMIT
              PduRDestPduRoutingType = API_FORWARDING
              PduRDestPduDataProcessing = IMMEDIATE
              PduRPduLengthHandlingStrategy = IGNORE
              PduRDestPduCrossPartitionDestination = false
              PduRDestPduDataProvision = PDUR_DIRECT
              PduRTransmissionConfirmation = true
              PduRDestPduRef = VCU_POD_oATOM_CAN_Matrix_PT_V600_20250211_bb987d73_Tx
              PduRDestPduPduRBswModulesRef = CanIf
          CGW_VIN3VER_oATOM_CAN_Matrix_PT_V600_20250211_255d67dc_Rx: PduRRoutingPathCommunicationType=COMMUNICATION_INTERFACE
            CGW_VIN3VER_oATOM_CAN_Matrix_PT_V600_20250211_255d67dc_Rx_c43586a5_Rx (PduRDestPdu):
              PduRDestPduHandleId = 36
              PduRDestPduDirection = RECEIVE
              PduRDestPduRoutingType = API_FORWARDING
              PduRDestPduDataProcessing = IMMEDIATE
              PduRPduLengthHandlingStrategy = IGNORE
              PduRDestPduCrossPartitionDestination = false
              PduRTransmissionConfirmation = false
              PduRDestPduRef = CGW_VIN3VER_oATOM_CAN_Matrix_PT_V600_20250211_df8c8006_Rx
              PduRDestPduPduRBswModulesRef = Com
            PduRSrcPdu_c43586a5 (PduRSrcPdu):
              PduRSourcePduHandleId = 36
              PduRSrcPduDirection = RECEIVE
              PduRSrcPduRef = CGW_VIN3VER_oATOM_CAN_Matrix_PT_V600_20250211_255d67dc_Rx
              PduRSrcPduPduRBswModulesRef = CanIf
          BCM_05_oATOM_CAN_Matrix_PT_V600_20250211_bf3214bb_Rx: PduRRoutingPathCommunicationType=COMMUNICATION_INTERFACE
            PduRSrcPdu_c4d092fa (PduRSrcPdu):
              PduRSourcePduHandleId = 9
              PduRSrcPduDirection = RECEIVE
              PduRSrcPduRef = BCM_05_oATOM_CAN_Matrix_PT_V600_20250211_bf3214bb_Rx
              PduRSrcPduPduRBswModulesRef = CanIf
            BCM_05_oATOM_CAN_Matrix_PT_V600_20250211_bf3214bb_Rx_c4d092fa_Rx (PduRDestPdu):
              PduRDestPduHandleId = 9
              PduRDestPduDirection = RECEIVE
              PduRDestPduRoutingType = API_FORWARDING
              PduRDestPduDataProcessing = IMMEDIATE
              PduRPduLengthHandlingStrategy = IGNORE
              PduRDestPduCrossPartitionDestination = false
              PduRTransmissionConfirmation = false
              PduRDestPduRef = BCM_05_oATOM_CAN_Matrix_PT_V600_20250211_0d1b9ac1_Rx
              PduRDestPduPduRBswModulesRef = Com
          BMS_status_02_oATOM_CAN_Matrix_PT_V600_20250211_6feab83a_Rx: PduRRoutingPathCommunicationType=COMMUNICATION_INTERFACE
            PduRSrcPdu_6d932377 (PduRSrcPdu):
              PduRSourcePduHandleId = 27
              PduRSrcPduDirection = RECEIVE
              PduRSrcPduRef = BMS_status_02_oATOM_CAN_Matrix_PT_V600_20250211_6feab83a_Rx
              PduRSrcPduPduRBswModulesRef = CanIf
            BMS_status_02_oATOM_CAN_Matrix_PT_V600_20250211_6feab83a_Rx_6d932377_Rx (PduRDestPdu):
              PduRDestPduHandleId = 27
              PduRDestPduDirection = RECEIVE
              PduRDestPduRoutingType = API_FORWARDING
              PduRDestPduDataProcessing = IMMEDIATE
              PduRPduLengthHandlingStrategy = IGNORE
              PduRDestPduCrossPartitionDestination = false
              PduRTransmissionConfirmation = false
              PduRDestPduRef = BMS_status_02_oATOM_CAN_Matrix_PT_V600_20250211_21a69c56_Rx
              PduRDestPduPduRBswModulesRef = Com
          DCM_FR_oATOM_CAN_Matrix_PT_V600_20250211_00cda30a_Rx: PduRRoutingPathCommunicationType=COMMUNICATION_INTERFACE
            DCM_FR_oATOM_CAN_Matrix_PT_V600_20250211_00cda30a_Rx_249eb541_Rx (PduRDestPdu):
              PduRDestPduHandleId = 46
              PduRDestPduDirection = RECEIVE
              PduRDestPduRoutingType = API_FORWARDING
              PduRDestPduDataProcessing = IMMEDIATE
              PduRPduLengthHandlingStrategy = IGNORE
              PduRDestPduCrossPartitionDestination = false
              PduRTransmissionConfirmation = false
              PduRDestPduRef = DCM_FR_oATOM_CAN_Matrix_PT_V600_20250211_22d2db3a_Rx
              PduRDestPduPduRBswModulesRef = Com
            PduRSrcPdu_249eb541 (PduRSrcPdu):
              PduRSourcePduHandleId = 46
              PduRSrcPduDirection = RECEIVE
              PduRSrcPduRef = DCM_FR_oATOM_CAN_Matrix_PT_V600_20250211_00cda30a_Rx
              PduRSrcPduPduRBswModulesRef = CanIf
          BCM_Authentication_oATOM_CAN_Matrix_PT_V600_20250211_8720645c_Rx: PduRRoutingPathCommunicationType=COMMUNICATION_INTERFACE
            PduRSrcPdu_07ad9208 (PduRSrcPdu):
              PduRSourcePduHandleId = 12
              PduRSrcPduDirection = RECEIVE
              PduRSrcPduRef = BCM_Authentication_oATOM_CAN_Matrix_PT_V600_20250211_8720645c_Rx
              PduRSrcPduPduRBswModulesRef = CanIf
            BCM_Authentication_oATOM_CAN_Matrix_PT_V600_20250211_8720645c_Rx_07ad9208_Rx (PduRDestPdu):
              PduRDestPduHandleId = 12
              PduRDestPduDirection = RECEIVE
              PduRDestPduRoutingType = API_FORWARDING
              PduRDestPduDataProcessing = IMMEDIATE
              PduRPduLengthHandlingStrategy = IGNORE
              PduRDestPduCrossPartitionDestination = false
              PduRTransmissionConfirmation = false
              PduRDestPduRef = BCM_Authentication_oATOM_CAN_Matrix_PT_V600_20250211_f1177f98_Rx
              PduRDestPduPduRBswModulesRef = Com
          DCM_RR_oATOM_CAN_Matrix_PT_V600_20250211_9a6ba105_Rx: PduRRoutingPathCommunicationType=COMMUNICATION_INTERFACE
            PduRSrcPdu_653320c0 (PduRSrcPdu):
              PduRSourcePduHandleId = 48
              PduRSrcPduDirection = RECEIVE
              PduRSrcPduRef = DCM_RR_oATOM_CAN_Matrix_PT_V600_20250211_9a6ba105_Rx
              PduRSrcPduPduRBswModulesRef = CanIf
            DCM_RR_oATOM_CAN_Matrix_PT_V600_20250211_9a6ba105_Rx_653320c0_Rx (PduRDestPdu):
              PduRDestPduHandleId = 48
              PduRDestPduDirection = RECEIVE
              PduRDestPduRoutingType = API_FORWARDING
              PduRDestPduDataProcessing = IMMEDIATE
              PduRPduLengthHandlingStrategy = IGNORE
              PduRDestPduCrossPartitionDestination = false
              PduRTransmissionConfirmation = false
              PduRDestPduRef = DCM_RR_oATOM_CAN_Matrix_PT_V600_20250211_fbc3e1f1_Rx
              PduRDestPduPduRBswModulesRef = Com
          VCU_05_oATOM_CAN_Matrix_PT_V600_20250211_2baed31b_Tx: PduRRoutingPathCommunicationType=COMMUNICATION_INTERFACE
            PduRSrcPdu_7179d90d (PduRSrcPdu):
              PduRSourcePduHandleId = 23
              PduRSrcPduDirection = TRANSMIT
              PduRSrcPduRef = VCU_05_oATOM_CAN_Matrix_PT_V600_20250211_2baed31b_Tx
              PduRSrcPduPduRBswModulesRef = Com
            VCU_05_oATOM_CAN_Matrix_PT_V600_20250211_f466f60f_Tx (PduRDestPdu):
              PduRDestPduHandleId = 15
              PduRDestPduDirection = TRANSMIT
              PduRDestPduRoutingType = API_FORWARDING
              PduRDestPduDataProcessing = IMMEDIATE
              PduRPduLengthHandlingStrategy = IGNORE
              PduRDestPduCrossPartitionDestination = false
              PduRDestPduDataProvision = PDUR_DIRECT
              PduRTransmissionConfirmation = true
              PduRDestPduRef = VCU_05_oATOM_CAN_Matrix_PT_V600_20250211_f466f60f_Tx
              PduRDestPduPduRBswModulesRef = CanIf
          DiagResp_VCU_OBD_oATOM_CAN_Matrix_PT_V600_20250211_599d1fc3_Tx: PduRRoutingPathCommunicationType=TRANSPORT_PROTOCOL
            PduRSrcPdu_59ef7a2a (PduRSrcPdu):
              PduRSourcePduHandleId = 13
              PduRSrcPduDirection = TRANSMIT
              PduRSrcPduRef = DiagResp_VCU_OBD_oATOM_CAN_Matrix_PT_V600_20250211_599d1fc3_Tx
              PduRSrcPduPduRBswModulesRef = Dcm
            DiagResp_VCU_OBD_oATOM_CAN_Matrix_PT_V600_20250211_e13d53cd_Tx (PduRDestPdu):
              PduRDestPduHandleId = 6
              PduRDestPduDirection = TRANSMIT
              PduRDestPduRoutingType = API_FORWARDING
              PduRDestPduDataProcessing = IMMEDIATE
              PduRPduLengthHandlingStrategy = UNUSED
              PduRDestPduCrossPartitionDestination = false
              PduRDestPduRef = DiagResp_VCU_OBD_oATOM_CAN_Matrix_PT_V600_20250211_e13d53cd_Tx
              PduRDestPduPduRBswModulesRef = CanTp
          SGW_01_oATOM_CAN_Matrix_PT_V600_20250211_4b04d591_Rx: PduRRoutingPathCommunicationType=COMMUNICATION_INTERFACE
            PduRSrcPdu_2ab3ccf5 (PduRSrcPdu):
              PduRSourcePduHandleId = 87
              PduRSrcPduDirection = RECEIVE
              PduRSrcPduRef = SGW_01_oATOM_CAN_Matrix_PT_V600_20250211_4b04d591_Rx
              PduRSrcPduPduRBswModulesRef = CanIf
            SGW_01_oATOM_CAN_Matrix_PT_V600_20250211_4b04d591_Rx_2ab3ccf5_Rx (PduRDestPdu):
              PduRDestPduHandleId = 87
              PduRDestPduDirection = RECEIVE
              PduRDestPduRoutingType = API_FORWARDING
              PduRDestPduDataProcessing = IMMEDIATE
              PduRPduLengthHandlingStrategy = IGNORE
              PduRDestPduCrossPartitionDestination = false
              PduRTransmissionConfirmation = false
              PduRDestPduRef = SGW_01_oATOM_CAN_Matrix_PT_V600_20250211_fdc48441_Rx
              PduRDestPduPduRBswModulesRef = Com
          VCU_AccPedal_oATOM_CAN_Matrix_PT_V600_20250211_32508e31_Tx: PduRRoutingPathCommunicationType=COMMUNICATION_INTERFACE
            VCU_AccPedal_oATOM_CAN_Matrix_PT_V600_20250211_5930977d_Tx (PduRDestPdu):
              PduRDestPduHandleId = 18
              PduRDestPduDirection = TRANSMIT
              PduRDestPduRoutingType = API_FORWARDING
              PduRDestPduDataProcessing = IMMEDIATE
              PduRPduLengthHandlingStrategy = IGNORE
              PduRDestPduCrossPartitionDestination = false
              PduRTransmissionConfirmation = true
              PduRDestPduDataProvision = PDUR_DIRECT
              PduRDestPduRef = VCU_AccPedal_oATOM_CAN_Matrix_PT_V600_20250211_5930977d_Tx
              PduRDestPduPduRBswModulesRef = CanIf
            PduRSrcPdu_80312ba0 (PduRSrcPdu):
              PduRSourcePduHandleId = 26
              PduRSrcPduDirection = TRANSMIT
              PduRSrcPduRef = VCU_AccPedal_oATOM_CAN_Matrix_PT_V600_20250211_32508e31_Tx
              PduRSrcPduPduRBswModulesRef = Com
          TCU_02_oATOM_CAN_Matrix_PT_V600_20250211_95cba541_Rx: PduRRoutingPathCommunicationType=COMMUNICATION_INTERFACE
            PduRSrcPdu_f8476887 (PduRSrcPdu):
              PduRSourcePduHandleId = 98
              PduRSrcPduDirection = RECEIVE
              PduRSrcPduRef = TCU_02_oATOM_CAN_Matrix_PT_V600_20250211_95cba541_Rx
              PduRSrcPduPduRBswModulesRef = CanIf
            TCU_02_oATOM_CAN_Matrix_PT_V600_20250211_95cba541_Rx_f8476887_Rx (PduRDestPdu):
              PduRDestPduHandleId = 98
              PduRDestPduDirection = RECEIVE
              PduRDestPduRoutingType = API_FORWARDING
              PduRDestPduDataProcessing = IMMEDIATE
              PduRPduLengthHandlingStrategy = IGNORE
              PduRDestPduCrossPartitionDestination = false
              PduRTransmissionConfirmation = false
              PduRDestPduRef = TCU_02_oATOM_CAN_Matrix_PT_V600_20250211_ad1f9c6f_Rx
              PduRDestPduPduRBswModulesRef = Com
          SGW_PT_01_oATOM_CAN_Matrix_PT_V600_20250211_3c4b1ea4_Rx: PduRRoutingPathCommunicationType=COMMUNICATION_INTERFACE
            SGW_PT_01_oATOM_CAN_Matrix_PT_V600_20250211_3c4b1ea4_Rx_999b8108_Rx (PduRDestPdu):
              PduRDestPduHandleId = 93
              PduRDestPduDirection = RECEIVE
              PduRDestPduRoutingType = API_FORWARDING
              PduRDestPduDataProcessing = IMMEDIATE
              PduRPduLengthHandlingStrategy = IGNORE
              PduRDestPduCrossPartitionDestination = false
              PduRTransmissionConfirmation = false
              PduRDestPduRef = SGW_PT_01_oATOM_CAN_Matrix_PT_V600_20250211_f69035b0_Rx
              PduRDestPduPduRBswModulesRef = Com
            PduRSrcPdu_999b8108 (PduRSrcPdu):
              PduRSourcePduHandleId = 93
              PduRSrcPduDirection = RECEIVE
              PduRSrcPduRef = SGW_PT_01_oATOM_CAN_Matrix_PT_V600_20250211_3c4b1ea4_Rx
              PduRSrcPduPduRBswModulesRef = CanIf
          BMS_Charge_03_oATOM_CAN_Matrix_PT_V600_20250211_29ea1b01_Rx: PduRRoutingPathCommunicationType=COMMUNICATION_INTERFACE
            BMS_Charge_03_oATOM_CAN_Matrix_PT_V600_20250211_29ea1b01_Rx_7dfb13db_Rx (PduRDestPdu):
              PduRDestPduHandleId = 20
              PduRDestPduDirection = RECEIVE
              PduRDestPduRoutingType = API_FORWARDING
              PduRDestPduDataProcessing = IMMEDIATE
              PduRPduLengthHandlingStrategy = IGNORE
              PduRDestPduCrossPartitionDestination = false
              PduRTransmissionConfirmation = false
              PduRDestPduRef = BMS_Charge_03_oATOM_CAN_Matrix_PT_V600_20250211_ed056dd0_Rx
              PduRDestPduPduRBswModulesRef = Com
            PduRSrcPdu_7dfb13db (PduRSrcPdu):
              PduRSourcePduHandleId = 20
              PduRSrcPduDirection = RECEIVE
              PduRSrcPduRef = BMS_Charge_03_oATOM_CAN_Matrix_PT_V600_20250211_29ea1b01_Rx
              PduRSrcPduPduRBswModulesRef = CanIf
          BMS_PRO_oATOM_CAN_Matrix_PT_V600_20250211_925408cc_Rx: PduRRoutingPathCommunicationType=COMMUNICATION_INTERFACE
            PduRSrcPdu_e3e26218 (PduRSrcPdu):
              PduRSourcePduHandleId = 23
              PduRSrcPduDirection = RECEIVE
              PduRSrcPduRef = BMS_PRO_oATOM_CAN_Matrix_PT_V600_20250211_925408cc_Rx
              PduRSrcPduPduRBswModulesRef = CanIf
            BMS_PRO_oATOM_CAN_Matrix_PT_V600_20250211_925408cc_Rx_e3e26218_Rx (PduRDestPdu):
              PduRDestPduHandleId = 23
              PduRDestPduDirection = RECEIVE
              PduRDestPduRoutingType = API_FORWARDING
              PduRDestPduDataProcessing = IMMEDIATE
              PduRPduLengthHandlingStrategy = IGNORE
              PduRDestPduCrossPartitionDestination = false
              PduRTransmissionConfirmation = false
              PduRDestPduRef = BMS_PRO_oATOM_CAN_Matrix_PT_V600_20250211_4a8c07e1_Rx
              PduRDestPduPduRBswModulesRef = Com
          VCU_MCU_03_oATOM_CAN_Matrix_PT_V600_20250211_32c07338_Tx: PduRRoutingPathCommunicationType=COMMUNICATION_INTERFACE
            PduRSrcPdu_699953c0 (PduRSrcPdu):
              PduRSourcePduHandleId = 41
              PduRSrcPduDirection = TRANSMIT
              PduRSrcPduRef = VCU_MCU_03_oATOM_CAN_Matrix_PT_V600_20250211_32c07338_Tx
              PduRSrcPduPduRBswModulesRef = Com
            VCU_MCU_03_oATOM_CAN_Matrix_PT_V600_20250211_f9e6048f_Tx (PduRDestPdu):
              PduRDestPduHandleId = 33
              PduRDestPduDirection = TRANSMIT
              PduRDestPduRoutingType = API_FORWARDING
              PduRDestPduDataProcessing = IMMEDIATE
              PduRPduLengthHandlingStrategy = IGNORE
              PduRDestPduCrossPartitionDestination = false
              PduRTransmissionConfirmation = true
              PduRDestPduDataProvision = PDUR_DIRECT
              PduRDestPduRef = VCU_MCU_03_oATOM_CAN_Matrix_PT_V600_20250211_f9e6048f_Tx
              PduRDestPduPduRBswModulesRef = CanIf
          APTC_TCU_oATOM_CAN_Matrix_PT_V600_20250211_e759f28b_Rx: PduRRoutingPathCommunicationType=COMMUNICATION_INTERFACE
            APTC_TCU_oATOM_CAN_Matrix_PT_V600_20250211_e759f28b_Rx_993d8e8a_Rx (PduRDestPdu):
              PduRDestPduHandleId = 8
              PduRDestPduDirection = RECEIVE
              PduRDestPduRoutingType = API_FORWARDING
              PduRDestPduDataProcessing = IMMEDIATE
              PduRPduLengthHandlingStrategy = IGNORE
              PduRDestPduCrossPartitionDestination = false
              PduRTransmissionConfirmation = false
              PduRDestPduRef = APTC_TCU_oATOM_CAN_Matrix_PT_V600_20250211_f53cb06f_Rx
              PduRDestPduPduRBswModulesRef = Com
            PduRSrcPdu_993d8e8a (PduRSrcPdu):
              PduRSourcePduHandleId = 8
              PduRSrcPduDirection = RECEIVE
              PduRSrcPduRef = APTC_TCU_oATOM_CAN_Matrix_PT_V600_20250211_e759f28b_Rx
              PduRSrcPduPduRBswModulesRef = CanIf
          POD_OBC_STATUS_04_oATOM_CAN_Matrix_PT_V600_20250211_c02c654c_Rx: PduRRoutingPathCommunicationType=COMMUNICATION_INTERFACE
            POD_OBC_STATUS_04_oATOM_CAN_Matrix_PT_V600_20250211_c02c654c_Rx_2e10d998_Rx (PduRDestPdu):
              PduRDestPduHandleId = 83
              PduRDestPduDirection = RECEIVE
              PduRDestPduRoutingType = API_FORWARDING
              PduRDestPduDataProcessing = IMMEDIATE
              PduRPduLengthHandlingStrategy = IGNORE
              PduRDestPduCrossPartitionDestination = false
              PduRTransmissionConfirmation = false
              PduRDestPduRef = POD_OBC_STATUS_04_oATOM_CAN_Matrix_PT_V600_20250211_9171b8f6_Rx
              PduRDestPduPduRBswModulesRef = Com
            PduRSrcPdu_2e10d998 (PduRSrcPdu):
              PduRSourcePduHandleId = 83
              PduRSrcPduDirection = RECEIVE
              PduRSrcPduRef = POD_OBC_STATUS_04_oATOM_CAN_Matrix_PT_V600_20250211_c02c654c_Rx
              PduRSrcPduPduRBswModulesRef = CanIf
          EVCOM_State_01_oATOM_CAN_Matrix_PT_V600_20250211_14a0a5cc_Rx: PduRRoutingPathCommunicationType=COMMUNICATION_INTERFACE
            PduRSrcPdu_fcbdca80 (PduRSrcPdu):
              PduRSourcePduHandleId = 49
              PduRSrcPduDirection = RECEIVE
              PduRSrcPduRef = EVCOM_State_01_oATOM_CAN_Matrix_PT_V600_20250211_14a0a5cc_Rx
              PduRSrcPduPduRBswModulesRef = CanIf
            EVCOM_State_01_oATOM_CAN_Matrix_PT_V600_20250211_14a0a5cc_Rx_fcbdca80_Rx (PduRDestPdu):
              PduRDestPduHandleId = 49
              PduRDestPduDirection = RECEIVE
              PduRDestPduRoutingType = API_FORWARDING
              PduRDestPduDataProcessing = IMMEDIATE
              PduRPduLengthHandlingStrategy = IGNORE
              PduRDestPduCrossPartitionDestination = false
              PduRTransmissionConfirmation = false
              PduRDestPduRef = EVCOM_State_01_oATOM_CAN_Matrix_PT_V600_20250211_58e3b562_Rx
              PduRDestPduPduRBswModulesRef = Com
          BMS_VersionInfor_oATOM_CAN_Matrix_PT_V600_20250211_a6395240_Rx: PduRRoutingPathCommunicationType=COMMUNICATION_INTERFACE
            BMS_VersionInfor_oATOM_CAN_Matrix_PT_V600_20250211_a6395240_Rx_334e1a89_Rx (PduRDestPdu):
              PduRDestPduHandleId = 25
              PduRDestPduDirection = RECEIVE
              PduRDestPduRoutingType = API_FORWARDING
              PduRDestPduDataProcessing = IMMEDIATE
              PduRPduLengthHandlingStrategy = IGNORE
              PduRDestPduCrossPartitionDestination = false
              PduRTransmissionConfirmation = false
              PduRDestPduRef = BMS_VersionInfor_oATOM_CAN_Matrix_PT_V600_20250211_8287fedd_Rx
              PduRDestPduPduRBswModulesRef = Com
            PduRSrcPdu_334e1a89 (PduRSrcPdu):
              PduRSourcePduHandleId = 25
              PduRSrcPduDirection = RECEIVE
              PduRSrcPduRef = BMS_VersionInfor_oATOM_CAN_Matrix_PT_V600_20250211_a6395240_Rx
              PduRSrcPduPduRBswModulesRef = CanIf
          POD_Status_01_oATOM_CAN_Matrix_PT_V600_20250211_e70d1cd3_Rx: PduRRoutingPathCommunicationType=COMMUNICATION_INTERFACE
            PduRSrcPdu_6a4f8110 (PduRSrcPdu):
              PduRSourcePduHandleId = 84
              PduRSrcPduDirection = RECEIVE
              PduRSrcPduRef = POD_Status_01_oATOM_CAN_Matrix_PT_V600_20250211_e70d1cd3_Rx
              PduRSrcPduPduRBswModulesRef = CanIf
            POD_Status_01_oATOM_CAN_Matrix_PT_V600_20250211_e70d1cd3_Rx_6a4f8110_Rx (PduRDestPdu):
              PduRDestPduHandleId = 84
              PduRDestPduDirection = RECEIVE
              PduRDestPduRoutingType = API_FORWARDING
              PduRDestPduDataProcessing = IMMEDIATE
              PduRPduLengthHandlingStrategy = IGNORE
              PduRDestPduCrossPartitionDestination = false
              PduRTransmissionConfirmation = false
              PduRDestPduRef = POD_Status_01_oATOM_CAN_Matrix_PT_V600_20250211_ccbeaeb3_Rx
              PduRDestPduPduRBswModulesRef = Com
          VCU_MCU_02_oATOM_CAN_Matrix_PT_V600_20250211_fd5e64f0_Tx: PduRRoutingPathCommunicationType=COMMUNICATION_INTERFACE
            VCU_MCU_02_oATOM_CAN_Matrix_PT_V600_20250211_38095b95_Tx (PduRDestPdu):
              PduRDestPduHandleId = 31
              PduRDestPduDirection = TRANSMIT
              PduRDestPduRoutingType = API_FORWARDING
              PduRDestPduDataProcessing = IMMEDIATE
              PduRPduLengthHandlingStrategy = IGNORE
              PduRDestPduCrossPartitionDestination = false
              PduRTransmissionConfirmation = true
              PduRDestPduDataProvision = PDUR_DIRECT
              PduRDestPduRef = VCU_MCU_02_oATOM_CAN_Matrix_PT_V600_20250211_38095b95_Tx
              PduRDestPduPduRBswModulesRef = CanIf
            PduRSrcPdu_2fb849ca (PduRSrcPdu):
              PduRSourcePduHandleId = 39
              PduRSrcPduDirection = TRANSMIT
              PduRSrcPduRef = VCU_MCU_02_oATOM_CAN_Matrix_PT_V600_20250211_fd5e64f0_Tx
              PduRSrcPduPduRBswModulesRef = Com
          CGW_02_oATOM_CAN_Matrix_PT_V600_20250211_f2411e65_Rx: PduRRoutingPathCommunicationType=COMMUNICATION_INTERFACE
            PduRSrcPdu_47d97d6b (PduRSrcPdu):
              PduRSourcePduHandleId = 33
              PduRSrcPduDirection = RECEIVE
              PduRSrcPduRef = CGW_02_oATOM_CAN_Matrix_PT_V600_20250211_f2411e65_Rx
              PduRSrcPduPduRBswModulesRef = CanIf
            CGW_02_oATOM_CAN_Matrix_PT_V600_20250211_f2411e65_Rx_47d97d6b_Rx (PduRDestPdu):
              PduRDestPduHandleId = 33
              PduRDestPduDirection = RECEIVE
              PduRDestPduRoutingType = API_FORWARDING
              PduRDestPduDataProcessing = IMMEDIATE
              PduRPduLengthHandlingStrategy = IGNORE
              PduRDestPduCrossPartitionDestination = false
              PduRTransmissionConfirmation = false
              PduRDestPduRef = CGW_02_oATOM_CAN_Matrix_PT_V600_20250211_82f0b9a6_Rx
              PduRDestPduPduRBswModulesRef = Com
          DiagResp_VCU_oATOM_CAN_Matrix_PT_V600_20250211_6bab0738_Tx: PduRRoutingPathCommunicationType=TRANSPORT_PROTOCOL
            PduRSrcPdu_d836fcb2 (PduRSrcPdu):
              PduRSourcePduHandleId = 14
              PduRSrcPduDirection = TRANSMIT
              PduRSrcPduRef = DiagResp_VCU_oATOM_CAN_Matrix_PT_V600_20250211_6bab0738_Tx
              PduRSrcPduPduRBswModulesRef = Dcm
            DiagResp_VCU_oATOM_CAN_Matrix_PT_V600_20250211_1dcc985c_Tx (PduRDestPdu):
              PduRDestPduHandleId = 7
              PduRDestPduDirection = TRANSMIT
              PduRDestPduRoutingType = API_FORWARDING
              PduRDestPduDataProcessing = IMMEDIATE
              PduRPduLengthHandlingStrategy = UNUSED
              PduRDestPduCrossPartitionDestination = false
              PduRDestPduRef = DiagResp_VCU_oATOM_CAN_Matrix_PT_V600_20250211_1dcc985c_Tx
              PduRDestPduPduRBswModulesRef = CanTp
          SGW_16_oATOM_CAN_Matrix_PT_V600_20250211_9eb85431_Rx: PduRRoutingPathCommunicationType=COMMUNICATION_INTERFACE
            PduRSrcPdu_f4111595 (PduRSrcPdu):
              PduRSourcePduHandleId = 89
              PduRSrcPduDirection = RECEIVE
              PduRSrcPduRef = SGW_16_oATOM_CAN_Matrix_PT_V600_20250211_9eb85431_Rx
              PduRSrcPduPduRBswModulesRef = CanIf
            SGW_16_oATOM_CAN_Matrix_PT_V600_20250211_9eb85431_Rx_f4111595_Rx (PduRDestPdu):
              PduRDestPduHandleId = 89
              PduRDestPduDirection = RECEIVE
              PduRDestPduRoutingType = API_FORWARDING
              PduRDestPduDataProcessing = IMMEDIATE
              PduRPduLengthHandlingStrategy = IGNORE
              PduRDestPduCrossPartitionDestination = false
              PduRTransmissionConfirmation = false
              PduRDestPduRef = SGW_16_oATOM_CAN_Matrix_PT_V600_20250211_6bfd3d6f_Rx
              PduRDestPduPduRBswModulesRef = Com
          IBS_Status_05_oATOM_CAN_Matrix_PT_V600_20250211_7868db81_Rx: PduRRoutingPathCommunicationType=COMMUNICATION_INTERFACE
            PduRSrcPdu_75f9cd0c (PduRSrcPdu):
              PduRSourcePduHandleId = 61
              PduRSrcPduDirection = RECEIVE
              PduRSrcPduRef = IBS_Status_05_oATOM_CAN_Matrix_PT_V600_20250211_7868db81_Rx
              PduRSrcPduPduRBswModulesRef = CanIf
            IBS_Status_05_oATOM_CAN_Matrix_PT_V600_20250211_7868db81_Rx_75f9cd0c_Rx (PduRDestPdu):
              PduRDestPduHandleId = 61
              PduRDestPduDirection = RECEIVE
              PduRDestPduRoutingType = API_FORWARDING
              PduRDestPduDataProcessing = IMMEDIATE
              PduRPduLengthHandlingStrategy = IGNORE
              PduRDestPduCrossPartitionDestination = false
              PduRTransmissionConfirmation = false
              PduRDestPduRef = IBS_Status_05_oATOM_CAN_Matrix_PT_V600_20250211_07ae5d67_Rx
              PduRDestPduPduRBswModulesRef = Com
          BMS_CellTemp_oATOM_CAN_Matrix_PT_V600_20250211_253e5592_Rx: PduRRoutingPathCommunicationType=COMMUNICATION_INTERFACE
            PduRSrcPdu_4ed79f7d (PduRSrcPdu):
              PduRSourcePduHandleId = 16
              PduRSrcPduDirection = RECEIVE
              PduRSrcPduRef = BMS_CellTemp_oATOM_CAN_Matrix_PT_V600_20250211_253e5592_Rx
              PduRSrcPduPduRBswModulesRef = CanIf
            BMS_CellTemp_oATOM_CAN_Matrix_PT_V600_20250211_253e5592_Rx_4ed79f7d_Rx (PduRDestPdu):
              PduRDestPduHandleId = 16
              PduRDestPduDirection = RECEIVE
              PduRDestPduRoutingType = API_FORWARDING
              PduRDestPduDataProcessing = IMMEDIATE
              PduRPduLengthHandlingStrategy = IGNORE
              PduRDestPduCrossPartitionDestination = false
              PduRTransmissionConfirmation = false
              PduRDestPduRef = BMS_CellTemp_oATOM_CAN_Matrix_PT_V600_20250211_fd2a47f3_Rx
              PduRDestPduPduRBswModulesRef = Com
          BMS_CellVoltage_oATOM_CAN_Matrix_PT_V600_20250211_49a2ff30_Rx: PduRRoutingPathCommunicationType=COMMUNICATION_INTERFACE
            PduRSrcPdu_e3bed30b (PduRSrcPdu):
              PduRSourcePduHandleId = 17
              PduRSrcPduDirection = RECEIVE
              PduRSrcPduRef = BMS_CellVoltage_oATOM_CAN_Matrix_PT_V600_20250211_49a2ff30_Rx
              PduRSrcPduPduRBswModulesRef = CanIf
            BMS_CellVoltage_oATOM_CAN_Matrix_PT_V600_20250211_49a2ff30_Rx_e3bed30b_Rx (PduRDestPdu):
              PduRDestPduHandleId = 17
              PduRDestPduDirection = RECEIVE
              PduRDestPduRoutingType = API_FORWARDING
              PduRDestPduDataProcessing = IMMEDIATE
              PduRPduLengthHandlingStrategy = IGNORE
              PduRDestPduCrossPartitionDestination = false
              PduRTransmissionConfirmation = false
              PduRDestPduRef = BMS_CellVoltage_oATOM_CAN_Matrix_PT_V600_20250211_61ce11e6_Rx
              PduRDestPduPduRBswModulesRef = Com
          IVI_01_oATOM_CAN_Matrix_PT_V600_20250211_6884d46d_Rx: PduRRoutingPathCommunicationType=COMMUNICATION_INTERFACE
            IVI_01_oATOM_CAN_Matrix_PT_V600_20250211_6884d46d_Rx_768473b3_Rx (PduRDestPdu):
              PduRDestPduHandleId = 67
              PduRDestPduDirection = RECEIVE
              PduRDestPduRoutingType = API_FORWARDING
              PduRDestPduDataProcessing = IMMEDIATE
              PduRPduLengthHandlingStrategy = IGNORE
              PduRDestPduCrossPartitionDestination = false
              PduRTransmissionConfirmation = false
              PduRDestPduRef = IVI_01_oATOM_CAN_Matrix_PT_V600_20250211_12948905_Rx
              PduRDestPduPduRBswModulesRef = Com
            PduRSrcPdu_768473b3 (PduRSrcPdu):
              PduRSourcePduHandleId = 67
              PduRSrcPduDirection = RECEIVE
              PduRSrcPduRef = IVI_01_oATOM_CAN_Matrix_PT_V600_20250211_6884d46d_Rx
              PduRSrcPduPduRBswModulesRef = CanIf
          DCM_FR_02_oATOM_CAN_Matrix_PT_V600_20250211_519d17ad_Rx: PduRRoutingPathCommunicationType=COMMUNICATION_INTERFACE
            DCM_FR_02_oATOM_CAN_Matrix_PT_V600_20250211_519d17ad_Rx_3867459e_Rx (PduRDestPdu):
              PduRDestPduHandleId = 45
              PduRDestPduDirection = RECEIVE
              PduRDestPduRoutingType = API_FORWARDING
              PduRDestPduDataProcessing = IMMEDIATE
              PduRPduLengthHandlingStrategy = IGNORE
              PduRDestPduCrossPartitionDestination = false
              PduRTransmissionConfirmation = false
              PduRDestPduRef = DCM_FR_02_oATOM_CAN_Matrix_PT_V600_20250211_98d3bd3c_Rx
              PduRDestPduPduRBswModulesRef = Com
            PduRSrcPdu_3867459e (PduRSrcPdu):
              PduRSourcePduHandleId = 45
              PduRSrcPduDirection = RECEIVE
              PduRSrcPduRef = DCM_FR_02_oATOM_CAN_Matrix_PT_V600_20250211_519d17ad_Rx
              PduRSrcPduPduRBswModulesRef = CanIf
          POD_OBC_STATUS_03_oATOM_CAN_Matrix_PT_V600_20250211_e833f2c9_Rx: PduRRoutingPathCommunicationType=COMMUNICATION_INTERFACE
            PduRSrcPdu_4262a7c2 (PduRSrcPdu):
              PduRSourcePduHandleId = 82
              PduRSrcPduDirection = RECEIVE
              PduRSrcPduRef = POD_OBC_STATUS_03_oATOM_CAN_Matrix_PT_V600_20250211_e833f2c9_Rx
              PduRSrcPduPduRBswModulesRef = CanIf
            POD_OBC_STATUS_03_oATOM_CAN_Matrix_PT_V600_20250211_e833f2c9_Rx_4262a7c2_Rx (PduRDestPdu):
              PduRDestPduHandleId = 82
              PduRDestPduDirection = RECEIVE
              PduRDestPduRoutingType = API_FORWARDING
              PduRDestPduDataProcessing = IMMEDIATE
              PduRPduLengthHandlingStrategy = IGNORE
              PduRDestPduCrossPartitionDestination = false
              PduRTransmissionConfirmation = false
              PduRDestPduRef = POD_OBC_STATUS_03_oATOM_CAN_Matrix_PT_V600_20250211_9238d54d_Rx
              PduRDestPduPduRBswModulesRef = Com
          BMS_BatInfor_01_oATOM_CAN_Matrix_PT_V600_20250211_95ec7fc6_Rx: PduRRoutingPathCommunicationType=COMMUNICATION_INTERFACE
            BMS_BatInfor_01_oATOM_CAN_Matrix_PT_V600_20250211_95ec7fc6_Rx_3881d9ad_Rx (PduRDestPdu):
              PduRDestPduHandleId = 13
              PduRDestPduDirection = RECEIVE
              PduRDestPduRoutingType = API_FORWARDING
              PduRDestPduDataProcessing = IMMEDIATE
              PduRPduLengthHandlingStrategy = IGNORE
              PduRDestPduCrossPartitionDestination = false
              PduRTransmissionConfirmation = false
              PduRDestPduRef = BMS_BatInfor_01_oATOM_CAN_Matrix_PT_V600_20250211_c71479d5_Rx
              PduRDestPduPduRBswModulesRef = Com
            PduRSrcPdu_3881d9ad (PduRSrcPdu):
              PduRSourcePduHandleId = 13
              PduRSrcPduDirection = RECEIVE
              PduRSrcPduRef = BMS_BatInfor_01_oATOM_CAN_Matrix_PT_V600_20250211_95ec7fc6_Rx
              PduRSrcPduPduRBswModulesRef = CanIf
          SGW_IBS_01_oATOM_CAN_Matrix_PT_V600_20250211_10cb64fa_Rx: PduRRoutingPathCommunicationType=COMMUNICATION_INTERFACE
            SGW_IBS_01_oATOM_CAN_Matrix_PT_V600_20250211_10cb64fa_Rx_a393dab1_Rx (PduRDestPdu):
              PduRDestPduHandleId = 92
              PduRDestPduDirection = RECEIVE
              PduRDestPduRoutingType = API_FORWARDING
              PduRDestPduDataProcessing = IMMEDIATE
              PduRPduLengthHandlingStrategy = IGNORE
              PduRDestPduCrossPartitionDestination = false
              PduRTransmissionConfirmation = false
              PduRDestPduRef = SGW_IBS_01_oATOM_CAN_Matrix_PT_V600_20250211_afe1198b_Rx
              PduRDestPduPduRBswModulesRef = Com
            PduRSrcPdu_a393dab1 (PduRSrcPdu):
              PduRSourcePduHandleId = 92
              PduRSrcPduDirection = RECEIVE
              PduRSrcPduRef = SGW_IBS_01_oATOM_CAN_Matrix_PT_V600_20250211_10cb64fa_Rx
              PduRSrcPduPduRBswModulesRef = CanIf
          DiagReq_PT_oATOM_CAN_Matrix_PT_V600_20250211_c86f8199_Rx: PduRRoutingPathCommunicationType=TRANSPORT_PROTOCOL
            PduRSrcPdu_d73377b4 (PduRSrcPdu):
              PduRSourcePduHandleId = 3
              PduRSrcPduDirection = RECEIVE
              PduRSrcPduRef = DiagReq_PT_oATOM_CAN_Matrix_PT_V600_20250211_c86f8199_Rx
              PduRSrcPduPduRBswModulesRef = CanTp
            DiagReq_PT_oATOM_CAN_Matrix_PT_V600_20250211_c86f8199_Rx_d73377b4_Rx (PduRDestPdu):
              PduRDestPduHandleId = 3
              PduRDestPduDirection = RECEIVE
              PduRDestPduRoutingType = API_FORWARDING
              PduRDestPduDataProcessing = IMMEDIATE
              PduRPduLengthHandlingStrategy = UNUSED
              PduRDestPduCrossPartitionDestination = false
              PduRDestPduRef = DiagReq_PT_oATOM_CAN_Matrix_PT_V600_20250211_35bae364_Rx
              PduRDestPduPduRBswModulesRef = Dcm
          VCU_HMIsignals_03_oATOM_CAN_Matrix_PT_V600_20250211_898acf8c_Tx: PduRRoutingPathCommunicationType=COMMUNICATION_INTERFACE
            PduRSrcPdu_d01c6afd (PduRSrcPdu):
              PduRSourcePduHandleId = 37
              PduRSrcPduDirection = TRANSMIT
              PduRSrcPduRef = VCU_HMIsignals_03_oATOM_CAN_Matrix_PT_V600_20250211_898acf8c_Tx
              PduRSrcPduPduRBswModulesRef = Com
            VCU_HMIsignals_03_oATOM_CAN_Matrix_PT_V600_20250211_901dd9e6_Tx (PduRDestPdu):
              PduRDestPduHandleId = 29
              PduRDestPduDirection = TRANSMIT
              PduRDestPduRoutingType = API_FORWARDING
              PduRDestPduDataProcessing = IMMEDIATE
              PduRPduLengthHandlingStrategy = IGNORE
              PduRDestPduCrossPartitionDestination = false
              PduRDestPduDataProvision = PDUR_DIRECT
              PduRTransmissionConfirmation = true
              PduRDestPduRef = VCU_HMIsignals_03_oATOM_CAN_Matrix_PT_V600_20250211_901dd9e6_Tx
              PduRDestPduPduRBswModulesRef = CanIf
          BMS_DIRelayState_oATOM_CAN_Matrix_PT_V600_20250211_64866c1e_Rx: PduRRoutingPathCommunicationType=COMMUNICATION_INTERFACE
            BMS_DIRelayState_oATOM_CAN_Matrix_PT_V600_20250211_64866c1e_Rx_b34f4ed8_Rx (PduRDestPdu):
              PduRDestPduHandleId = 21
              PduRDestPduDirection = RECEIVE
              PduRDestPduRoutingType = API_FORWARDING
              PduRDestPduDataProcessing = IMMEDIATE
              PduRPduLengthHandlingStrategy = IGNORE
              PduRDestPduCrossPartitionDestination = false
              PduRTransmissionConfirmation = false
              PduRDestPduRef = BMS_DIRelayState_oATOM_CAN_Matrix_PT_V600_20250211_48edebca_Rx
              PduRDestPduPduRBswModulesRef = Com
            PduRSrcPdu_b34f4ed8 (PduRSrcPdu):
              PduRSourcePduHandleId = 21
              PduRSrcPduDirection = RECEIVE
              PduRSrcPduRef = BMS_DIRelayState_oATOM_CAN_Matrix_PT_V600_20250211_64866c1e_Rx
              PduRSrcPduPduRBswModulesRef = CanIf
          CGW_VIN1_oATOM_CAN_Matrix_PT_V600_20250211_a569c65a_Rx: PduRRoutingPathCommunicationType=COMMUNICATION_INTERFACE
            PduRSrcPdu_1c3803b9 (PduRSrcPdu):
              PduRSourcePduHandleId = 34
              PduRSrcPduDirection = RECEIVE
              PduRSrcPduRef = CGW_VIN1_oATOM_CAN_Matrix_PT_V600_20250211_a569c65a_Rx
              PduRSrcPduPduRBswModulesRef = CanIf
            CGW_VIN1_oATOM_CAN_Matrix_PT_V600_20250211_a569c65a_Rx_1c3803b9_Rx (PduRDestPdu):
              PduRDestPduHandleId = 34
              PduRDestPduDirection = RECEIVE
              PduRDestPduRoutingType = API_FORWARDING
              PduRDestPduDataProcessing = IMMEDIATE
              PduRPduLengthHandlingStrategy = IGNORE
              PduRDestPduCrossPartitionDestination = false
              PduRTransmissionConfirmation = false
              PduRDestPduRef = CGW_VIN1_oATOM_CAN_Matrix_PT_V600_20250211_661858dc_Rx
              PduRDestPduPduRBswModulesRef = Com
          TCU_01_oATOM_CAN_Matrix_PT_V600_20250211_0c8b422e_Rx: PduRRoutingPathCommunicationType=COMMUNICATION_INTERFACE
            TCU_01_oATOM_CAN_Matrix_PT_V600_20250211_0c8b422e_Rx_db4bf9f4_Rx (PduRDestPdu):
              PduRDestPduHandleId = 97
              PduRDestPduDirection = RECEIVE
              PduRDestPduRoutingType = API_FORWARDING
              PduRDestPduDataProcessing = IMMEDIATE
              PduRPduLengthHandlingStrategy = IGNORE
              PduRDestPduCrossPartitionDestination = false
              PduRTransmissionConfirmation = false
              PduRDestPduRef = TCU_01_oATOM_CAN_Matrix_PT_V600_20250211_26cca276_Rx
              PduRDestPduPduRBswModulesRef = Com
            PduRSrcPdu_db4bf9f4 (PduRSrcPdu):
              PduRSourcePduHandleId = 97
              PduRSrcPduDirection = RECEIVE
              PduRSrcPduRef = TCU_01_oATOM_CAN_Matrix_PT_V600_20250211_0c8b422e_Rx
              PduRSrcPduPduRBswModulesRef = CanIf
          VCU_HMIsignals_02_oATOM_CAN_Matrix_PT_V600_20250211_4614d844_Tx: PduRRoutingPathCommunicationType=COMMUNICATION_INTERFACE
            PduRSrcPdu_93186e38 (PduRSrcPdu):
              PduRSourcePduHandleId = 36
              PduRSrcPduDirection = TRANSMIT
              PduRSrcPduRef = VCU_HMIsignals_02_oATOM_CAN_Matrix_PT_V600_20250211_4614d844_Tx
              PduRSrcPduPduRBswModulesRef = Com
            VCU_HMIsignals_02_oATOM_CAN_Matrix_PT_V600_20250211_51f286fc_Tx (PduRDestPdu):
              PduRDestPduHandleId = 28
              PduRDestPduDirection = TRANSMIT
              PduRDestPduRoutingType = API_FORWARDING
              PduRDestPduDataProcessing = IMMEDIATE
              PduRPduLengthHandlingStrategy = IGNORE
              PduRDestPduCrossPartitionDestination = false
              PduRDestPduDataProvision = PDUR_DIRECT
              PduRTransmissionConfirmation = true
              PduRDestPduRef = VCU_HMIsignals_02_oATOM_CAN_Matrix_PT_V600_20250211_51f286fc_Tx
              PduRDestPduPduRBswModulesRef = CanIf
          POD_OBC_CHRGSTATION_oATOM_CAN_Matrix_PT_V600_20250211_df8ecd71_Rx: PduRRoutingPathCommunicationType=COMMUNICATION_INTERFACE
            PduRSrcPdu_55bb8b3e (PduRSrcPdu):
              PduRSourcePduHandleId = 80
              PduRSrcPduDirection = RECEIVE
              PduRSrcPduRef = POD_OBC_CHRGSTATION_oATOM_CAN_Matrix_PT_V600_20250211_df8ecd71_Rx
              PduRSrcPduPduRBswModulesRef = CanIf
            POD_OBC_CHRGSTATION_oATOM_CAN_Matrix_PT_V600_20250211_df8ecd71_Rx_55bb8b3e_Rx (PduRDestPdu):
              PduRDestPduHandleId = 80
              PduRDestPduDirection = RECEIVE
              PduRDestPduRoutingType = API_FORWARDING
              PduRDestPduDataProcessing = IMMEDIATE
              PduRPduLengthHandlingStrategy = IGNORE
              PduRDestPduCrossPartitionDestination = false
              PduRTransmissionConfirmation = false
              PduRDestPduRef = POD_OBC_CHRGSTATION_oATOM_CAN_Matrix_PT_V600_20250211_9a75b36b_Rx
              PduRDestPduPduRBswModulesRef = Com
          BMS_Charge_02_oATOM_CAN_Matrix_PT_V600_20250211_e805441b_Rx: PduRRoutingPathCommunicationType=COMMUNICATION_INTERFACE
            PduRSrcPdu_2f5b0f93 (PduRSrcPdu):
              PduRSourcePduHandleId = 19
              PduRSrcPduDirection = RECEIVE
              PduRSrcPduRef = BMS_Charge_02_oATOM_CAN_Matrix_PT_V600_20250211_e805441b_Rx
              PduRSrcPduPduRBswModulesRef = CanIf
            BMS_Charge_02_oATOM_CAN_Matrix_PT_V600_20250211_e805441b_Rx_2f5b0f93_Rx (PduRDestPdu):
              PduRDestPduHandleId = 19
              PduRDestPduDirection = RECEIVE
              PduRDestPduRoutingType = API_FORWARDING
              PduRDestPduDataProcessing = IMMEDIATE
              PduRPduLengthHandlingStrategy = IGNORE
              PduRDestPduCrossPartitionDestination = false
              PduRTransmissionConfirmation = false
              PduRDestPduRef = BMS_Charge_02_oATOM_CAN_Matrix_PT_V600_20250211_229b7a18_Rx
              PduRDestPduPduRBswModulesRef = Com
          BMS_BatInfor_02_oATOM_CAN_Matrix_PT_V600_20250211_0cac98a9_Rx: PduRRoutingPathCommunicationType=COMMUNICATION_INTERFACE
            PduRSrcPdu_55b90c68 (PduRSrcPdu):
              PduRSourcePduHandleId = 14
              PduRSrcPduDirection = RECEIVE
              PduRSrcPduRef = BMS_BatInfor_02_oATOM_CAN_Matrix_PT_V600_20250211_0cac98a9_Rx
              PduRSrcPduPduRBswModulesRef = CanIf
            BMS_BatInfor_02_oATOM_CAN_Matrix_PT_V600_20250211_0cac98a9_Rx_55b90c68_Rx (PduRDestPdu):
              PduRDestPduHandleId = 14
              PduRDestPduDirection = RECEIVE
              PduRDestPduRoutingType = API_FORWARDING
              PduRDestPduDataProcessing = IMMEDIATE
              PduRPduLengthHandlingStrategy = IGNORE
              PduRDestPduCrossPartitionDestination = false
              PduRTransmissionConfirmation = false
              PduRDestPduRef = BMS_BatInfor_02_oATOM_CAN_Matrix_PT_V600_20250211_4cc747cc_Rx
              PduRDestPduPduRBswModulesRef = Com
          VCU_DiagInfor_oATOM_CAN_Matrix_PT_V600_20250211_ad82eb28_Tx: PduRRoutingPathCommunicationType=COMMUNICATION_INTERFACE
            VCU_DiagInfor_oATOM_CAN_Matrix_PT_V600_20250211_99a29031_Tx (PduRDestPdu):
              PduRDestPduHandleId = 23
              PduRDestPduDirection = TRANSMIT
              PduRDestPduRoutingType = API_FORWARDING
              PduRDestPduDataProcessing = IMMEDIATE
              PduRPduLengthHandlingStrategy = IGNORE
              PduRDestPduCrossPartitionDestination = false
              PduRDestPduDataProvision = PDUR_DIRECT
              PduRTransmissionConfirmation = true
              PduRDestPduRef = VCU_DiagInfor_oATOM_CAN_Matrix_PT_V600_20250211_99a29031_Tx
              PduRDestPduPduRBswModulesRef = CanIf
            PduRSrcPdu_096ff783 (PduRSrcPdu):
              PduRSourcePduHandleId = 31
              PduRSrcPduDirection = TRANSMIT
              PduRSrcPduRef = VCU_DiagInfor_oATOM_CAN_Matrix_PT_V600_20250211_ad82eb28_Tx
              PduRSrcPduPduRBswModulesRef = Com
          SGW_04_oATOM_CAN_Matrix_PT_V600_20250211_3bb4fa61_Rx: PduRRoutingPathCommunicationType=COMMUNICATION_INTERFACE
            SGW_04_oATOM_CAN_Matrix_PT_V600_20250211_3bb4fa61_Rx_ca105c2f_Rx (PduRDestPdu):
              PduRDestPduHandleId = 88
              PduRDestPduDirection = RECEIVE
              PduRDestPduRoutingType = API_FORWARDING
              PduRDestPduDataProcessing = IMMEDIATE
              PduRPduLengthHandlingStrategy = IGNORE
              PduRDestPduCrossPartitionDestination = false
              PduRTransmissionConfirmation = false
              PduRDestPduRef = SGW_04_oATOM_CAN_Matrix_PT_V600_20250211_bac0c02b_Rx
              PduRDestPduPduRBswModulesRef = Com
            PduRSrcPdu_ca105c2f (PduRSrcPdu):
              PduRSourcePduHandleId = 88
              PduRSrcPduDirection = RECEIVE
              PduRSrcPduRef = SGW_04_oATOM_CAN_Matrix_PT_V600_20250211_3bb4fa61_Rx
              PduRSrcPduPduRBswModulesRef = CanIf
          DiagReq_FUN_oATOM_CAN_Matrix_PT_V600_20250211_f00b311f_Rx: PduRRoutingPathCommunicationType=TRANSPORT_PROTOCOL
            DiagReq_FUN_oATOM_CAN_Matrix_PT_V600_20250211_f00b311f_Rx_f4a18b15_Rx (PduRDestPdu):
              PduRDestPduHandleId = 1
              PduRDestPduDirection = RECEIVE
              PduRDestPduRoutingType = API_FORWARDING
              PduRDestPduDataProcessing = IMMEDIATE
              PduRPduLengthHandlingStrategy = UNUSED
              PduRDestPduCrossPartitionDestination = false
              PduRDestPduRef = DiagReq_FUN_oATOM_CAN_Matrix_PT_V600_20250211_f8649eb7_Rx
              PduRDestPduPduRBswModulesRef = Dcm
            PduRSrcPdu_f4a18b15 (PduRSrcPdu):
              PduRSourcePduHandleId = 1
              PduRSrcPduDirection = RECEIVE
              PduRSrcPduRef = DiagReq_FUN_oATOM_CAN_Matrix_PT_V600_20250211_f00b311f_Rx
              PduRSrcPduPduRBswModulesRef = CanTp
          IVI_03_oATOM_CAN_Matrix_PT_V600_20250211_302b6c18_Rx: PduRRoutingPathCommunicationType=COMMUNICATION_INTERFACE
            PduRSrcPdu_56ab55cb (PduRSrcPdu):
              PduRSourcePduHandleId = 68
              PduRSrcPduDirection = RECEIVE
              PduRSrcPduRef = IVI_03_oATOM_CAN_Matrix_PT_V600_20250211_302b6c18_Rx
              PduRSrcPduPduRBswModulesRef = CanIf
            IVI_03_oATOM_CAN_Matrix_PT_V600_20250211_302b6c18_Rx_56ab55cb_Rx (PduRDestPdu):
              PduRDestPduHandleId = 68
              PduRDestPduDirection = RECEIVE
              PduRDestPduRoutingType = API_FORWARDING
              PduRDestPduDataProcessing = IMMEDIATE
              PduRPduLengthHandlingStrategy = IGNORE
              PduRDestPduCrossPartitionDestination = false
              PduRTransmissionConfirmation = false
              PduRDestPduRef = IVI_03_oATOM_CAN_Matrix_PT_V600_20250211_56d9a0d4_Rx
              PduRDestPduPduRBswModulesRef = Com
          CGW_01_oATOM_CAN_Matrix_PT_V600_20250211_6b01f90a_Rx: PduRRoutingPathCommunicationType=COMMUNICATION_INTERFACE
            PduRSrcPdu_36051844 (PduRSrcPdu):
              PduRSourcePduHandleId = 32
              PduRSrcPduDirection = RECEIVE
              PduRSrcPduRef = CGW_01_oATOM_CAN_Matrix_PT_V600_20250211_6b01f90a_Rx
              PduRSrcPduPduRBswModulesRef = CanIf
            CGW_01_oATOM_CAN_Matrix_PT_V600_20250211_6b01f90a_Rx_36051844_Rx (PduRDestPdu):
              PduRDestPduHandleId = 32
              PduRDestPduDirection = RECEIVE
              PduRDestPduRoutingType = API_FORWARDING
              PduRDestPduDataProcessing = IMMEDIATE
              PduRPduLengthHandlingStrategy = IGNORE
              PduRDestPduCrossPartitionDestination = false
              PduRTransmissionConfirmation = false
              PduRDestPduRef = CGW_01_oATOM_CAN_Matrix_PT_V600_20250211_092387bf_Rx
              PduRDestPduPduRBswModulesRef = Com
          SGW_FVSynchronization_01_oATOM_CAN_Matrix_PT_V600_20250211_d9a61796_Rx: PduRRoutingPathCommunicationType=COMMUNICATION_INTERFACE
            SGW_FVSynchronization_01_oATOM_CAN_Matrix_PT_V600_20250211_d9a61796_Rx_160807d5_Rx (PduRDestPdu):
              PduRDestPduHandleId = 91
              PduRDestPduDirection = RECEIVE
              PduRDestPduRoutingType = API_FORWARDING
              PduRDestPduDataProcessing = IMMEDIATE
              PduRPduLengthHandlingStrategy = IGNORE
              PduRDestPduCrossPartitionDestination = false
              PduRTransmissionConfirmation = false
              PduRDestPduRef = SGW_FVSynchronization_01_oATOM_CAN_Matrix_PT_V600_20250211_640f878f_Rx
              PduRDestPduPduRBswModulesRef = Com
            PduRSrcPdu_160807d5 (PduRSrcPdu):
              PduRSourcePduHandleId = 91
              PduRSrcPduDirection = RECEIVE
              PduRSrcPduRef = SGW_FVSynchronization_01_oATOM_CAN_Matrix_PT_V600_20250211_d9a61796_Rx
              PduRSrcPduPduRBswModulesRef = CanIf
          MCU_Temperature_02_oATOM_CAN_Matrix_PT_V600_20250211_73569f60_Rx: PduRRoutingPathCommunicationType=COMMUNICATION_INTERFACE
            PduRSrcPdu_2d50859d (PduRSrcPdu):
              PduRSourcePduHandleId = 75
              PduRSrcPduDirection = RECEIVE
              PduRSrcPduRef = MCU_Temperature_02_oATOM_CAN_Matrix_PT_V600_20250211_73569f60_Rx
              PduRSrcPduPduRBswModulesRef = CanIf
            MCU_Temperature_02_oATOM_CAN_Matrix_PT_V600_20250211_73569f60_Rx_2d50859d_Rx (PduRDestPdu):
              PduRDestPduHandleId = 75
              PduRDestPduDirection = RECEIVE
              PduRDestPduRoutingType = API_FORWARDING
              PduRDestPduDataProcessing = IMMEDIATE
              PduRPduLengthHandlingStrategy = IGNORE
              PduRDestPduCrossPartitionDestination = false
              PduRTransmissionConfirmation = false
              PduRDestPduRef = MCU_Temperature_02_oATOM_CAN_Matrix_PT_V600_20250211_89cf23c7_Rx
              PduRDestPduPduRBswModulesRef = Com
          BMS_status_03_oATOM_CAN_Matrix_PT_V600_20250211_ae05e720_Rx: PduRRoutingPathCommunicationType=COMMUNICATION_INTERFACE
            BMS_status_03_oATOM_CAN_Matrix_PT_V600_20250211_ae05e720_Rx_2dd16f9f_Rx (PduRDestPdu):
              PduRDestPduHandleId = 28
              PduRDestPduDirection = RECEIVE
              PduRDestPduRoutingType = API_FORWARDING
              PduRDestPduDataProcessing = IMMEDIATE
              PduRPduLengthHandlingStrategy = IGNORE
              PduRDestPduCrossPartitionDestination = false
              PduRTransmissionConfirmation = false
              PduRDestPduRef = BMS_status_03_oATOM_CAN_Matrix_PT_V600_20250211_ee388b9e_Rx
              PduRDestPduPduRBswModulesRef = Com
            PduRSrcPdu_2dd16f9f (PduRSrcPdu):
              PduRSourcePduHandleId = 28
              PduRSrcPduDirection = RECEIVE
              PduRSrcPduRef = BMS_status_03_oATOM_CAN_Matrix_PT_V600_20250211_ae05e720_Rx
              PduRSrcPduPduRBswModulesRef = CanIf
          VcuCan12TxMsg1_oATOM_CAN_XCP_895c1d63_Tx: PduRRoutingPathCommunicationType=COMMUNICATION_INTERFACE
            VcuCan12TxMsg1_oATOM_CAN_XCP_4049029a_Tx (PduRDestPdu):
              PduRDestPduHandleId = 54
              PduRDestPduDirection = TRANSMIT
              PduRDestPduRoutingType = API_FORWARDING
              PduRDestPduDataProcessing = IMMEDIATE
              PduRPduLengthHandlingStrategy = IGNORE
              PduRDestPduCrossPartitionDestination = false
              PduRDestPduDataProvision = PDUR_DIRECT
              PduRTransmissionConfirmation = false
              PduRDestPduRef = VcuCan12TxMsg1_oATOM_CAN_XCP_4049029a_Tx
              PduRDestPduPduRBswModulesRef = CanIf
            PduRSrcPdu_38cf320f (PduRSrcPdu): PduRSourcePduHandleId=62, PduRSrcPduDirection=TRANSMIT, PduRSrcPduRef=VcuCan12TxMsg1_oATOM_CAN_XCP_895c1d63_Tx, PduRSrcPduPduRBswModulesRef=Com
          CSD_oJ1939_bms_579b3adb_Rx: PduRRoutingPathCommunicationType=COMMUNICATION_INTERFACE
            PduRSrcPdu_cdbf7751 (PduRSrcPdu): PduRSourcePduHandleId=41, PduRSrcPduDirection=RECEIVE, PduRSrcPduRef=CSD_oJ1939_bms_579b3adb_Rx, PduRSrcPduPduRBswModulesRef=CanIf
            CSD_oJ1939_bms_579b3adb_Rx_cdbf7751_Rx (PduRDestPdu):
              PduRDestPduHandleId = 41
              PduRDestPduDirection = RECEIVE
              PduRDestPduRoutingType = API_FORWARDING
              PduRDestPduDataProcessing = IMMEDIATE
              PduRPduLengthHandlingStrategy = IGNORE
              PduRDestPduCrossPartitionDestination = false
              PduRTransmissionConfirmation = false
              PduRDestPduRef = CSD_oJ1939_bms_caf47c5b_Rx
              PduRDestPduPduRBswModulesRef = Com
          BRO_oJ1939_bms_fbffe0a6_Tx: PduRRoutingPathCommunicationType=COMMUNICATION_INTERFACE
            PduRSrcPdu_cff815f6 (PduRSrcPdu): PduRSourcePduHandleId=8, PduRSrcPduDirection=TRANSMIT, PduRSrcPduRef=BRO_oJ1939_bms_fbffe0a6_Tx, PduRSrcPduPduRBswModulesRef=Com
            BRO_oJ1939_bms_f4a4d079_Tx (PduRDestPdu):
              PduRDestPduHandleId = 3
              PduRDestPduDirection = TRANSMIT
              PduRDestPduRoutingType = API_FORWARDING
              PduRDestPduDataProcessing = IMMEDIATE
              PduRPduLengthHandlingStrategy = IGNORE
              PduRDestPduCrossPartitionDestination = false
              PduRDestPduDataProvision = PDUR_DIRECT
              PduRTransmissionConfirmation = false
              PduRDestPduRef = BRO_oJ1939_bms_f4a4d079_Tx
              PduRDestPduPduRBswModulesRef = CanIf
          BHM_oJ1939_bms_999cbec5_Tx: PduRRoutingPathCommunicationType=COMMUNICATION_INTERFACE
            BHM_oJ1939_bms_2fe35673_Tx (PduRDestPdu):
              PduRDestPduHandleId = 2
              PduRDestPduDirection = TRANSMIT
              PduRDestPduRoutingType = API_FORWARDING
              PduRDestPduDataProcessing = IMMEDIATE
              PduRPduLengthHandlingStrategy = IGNORE
              PduRDestPduCrossPartitionDestination = false
              PduRDestPduDataProvision = PDUR_DIRECT
              PduRTransmissionConfirmation = false
              PduRDestPduRef = BHM_oJ1939_bms_2fe35673_Tx
              PduRDestPduPduRBswModulesRef = CanIf
            PduRSrcPdu_4c91c4a7 (PduRSrcPdu): PduRSourcePduHandleId=4, PduRSrcPduDirection=TRANSMIT, PduRSrcPduRef=BHM_oJ1939_bms_999cbec5_Tx, PduRSrcPduPduRBswModulesRef=Com
          BSM_oJ1939_bms_ca52a7bc_Tx: PduRRoutingPathCommunicationType=COMMUNICATION_INTERFACE
            PduRSrcPdu_e1a24fd2 (PduRSrcPdu): PduRSourcePduHandleId=10, PduRSrcPduDirection=TRANSMIT, PduRSrcPduRef=BSM_oJ1939_bms_ca52a7bc_Tx, PduRSrcPduPduRBswModulesRef=Com
            BSM_oJ1939_bms_18b10471_Tx (PduRDestPdu):
              PduRDestPduHandleId = 5
              PduRDestPduDirection = TRANSMIT
              PduRDestPduRoutingType = API_FORWARDING
              PduRDestPduDataProcessing = IMMEDIATE
              PduRPduLengthHandlingStrategy = IGNORE
              PduRDestPduCrossPartitionDestination = false
              PduRDestPduDataProvision = PDUR_DIRECT
              PduRTransmissionConfirmation = false
              PduRDestPduRef = BSM_oJ1939_bms_18b10471_Tx
              PduRDestPduPduRBswModulesRef = CanIf
          BCL_oJ1939_bms_e5f04d09_Tx: PduRRoutingPathCommunicationType=COMMUNICATION_INTERFACE
            PduRSrcPdu_74b45400 (PduRSrcPdu): PduRSourcePduHandleId=0, PduRSrcPduDirection=TRANSMIT, PduRSrcPduRef=BCL_oJ1939_bms_e5f04d09_Tx, PduRSrcPduPduRBswModulesRef=Com
            BCL_oJ1939_bms_0b0f8249_Tx (PduRDestPdu):
              PduRDestPduHandleId = 0
              PduRDestPduDirection = TRANSMIT
              PduRDestPduRoutingType = API_FORWARDING
              PduRDestPduDataProcessing = IMMEDIATE
              PduRPduLengthHandlingStrategy = IGNORE
              PduRDestPduCrossPartitionDestination = false
              PduRDestPduDataProvision = PDUR_DIRECT
              PduRTransmissionConfirmation = false
              PduRDestPduRef = BCL_oJ1939_bms_0b0f8249_Tx
              PduRDestPduPduRBswModulesRef = CanIf
          CCS_oJ1939_bms_8c0b4315_Rx: PduRRoutingPathCommunicationType=COMMUNICATION_INTERFACE
            CCS_oJ1939_bms_8c0b4315_Rx_2edb25c9_Rx (PduRDestPdu):
              PduRDestPduHandleId = 30
              PduRDestPduDirection = RECEIVE
              PduRDestPduRoutingType = API_FORWARDING
              PduRDestPduDataProcessing = IMMEDIATE
              PduRPduLengthHandlingStrategy = IGNORE
              PduRDestPduCrossPartitionDestination = false
              PduRTransmissionConfirmation = false
              PduRDestPduRef = CCS_oJ1939_bms_0673def2_Rx
              PduRDestPduPduRBswModulesRef = Com
            PduRSrcPdu_2edb25c9 (PduRSrcPdu): PduRSourcePduHandleId=30, PduRSrcPduDirection=RECEIVE, PduRSrcPduRef=CCS_oJ1939_bms_8c0b4315_Rx, PduRSrcPduPduRBswModulesRef=CanIf
          CML_oJ1939_bms_97a631d1_Rx: PduRRoutingPathCommunicationType=COMMUNICATION_INTERFACE
            CML_oJ1939_bms_97a631d1_Rx_c7bfb7be_Rx (PduRDestPdu):
              PduRDestPduHandleId = 38
              PduRDestPduDirection = RECEIVE
              PduRDestPduRoutingType = API_FORWARDING
              PduRDestPduDataProcessing = IMMEDIATE
              PduRPduLengthHandlingStrategy = IGNORE
              PduRDestPduCrossPartitionDestination = false
              PduRTransmissionConfirmation = false
              PduRDestPduRef = CML_oJ1939_bms_8219a0cf_Rx
              PduRDestPduPduRBswModulesRef = Com
            PduRSrcPdu_c7bfb7be (PduRSrcPdu): PduRSourcePduHandleId=38, PduRSrcPduDirection=RECEIVE, PduRSrcPduRef=CML_oJ1939_bms_97a631d1_Rx, PduRSrcPduPduRBswModulesRef=CanIf
          CTS_oJ1939_bms_29c73f69_Rx: PduRRoutingPathCommunicationType=COMMUNICATION_INTERFACE
            CTS_oJ1939_bms_29c73f69_Rx_c30ef479_Rx (PduRDestPdu):
              PduRDestPduHandleId = 43
              PduRDestPduDirection = RECEIVE
              PduRDestPduRoutingType = API_FORWARDING
              PduRDestPduDataProcessing = IMMEDIATE
              PduRPduLengthHandlingStrategy = IGNORE
              PduRDestPduCrossPartitionDestination = false
              PduRTransmissionConfirmation = false
              PduRDestPduRef = CTS_oJ1939_bms_cf077e70_Rx
              PduRDestPduPduRBswModulesRef = Com
            PduRSrcPdu_c30ef479 (PduRSrcPdu): PduRSourcePduHandleId=43, PduRSrcPduDirection=RECEIVE, PduRSrcPduRef=CTS_oJ1939_bms_29c73f69_Rx, PduRSrcPduPduRBswModulesRef=CanIf
          CHM_oJ1939_bms_1911c680_Rx: PduRRoutingPathCommunicationType=COMMUNICATION_INTERFACE
            PduRSrcPdu_bfbe0d55 (PduRSrcPdu): PduRSourcePduHandleId=37, PduRSrcPduDirection=RECEIVE, PduRSrcPduRef=CHM_oJ1939_bms_1911c680_Rx, PduRSrcPduPduRBswModulesRef=CanIf
            CHM_oJ1939_bms_1911c680_Rx_bfbe0d55_Rx (PduRDestPdu):
              PduRDestPduHandleId = 37
              PduRDestPduDirection = RECEIVE
              PduRDestPduRoutingType = API_FORWARDING
              PduRDestPduDataProcessing = IMMEDIATE
              PduRPduLengthHandlingStrategy = IGNORE
              PduRDestPduCrossPartitionDestination = false
              PduRTransmissionConfirmation = false
              PduRDestPduRef = CHM_oJ1939_bms_04935fb3_Rx
              PduRDestPduPduRBswModulesRef = Com
          BMT_oJ1939_bms_1502dabb_Tx: PduRRoutingPathCommunicationType=TRANSPORT_PROTOCOL
            PduRSrcPdu_38cf15b9 (PduRSrcPdu): PduRSourcePduHandleId=5, PduRSrcPduDirection=TRANSMIT, PduRSrcPduRef=BMT_oJ1939_bms_1502dabb_Tx, PduRSrcPduPduRBswModulesRef=Com
            BMT_oJ1939_bms_38156aba_Tx (PduRDestPdu):
              PduRDestPduHandleId = 2
              PduRDestPduDirection = TRANSMIT
              PduRDestPduRoutingType = API_FORWARDING
              PduRDestPduDataProcessing = IMMEDIATE
              PduRPduLengthHandlingStrategy = UNUSED
              PduRDestPduCrossPartitionDestination = false
              PduRDestPduRef = BMT_oJ1939_bms_38156aba_Tx
              PduRDestPduPduRBswModulesRef = J1939Tp
          BSOC_oJ1939_bms_5e951453_Tx: PduRRoutingPathCommunicationType=TRANSPORT_PROTOCOL
            BSOC_oJ1939_bms_340842a2_Tx (PduRDestPdu):
              PduRDestPduHandleId = 5
              PduRDestPduDirection = TRANSMIT
              PduRDestPduRoutingType = API_FORWARDING
              PduRDestPduDataProcessing = IMMEDIATE
              PduRPduLengthHandlingStrategy = UNUSED
              PduRDestPduCrossPartitionDestination = false
              PduRDestPduRef = BSOC_oJ1939_bms_340842a2_Tx
              PduRDestPduPduRBswModulesRef = J1939Tp
            PduRSrcPdu_71424d7d (PduRSrcPdu): PduRSourcePduHandleId=11, PduRSrcPduDirection=TRANSMIT, PduRSrcPduRef=BSOC_oJ1939_bms_5e951453_Tx, PduRSrcPduPduRBswModulesRef=Com
          CRO_oJ1939_bms_c256408a_Rx: PduRRoutingPathCommunicationType=COMMUNICATION_INTERFACE
            CRO_oJ1939_bms_c256408a_Rx_4e7ec83a_Rx (PduRDestPdu):
              PduRDestPduHandleId = 40
              PduRDestPduDirection = RECEIVE
              PduRDestPduRoutingType = API_FORWARDING
              PduRDestPduDataProcessing = IMMEDIATE
              PduRPduLengthHandlingStrategy = IGNORE
              PduRDestPduCrossPartitionDestination = false
              PduRTransmissionConfirmation = false
              PduRDestPduRef = CRO_oJ1939_bms_66f001d0_Rx
              PduRDestPduPduRBswModulesRef = Com
            PduRSrcPdu_4e7ec83a (PduRSrcPdu): PduRSourcePduHandleId=40, PduRSrcPduDirection=RECEIVE, PduRSrcPduRef=CRO_oJ1939_bms_c256408a_Rx, PduRSrcPduPduRBswModulesRef=CanIf
          BMV_oJ1939_bms_f9394424_Tx: PduRRoutingPathCommunicationType=TRANSPORT_PROTOCOL
            PduRSrcPdu_67493e4a (PduRSrcPdu): PduRSourcePduHandleId=6, PduRSrcPduDirection=TRANSMIT, PduRSrcPduRef=BMV_oJ1939_bms_f9394424_Tx, PduRSrcPduPduRBswModulesRef=Com
            BMV_oJ1939_bms_25dabb18_Tx (PduRDestPdu):
              PduRDestPduHandleId = 3
              PduRDestPduDirection = TRANSMIT
              PduRDestPduRoutingType = API_FORWARDING
              PduRDestPduDataProcessing = IMMEDIATE
              PduRPduLengthHandlingStrategy = UNUSED
              PduRDestPduCrossPartitionDestination = false
              PduRDestPduRef = BMV_oJ1939_bms_25dabb18_Tx
              PduRDestPduPduRBswModulesRef = J1939Tp
          BST_oJ1939_bms_5be370d1_Tx: PduRRoutingPathCommunicationType=COMMUNICATION_INTERFACE
            PduRSrcPdu_bb615a46 (PduRSrcPdu): PduRSourcePduHandleId=12, PduRSrcPduDirection=TRANSMIT, PduRSrcPduRef=BST_oJ1939_bms_5be370d1_Tx, PduRSrcPduPduRBswModulesRef=Com
            BST_oJ1939_bms_8f172738_Tx (PduRDestPdu):
              PduRDestPduHandleId = 6
              PduRDestPduDirection = TRANSMIT
              PduRDestPduRoutingType = API_FORWARDING
              PduRDestPduDataProcessing = IMMEDIATE
              PduRPduLengthHandlingStrategy = IGNORE
              PduRDestPduCrossPartitionDestination = false
              PduRDestPduDataProvision = PDUR_DIRECT
              PduRTransmissionConfirmation = false
              PduRDestPduRef = BST_oJ1939_bms_8f172738_Tx
              PduRDestPduPduRBswModulesRef = CanIf
          BRM_oJ1939_bms_17c47e39_Tx: PduRRoutingPathCommunicationType=TRANSPORT_PROTOCOL
            BRM_oJ1939_bms_e96b01db_Tx (PduRDestPdu):
              PduRDestPduHandleId = 4
              PduRDestPduDirection = TRANSMIT
              PduRDestPduRoutingType = API_FORWARDING
              PduRDestPduDataProcessing = IMMEDIATE
              PduRPduLengthHandlingStrategy = UNUSED
              PduRDestPduCrossPartitionDestination = false
              PduRDestPduRef = BRM_oJ1939_bms_e96b01db_Tx
              PduRDestPduPduRBswModulesRef = J1939Tp
            PduRSrcPdu_b7560081 (PduRSrcPdu): PduRSourcePduHandleId=7, PduRSrcPduDirection=TRANSMIT, PduRSrcPduRef=BRM_oJ1939_bms_17c47e39_Tx, PduRSrcPduPduRBswModulesRef=Com
          BCS_oJ1939_bms_9b7c3f84_Tx: PduRRoutingPathCommunicationType=TRANSPORT_PROTOCOL
            PduRSrcPdu_35535faf (PduRSrcPdu): PduRSourcePduHandleId=2, PduRSrcPduDirection=TRANSMIT, PduRSrcPduRef=BCS_oJ1939_bms_9b7c3f84_Tx, PduRSrcPduPduRBswModulesRef=Com
            BCS_oJ1939_bms_baf9d3e6_Tx (PduRDestPdu):
              PduRDestPduHandleId = 1
              PduRDestPduDirection = TRANSMIT
              PduRDestPduRoutingType = API_FORWARDING
              PduRDestPduDataProcessing = IMMEDIATE
              PduRPduLengthHandlingStrategy = UNUSED
              PduRDestPduCrossPartitionDestination = false
              PduRDestPduRef = BCS_oJ1939_bms_baf9d3e6_Tx
              PduRDestPduPduRBswModulesRef = J1939Tp
          CST_oJ1939_bms_b9e5b7cb_Rx: PduRRoutingPathCommunicationType=COMMUNICATION_INTERFACE
            PduRSrcPdu_db486d3c (PduRSrcPdu): PduRSourcePduHandleId=42, PduRSrcPduDirection=RECEIVE, PduRSrcPduRef=CST_oJ1939_bms_b9e5b7cb_Rx, PduRSrcPduPduRBswModulesRef=CanIf
            CST_oJ1939_bms_b9e5b7cb_Rx_db486d3c_Rx (PduRDestPdu):
              PduRDestPduHandleId = 42
              PduRDestPduDirection = RECEIVE
              PduRDestPduRoutingType = API_FORWARDING
              PduRDestPduDataProcessing = IMMEDIATE
              PduRPduLengthHandlingStrategy = IGNORE
              PduRDestPduCrossPartitionDestination = false
              PduRTransmissionConfirmation = false
              PduRDestPduRef = CST_oJ1939_bms_c6ec91a7_Rx
              PduRDestPduPduRBswModulesRef = Com
          BSD_oJ1939_bms_57fb9d2d_Tx: PduRRoutingPathCommunicationType=COMMUNICATION_INTERFACE
            PduRSrcPdu_b79653ad (PduRSrcPdu): PduRSourcePduHandleId=9, PduRSrcPduDirection=TRANSMIT, PduRSrcPduRef=BSD_oJ1939_bms_57fb9d2d_Tx, PduRSrcPduPduRBswModulesRef=Com
            BSD_oJ1939_bms_6169aa28_Tx (PduRDestPdu):
              PduRDestPduHandleId = 4
              PduRDestPduDirection = TRANSMIT
              PduRDestPduRoutingType = API_FORWARDING
              PduRDestPduDataProcessing = IMMEDIATE
              PduRPduLengthHandlingStrategy = IGNORE
              PduRDestPduCrossPartitionDestination = false
              PduRDestPduDataProvision = PDUR_DIRECT
              PduRTransmissionConfirmation = false
              PduRDestPduRef = BSD_oJ1939_bms_6169aa28_Tx
              PduRDestPduPduRBswModulesRef = CanIf
          BEM_oJ1939_bms_deb0debb_Tx: PduRRoutingPathCommunicationType=COMMUNICATION_INTERFACE
            BEM_oJ1939_bms_4ca77da7_Tx (PduRDestPdu):
              PduRDestPduHandleId = 1
              PduRDestPduDirection = TRANSMIT
              PduRDestPduRoutingType = API_FORWARDING
              PduRDestPduDataProcessing = IMMEDIATE
              PduRPduLengthHandlingStrategy = IGNORE
              PduRDestPduCrossPartitionDestination = false
              PduRDestPduDataProvision = PDUR_DIRECT
              PduRTransmissionConfirmation = false
              PduRDestPduRef = BEM_oJ1939_bms_4ca77da7_Tx
              PduRDestPduPduRBswModulesRef = CanIf
            PduRSrcPdu_0d6a7b1f (PduRSrcPdu): PduRSourcePduHandleId=3, PduRSrcPduDirection=TRANSMIT, PduRSrcPduRef=BEM_oJ1939_bms_deb0debb_Tx, PduRSrcPduPduRBswModulesRef=Com
          CEM_oJ1939_bms_7a55ed54_Rx: PduRRoutingPathCommunicationType=COMMUNICATION_INTERFACE
            CEM_oJ1939_bms_7a55ed54_Rx_0337d83e_Rx (PduRDestPdu):
              PduRDestPduHandleId = 31
              PduRDestPduDirection = RECEIVE
              PduRDestPduRoutingType = API_FORWARDING
              PduRDestPduDataProcessing = IMMEDIATE
              PduRPduLengthHandlingStrategy = IGNORE
              PduRDestPduCrossPartitionDestination = false
              PduRTransmissionConfirmation = false
              PduRDestPduRef = CEM_oJ1939_bms_43bf3fcd_Rx
              PduRDestPduPduRBswModulesRef = Com
            PduRSrcPdu_0337d83e (PduRSrcPdu): PduRSourcePduHandleId=31, PduRSrcPduDirection=RECEIVE, PduRSrcPduRef=CEM_oJ1939_bms_7a55ed54_Rx, PduRSrcPduPduRBswModulesRef=CanIf
          BCP_oJ1939_bms_ece2ed74_Tx: PduRRoutingPathCommunicationType=TRANSPORT_PROTOCOL
            BCP_oJ1939_bms_a9d1ea95_Tx (PduRDestPdu):
              PduRDestPduHandleId = 0
              PduRDestPduDirection = TRANSMIT
              PduRDestPduRoutingType = API_FORWARDING
              PduRDestPduDataProcessing = IMMEDIATE
              PduRPduLengthHandlingStrategy = UNUSED
              PduRDestPduCrossPartitionDestination = false
              PduRDestPduRef = BCP_oJ1939_bms_a9d1ea95_Tx
              PduRDestPduPduRBswModulesRef = J1939Tp
            PduRSrcPdu_ba9ea2a5 (PduRSrcPdu): PduRSourcePduHandleId=1, PduRSrcPduDirection=TRANSMIT, PduRSrcPduRef=BCP_oJ1939_bms_ece2ed74_Tx, PduRSrcPduPduRBswModulesRef=Com
          CRM_oJ1939_bms_df999128_Rx: PduRRoutingPathCommunicationType=COMMUNICATION_INTERFACE
            CRM_oJ1939_bms_df999128_Rx_67ab3cd0_Rx (PduRDestPdu):
              PduRDestPduHandleId = 39
              PduRDestPduDirection = RECEIVE
              PduRDestPduRoutingType = API_FORWARDING
              PduRDestPduDataProcessing = IMMEDIATE
              PduRPduLengthHandlingStrategy = IGNORE
              PduRDestPduCrossPartitionDestination = false
              PduRTransmissionConfirmation = false
              PduRDestPduRef = CRM_oJ1939_bms_8acb9f4f_Rx
              PduRDestPduPduRBswModulesRef = Com
            PduRSrcPdu_67ab3cd0 (PduRSrcPdu): PduRSourcePduHandleId=39, PduRSrcPduDirection=RECEIVE, PduRSrcPduRef=CRM_oJ1939_bms_df999128_Rx, PduRSrcPduPduRBswModulesRef=CanIf
      PduRLock_PduRExclusiveArea (PduRLock)
        PduRExclusiveArea: PduRExclusiveAreaId=0
    6 x PduRBswModules, all with PduRCancelReceive=false, PduRChangeParameterRequestApi=false:
      CanIf: PduRCancelTransmit=false, PduRCommunicationInterface=true, PduRLowerModule=true, PduRTransportProtocol=false, PduRTriggertransmit=false, PduRTxConfirmation=true, PduRUpperModule=false, PduRUseTag=false, PduRBswModuleRef=CanIf
      Com: PduRCancelTransmit=false, PduRCommunicationInterface=true, PduRLowerModule=false, PduRTransportProtocol=true, PduRTriggertransmit=true, PduRTxConfirmation=true, PduRUpperModule=true, PduRUseTag=false, PduRBswModuleRef=Com
      Dcm: PduRCancelTransmit=true, PduRCommunicationInterface=false, PduRLowerModule=false, PduRTransportProtocol=true, PduRTriggertransmit=false, PduRTxConfirmation=false, PduRUpperModule=true, PduRUseTag=true, PduRBswModuleRef=Dcm
      CanTp: PduRCancelTransmit=true, PduRCommunicationInterface=false, PduRLowerModule=true, PduRTransportProtocol=true, PduRTriggertransmit=false, PduRTxConfirmation=false, PduRUpperModule=false, PduRUseTag=false, PduRBswModuleRef=CanTp
      LinIf: PduRCancelTransmit=false, PduRCommunicationInterface=true, PduRLowerModule=true, PduRTransportProtocol=false, PduRTriggertransmit=true, PduRTxConfirmation=true, PduRUpperModule=false, PduRUseTag=false, PduRBswModuleRef=LinIf
      J1939Tp: PduRCancelTransmit=false, PduRCommunicationInterface=false, PduRLowerModule=true, PduRTransportProtocol=true, PduRTriggertransmit=false, PduRTxConfirmation=false, PduRUpperModule=false, PduRUseTag=false, PduRBswModuleRef=J1939Tp
