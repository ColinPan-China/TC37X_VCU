AUTOSAR XML (schema 00048)
package /ActiveEcuC
  module config PduR: implementation-config-variant=VARIANT-PRE-COMPILE, module-description=PduR_Impl
    PduRGeneral:
      PduRDevErrorDetect = true
      PduRVersionInfoApi = false
      PduRMetaDataSupport = false
      PduRPduCallback = false
      PduRSwitching = false
      PduRSafeBswChecks = false
      PduREnableDeferredTransmission = false
      PduREnableDeferredReception = false
      PduRSupportMulticore = false
      PduRRoutingTypeGateway = false
      PduRSpinlockRetryCounter = 4294967295
      PduRExtendedErrorChecks = false
      PduRGeneration:
        PduROutOfBoundsWriteProtectionStrategy = NONE
        PduROutOfBoundsWriteSanitizer = false
        PduROutOfBoundsReadSanitizer = false
        PduRNumericalDataTypeMinimizationStrategy = WITH_CAST
        PduRReduceConstantData2Define = false
        PduRBoolDataInArrayOfStructStrategy = BITMASKING
        PduRDeduplicateIndirectedData = true
        PduRDataDeduplicationStrategy = WITH_CAST
        PduRReduceBoolDataByNegationThreshold = 2
        PduRReduceBoolDataByNumericalComparisonThreshold = 2
        PduRReduceBoolDataByNumericalRelationThreshold = 2
        PduRReduceBoolDataByNumericalOperandStrategy = WITH_ANY_VALUE
        PduRReduceNumericalDataByOffsetThreshold = 2
        PduRReduceNumericalDataByArraySubtractionThreshold = 2
        PduRReduceDataByStreaming = false
        PduRShortSymbols = false
        PduRInterfacesForDeactivatedData = false
        PduRReferringKeysInComments = false
    PduRRoutingTables: PduRConfigurationId=0
      PduRRoutingTable
        48 x PduRRoutingPath, all with PduRMulticoreRoutingPath=false, PduRLockRef=PduRLock_PduRExclusiveArea:
          VcuRxMsg1_oTC37X_VCU_CAN00_4589bbed_Rx: PduRRoutingPathCommunicationType=COMMUNICATION_INTERFACE
            VcuRxMsg1_oTC37X_VCU_CAN00_4589bbed_Rx_6711bd67_Rx (PduRDestPdu):
              PduRDestPduHandleId = 13
              PduRDestPduDirection = RECEIVE
              PduRDestPduRoutingType = API_FORWARDING
              PduRDestPduDataProcessing = IMMEDIATE
              PduRPduLengthHandlingStrategy = IGNORE
              PduRDestPduCrossPartitionDestination = false
              PduRTransmissionConfirmation = false
              PduRDestPduRef = VcuRxMsg1_oTC37X_VCU_CAN00_78805594_Rx
              PduRDestPduPduRBswModulesRef = Com
            PduRSrcPdu_6711bd67 (PduRSrcPdu): PduRSourcePduHandleId=13, PduRSrcPduDirection=RECEIVE, PduRSrcPduRef=VcuRxMsg1_oTC37X_VCU_CAN00_4589bbed_Rx, PduRSrcPduPduRBswModulesRef=CanIf
          VcuTxMsg1_oTC37X_VCU_CAN00_954a27ee_Tx: PduRRoutingPathCommunicationType=COMMUNICATION_INTERFACE
            PduRSrcPdu_91d52164 (PduRSrcPdu): PduRSourcePduHandleId=22, PduRSrcPduDirection=TRANSMIT, PduRSrcPduRef=VcuTxMsg1_oTC37X_VCU_CAN00_954a27ee_Tx, PduRSrcPduPduRBswModulesRef=Com
            VcuTxMsg1_oTC37X_VCU_CAN00_c82dd125_Tx (PduRDestPdu):
              PduRDestPduHandleId = 22
              PduRDestPduDirection = TRANSMIT
              PduRDestPduRoutingType = API_FORWARDING
              PduRDestPduDataProcessing = IMMEDIATE
              PduRPduLengthHandlingStrategy = IGNORE
              PduRDestPduCrossPartitionDestination = false
              PduRTransmissionConfirmation = false
              PduRDestPduDataProvision = PDUR_DIRECT
              PduRDestPduRef = VcuTxMsg1_oTC37X_VCU_CAN00_c82dd125_Tx
              PduRDestPduPduRBswModulesRef = CanIf
          VcuTxMsg2_oTC37X_VCU_CAN00_7fccfa8c_Tx: PduRRoutingPathCommunicationType=COMMUNICATION_INTERFACE
            PduRSrcPdu_69924b1b (PduRSrcPdu): PduRSourcePduHandleId=23, PduRSrcPduDirection=TRANSMIT, PduRSrcPduRef=VcuTxMsg2_oTC37X_VCU_CAN00_7fccfa8c_Tx, PduRSrcPduPduRBswModulesRef=Com
            VcuTxMsg2_oTC37X_VCU_CAN00_0119ca28_Tx (PduRDestPdu):
              PduRDestPduHandleId = 23
              PduRDestPduDirection = TRANSMIT
              PduRDestPduRoutingType = API_FORWARDING
              PduRDestPduDataProcessing = IMMEDIATE
              PduRPduLengthHandlingStrategy = IGNORE
              PduRDestPduCrossPartitionDestination = false
              PduRTransmissionConfirmation = false
              PduRDestPduDataProvision = PDUR_DIRECT
              PduRDestPduRef = VcuTxMsg2_oTC37X_VCU_CAN00_0119ca28_Tx
              PduRDestPduPduRBswModulesRef = CanIf
          VcuRxMsg2_oTC37X_VCU_CAN00_8cbda0e0_Rx: PduRRoutingPathCommunicationType=COMMUNICATION_INTERFACE
            PduRSrcPdu_803efadc (PduRSrcPdu): PduRSourcePduHandleId=14, PduRSrcPduDirection=RECEIVE, PduRSrcPduRef=VcuRxMsg2_oTC37X_VCU_CAN00_8cbda0e0_Rx, PduRSrcPduPduRBswModulesRef=CanIf
            VcuRxMsg2_oTC37X_VCU_CAN00_8cbda0e0_Rx_803efadc_Rx (PduRDestPdu):
              PduRDestPduHandleId = 14
              PduRDestPduDirection = RECEIVE
              PduRDestPduRoutingType = API_FORWARDING
              PduRDestPduDataProcessing = IMMEDIATE
              PduRPduLengthHandlingStrategy = IGNORE
              PduRDestPduCrossPartitionDestination = false
              PduRTransmissionConfirmation = false
              PduRDestPduRef = VcuRxMsg2_oTC37X_VCU_CAN00_920688f6_Rx
              PduRDestPduPduRBswModulesRef = Com
          Vcu_Uds_Func_Request_oTC37X_VCU_CAN00_455d4346_Rx: PduRRoutingPathCommunicationType=TRANSPORT_PROTOCOL
            PduRSrcPdu_4bac36fb (PduRSrcPdu):
              PduRSourcePduHandleId = 0
              PduRSrcPduDirection = RECEIVE
              PduRSrcPduRef = Vcu_Uds_Func_Request_oTC37X_VCU_CAN00_455d4346_Rx
              PduRSrcPduPduRBswModulesRef = CanTp
            Vcu_Uds_Func_Request_oTC37X_VCU_CAN00_455d4346_Rx_4bac36fb_Rx (PduRDestPdu):
              PduRDestPduHandleId = 0
              PduRDestPduDirection = RECEIVE
              PduRDestPduRoutingType = API_FORWARDING
              PduRDestPduDataProcessing = IMMEDIATE
              PduRPduLengthHandlingStrategy = UNUSED
              PduRDestPduCrossPartitionDestination = false
              PduRDestPduRef = Vcu_Uds_Func_Request_oTC37X_VCU_CAN00_21e26bac_Rx
              PduRDestPduPduRBswModulesRef = Dcm
          Vcu_Uds_Phy_Request_oTC37X_VCU_CAN00_16119f6f_Rx: PduRRoutingPathCommunicationType=TRANSPORT_PROTOCOL
            PduRSrcPdu_925fbf89 (PduRSrcPdu):
              PduRSourcePduHandleId = 1
              PduRSrcPduDirection = RECEIVE
              PduRSrcPduRef = Vcu_Uds_Phy_Request_oTC37X_VCU_CAN00_16119f6f_Rx
              PduRSrcPduPduRBswModulesRef = CanTp
            Vcu_Uds_Phy_Request_oTC37X_VCU_CAN00_16119f6f_Rx_925fbf89_Rx (PduRDestPdu):
              PduRDestPduHandleId = 1
              PduRDestPduDirection = RECEIVE
              PduRDestPduRoutingType = API_FORWARDING
              PduRDestPduDataProcessing = IMMEDIATE
              PduRPduLengthHandlingStrategy = UNUSED
              PduRDestPduCrossPartitionDestination = false
              PduRDestPduRef = Vcu_Uds_Phy_Request_oTC37X_VCU_CAN00_d561dcee_Rx
              PduRDestPduPduRBswModulesRef = Dcm
          Vcu_Uds_Response_oTC37X_VCU_CAN00_4d111be6_Tx: PduRRoutingPathCommunicationType=TRANSPORT_PROTOCOL
            Vcu_Uds_Response_oTC37X_VCU_CAN00_39638a1a_Tx (PduRDestPdu):
              PduRDestPduHandleId = 0
              PduRDestPduDirection = TRANSMIT
              PduRDestPduRoutingType = API_FORWARDING
              PduRDestPduDataProcessing = IMMEDIATE
              PduRPduLengthHandlingStrategy = UNUSED
              PduRDestPduCrossPartitionDestination = false
              PduRDestPduRef = Vcu_Uds_Response_oTC37X_VCU_CAN00_39638a1a_Tx
              PduRDestPduPduRBswModulesRef = CanTp
            PduRSrcPdu_1a8748e9 (PduRSrcPdu):
              PduRSourcePduHandleId = 26
              PduRSrcPduDirection = TRANSMIT
              PduRSrcPduRef = Vcu_Uds_Response_oTC37X_VCU_CAN00_4d111be6_Tx
              PduRSrcPduPduRBswModulesRef = Dcm
          VcuRxMsg4_oTC37X_VCU_CAN01_55be06ba_Rx: PduRRoutingPathCommunicationType=COMMUNICATION_INTERFACE
            VcuRxMsg4_oTC37X_VCU_CAN01_55be06ba_Rx_f5b46736_Rx (PduRDestPdu):
              PduRDestPduHandleId = 16
              PduRDestPduDirection = RECEIVE
              PduRDestPduRoutingType = API_FORWARDING
              PduRDestPduDataProcessing = IMMEDIATE
              PduRPduLengthHandlingStrategy = IGNORE
              PduRDestPduCrossPartitionDestination = false
              PduRTransmissionConfirmation = false
              PduRDestPduRef = VcuRxMsg4_oTC37X_VCU_CAN01_eb7d04e5_Rx
              PduRDestPduPduRBswModulesRef = Com
            PduRSrcPdu_f5b46736 (PduRSrcPdu): PduRSourcePduHandleId=16, PduRSrcPduDirection=RECEIVE, PduRSrcPduRef=VcuRxMsg4_oTC37X_VCU_CAN01_55be06ba_Rx, PduRSrcPduPduRBswModulesRef=CanIf
          VcuAdcTxMsg2_oTC37X_VCU_CAN01_1723c88c_Tx: PduRRoutingPathCommunicationType=COMMUNICATION_INTERFACE
            VcuAdcTxMsg2_oTC37X_VCU_CAN01_afb1dcb2_Tx (PduRDestPdu):
              PduRDestPduHandleId = 9
              PduRDestPduDirection = TRANSMIT
              PduRDestPduRoutingType = API_FORWARDING
              PduRDestPduDataProcessing = IMMEDIATE
              PduRPduLengthHandlingStrategy = IGNORE
              PduRDestPduCrossPartitionDestination = false
              PduRDestPduDataProvision = PDUR_DIRECT
              PduRTransmissionConfirmation = false
              PduRDestPduRef = VcuAdcTxMsg2_oTC37X_VCU_CAN01_afb1dcb2_Tx
              PduRDestPduPduRBswModulesRef = CanIf
            PduRSrcPdu_df42a212 (PduRSrcPdu): PduRSourcePduHandleId=9, PduRSrcPduDirection=TRANSMIT, PduRSrcPduRef=VcuAdcTxMsg2_oTC37X_VCU_CAN01_1723c88c_Tx, PduRSrcPduPduRBswModulesRef=Com
          VcuAdcTxMsg1_oTC37X_VCU_CAN01_fda515ee_Tx: PduRRoutingPathCommunicationType=COMMUNICATION_INTERFACE
            PduRSrcPdu_f8c9b934 (PduRSrcPdu): PduRSourcePduHandleId=8, PduRSrcPduDirection=TRANSMIT, PduRSrcPduRef=VcuAdcTxMsg1_oTC37X_VCU_CAN01_fda515ee_Tx, PduRSrcPduPduRBswModulesRef=Com
            VcuAdcTxMsg1_oTC37X_VCU_CAN01_6685c7bf_Tx (PduRDestPdu):
              PduRDestPduHandleId = 8
              PduRDestPduDirection = TRANSMIT
              PduRDestPduRoutingType = API_FORWARDING
              PduRDestPduDataProcessing = IMMEDIATE
              PduRPduLengthHandlingStrategy = IGNORE
              PduRDestPduCrossPartitionDestination = false
              PduRDestPduDataProvision = PDUR_DIRECT
              PduRTransmissionConfirmation = false
              PduRDestPduRef = VcuAdcTxMsg1_oTC37X_VCU_CAN01_6685c7bf_Tx
              PduRDestPduPduRBswModulesRef = CanIf
          VcuRxMsg3_oTC37X_VCU_CAN01_5bb4c01a_Rx: PduRRoutingPathCommunicationType=COMMUNICATION_INTERFACE
            PduRSrcPdu_3905054b (PduRSrcPdu): PduRSourcePduHandleId=15, PduRSrcPduDirection=RECEIVE, PduRSrcPduRef=VcuRxMsg3_oTC37X_VCU_CAN01_5bb4c01a_Rx, PduRSrcPduPduRBswModulesRef=CanIf
            VcuRxMsg3_oTC37X_VCU_CAN01_5bb4c01a_Rx_3905054b_Rx (PduRDestPdu):
              PduRDestPduHandleId = 15
              PduRDestPduDirection = RECEIVE
              PduRDestPduRoutingType = API_FORWARDING
              PduRDestPduDataProcessing = IMMEDIATE
              PduRPduLengthHandlingStrategy = IGNORE
              PduRDestPduCrossPartitionDestination = false
              PduRTransmissionConfirmation = false
              PduRDestPduRef = VcuRxMsg3_oTC37X_VCU_CAN01_0a530e81_Rx
              PduRDestPduPduRBswModulesRef = Com
          VcuTxIoMsg1_oTC37X_VCU_CAN00_54884add_Tx: PduRRoutingPathCommunicationType=COMMUNICATION_INTERFACE
            PduRSrcPdu_96b222db (PduRSrcPdu): PduRSourcePduHandleId=14, PduRSrcPduDirection=TRANSMIT, PduRSrcPduRef=VcuTxIoMsg1_oTC37X_VCU_CAN00_54884add_Tx, PduRSrcPduPduRBswModulesRef=Com
            VcuTxIoMsg1_oTC37X_VCU_CAN00_869e33bc_Tx (PduRDestPdu):
              PduRDestPduHandleId = 14
              PduRDestPduDirection = TRANSMIT
              PduRDestPduRoutingType = API_FORWARDING
              PduRDestPduDataProcessing = IMMEDIATE
              PduRPduLengthHandlingStrategy = IGNORE
              PduRDestPduCrossPartitionDestination = false
              PduRDestPduDataProvision = PDUR_DIRECT
              PduRTransmissionConfirmation = false
              PduRDestPduRef = VcuTxIoMsg1_oTC37X_VCU_CAN00_869e33bc_Tx
              PduRDestPduPduRBswModulesRef = CanIf
          VcuTxIoMsg2_oTC37X_VCU_CAN00_be0e97bf_Tx: PduRRoutingPathCommunicationType=COMMUNICATION_INTERFACE
            VcuTxIoMsg2_oTC37X_VCU_CAN00_4faa28b1_Tx (PduRDestPdu):
              PduRDestPduHandleId = 15
              PduRDestPduDirection = TRANSMIT
              PduRDestPduRoutingType = API_FORWARDING
              PduRDestPduDataProcessing = IMMEDIATE
              PduRPduLengthHandlingStrategy = IGNORE
              PduRDestPduCrossPartitionDestination = false
              PduRTransmissionConfirmation = false
              PduRDestPduDataProvision = PDUR_DIRECT
              PduRDestPduRef = VcuTxIoMsg2_oTC37X_VCU_CAN00_4faa28b1_Tx
              PduRDestPduPduRBswModulesRef = CanIf
            PduRSrcPdu_3ef2d11c (PduRSrcPdu): PduRSourcePduHandleId=15, PduRSrcPduDirection=TRANSMIT, PduRSrcPduRef=VcuTxIoMsg2_oTC37X_VCU_CAN00_be0e97bf_Tx, PduRSrcPduPduRBswModulesRef=Com
          VcuTxIoMsg4_oTC37X_VCU_CAN00_b0722b3a_Tx: PduRRoutingPathCommunicationType=COMMUNICATION_INTERFACE
            VcuTxIoMsg4_oTC37X_VCU_CAN00_06b318ea_Tx (PduRDestPdu):
              PduRDestPduHandleId = 17
              PduRDestPduDirection = TRANSMIT
              PduRDestPduRoutingType = API_FORWARDING
              PduRDestPduDataProcessing = IMMEDIATE
              PduRPduLengthHandlingStrategy = IGNORE
              PduRDestPduCrossPartitionDestination = false
              PduRDestPduDataProvision = PDUR_DIRECT
              PduRTransmissionConfirmation = false
              PduRDestPduRef = VcuTxIoMsg4_oTC37X_VCU_CAN00_06b318ea_Tx
              PduRDestPduPduRBswModulesRef = CanIf
            PduRSrcPdu_15ef524a (PduRSrcPdu): PduRSourcePduHandleId=17, PduRSrcPduDirection=TRANSMIT, PduRSrcPduRef=VcuTxIoMsg4_oTC37X_VCU_CAN00_b0722b3a_Tx, PduRSrcPduPduRBswModulesRef=Com
          VcuTxIoMsg6_oTC37X_VCU_CAN00_b5a640b9_Tx: PduRRoutingPathCommunicationType=COMMUNICATION_INTERFACE
            VcuTxIoMsg6_oTC37X_VCU_CAN00_8894f51c_Tx (PduRDestPdu):
              PduRDestPduHandleId = 19
              PduRDestPduDirection = TRANSMIT
              PduRDestPduRoutingType = API_FORWARDING
              PduRDestPduDataProcessing = IMMEDIATE
              PduRPduLengthHandlingStrategy = IGNORE
              PduRDestPduCrossPartitionDestination = false
              PduRTransmissionConfirmation = false
              PduRDestPduDataProvision = PDUR_DIRECT
              PduRDestPduRef = VcuTxIoMsg6_oTC37X_VCU_CAN00_8894f51c_Tx
              PduRDestPduPduRBswModulesRef = CanIf
            PduRSrcPdu_275934e8 (PduRSrcPdu): PduRSourcePduHandleId=19, PduRSrcPduDirection=TRANSMIT, PduRSrcPduRef=VcuTxIoMsg6_oTC37X_VCU_CAN00_b5a640b9_Tx, PduRSrcPduPduRBswModulesRef=Com
          VcuTxIoMsg5_oTC37X_VCU_CAN00_5f209ddb_Tx: PduRRoutingPathCommunicationType=COMMUNICATION_INTERFACE
            VcuTxIoMsg5_oTC37X_VCU_CAN00_41a0ee11_Tx (PduRDestPdu):
              PduRDestPduHandleId = 18
              PduRDestPduDirection = TRANSMIT
              PduRDestPduRoutingType = API_FORWARDING
              PduRDestPduDataProcessing = IMMEDIATE
              PduRPduLengthHandlingStrategy = IGNORE
              PduRDestPduCrossPartitionDestination = false
              PduRDestPduDataProvision = PDUR_DIRECT
              PduRTransmissionConfirmation = false
              PduRDestPduRef = VcuTxIoMsg5_oTC37X_VCU_CAN00_41a0ee11_Tx
              PduRDestPduPduRBswModulesRef = CanIf
            PduRSrcPdu_886ac60a (PduRSrcPdu): PduRSourcePduHandleId=18, PduRSrcPduDirection=TRANSMIT, PduRSrcPduRef=VcuTxIoMsg5_oTC37X_VCU_CAN00_5f209ddb_Tx, PduRSrcPduPduRBswModulesRef=Com
          VcuTxIoMsg3_oTC37X_VCU_CAN00_515c215e_Tx: PduRRoutingPathCommunicationType=COMMUNICATION_INTERFACE
            PduRSrcPdu_23c89b9b (PduRSrcPdu): PduRSourcePduHandleId=16, PduRSrcPduDirection=TRANSMIT, PduRSrcPduRef=VcuTxIoMsg3_oTC37X_VCU_CAN00_515c215e_Tx, PduRSrcPduPduRBswModulesRef=Com
            VcuTxIoMsg3_oTC37X_VCU_CAN00_08b9de4a_Tx (PduRDestPdu):
              PduRDestPduHandleId = 16
              PduRDestPduDirection = TRANSMIT
              PduRDestPduRoutingType = API_FORWARDING
              PduRDestPduDataProcessing = IMMEDIATE
              PduRPduLengthHandlingStrategy = IGNORE
              PduRDestPduCrossPartitionDestination = false
              PduRDestPduDataProvision = PDUR_DIRECT
              PduRTransmissionConfirmation = false
              PduRDestPduRef = VcuTxIoMsg3_oTC37X_VCU_CAN00_08b9de4a_Tx
              PduRDestPduPduRBswModulesRef = CanIf
          VcuTxIoMsg8_oTC37X_VCU_CAN00_ac8b5230_Tx: PduRRoutingPathCommunicationType=COMMUNICATION_INTERFACE
            PduRSrcPdu_27dcf988 (PduRSrcPdu): PduRSourcePduHandleId=21, PduRSrcPduDirection=TRANSMIT, PduRSrcPduRef=VcuTxIoMsg8_oTC37X_VCU_CAN00_ac8b5230_Tx, PduRSrcPduPduRBswModulesRef=Com
            VcuTxIoMsg8_oTC37X_VCU_CAN00_9481785c_Tx (PduRDestPdu):
              PduRDestPduHandleId = 21
              PduRDestPduDirection = TRANSMIT
              PduRDestPduRoutingType = API_FORWARDING
              PduRDestPduDataProcessing = IMMEDIATE
              PduRPduLengthHandlingStrategy = IGNORE
              PduRDestPduCrossPartitionDestination = false
              PduRDestPduDataProvision = PDUR_DIRECT
              PduRTransmissionConfirmation = false
              PduRDestPduRef = VcuTxIoMsg8_oTC37X_VCU_CAN00_9481785c_Tx
              PduRDestPduPduRBswModulesRef = CanIf
          VcuTxIoMsg7_oTC37X_VCU_CAN00_5af4f658_Tx: PduRRoutingPathCommunicationType=COMMUNICATION_INTERFACE
            VcuTxIoMsg7_oTC37X_VCU_CAN00_cf8703e7_Tx (PduRDestPdu):
              PduRDestPduHandleId = 20
              PduRDestPduDirection = TRANSMIT
              PduRDestPduRoutingType = API_FORWARDING
              PduRDestPduDataProcessing = IMMEDIATE
              PduRPduLengthHandlingStrategy = IGNORE
              PduRDestPduCrossPartitionDestination = false
              PduRDestPduDataProvision = PDUR_DIRECT
              PduRTransmissionConfirmation = false
              PduRDestPduRef = VcuTxIoMsg7_oTC37X_VCU_CAN00_cf8703e7_Tx
              PduRDestPduPduRBswModulesRef = CanIf
            PduRSrcPdu_8c9b3cfc (PduRSrcPdu): PduRSourcePduHandleId=20, PduRSrcPduDirection=TRANSMIT, PduRSrcPduRef=VcuTxIoMsg7_oTC37X_VCU_CAN00_5af4f658_Tx, PduRSrcPduPduRBswModulesRef=Com
          PMP3_Sts_oLIN00_4e808b3d_Rx: PduRRoutingPathCommunicationType=COMMUNICATION_INTERFACE
            PMP3_Sts_oLIN00_4e808b3d_Rx_43cea622_Rx (PduRDestPdu):
              PduRDestPduHandleId = 6
              PduRDestPduDirection = RECEIVE
              PduRDestPduRoutingType = API_FORWARDING
              PduRDestPduDataProcessing = IMMEDIATE
              PduRPduLengthHandlingStrategy = IGNORE
              PduRDestPduCrossPartitionDestination = false
              PduRTransmissionConfirmation = false
              PduRDestPduRef = PMP3_Sts_oLIN00_511c4704_Rx
              PduRDestPduPduRBswModulesRef = Com
            PduRSrcPdu_43cea622 (PduRSrcPdu): PduRSourcePduHandleId=6, PduRSrcPduDirection=RECEIVE, PduRSrcPduRef=PMP3_Sts_oLIN00_4e808b3d_Rx, PduRSrcPduPduRBswModulesRef=LinIf
          EXV_2_VCU_oLIN00_85f64a15_Rx: PduRRoutingPathCommunicationType=COMMUNICATION_INTERFACE
            PduRSrcPdu_b894d38e (PduRSrcPdu): PduRSourcePduHandleId=2, PduRSrcPduDirection=RECEIVE, PduRSrcPduRef=EXV_2_VCU_oLIN00_85f64a15_Rx, PduRSrcPduPduRBswModulesRef=LinIf
            EXV_2_VCU_oLIN00_85f64a15_Rx_b894d38e_Rx (PduRDestPdu):
              PduRDestPduHandleId = 2
              PduRDestPduDirection = RECEIVE
              PduRDestPduRoutingType = API_FORWARDING
              PduRDestPduDataProcessing = IMMEDIATE
              PduRPduLengthHandlingStrategy = IGNORE
              PduRDestPduCrossPartitionDestination = false
              PduRTransmissionConfirmation = false
              PduRDestPduRef = EXV_2_VCU_oLIN00_1e4a3daf_Rx
              PduRDestPduPduRBswModulesRef = Com
          PMP_Cmd_oLIN00_3912b28b_Tx: PduRRoutingPathCommunicationType=COMMUNICATION_INTERFACE
            PduRSrcPdu_4bd8719a (PduRSrcPdu): PduRSourcePduHandleId=1, PduRSrcPduDirection=TRANSMIT, PduRSrcPduRef=PMP_Cmd_oLIN00_3912b28b_Tx, PduRSrcPduPduRBswModulesRef=Com
            PMP_Cmd_oLIN00_6d889c97_Tx (PduRDestPdu):
              PduRDestPduHandleId = 1
              PduRDestPduDirection = TRANSMIT
              PduRDestPduRoutingType = API_FORWARDING
              PduRDestPduDataProcessing = IMMEDIATE
              PduRPduLengthHandlingStrategy = IGNORE
              PduRDestPduCrossPartitionDestination = false
              PduRDestPduDataProvision = PDUR_TRIGGERTRANSMIT
              PduRTransmissionConfirmation = false
              PduRDestPduRef = PMP_Cmd_oLIN00_6d889c97_Tx
              PduRDestPduPduRBswModulesRef = LinIf
          EXV2_Status_oLIN00_7fcf9f75_Rx: PduRRoutingPathCommunicationType=COMMUNICATION_INTERFACE
            EXV2_Status_oLIN00_7fcf9f75_Rx_c3f2be6b_Rx (PduRDestPdu):
              PduRDestPduHandleId = 0
              PduRDestPduDirection = RECEIVE
              PduRDestPduRoutingType = API_FORWARDING
              PduRDestPduDataProcessing = IMMEDIATE
              PduRPduLengthHandlingStrategy = IGNORE
              PduRDestPduCrossPartitionDestination = false
              PduRTransmissionConfirmation = false
              PduRDestPduRef = EXV2_Status_oLIN00_d5e93929_Rx
              PduRDestPduPduRBswModulesRef = Com
            PduRSrcPdu_c3f2be6b (PduRSrcPdu): PduRSourcePduHandleId=0, PduRSrcPduDirection=RECEIVE, PduRSrcPduRef=EXV2_Status_oLIN00_7fcf9f75_Rx, PduRSrcPduPduRBswModulesRef=LinIf
          SVA_VCU_STD_oLIN00_4f0795ef_Rx: PduRRoutingPathCommunicationType=COMMUNICATION_INTERFACE
            PduRSrcPdu_166cd16c (PduRSrcPdu): PduRSourcePduHandleId=7, PduRSrcPduDirection=RECEIVE, PduRSrcPduRef=SVA_VCU_STD_oLIN00_4f0795ef_Rx, PduRSrcPduPduRBswModulesRef=LinIf
            SVA_VCU_STD_oLIN00_4f0795ef_Rx_166cd16c_Rx (PduRDestPdu):
              PduRDestPduHandleId = 7
              PduRDestPduDirection = RECEIVE
              PduRDestPduRoutingType = API_FORWARDING
              PduRDestPduDataProcessing = IMMEDIATE
              PduRPduLengthHandlingStrategy = IGNORE
              PduRDestPduCrossPartitionDestination = false
              PduRTransmissionConfirmation = false
              PduRDestPduRef = SVA_VCU_STD_oLIN00_4526aa1c_Rx
              PduRDestPduPduRBswModulesRef = Com
          HVCH_Rsp02_oLIN00_a3ea669e_Rx: PduRRoutingPathCommunicationType=COMMUNICATION_INTERFACE
            HVCH_Rsp02_oLIN00_a3ea669e_Rx_90a9658c_Rx (PduRDestPdu):
              PduRDestPduHandleId = 4
              PduRDestPduDirection = RECEIVE
              PduRDestPduRoutingType = API_FORWARDING
              PduRDestPduDataProcessing = IMMEDIATE
              PduRPduLengthHandlingStrategy = IGNORE
              PduRDestPduCrossPartitionDestination = false
              PduRTransmissionConfirmation = false
              PduRDestPduRef = HVCH_Rsp02_oLIN00_286c390c_Rx
              PduRDestPduPduRBswModulesRef = Com
            PduRSrcPdu_90a9658c (PduRSrcPdu): PduRSourcePduHandleId=4, PduRSrcPduDirection=RECEIVE, PduRSrcPduRef=HVCH_Rsp02_oLIN00_a3ea669e_Rx, PduRSrcPduPduRBswModulesRef=LinIf
          VCU_EXV_1_oLIN00_50eec975_Tx: PduRRoutingPathCommunicationType=COMMUNICATION_INTERFACE
            PduRSrcPdu_91ca29f5 (PduRSrcPdu): PduRSourcePduHandleId=3, PduRSrcPduDirection=TRANSMIT, PduRSrcPduRef=VCU_EXV_1_oLIN00_50eec975_Tx, PduRSrcPduPduRBswModulesRef=Com
            VCU_EXV_1_oLIN00_58a890ac_Tx (PduRDestPdu):
              PduRDestPduHandleId = 3
              PduRDestPduDirection = TRANSMIT
              PduRDestPduRoutingType = API_FORWARDING
              PduRDestPduDataProcessing = IMMEDIATE
              PduRPduLengthHandlingStrategy = IGNORE
              PduRDestPduCrossPartitionDestination = false
              PduRDestPduDataProvision = PDUR_TRIGGERTRANSMIT
              PduRTransmissionConfirmation = false
              PduRDestPduRef = VCU_EXV_1_oLIN00_58a890ac_Tx
              PduRDestPduPduRBswModulesRef = LinIf
          VCU_SVA_CMD_oLIN00_756d14f6_Tx: PduRRoutingPathCommunicationType=COMMUNICATION_INTERFACE
            PduRSrcPdu_b06eca36 (PduRSrcPdu): PduRSourcePduHandleId=7, PduRSrcPduDirection=TRANSMIT, PduRSrcPduRef=VCU_SVA_CMD_oLIN00_756d14f6_Tx, PduRSrcPduPduRBswModulesRef=Com
            VCU_SVA_CMD_oLIN00_89e2bb7b_Tx (PduRDestPdu):
              PduRDestPduHandleId = 7
              PduRDestPduDirection = TRANSMIT
              PduRDestPduRoutingType = API_FORWARDING
              PduRDestPduDataProcessing = IMMEDIATE
              PduRPduLengthHandlingStrategy = IGNORE
              PduRDestPduCrossPartitionDestination = false
              PduRDestPduDataProvision = PDUR_TRIGGERTRANSMIT
              PduRTransmissionConfirmation = false
              PduRDestPduRef = VCU_SVA_CMD_oLIN00_89e2bb7b_Tx
              PduRDestPduPduRBswModulesRef = LinIf
          HVCH_Rsp01_oLIN00_d50f5fa3_Rx: PduRRoutingPathCommunicationType=COMMUNICATION_INTERFACE
            HVCH_Rsp01_oLIN00_d50f5fa3_Rx_aa2a3f7d_Rx (PduRDestPdu):
              PduRDestPduHandleId = 3
              PduRDestPduDirection = RECEIVE
              PduRDestPduRoutingType = API_FORWARDING
              PduRDestPduDataProcessing = IMMEDIATE
              PduRPduLengthHandlingStrategy = IGNORE
              PduRDestPduCrossPartitionDestination = false
              PduRTransmissionConfirmation = false
              PduRDestPduRef = HVCH_Rsp01_oLIN00_a6e33eef_Rx
              PduRDestPduPduRBswModulesRef = Com
            PduRSrcPdu_aa2a3f7d (PduRSrcPdu): PduRSourcePduHandleId=3, PduRSrcPduDirection=RECEIVE, PduRSrcPduRef=HVCH_Rsp01_oLIN00_d50f5fa3_Rx, PduRSrcPduPduRBswModulesRef=LinIf
          EXV_1_VCU_oLIN00_366267d6_Rx: PduRRoutingPathCommunicationType=COMMUNICATION_INTERFACE
            EXV_1_VCU_oLIN00_366267d6_Rx_718a1cfb_Rx (PduRDestPdu):
              PduRDestPduHandleId = 1
              PduRDestPduDirection = RECEIVE
              PduRDestPduRoutingType = API_FORWARDING
              PduRDestPduDataProcessing = IMMEDIATE
              PduRPduLengthHandlingStrategy = IGNORE
              PduRDestPduCrossPartitionDestination = false
              PduRTransmissionConfirmation = false
              PduRDestPduRef = EXV_1_VCU_oLIN00_69d4ef5f_Rx
              PduRDestPduPduRBswModulesRef = Com
            PduRSrcPdu_718a1cfb (PduRSrcPdu): PduRSourcePduHandleId=1, PduRSrcPduDirection=RECEIVE, PduRSrcPduRef=EXV_1_VCU_oLIN00_366267d6_Rx, PduRSrcPduPduRBswModulesRef=LinIf
          PMP2_Sts_oLIN00_200c907c_Rx: PduRRoutingPathCommunicationType=COMMUNICATION_INTERFACE
            PduRSrcPdu_9a742e46 (PduRSrcPdu): PduRSourcePduHandleId=5, PduRSrcPduDirection=RECEIVE, PduRSrcPduRef=PMP2_Sts_oLIN00_200c907c_Rx, PduRSrcPduPduRBswModulesRef=LinIf
            PMP2_Sts_oLIN00_200c907c_Rx_9a742e46_Rx (PduRDestPdu):
              PduRDestPduHandleId = 5
              PduRDestPduDirection = RECEIVE
              PduRDestPduRoutingType = API_FORWARDING
              PduRDestPduDataProcessing = IMMEDIATE
              PduRPduLengthHandlingStrategy = IGNORE
              PduRDestPduCrossPartitionDestination = false
              PduRTransmissionConfirmation = false
              PduRDestPduRef = PMP2_Sts_oLIN00_cab90b6b_Rx
              PduRDestPduPduRBswModulesRef = Com
          TCU_HVCH_Cmd_oLIN00_385d5651_Tx: PduRRoutingPathCommunicationType=COMMUNICATION_INTERFACE
            TCU_HVCH_Cmd_oLIN00_ddc31229_Tx (PduRDestPdu):
              PduRDestPduHandleId = 2
              PduRDestPduDirection = TRANSMIT
              PduRDestPduRoutingType = API_FORWARDING
              PduRDestPduDataProcessing = IMMEDIATE
              PduRPduLengthHandlingStrategy = IGNORE
              PduRDestPduCrossPartitionDestination = false
              PduRDestPduDataProvision = PDUR_TRIGGERTRANSMIT
              PduRTransmissionConfirmation = false
              PduRDestPduRef = TCU_HVCH_Cmd_oLIN00_ddc31229_Tx
              PduRDestPduPduRBswModulesRef = LinIf
            PduRSrcPdu_6a17111c (PduRSrcPdu): PduRSourcePduHandleId=2, PduRSrcPduDirection=TRANSMIT, PduRSrcPduRef=TCU_HVCH_Cmd_oLIN00_385d5651_Tx, PduRSrcPduPduRBswModulesRef=Com
          EDCU_EXV2_oLIN00_1f8750a5_Tx: PduRRoutingPathCommunicationType=COMMUNICATION_INTERFACE
            EDCU_EXV2_oLIN00_18b050dc_Tx (PduRDestPdu):
              PduRDestPduHandleId = 0
              PduRDestPduDirection = TRANSMIT
              PduRDestPduRoutingType = API_FORWARDING
              PduRDestPduDataProcessing = IMMEDIATE
              PduRPduLengthHandlingStrategy = IGNORE
              PduRDestPduCrossPartitionDestination = false
              PduRDestPduDataProvision = PDUR_TRIGGERTRANSMIT
              PduRTransmissionConfirmation = false
              PduRDestPduRef = EDCU_EXV2_oLIN00_18b050dc_Tx
              PduRDestPduPduRBswModulesRef = LinIf
            PduRSrcPdu_0361509d (PduRSrcPdu): PduRSourcePduHandleId=0, PduRSrcPduDirection=TRANSMIT, PduRSrcPduRef=EDCU_EXV2_oLIN00_1f8750a5_Tx, PduRSrcPduPduRBswModulesRef=Com
          VCU_EXV_2_oLIN00_de61ce96_Tx: PduRRoutingPathCommunicationType=COMMUNICATION_INTERFACE
            PduRSrcPdu_9414725b (PduRSrcPdu): PduRSourcePduHandleId=4, PduRSrcPduDirection=TRANSMIT, PduRSrcPduRef=VCU_EXV_2_oLIN00_de61ce96_Tx, PduRSrcPduPduRBswModulesRef=Com
            VCU_EXV_2_oLIN00_2e4da991_Tx (PduRDestPdu):
              PduRDestPduHandleId = 4
              PduRDestPduDirection = TRANSMIT
              PduRDestPduRoutingType = API_FORWARDING
              PduRDestPduDataProcessing = IMMEDIATE
              PduRPduLengthHandlingStrategy = IGNORE
              PduRDestPduCrossPartitionDestination = false
              PduRDestPduDataProvision = PDUR_TRIGGERTRANSMIT
              PduRTransmissionConfirmation = false
              PduRDestPduRef = VCU_EXV_2_oLIN00_2e4da991_Tx
              PduRDestPduPduRBswModulesRef = LinIf
          VCU_Minor_01_oKAMA_FP_EPT_0303_39c0a2ee_Tx: PduRRoutingPathCommunicationType=COMMUNICATION_INTERFACE
            VCU_Minor_01_oKAMA_FP_EPT_0303_45280963_Tx (PduRDestPdu):
              PduRDestPduHandleId = 5
              PduRDestPduDirection = TRANSMIT
              PduRDestPduRoutingType = API_FORWARDING
              PduRDestPduDataProcessing = IMMEDIATE
              PduRPduLengthHandlingStrategy = IGNORE
              PduRDestPduCrossPartitionDestination = false
              PduRDestPduDataProvision = PDUR_DIRECT
              PduRTransmissionConfirmation = false
              PduRDestPduRef = VCU_Minor_01_oKAMA_FP_EPT_0303_45280963_Tx
              PduRDestPduPduRBswModulesRef = CanIf
            PduRSrcPdu_73c8c9ca (PduRSrcPdu): PduRSourcePduHandleId=5, PduRSrcPduDirection=TRANSMIT, PduRSrcPduRef=VCU_Minor_01_oKAMA_FP_EPT_0303_39c0a2ee_Tx, PduRSrcPduPduRBswModulesRef=Com
          VCU_Minor_02_oKAMA_FP_EPT_0303_9a962447_Tx: PduRRoutingPathCommunicationType=COMMUNICATION_INTERFACE
            VCU_Minor_02_oKAMA_FP_EPT_0303_7ae377f6_Tx (PduRDestPdu):
              PduRDestPduHandleId = 6
              PduRDestPduDirection = TRANSMIT
              PduRDestPduRoutingType = API_FORWARDING
              PduRDestPduDataProcessing = IMMEDIATE
              PduRPduLengthHandlingStrategy = IGNORE
              PduRDestPduCrossPartitionDestination = false
              PduRTransmissionConfirmation = false
              PduRDestPduDataProvision = PDUR_DIRECT
              PduRDestPduRef = VCU_Minor_02_oKAMA_FP_EPT_0303_7ae377f6_Tx
              PduRDestPduPduRBswModulesRef = CanIf
            PduRSrcPdu_a98c9d8b (PduRSrcPdu): PduRSourcePduHandleId=6, PduRSrcPduDirection=TRANSMIT, PduRSrcPduRef=VCU_Minor_02_oKAMA_FP_EPT_0303_9a962447_Tx, PduRSrcPduPduRBswModulesRef=Com
          VCU_Minor_03_oKAMA_FP_EPT_0303_d9755fba_Rx: PduRRoutingPathCommunicationType=COMMUNICATION_INTERFACE
            VCU_Minor_03_oKAMA_FP_EPT_0303_d9755fba_Rx_7341a555_Rx (PduRDestPdu):
              PduRDestPduHandleId = 8
              PduRDestPduDirection = RECEIVE
              PduRDestPduRoutingType = API_FORWARDING
              PduRDestPduDataProcessing = IMMEDIATE
              PduRPduLengthHandlingStrategy = IGNORE
              PduRDestPduCrossPartitionDestination = false
              PduRTransmissionConfirmation = false
              PduRDestPduRef = VCU_Minor_03_oKAMA_FP_EPT_0303_4d74a41f_Rx
              PduRDestPduPduRBswModulesRef = Com
            PduRSrcPdu_7341a555 (PduRSrcPdu): PduRSourcePduHandleId=8, PduRSrcPduDirection=RECEIVE, PduRSrcPduRef=VCU_Minor_03_oKAMA_FP_EPT_0303_d9755fba_Rx, PduRSrcPduPduRBswModulesRef=CanIf
          VcuCan12TxMsg2_oTC37X_VCU_CAN12_3a1dfcb9_Tx: PduRRoutingPathCommunicationType=COMMUNICATION_INTERFACE
            VcuCan12TxMsg2_oTC37X_VCU_CAN12_e5a6e89d_Tx (PduRDestPdu):
              PduRDestPduHandleId = 13
              PduRDestPduDirection = TRANSMIT
              PduRDestPduRoutingType = API_FORWARDING
              PduRDestPduDataProcessing = IMMEDIATE
              PduRPduLengthHandlingStrategy = IGNORE
              PduRDestPduCrossPartitionDestination = false
              PduRDestPduDataProvision = PDUR_DIRECT
              PduRTransmissionConfirmation = false
              PduRDestPduRef = VcuCan12TxMsg2_oTC37X_VCU_CAN12_e5a6e89d_Tx
              PduRDestPduPduRBswModulesRef = CanIf
            PduRSrcPdu_573a7055 (PduRSrcPdu): PduRSourcePduHandleId=13, PduRSrcPduDirection=TRANSMIT, PduRSrcPduRef=VcuCan12TxMsg2_oTC37X_VCU_CAN12_3a1dfcb9_Tx, PduRSrcPduPduRBswModulesRef=Com
          VcuCan12RxMsg3_oTC37X_VCU_CAN12_2f1174ae_Rx: PduRRoutingPathCommunicationType=COMMUNICATION_INTERFACE
            PduRSrcPdu_9d116735 (PduRSrcPdu):
              PduRSourcePduHandleId = 11
              PduRSrcPduDirection = RECEIVE
              PduRSrcPduRef = VcuCan12RxMsg3_oTC37X_VCU_CAN12_2f1174ae_Rx
              PduRSrcPduPduRBswModulesRef = CanIf
            VcuCan12RxMsg3_oTC37X_VCU_CAN12_2f1174ae_Rx_9d116735_Rx (PduRDestPdu):
              PduRDestPduHandleId = 11
              PduRDestPduDirection = RECEIVE
              PduRDestPduRoutingType = API_FORWARDING
              PduRDestPduDataProcessing = IMMEDIATE
              PduRPduLengthHandlingStrategy = IGNORE
              PduRDestPduCrossPartitionDestination = false
              PduRTransmissionConfirmation = false
              PduRDestPduRef = VcuCan12RxMsg3_oTC37X_VCU_CAN12_38853822_Rx
              PduRDestPduPduRBswModulesRef = Com
          VcuCan12RxMsg4_oTC37X_VCU_CAN12_211bb20e_Rx: PduRRoutingPathCommunicationType=COMMUNICATION_INTERFACE
            PduRSrcPdu_0a95646f (PduRSrcPdu):
              PduRSourcePduHandleId = 12
              PduRSrcPduDirection = RECEIVE
              PduRSrcPduRef = VcuCan12RxMsg4_oTC37X_VCU_CAN12_211bb20e_Rx
              PduRSrcPduPduRBswModulesRef = CanIf
            VcuCan12RxMsg4_oTC37X_VCU_CAN12_211bb20e_Rx_0a95646f_Rx (PduRDestPdu):
              PduRDestPduHandleId = 12
              PduRDestPduDirection = RECEIVE
              PduRDestPduRoutingType = API_FORWARDING
              PduRDestPduDataProcessing = IMMEDIATE
              PduRPduLengthHandlingStrategy = IGNORE
              PduRDestPduCrossPartitionDestination = false
              PduRTransmissionConfirmation = false
              PduRDestPduRef = VcuCan12RxMsg4_oTC37X_VCU_CAN12_d9ab3246_Rx
              PduRDestPduPduRBswModulesRef = Com
          VcuCan12TxMsg1_oTC37X_VCU_CAN12_d09b21db_Tx: PduRRoutingPathCommunicationType=COMMUNICATION_INTERFACE
            VcuCan12TxMsg1_oTC37X_VCU_CAN12_2c92f390_Tx (PduRDestPdu):
              PduRDestPduHandleId = 12
              PduRDestPduDirection = TRANSMIT
              PduRDestPduRoutingType = API_FORWARDING
              PduRDestPduDataProcessing = IMMEDIATE
              PduRPduLengthHandlingStrategy = IGNORE
              PduRDestPduCrossPartitionDestination = false
              PduRTransmissionConfirmation = false
              PduRDestPduDataProvision = PDUR_DIRECT
              PduRDestPduRef = VcuCan12TxMsg1_oTC37X_VCU_CAN12_2c92f390_Tx
              PduRDestPduPduRBswModulesRef = CanIf
            PduRSrcPdu_6cefc258 (PduRSrcPdu): PduRSourcePduHandleId=12, PduRSrcPduDirection=TRANSMIT, PduRSrcPduRef=VcuCan12TxMsg1_oTC37X_VCU_CAN12_d09b21db_Tx, PduRSrcPduPduRBswModulesRef=Com
          VcuCan03RxMsg2_oTC37X_VCU_CAN03_84e608b6_Rx: PduRRoutingPathCommunicationType=COMMUNICATION_INTERFACE
            VcuCan03RxMsg2_oTC37X_VCU_CAN03_84e608b6_Rx_a2204cbf_Rx (PduRDestPdu):
              PduRDestPduHandleId = 10
              PduRDestPduDirection = RECEIVE
              PduRDestPduRoutingType = API_FORWARDING
              PduRDestPduDataProcessing = IMMEDIATE
              PduRPduLengthHandlingStrategy = IGNORE
              PduRDestPduCrossPartitionDestination = false
              PduRTransmissionConfirmation = false
              PduRDestPduRef = VcuCan03RxMsg2_oTC37X_VCU_CAN03_9d657a3d_Rx
              PduRDestPduPduRBswModulesRef = Com
            PduRSrcPdu_a2204cbf (PduRSrcPdu):
              PduRSourcePduHandleId = 10
              PduRSrcPduDirection = RECEIVE
              PduRSrcPduRef = VcuCan03RxMsg2_oTC37X_VCU_CAN03_84e608b6_Rx
              PduRSrcPduPduRBswModulesRef = CanIf
          VcuCan03TxMsg2_oTC37X_VCU_CAN03_70af0847_Tx: PduRRoutingPathCommunicationType=COMMUNICATION_INTERFACE
            PduRSrcPdu_a59b3a32 (PduRSrcPdu): PduRSourcePduHandleId=11, PduRSrcPduDirection=TRANSMIT, PduRSrcPduRef=VcuCan03TxMsg2_oTC37X_VCU_CAN03_70af0847_Tx, PduRSrcPduPduRBswModulesRef=Com
            VcuCan03TxMsg2_oTC37X_VCU_CAN03_0942627e_Tx (PduRDestPdu):
              PduRDestPduHandleId = 11
              PduRDestPduDirection = TRANSMIT
              PduRDestPduRoutingType = API_FORWARDING
              PduRDestPduDataProcessing = IMMEDIATE
              PduRPduLengthHandlingStrategy = IGNORE
              PduRDestPduCrossPartitionDestination = false
              PduRDestPduDataProvision = PDUR_DIRECT
              PduRTransmissionConfirmation = false
              PduRDestPduRef = VcuCan03TxMsg2_oTC37X_VCU_CAN03_0942627e_Tx
              PduRDestPduPduRBswModulesRef = CanIf
          VcuCan03RxMsg1_oTC37X_VCU_CAN03_4dd213bb_Rx: PduRRoutingPathCommunicationType=COMMUNICATION_INTERFACE
            PduRSrcPdu_4e610413 (PduRSrcPdu): PduRSourcePduHandleId=9, PduRSrcPduDirection=RECEIVE, PduRSrcPduRef=VcuCan03RxMsg1_oTC37X_VCU_CAN03_4dd213bb_Rx, PduRSrcPduPduRBswModulesRef=CanIf
            VcuCan03RxMsg1_oTC37X_VCU_CAN03_4dd213bb_Rx_4e610413_Rx (PduRDestPdu):
              PduRDestPduHandleId = 9
              PduRDestPduDirection = RECEIVE
              PduRDestPduRoutingType = API_FORWARDING
              PduRDestPduDataProcessing = IMMEDIATE
              PduRPduLengthHandlingStrategy = IGNORE
              PduRDestPduCrossPartitionDestination = false
              PduRTransmissionConfirmation = false
              PduRDestPduRef = VcuCan03RxMsg1_oTC37X_VCU_CAN03_77e3a75f_Rx
              PduRDestPduPduRBswModulesRef = Com
          VcuCan03TxMsg1_oTC37X_VCU_CAN03_9a29d525_Tx: PduRRoutingPathCommunicationType=COMMUNICATION_INTERFACE
            VcuCan03TxMsg1_oTC37X_VCU_CAN03_c0767973_Tx (PduRDestPdu):
              PduRDestPduHandleId = 10
              PduRDestPduDirection = TRANSMIT
              PduRDestPduRoutingType = API_FORWARDING
              PduRDestPduDataProcessing = IMMEDIATE
              PduRPduLengthHandlingStrategy = IGNORE
              PduRDestPduCrossPartitionDestination = false
              PduRDestPduDataProvision = PDUR_DIRECT
              PduRTransmissionConfirmation = false
              PduRDestPduRef = VcuCan03TxMsg1_oTC37X_VCU_CAN03_c0767973_Tx
              PduRDestPduPduRBswModulesRef = CanIf
            PduRSrcPdu_6c0ea6d2 (PduRSrcPdu): PduRSourcePduHandleId=10, PduRSrcPduDirection=TRANSMIT, PduRSrcPduRef=VcuCan03TxMsg1_oTC37X_VCU_CAN03_9a29d525_Tx, PduRSrcPduPduRBswModulesRef=Com
          Vcu_Lin0_RxMsg2_oLIN01_717e4d45_Rx: PduRRoutingPathCommunicationType=COMMUNICATION_INTERFACE
            PduRSrcPdu_d314568e (PduRSrcPdu): PduRSourcePduHandleId=18, PduRSrcPduDirection=RECEIVE, PduRSrcPduRef=Vcu_Lin0_RxMsg2_oLIN01_717e4d45_Rx, PduRSrcPduPduRBswModulesRef=LinIf
            Vcu_Lin0_RxMsg2_oLIN01_717e4d45_Rx_d314568e_Rx (PduRDestPdu):
              PduRDestPduHandleId = 18
              PduRDestPduDirection = RECEIVE
              PduRDestPduRoutingType = API_FORWARDING
              PduRDestPduDataProcessing = IMMEDIATE
              PduRPduLengthHandlingStrategy = IGNORE
              PduRDestPduCrossPartitionDestination = false
              PduRTransmissionConfirmation = false
              PduRDestPduRef = Vcu_Lin0_RxMsg2_oLIN01_aaf70b87_Rx
              PduRDestPduPduRBswModulesRef = Com
          Vcu_Lin0_TxMsg2_oLIN01_0a12d45a_Tx: PduRRoutingPathCommunicationType=COMMUNICATION_INTERFACE
            Vcu_Lin0_TxMsg2_oLIN01_74c2430b_Tx (PduRDestPdu):
              PduRDestPduHandleId = 25
              PduRDestPduDirection = TRANSMIT
              PduRDestPduRoutingType = API_FORWARDING
              PduRDestPduDataProcessing = IMMEDIATE
              PduRPduLengthHandlingStrategy = IGNORE
              PduRDestPduCrossPartitionDestination = false
              PduRDestPduDataProvision = PDUR_TRIGGERTRANSMIT
              PduRTransmissionConfirmation = false
              PduRDestPduRef = Vcu_Lin0_TxMsg2_oLIN01_74c2430b_Tx
              PduRDestPduPduRBswModulesRef = LinIf
            PduRSrcPdu_0417dd35 (PduRSrcPdu): PduRSourcePduHandleId=25, PduRSrcPduDirection=TRANSMIT, PduRSrcPduRef=Vcu_Lin0_TxMsg2_oLIN01_0a12d45a_Tx, PduRSrcPduPduRBswModulesRef=Com
          Vcu_Lin0_TxMsg1_oLIN01_849dd3b9_Tx: PduRRoutingPathCommunicationType=COMMUNICATION_INTERFACE
            PduRSrcPdu_ff5e60c1 (PduRSrcPdu): PduRSourcePduHandleId=24, PduRSrcPduDirection=TRANSMIT, PduRSrcPduRef=Vcu_Lin0_TxMsg1_oLIN01_849dd3b9_Tx, PduRSrcPduPduRBswModulesRef=Com
            Vcu_Lin0_TxMsg1_oLIN01_02277a36_Tx (PduRDestPdu):
              PduRDestPduHandleId = 24
              PduRDestPduDirection = TRANSMIT
              PduRDestPduRoutingType = API_FORWARDING
              PduRDestPduDataProcessing = IMMEDIATE
              PduRPduLengthHandlingStrategy = IGNORE
              PduRDestPduCrossPartitionDestination = false
              PduRTransmissionConfirmation = false
              PduRDestPduDataProvision = PDUR_TRIGGERTRANSMIT
              PduRDestPduRef = Vcu_Lin0_TxMsg1_oLIN01_02277a36_Tx
              PduRDestPduPduRBswModulesRef = LinIf
          Vcu_Lin0_RxMsg1_oLIN01_079b7478_Rx: PduRRoutingPathCommunicationType=COMMUNICATION_INTERFACE
            Vcu_Lin0_RxMsg1_oLIN01_079b7478_Rx_12331c6c_Rx (PduRDestPdu):
              PduRDestPduHandleId = 17
              PduRDestPduDirection = RECEIVE
              PduRDestPduRoutingType = API_FORWARDING
              PduRDestPduDataProcessing = IMMEDIATE
              PduRPduLengthHandlingStrategy = IGNORE
              PduRDestPduCrossPartitionDestination = false
              PduRTransmissionConfirmation = false
              PduRDestPduRef = Vcu_Lin0_RxMsg1_oLIN01_24780c64_Rx
              PduRDestPduPduRBswModulesRef = Com
            PduRSrcPdu_12331c6c (PduRSrcPdu): PduRSourcePduHandleId=17, PduRSrcPduDirection=RECEIVE, PduRSrcPduRef=Vcu_Lin0_RxMsg1_oLIN01_079b7478_Rx, PduRSrcPduPduRBswModulesRef=LinIf
      PduRLock_PduRExclusiveArea (PduRLock)
        PduRExclusiveArea: PduRExclusiveAreaId=0
    5 x PduRBswModules, all with PduRCancelReceive=false, PduRChangeParameterRequestApi=false:
      CanIf: PduRCancelTransmit=false, PduRCommunicationInterface=true, PduRLowerModule=true, PduRTransportProtocol=false, PduRTriggertransmit=false, PduRTxConfirmation=false, PduRUpperModule=false, PduRUseTag=false, PduRBswModuleRef=CanIf
      Com: PduRCancelTransmit=false, PduRCommunicationInterface=true, PduRLowerModule=false, PduRTransportProtocol=false, PduRTriggertransmit=true, PduRTxConfirmation=false, PduRUpperModule=true, PduRUseTag=false, PduRBswModuleRef=Com
      Dcm: PduRCancelTransmit=true, PduRCommunicationInterface=false, PduRLowerModule=false, PduRTransportProtocol=true, PduRTriggertransmit=false, PduRTxConfirmation=false, PduRUpperModule=true, PduRUseTag=true, PduRBswModuleRef=Dcm
      CanTp: PduRCancelTransmit=true, PduRCommunicationInterface=false, PduRLowerModule=true, PduRTransportProtocol=true, PduRTriggertransmit=false, PduRTxConfirmation=false, PduRUpperModule=false, PduRUseTag=false, PduRBswModuleRef=CanTp
      LinIf: PduRCancelTransmit=false, PduRCommunicationInterface=true, PduRLowerModule=true, PduRTransportProtocol=false, PduRTriggertransmit=true, PduRTxConfirmation=true, PduRUpperModule=false, PduRUseTag=false, PduRBswModuleRef=LinIf
