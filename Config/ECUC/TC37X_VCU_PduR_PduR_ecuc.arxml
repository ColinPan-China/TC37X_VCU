AUTOSAR XML (schema 00048)
package /ActiveEcuC
  module config PduR: implementation-config-variant=VARIANT-PRE-COMPILE, module-description=PduR_Impl
    PduRGeneral:
      PduRDevErrorDetect = true
      PduRVersionInfoApi = false
      PduRMetaDataSupport = false
      PduRPduCallback = false
      PduRSwitching = false
      PduRSafeBswChecks = false
      PduREnableDeferredTransmission = false
      PduREnableDeferredReception = false
      PduRSupportMulticore = false
      PduRRoutingTypeGateway = false
      PduRSpinlockRetryCounter = 4294967295
      PduRExtendedErrorChecks = false
      PduRGeneration:
        PduROutOfBoundsWriteProtectionStrategy = NONE
        PduROutOfBoundsWriteSanitizer = false
        PduROutOfBoundsReadSanitizer = false
        PduRNumericalDataTypeMinimizationStrategy = WITH_CAST
        PduRReduceConstantData2Define = false
        PduRBoolDataInArrayOfStructStrategy = BITMASKING
        PduRDeduplicateIndirectedData = true
        PduRDataDeduplicationStrategy = WITH_CAST
        PduRReduceBoolDataByNegationThreshold = 2
        PduRReduceBoolDataByNumericalComparisonThreshold = 2
        PduRReduceBoolDataByNumericalRelationThreshold = 2
        PduRReduceBoolDataByNumericalOperandStrategy = WITH_ANY_VALUE
        PduRReduceNumericalDataByOffsetThreshold = 2
        PduRReduceNumericalDataByArraySubtractionThreshold = 2
        PduRReduceDataByStreaming = false
        PduRShortSymbols = false
        PduRInterfacesForDeactivatedData = false
        PduRReferringKeysInComments = false
    PduRRoutingTables: PduRConfigurationId=0
      PduRRoutingTable
        23 x PduRRoutingPath, all with PduRMulticoreRoutingPath=false, PduRLockRef=PduRLock_PduRExclusiveArea:
          VcuRxMsg1_oTC37X_VCU_CAN00_4589bbed_Rx: PduRRoutingPathCommunicationType=COMMUNICATION_INTERFACE
            VcuRxMsg1_oTC37X_VCU_CAN00_4589bbed_Rx_6711bd67_Rx (PduRDestPdu):
              PduRDestPduHandleId = 0
              PduRDestPduDirection = RECEIVE
              PduRDestPduRoutingType = API_FORWARDING
              PduRDestPduDataProcessing = IMMEDIATE
              PduRPduLengthHandlingStrategy = IGNORE
              PduRDestPduCrossPartitionDestination = false
              PduRTransmissionConfirmation = false
              PduRDestPduRef = VcuRxMsg1_oTC37X_VCU_CAN00_78805594_Rx
              PduRDestPduPduRBswModulesRef = Com
            PduRSrcPdu_6711bd67 (PduRSrcPdu): PduRSourcePduHandleId=0, PduRSrcPduDirection=RECEIVE, PduRSrcPduRef=VcuRxMsg1_oTC37X_VCU_CAN00_4589bbed_Rx, PduRSrcPduPduRBswModulesRef=CanIf
          VcuTxMsg1_oTC37X_VCU_CAN00_954a27ee_Tx: PduRRoutingPathCommunicationType=COMMUNICATION_INTERFACE
            PduRSrcPdu_91d52164 (PduRSrcPdu): PduRSourcePduHandleId=10, PduRSrcPduDirection=TRANSMIT, PduRSrcPduRef=VcuTxMsg1_oTC37X_VCU_CAN00_954a27ee_Tx, PduRSrcPduPduRBswModulesRef=Com
            VcuTxMsg1_oTC37X_VCU_CAN00_c82dd125_Tx (PduRDestPdu):
              PduRDestPduHandleId = 10
              PduRDestPduDirection = TRANSMIT
              PduRDestPduRoutingType = API_FORWARDING
              PduRDestPduDataProcessing = IMMEDIATE
              PduRPduLengthHandlingStrategy = IGNORE
              PduRDestPduCrossPartitionDestination = false
              PduRTransmissionConfirmation = false
              PduRDestPduDataProvision = PDUR_DIRECT
              PduRDestPduRef = VcuTxMsg1_oTC37X_VCU_CAN00_c82dd125_Tx
              PduRDestPduPduRBswModulesRef = CanIf
          VcuTxMsg2_oTC37X_VCU_CAN00_7fccfa8c_Tx: PduRRoutingPathCommunicationType=COMMUNICATION_INTERFACE
            PduRSrcPdu_69924b1b (PduRSrcPdu): PduRSourcePduHandleId=11, PduRSrcPduDirection=TRANSMIT, PduRSrcPduRef=VcuTxMsg2_oTC37X_VCU_CAN00_7fccfa8c_Tx, PduRSrcPduPduRBswModulesRef=Com
            VcuTxMsg2_oTC37X_VCU_CAN00_0119ca28_Tx (PduRDestPdu):
              PduRDestPduHandleId = 11
              PduRDestPduDirection = TRANSMIT
              PduRDestPduRoutingType = API_FORWARDING
              PduRDestPduDataProcessing = IMMEDIATE
              PduRPduLengthHandlingStrategy = IGNORE
              PduRDestPduCrossPartitionDestination = false
              PduRTransmissionConfirmation = false
              PduRDestPduDataProvision = PDUR_DIRECT
              PduRDestPduRef = VcuTxMsg2_oTC37X_VCU_CAN00_0119ca28_Tx
              PduRDestPduPduRBswModulesRef = CanIf
          VcuRxMsg2_oTC37X_VCU_CAN00_8cbda0e0_Rx: PduRRoutingPathCommunicationType=COMMUNICATION_INTERFACE
            PduRSrcPdu_803efadc (PduRSrcPdu): PduRSourcePduHandleId=1, PduRSrcPduDirection=RECEIVE, PduRSrcPduRef=VcuRxMsg2_oTC37X_VCU_CAN00_8cbda0e0_Rx, PduRSrcPduPduRBswModulesRef=CanIf
            VcuRxMsg2_oTC37X_VCU_CAN00_8cbda0e0_Rx_803efadc_Rx (PduRDestPdu):
              PduRDestPduHandleId = 1
              PduRDestPduDirection = RECEIVE
              PduRDestPduRoutingType = API_FORWARDING
              PduRDestPduDataProcessing = IMMEDIATE
              PduRPduLengthHandlingStrategy = IGNORE
              PduRDestPduCrossPartitionDestination = false
              PduRTransmissionConfirmation = false
              PduRDestPduRef = VcuRxMsg2_oTC37X_VCU_CAN00_920688f6_Rx
              PduRDestPduPduRBswModulesRef = Com
          Vcu_Uds_Func_Request_oTC37X_VCU_CAN00_455d4346_Rx: PduRRoutingPathCommunicationType=TRANSPORT_PROTOCOL
            PduRSrcPdu_4bac36fb (PduRSrcPdu):
              PduRSourcePduHandleId = 0
              PduRSrcPduDirection = RECEIVE
              PduRSrcPduRef = Vcu_Uds_Func_Request_oTC37X_VCU_CAN00_455d4346_Rx
              PduRSrcPduPduRBswModulesRef = CanTp
            Vcu_Uds_Func_Request_oTC37X_VCU_CAN00_455d4346_Rx_4bac36fb_Rx (PduRDestPdu):
              PduRDestPduHandleId = 0
              PduRDestPduDirection = RECEIVE
              PduRDestPduRoutingType = API_FORWARDING
              PduRDestPduDataProcessing = IMMEDIATE
              PduRPduLengthHandlingStrategy = UNUSED
              PduRDestPduCrossPartitionDestination = false
              PduRDestPduRef = Vcu_Uds_Func_Request_oTC37X_VCU_CAN00_21e26bac_Rx
              PduRDestPduPduRBswModulesRef = Dcm
          Vcu_Uds_Phy_Request_oTC37X_VCU_CAN00_16119f6f_Rx: PduRRoutingPathCommunicationType=TRANSPORT_PROTOCOL
            PduRSrcPdu_925fbf89 (PduRSrcPdu):
              PduRSourcePduHandleId = 1
              PduRSrcPduDirection = RECEIVE
              PduRSrcPduRef = Vcu_Uds_Phy_Request_oTC37X_VCU_CAN00_16119f6f_Rx
              PduRSrcPduPduRBswModulesRef = CanTp
            Vcu_Uds_Phy_Request_oTC37X_VCU_CAN00_16119f6f_Rx_925fbf89_Rx (PduRDestPdu):
              PduRDestPduHandleId = 1
              PduRDestPduDirection = RECEIVE
              PduRDestPduRoutingType = API_FORWARDING
              PduRDestPduDataProcessing = IMMEDIATE
              PduRPduLengthHandlingStrategy = UNUSED
              PduRDestPduCrossPartitionDestination = false
              PduRDestPduRef = Vcu_Uds_Phy_Request_oTC37X_VCU_CAN00_d561dcee_Rx
              PduRDestPduPduRBswModulesRef = Dcm
          Vcu_Uds_Response_oTC37X_VCU_CAN00_4d111be6_Tx: PduRRoutingPathCommunicationType=TRANSPORT_PROTOCOL
            Vcu_Uds_Response_oTC37X_VCU_CAN00_39638a1a_Tx (PduRDestPdu):
              PduRDestPduHandleId = 0
              PduRDestPduDirection = TRANSMIT
              PduRDestPduRoutingType = API_FORWARDING
              PduRDestPduDataProcessing = IMMEDIATE
              PduRPduLengthHandlingStrategy = UNUSED
              PduRDestPduCrossPartitionDestination = false
              PduRDestPduRef = Vcu_Uds_Response_oTC37X_VCU_CAN00_39638a1a_Tx
              PduRDestPduPduRBswModulesRef = CanTp
            PduRSrcPdu_1a8748e9 (PduRSrcPdu):
              PduRSourcePduHandleId = 14
              PduRSrcPduDirection = TRANSMIT
              PduRSrcPduRef = Vcu_Uds_Response_oTC37X_VCU_CAN00_4d111be6_Tx
              PduRSrcPduPduRBswModulesRef = Dcm
          VcuRxMsg4_oTC37X_VCU_CAN01_55be06ba_Rx: PduRRoutingPathCommunicationType=COMMUNICATION_INTERFACE
            VcuRxMsg4_oTC37X_VCU_CAN01_55be06ba_Rx_f5b46736_Rx (PduRDestPdu):
              PduRDestPduHandleId = 3
              PduRDestPduDirection = RECEIVE
              PduRDestPduRoutingType = API_FORWARDING
              PduRDestPduDataProcessing = IMMEDIATE
              PduRPduLengthHandlingStrategy = IGNORE
              PduRDestPduCrossPartitionDestination = false
              PduRTransmissionConfirmation = false
              PduRDestPduRef = VcuRxMsg4_oTC37X_VCU_CAN01_eb7d04e5_Rx
              PduRDestPduPduRBswModulesRef = Com
            PduRSrcPdu_f5b46736 (PduRSrcPdu): PduRSourcePduHandleId=3, PduRSrcPduDirection=RECEIVE, PduRSrcPduRef=VcuRxMsg4_oTC37X_VCU_CAN01_55be06ba_Rx, PduRSrcPduPduRBswModulesRef=CanIf
          VcuAdcTxMsg2_oTC37X_VCU_CAN01_1723c88c_Tx: PduRRoutingPathCommunicationType=COMMUNICATION_INTERFACE
            VcuAdcTxMsg2_oTC37X_VCU_CAN01_afb1dcb2_Tx (PduRDestPdu):
              PduRDestPduHandleId = 1
              PduRDestPduDirection = TRANSMIT
              PduRDestPduRoutingType = API_FORWARDING
              PduRDestPduDataProcessing = IMMEDIATE
              PduRPduLengthHandlingStrategy = IGNORE
              PduRDestPduCrossPartitionDestination = false
              PduRDestPduDataProvision = PDUR_DIRECT
              PduRTransmissionConfirmation = false
              PduRDestPduRef = VcuAdcTxMsg2_oTC37X_VCU_CAN01_afb1dcb2_Tx
              PduRDestPduPduRBswModulesRef = CanIf
            PduRSrcPdu_df42a212 (PduRSrcPdu): PduRSourcePduHandleId=1, PduRSrcPduDirection=TRANSMIT, PduRSrcPduRef=VcuAdcTxMsg2_oTC37X_VCU_CAN01_1723c88c_Tx, PduRSrcPduPduRBswModulesRef=Com
          VcuAdcTxMsg1_oTC37X_VCU_CAN01_fda515ee_Tx: PduRRoutingPathCommunicationType=COMMUNICATION_INTERFACE
            PduRSrcPdu_f8c9b934 (PduRSrcPdu): PduRSourcePduHandleId=0, PduRSrcPduDirection=TRANSMIT, PduRSrcPduRef=VcuAdcTxMsg1_oTC37X_VCU_CAN01_fda515ee_Tx, PduRSrcPduPduRBswModulesRef=Com
            VcuAdcTxMsg1_oTC37X_VCU_CAN01_6685c7bf_Tx (PduRDestPdu):
              PduRDestPduHandleId = 0
              PduRDestPduDirection = TRANSMIT
              PduRDestPduRoutingType = API_FORWARDING
              PduRDestPduDataProcessing = IMMEDIATE
              PduRPduLengthHandlingStrategy = IGNORE
              PduRDestPduCrossPartitionDestination = false
              PduRDestPduDataProvision = PDUR_DIRECT
              PduRTransmissionConfirmation = false
              PduRDestPduRef = VcuAdcTxMsg1_oTC37X_VCU_CAN01_6685c7bf_Tx
              PduRDestPduPduRBswModulesRef = CanIf
          VcuRxMsg3_oTC37X_VCU_CAN01_5bb4c01a_Rx: PduRRoutingPathCommunicationType=COMMUNICATION_INTERFACE
            PduRSrcPdu_3905054b (PduRSrcPdu): PduRSourcePduHandleId=2, PduRSrcPduDirection=RECEIVE, PduRSrcPduRef=VcuRxMsg3_oTC37X_VCU_CAN01_5bb4c01a_Rx, PduRSrcPduPduRBswModulesRef=CanIf
            VcuRxMsg3_oTC37X_VCU_CAN01_5bb4c01a_Rx_3905054b_Rx (PduRDestPdu):
              PduRDestPduHandleId = 2
              PduRDestPduDirection = RECEIVE
              PduRDestPduRoutingType = API_FORWARDING
              PduRDestPduDataProcessing = IMMEDIATE
              PduRPduLengthHandlingStrategy = IGNORE
              PduRDestPduCrossPartitionDestination = false
              PduRTransmissionConfirmation = false
              PduRDestPduRef = VcuRxMsg3_oTC37X_VCU_CAN01_0a530e81_Rx
              PduRDestPduPduRBswModulesRef = Com
          Vcu_Lin0_TxMsg1_oLIN00_f39ae32f_Tx: PduRRoutingPathCommunicationType=COMMUNICATION_INTERFACE
            Vcu_Lin0_TxMsg1_oLIN00_db48db31_Tx (PduRDestPdu):
              PduRDestPduHandleId = 12
              PduRDestPduDirection = TRANSMIT
              PduRDestPduRoutingType = API_FORWARDING
              PduRDestPduDataProcessing = IMMEDIATE
              PduRPduLengthHandlingStrategy = IGNORE
              PduRDestPduCrossPartitionDestination = false
              PduRTransmissionConfirmation = false
              PduRDestPduDataProvision = PDUR_TRIGGERTRANSMIT
              PduRDestPduRef = Vcu_Lin0_TxMsg1_oLIN00_db48db31_Tx
              PduRDestPduPduRBswModulesRef = LinIf
            PduRSrcPdu_af3681f0 (PduRSrcPdu): PduRSourcePduHandleId=12, PduRSrcPduDirection=TRANSMIT, PduRSrcPduRef=Vcu_Lin0_TxMsg1_oLIN00_f39ae32f_Tx, PduRSrcPduPduRBswModulesRef=Com
          Vcu_Lin0_RxMsg2_oLIN00_a811ec42_Rx: PduRRoutingPathCommunicationType=COMMUNICATION_INTERFACE
            PduRSrcPdu_c59add12 (PduRSrcPdu): PduRSourcePduHandleId=5, PduRSrcPduDirection=RECEIVE, PduRSrcPduRef=Vcu_Lin0_RxMsg2_oLIN00_a811ec42_Rx, PduRSrcPduPduRBswModulesRef=LinIf
            Vcu_Lin0_RxMsg2_oLIN00_a811ec42_Rx_c59add12_Rx (PduRDestPdu):
              PduRDestPduHandleId = 5
              PduRDestPduDirection = RECEIVE
              PduRDestPduRoutingType = API_FORWARDING
              PduRDestPduDataProcessing = IMMEDIATE
              PduRPduLengthHandlingStrategy = IGNORE
              PduRDestPduCrossPartitionDestination = false
              PduRTransmissionConfirmation = false
              PduRDestPduRef = Vcu_Lin0_RxMsg2_oLIN00_ddf03b11_Rx
              PduRDestPduPduRBswModulesRef = Com
          Vcu_Lin0_TxMsg2_oLIN00_7d15e4cc_Tx: PduRRoutingPathCommunicationType=COMMUNICATION_INTERFACE
            PduRSrcPdu_a77b2a3a (PduRSrcPdu): PduRSourcePduHandleId=13, PduRSrcPduDirection=TRANSMIT, PduRSrcPduRef=Vcu_Lin0_TxMsg2_oLIN00_7d15e4cc_Tx, PduRSrcPduPduRBswModulesRef=Com
            Vcu_Lin0_TxMsg2_oLIN00_adade20c_Tx (PduRDestPdu):
              PduRDestPduHandleId = 13
              PduRDestPduDirection = TRANSMIT
              PduRDestPduRoutingType = API_FORWARDING
              PduRDestPduDataProcessing = IMMEDIATE
              PduRPduLengthHandlingStrategy = IGNORE
              PduRDestPduCrossPartitionDestination = false
              PduRDestPduDataProvision = PDUR_TRIGGERTRANSMIT
              PduRTransmissionConfirmation = false
              PduRDestPduRef = Vcu_Lin0_TxMsg2_oLIN00_adade20c_Tx
              PduRDestPduPduRBswModulesRef = LinIf
          Vcu_Lin0_RxMsg1_oLIN00_def4d57f_Rx: PduRRoutingPathCommunicationType=COMMUNICATION_INTERFACE
            Vcu_Lin0_RxMsg1_oLIN00_def4d57f_Rx_763211c2_Rx (PduRDestPdu):
              PduRDestPduHandleId = 4
              PduRDestPduDirection = RECEIVE
              PduRDestPduRoutingType = API_FORWARDING
              PduRDestPduDataProcessing = IMMEDIATE
              PduRPduLengthHandlingStrategy = IGNORE
              PduRDestPduCrossPartitionDestination = false
              PduRTransmissionConfirmation = false
              PduRDestPduRef = Vcu_Lin0_RxMsg1_oLIN00_537f3cf2_Rx
              PduRDestPduPduRBswModulesRef = Com
            PduRSrcPdu_763211c2 (PduRSrcPdu): PduRSourcePduHandleId=4, PduRSrcPduDirection=RECEIVE, PduRSrcPduRef=Vcu_Lin0_RxMsg1_oLIN00_def4d57f_Rx, PduRSrcPduPduRBswModulesRef=LinIf
          VcuTxIoMsg1_oTC37X_VCU_CAN00_54884add_Tx: PduRRoutingPathCommunicationType=COMMUNICATION_INTERFACE
            PduRSrcPdu_96b222db (PduRSrcPdu): PduRSourcePduHandleId=2, PduRSrcPduDirection=TRANSMIT, PduRSrcPduRef=VcuTxIoMsg1_oTC37X_VCU_CAN00_54884add_Tx, PduRSrcPduPduRBswModulesRef=Com
            VcuTxIoMsg1_oTC37X_VCU_CAN00_869e33bc_Tx (PduRDestPdu):
              PduRDestPduHandleId = 2
              PduRDestPduDirection = TRANSMIT
              PduRDestPduRoutingType = API_FORWARDING
              PduRDestPduDataProcessing = IMMEDIATE
              PduRPduLengthHandlingStrategy = IGNORE
              PduRDestPduCrossPartitionDestination = false
              PduRDestPduDataProvision = PDUR_DIRECT
              PduRTransmissionConfirmation = false
              PduRDestPduRef = VcuTxIoMsg1_oTC37X_VCU_CAN00_869e33bc_Tx
              PduRDestPduPduRBswModulesRef = CanIf
          VcuTxIoMsg2_oTC37X_VCU_CAN00_be0e97bf_Tx: PduRRoutingPathCommunicationType=COMMUNICATION_INTERFACE
            VcuTxIoMsg2_oTC37X_VCU_CAN00_4faa28b1_Tx (PduRDestPdu):
              PduRDestPduHandleId = 3
              PduRDestPduDirection = TRANSMIT
              PduRDestPduRoutingType = API_FORWARDING
              PduRDestPduDataProcessing = IMMEDIATE
              PduRPduLengthHandlingStrategy = IGNORE
              PduRDestPduCrossPartitionDestination = false
              PduRTransmissionConfirmation = false
              PduRDestPduDataProvision = PDUR_DIRECT
              PduRDestPduRef = VcuTxIoMsg2_oTC37X_VCU_CAN00_4faa28b1_Tx
              PduRDestPduPduRBswModulesRef = CanIf
            PduRSrcPdu_3ef2d11c (PduRSrcPdu): PduRSourcePduHandleId=3, PduRSrcPduDirection=TRANSMIT, PduRSrcPduRef=VcuTxIoMsg2_oTC37X_VCU_CAN00_be0e97bf_Tx, PduRSrcPduPduRBswModulesRef=Com
          VcuTxIoMsg4_oTC37X_VCU_CAN00_b0722b3a_Tx: PduRRoutingPathCommunicationType=COMMUNICATION_INTERFACE
            VcuTxIoMsg4_oTC37X_VCU_CAN00_06b318ea_Tx (PduRDestPdu):
              PduRDestPduHandleId = 5
              PduRDestPduDirection = TRANSMIT
              PduRDestPduRoutingType = API_FORWARDING
              PduRDestPduDataProcessing = IMMEDIATE
              PduRPduLengthHandlingStrategy = IGNORE
              PduRDestPduCrossPartitionDestination = false
              PduRDestPduDataProvision = PDUR_DIRECT
              PduRTransmissionConfirmation = false
              PduRDestPduRef = VcuTxIoMsg4_oTC37X_VCU_CAN00_06b318ea_Tx
              PduRDestPduPduRBswModulesRef = CanIf
            PduRSrcPdu_15ef524a (PduRSrcPdu): PduRSourcePduHandleId=5, PduRSrcPduDirection=TRANSMIT, PduRSrcPduRef=VcuTxIoMsg4_oTC37X_VCU_CAN00_b0722b3a_Tx, PduRSrcPduPduRBswModulesRef=Com
          VcuTxIoMsg6_oTC37X_VCU_CAN00_b5a640b9_Tx: PduRRoutingPathCommunicationType=COMMUNICATION_INTERFACE
            VcuTxIoMsg6_oTC37X_VCU_CAN00_8894f51c_Tx (PduRDestPdu):
              PduRDestPduHandleId = 7
              PduRDestPduDirection = TRANSMIT
              PduRDestPduRoutingType = API_FORWARDING
              PduRDestPduDataProcessing = IMMEDIATE
              PduRPduLengthHandlingStrategy = IGNORE
              PduRDestPduCrossPartitionDestination = false
              PduRTransmissionConfirmation = false
              PduRDestPduDataProvision = PDUR_DIRECT
              PduRDestPduRef = VcuTxIoMsg6_oTC37X_VCU_CAN00_8894f51c_Tx
              PduRDestPduPduRBswModulesRef = CanIf
            PduRSrcPdu_275934e8 (PduRSrcPdu): PduRSourcePduHandleId=7, PduRSrcPduDirection=TRANSMIT, PduRSrcPduRef=VcuTxIoMsg6_oTC37X_VCU_CAN00_b5a640b9_Tx, PduRSrcPduPduRBswModulesRef=Com
          VcuTxIoMsg5_oTC37X_VCU_CAN00_5f209ddb_Tx: PduRRoutingPathCommunicationType=COMMUNICATION_INTERFACE
            VcuTxIoMsg5_oTC37X_VCU_CAN00_41a0ee11_Tx (PduRDestPdu):
              PduRDestPduHandleId = 6
              PduRDestPduDirection = TRANSMIT
              PduRDestPduRoutingType = API_FORWARDING
              PduRDestPduDataProcessing = IMMEDIATE
              PduRPduLengthHandlingStrategy = IGNORE
              PduRDestPduCrossPartitionDestination = false
              PduRDestPduDataProvision = PDUR_DIRECT
              PduRTransmissionConfirmation = false
              PduRDestPduRef = VcuTxIoMsg5_oTC37X_VCU_CAN00_41a0ee11_Tx
              PduRDestPduPduRBswModulesRef = CanIf
            PduRSrcPdu_886ac60a (PduRSrcPdu): PduRSourcePduHandleId=6, PduRSrcPduDirection=TRANSMIT, PduRSrcPduRef=VcuTxIoMsg5_oTC37X_VCU_CAN00_5f209ddb_Tx, PduRSrcPduPduRBswModulesRef=Com
          VcuTxIoMsg3_oTC37X_VCU_CAN00_515c215e_Tx: PduRRoutingPathCommunicationType=COMMUNICATION_INTERFACE
            PduRSrcPdu_23c89b9b (PduRSrcPdu): PduRSourcePduHandleId=4, PduRSrcPduDirection=TRANSMIT, PduRSrcPduRef=VcuTxIoMsg3_oTC37X_VCU_CAN00_515c215e_Tx, PduRSrcPduPduRBswModulesRef=Com
            VcuTxIoMsg3_oTC37X_VCU_CAN00_08b9de4a_Tx (PduRDestPdu):
              PduRDestPduHandleId = 4
              PduRDestPduDirection = TRANSMIT
              PduRDestPduRoutingType = API_FORWARDING
              PduRDestPduDataProcessing = IMMEDIATE
              PduRPduLengthHandlingStrategy = IGNORE
              PduRDestPduCrossPartitionDestination = false
              PduRDestPduDataProvision = PDUR_DIRECT
              PduRTransmissionConfirmation = false
              PduRDestPduRef = VcuTxIoMsg3_oTC37X_VCU_CAN00_08b9de4a_Tx
              PduRDestPduPduRBswModulesRef = CanIf
          VcuTxIoMsg8_oTC37X_VCU_CAN00_ac8b5230_Tx: PduRRoutingPathCommunicationType=COMMUNICATION_INTERFACE
            PduRSrcPdu_27dcf988 (PduRSrcPdu): PduRSourcePduHandleId=9, PduRSrcPduDirection=TRANSMIT, PduRSrcPduRef=VcuTxIoMsg8_oTC37X_VCU_CAN00_ac8b5230_Tx, PduRSrcPduPduRBswModulesRef=Com
            VcuTxIoMsg8_oTC37X_VCU_CAN00_9481785c_Tx (PduRDestPdu):
              PduRDestPduHandleId = 9
              PduRDestPduDirection = TRANSMIT
              PduRDestPduRoutingType = API_FORWARDING
              PduRDestPduDataProcessing = IMMEDIATE
              PduRPduLengthHandlingStrategy = IGNORE
              PduRDestPduCrossPartitionDestination = false
              PduRDestPduDataProvision = PDUR_DIRECT
              PduRTransmissionConfirmation = false
              PduRDestPduRef = VcuTxIoMsg8_oTC37X_VCU_CAN00_9481785c_Tx
              PduRDestPduPduRBswModulesRef = CanIf
          VcuTxIoMsg7_oTC37X_VCU_CAN00_5af4f658_Tx: PduRRoutingPathCommunicationType=COMMUNICATION_INTERFACE
            VcuTxIoMsg7_oTC37X_VCU_CAN00_cf8703e7_Tx (PduRDestPdu):
              PduRDestPduHandleId = 8
              PduRDestPduDirection = TRANSMIT
              PduRDestPduRoutingType = API_FORWARDING
              PduRDestPduDataProcessing = IMMEDIATE
              PduRPduLengthHandlingStrategy = IGNORE
              PduRDestPduCrossPartitionDestination = false
              PduRDestPduDataProvision = PDUR_DIRECT
              PduRTransmissionConfirmation = false
              PduRDestPduRef = VcuTxIoMsg7_oTC37X_VCU_CAN00_cf8703e7_Tx
              PduRDestPduPduRBswModulesRef = CanIf
            PduRSrcPdu_8c9b3cfc (PduRSrcPdu): PduRSourcePduHandleId=8, PduRSrcPduDirection=TRANSMIT, PduRSrcPduRef=VcuTxIoMsg7_oTC37X_VCU_CAN00_5af4f658_Tx, PduRSrcPduPduRBswModulesRef=Com
      PduRLock_PduRExclusiveArea (PduRLock)
        PduRExclusiveArea: PduRExclusiveAreaId=0
    5 x PduRBswModules, all with PduRCancelReceive=false, PduRChangeParameterRequestApi=false:
      CanIf: PduRCancelTransmit=false, PduRCommunicationInterface=true, PduRLowerModule=true, PduRTransportProtocol=false, PduRTriggertransmit=false, PduRTxConfirmation=false, PduRUpperModule=false, PduRUseTag=false, PduRBswModuleRef=CanIf
      Com: PduRCancelTransmit=false, PduRCommunicationInterface=true, PduRLowerModule=false, PduRTransportProtocol=false, PduRTriggertransmit=true, PduRTxConfirmation=false, PduRUpperModule=true, PduRUseTag=false, PduRBswModuleRef=Com
      Dcm: PduRCancelTransmit=true, PduRCommunicationInterface=false, PduRLowerModule=false, PduRTransportProtocol=true, PduRTriggertransmit=false, PduRTxConfirmation=false, PduRUpperModule=true, PduRUseTag=true, PduRBswModuleRef=Dcm
      CanTp: PduRCancelTransmit=true, PduRCommunicationInterface=false, PduRLowerModule=true, PduRTransportProtocol=true, PduRTriggertransmit=false, PduRTxConfirmation=false, PduRUpperModule=false, PduRUseTag=false, PduRBswModuleRef=CanTp
      LinIf: PduRCancelTransmit=false, PduRCommunicationInterface=true, PduRLowerModule=true, PduRTransportProtocol=false, PduRTriggertransmit=true, PduRTxConfirmation=true, PduRUpperModule=false, PduRUseTag=false, PduRBswModuleRef=LinIf
