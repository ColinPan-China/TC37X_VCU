AUTOSAR XML (schema 00048)
package /ActiveEcuC
  module config BswM: implementation-config-variant=VARIANT-PRE-COMPILE, module-description=BswM_Impl
    BswMGeneral:
      BswMCanSMEnabled = true
      BswMComMEnabled = true
      BswMDcmEnabled = true
      BswMDevErrorDetect = false
      BswMEcuMEnabled = true
      BswMEthIfEnabled = false
      BswMEthSMEnabled = false
      BswMFrSMEnabled = false
      BswMGenericRequestEnabled = true
      BswMJ1939DcmEnabled = false
      BswMJ1939NmEnabled = false
      BswMLinSMEnabled = true
      BswMLinTPEnabled = false
      BswMNmEnabled = true
      BswMNvMEnabled = true
      BswMPduREnabled = false
      BswMRuleControlEnabled = false
      BswMSdEnabled = false
      BswMVersionInfoApi = false
      BswMWdgMEnabled = false
      BswMModeCheck = true
      BswMActionListQueueSearchAlgorithm = LINEAR_SEARCH
      BswMSafeBswChecks = false
      BswMMainFunctionPeriod = 0.01
      BswMCommonData
      BswMGeneration:
        BswMOutOfBoundsWriteSanitizer = false
        BswMOutOfBoundsReadSanitizer = false
        BswMReduceConstantData2Define = true
        BswMBoolDataInArrayOfStructStrategy = BITMASKING
        BswMInterfacesForDeactivatedData = false
    BswMConfig
      BswMArbitration
        ESH_RunToPostRun (BswMRule):
          BswMNestedExecutionOnly = false
          BswMRuleId = 37
          BswMRuleInitState = BSWM_FALSE
          BswMRuleExpressionRef = ESH_LE_RunToPostRunTransition
          BswMRuleTrueActionList = ESH_AL_ExitRun
        ESH_LE_RunToPostRunTransition (BswMLogicalExpression): BswMLogicalOperator=BSWM_AND, BswMArgumentRef=ESH_LE_RunReached, BswMArgumentRef=ESH_LE_NoRunAndNoKillAllRequest
        ESH_LE_RunReached (BswMLogicalExpression): BswMLogicalOperator=BSWM_AND, BswMArgumentRef=ESH_Cond_StateIsRun, BswMArgumentRef=ESH_Cond_ModeIsRun
        ESH_Cond_StateIsRun (BswMModeCondition): BswMConditionType=BSWM_EQUALS, BswMConditionMode=ESH_State
          BswMConditionValue
            BswMBswMode: BswMBswRequestedMode=ESH_RUN
        ESH_State (BswMModeRequestPort): BswMArbitrateOnInit=true, BswMRequestProcessing=BSWM_IMMEDIATE
          BswMModeRequestSource
            BswMGenericRequest: BswMModeRequesterId=230, BswMRequestedModeMax=7
              7 x BswMGenericRequestMode:
                ESH_INIT: BswMGenericRequestModeValue=0
                ESH_RUN: BswMGenericRequestModeValue=1
                ESH_POST_RUN: BswMGenericRequestModeValue=2
                ESH_PREP_SHUTDOWN: BswMGenericRequestModeValue=3
                ESH_WAIT_FOR_NVM: BswMGenericRequestModeValue=4
                ESH_SHUTDOWN: BswMGenericRequestModeValue=5
                ESH_WAKEUP: BswMGenericRequestModeValue=6
          BswMModeInitValue
            BswMBswModeInitValue: BswMBswModeInitValueMode=ESH_INIT
        3 x BswMLogicalExpression:
          ESH_LE_NoRunAndNoKillAllRequest: BswMLogicalOperator=BSWM_OR, BswMArgumentRef=ESH_LE_NoRunReasons
          ESH_LE_NoRunReasons: BswMLogicalOperator=BSWM_AND, BswMArgumentRef=ESH_LE_AllChannelsNoCom, BswMArgumentRef=ESH_LE_RunReleased, BswMArgumentRef=ESH_Cond_SelfRunReqTimerExpired
          ESH_LE_RunReleased: BswMLogicalOperator=BSWM_AND, BswMArgumentRef=ESH_Cond_RunRequest0IsReleased, BswMArgumentRef=ESH_Cond_RunRequest1IsReleased
        ESH_Cond_RunRequest0IsReleased (BswMModeCondition): BswMConditionType=BSWM_EQUALS, BswMConditionMode=ESH_RunRequest_0
          BswMConditionValue
            BswMModeDeclaration: BswMModeValueRef=RELEASED
        ESH_RunRequest_0 (BswMModeRequestPort): BswMArbitrateOnInit=false, BswMRequestProcessing=BSWM_DEFERRED
          BswMModeRequestSource
            BswMSwcModeRequest: BswMModeRequestDataElementPrototypeName=requestedMode, BswMSwcModeRequestModeDeclarationGroupPrototypeRef=BswM_MDGP_ESH_RunRequest
          BswMModeInitValue
            BswMSwcModeInitValue: BswMSwcModeInitValueRef=RELEASED
        ESH_Cond_RunRequest1IsReleased (BswMModeCondition): BswMConditionType=BSWM_EQUALS, BswMConditionMode=ESH_RunRequest_1
          BswMConditionValue
            BswMModeDeclaration: BswMModeValueRef=RELEASED
        ESH_RunRequest_1 (BswMModeRequestPort): BswMArbitrateOnInit=false, BswMRequestProcessing=BSWM_DEFERRED
          BswMModeRequestSource
            BswMSwcModeRequest: BswMModeRequestDataElementPrototypeName=requestedMode, BswMSwcModeRequestModeDeclarationGroupPrototypeRef=BswM_MDGP_ESH_RunRequest
          BswMModeInitValue
            BswMSwcModeInitValue: BswMSwcModeInitValueRef=RELEASED
        ESH_Cond_SelfRunReqTimerExpired (BswMModeCondition): BswMConditionType=BSWM_EQUALS, BswMConditionMode=ESH_SelfRunRequestTimer
          BswMConditionValue
            BswMBswMode: BswMBswRequestedMode=BSWM_TIMER_EXPIRED
        ESH_SelfRunRequestTimer (BswMModeRequestPort): BswMArbitrateOnInit=false, BswMRequestProcessing=BSWM_DEFERRED
          BswMModeRequestSource
            BswMTimer
          BswMModeInitValue
            BswMBswModeInitValue: BswMBswModeInitValueMode=BSWM_TIMER_STOPPED
        ESH_WaitToShutdown (BswMRule):
          BswMNestedExecutionOnly = false
          BswMRuleId = 39
          BswMRuleInitState = BSWM_FALSE
          BswMRuleExpressionRef = ESH_LE_WaitForNvMToShutdown
          BswMRuleTrueActionList = ESH_AL_WaitForNvMToShutdown
        ESH_LE_WaitForNvMToShutdown (BswMLogicalExpression):
          BswMLogicalOperator = BSWM_AND
          BswMArgumentRef = ESH_Cond_StateIsWaitForNvm
          BswMArgumentRef = ESH_LE_WriteNotPending
          BswMArgumentRef = ESH_LE_NoWakeupOrKillAll
        ESH_Cond_StateIsWaitForNvm (BswMModeCondition): BswMConditionType=BSWM_EQUALS, BswMConditionMode=ESH_State
          BswMConditionValue
            BswMBswMode: BswMBswRequestedMode=ESH_WAIT_FOR_NVM
        ESH_LE_NoWakeupOrKillAll (BswMLogicalExpression): BswMLogicalOperator=BSWM_OR, BswMArgumentRef=ESH_LE_NoWakeup
        ESH_LE_NoWakeup (BswMLogicalExpression): BswMLogicalOperator=BSWM_AND, BswMArgumentRef=ESH_Cond_NoValidatedWakeups, BswMArgumentRef=ESH_Cond_ComMNoPendingRequests
        ESH_Cond_NoValidatedWakeups (BswMModeCondition): BswMConditionType=BSWM_EQUALS, BswMConditionMode=ESH_EcuM_GetValidatedWakeupEvents
          BswMConditionValue
            BswMBswMode: BswMBswRequestedMode=0
        ESH_EcuM_GetValidatedWakeupEvents (BswMModeRequestPort): BswMArbitrateOnInit=false, BswMRequestProcessing=BSWM_DEFERRED
          BswMModeRequestSource
            BswMUserConditionRequest: BswMUserCondition=EcuM_GetValidatedWakeupEvents()
        ESH_WakeupToPrep (BswMRule):
          BswMNestedExecutionOnly = false
          BswMRuleId = 41
          BswMRuleInitState = BSWM_FALSE
          BswMRuleExpressionRef = ESH_LE_WakeupToPrepShutdown
          BswMRuleTrueActionList = ESH_AL_WakeupToPrep
        ESH_LE_WakeupToPrepShutdown (BswMLogicalExpression):
          BswMLogicalOperator = BSWM_AND
          BswMArgumentRef = ESH_Cond_StateIsWakeup
          BswMArgumentRef = ESH_LE_CancelNotPending
          BswMArgumentRef = ESH_Cond_NoPendingWakeups
          BswMArgumentRef = ESH_LE_NoWakeup
          BswMArgumentRef = ESH_Cond_ModeIsWakeup
        ESH_Cond_StateIsWakeup (BswMModeCondition): BswMConditionType=BSWM_EQUALS, BswMConditionMode=ESH_State
          BswMConditionValue
            BswMBswMode: BswMBswRequestedMode=ESH_WAKEUP
        ESH_Cond_NoPendingWakeups (BswMModeCondition): BswMConditionType=BSWM_EQUALS, BswMConditionMode=ESH_EcuM_GetPendingWakeupEvents
          BswMConditionValue
            BswMBswMode: BswMBswRequestedMode=0
        ESH_EcuM_GetPendingWakeupEvents (BswMModeRequestPort): BswMArbitrateOnInit=false, BswMRequestProcessing=BSWM_DEFERRED
          BswMModeRequestSource
            BswMUserConditionRequest: BswMUserCondition=EcuM_GetPendingWakeupEvents()
        ESH_WaitToWakeup (BswMRule):
          BswMNestedExecutionOnly = false
          BswMRuleId = 40
          BswMRuleInitState = BSWM_FALSE
          BswMRuleExpressionRef = ESH_LE_WaitForNvMToWakeup
          BswMRuleTrueActionList = ESH_AL_WaitForNvMWakeup
        ESH_LE_WaitForNvMToWakeup (BswMLogicalExpression): BswMLogicalOperator=BSWM_AND, BswMArgumentRef=ESH_Cond_StateIsWaitForNvm, BswMArgumentRef=ESH_LE_ValidWakeup
        ESH_LE_ValidWakeup (BswMLogicalExpression): BswMLogicalOperator=BSWM_OR, BswMArgumentRef=ESH_Cond_ValidatedWakeups, BswMArgumentRef=ESH_Cond_ComMPendingRequests
        ESH_Cond_ValidatedWakeups (BswMModeCondition): BswMConditionType=BSWM_EQUALS_NOT, BswMConditionMode=ESH_EcuM_GetValidatedWakeupEvents
          BswMConditionValue
            BswMBswMode: BswMBswRequestedMode=0
        ESH_WakeupToRun (BswMRule):
          BswMNestedExecutionOnly = false
          BswMRuleId = 42
          BswMRuleInitState = BSWM_FALSE
          BswMRuleExpressionRef = ESH_LE_WakeupToRun
          BswMRuleTrueActionList = ESH_AL_WakeupToRun
        ESH_LE_WakeupToRun (BswMLogicalExpression):
          BswMLogicalOperator = BSWM_AND
          BswMArgumentRef = ESH_Cond_StateIsWakeup
          BswMArgumentRef = ESH_LE_ValidWakeup
          BswMArgumentRef = ESH_LE_CancelNotPending
          BswMArgumentRef = ESH_Cond_ModeIsWakeup
        ESH_InitToWakeup (BswMRule):
          BswMNestedExecutionOnly = false
          BswMRuleId = 32
          BswMRuleInitState = BSWM_FALSE
          BswMRuleExpressionRef = ESH_LE_InitToWakeup
          BswMRuleTrueActionList = ESH_AL_InitToWakeup
        ESH_LE_InitToWakeup (BswMLogicalExpression): BswMLogicalOperator=BSWM_AND, BswMArgumentRef=ESH_Cond_StateIsInit
        ESH_Cond_StateIsInit (BswMModeCondition): BswMConditionType=BSWM_EQUALS, BswMConditionMode=ESH_State
          BswMConditionValue
            BswMBswMode: BswMBswRequestedMode=ESH_INIT
        ESH_PostRunToPrepNested (BswMRule):
          BswMNestedExecutionOnly = true
          BswMRuleId = 35
          BswMRuleInitState = BSWM_FALSE
          BswMRuleExpressionRef = ESH_LE_Dem_PostRunRequested
          BswMRuleTrueActionList = ESH_AL_PostRunToPrepShutdown
        3 x BswMLogicalExpression:
          ESH_LE_Dem_PostRunRequested: BswMLogicalOperator=BSWM_AND, BswMArgumentRef=ESH_LE_PostRunToPrep, BswMArgumentRef=ESH_Cond_DemPostRunRequested
          ESH_LE_PostRunToPrep: BswMLogicalOperator=BSWM_OR, BswMArgumentRef=ESH_LE_PostRunReleased
          ESH_LE_PostRunReleased: BswMLogicalOperator=BSWM_AND, BswMArgumentRef=ESH_Cond_PostRunRequest0IsReleased, BswMArgumentRef=ESH_Cond_PostRunRequest1IsReleased
        ESH_Cond_PostRunRequest0IsReleased (BswMModeCondition): BswMConditionType=BSWM_EQUALS, BswMConditionMode=ESH_PostRunRequest_0
          BswMConditionValue
            BswMModeDeclaration: BswMModeValueRef=RELEASED
        ESH_PostRunRequest_0 (BswMModeRequestPort): BswMArbitrateOnInit=false, BswMRequestProcessing=BSWM_DEFERRED
          BswMModeRequestSource
            BswMSwcModeRequest: BswMModeRequestDataElementPrototypeName=requestedMode, BswMSwcModeRequestModeDeclarationGroupPrototypeRef=BswM_MDGP_ESH_RunRequest
          BswMModeInitValue
            BswMSwcModeInitValue: BswMSwcModeInitValueRef=RELEASED
        ESH_Cond_PostRunRequest1IsReleased (BswMModeCondition): BswMConditionType=BSWM_EQUALS, BswMConditionMode=ESH_PostRunRequest_1
          BswMConditionValue
            BswMModeDeclaration: BswMModeValueRef=RELEASED
        ESH_PostRunRequest_1 (BswMModeRequestPort): BswMArbitrateOnInit=false, BswMRequestProcessing=BSWM_DEFERRED
          BswMModeRequestSource
            BswMSwcModeRequest: BswMModeRequestDataElementPrototypeName=requestedMode, BswMSwcModeRequestModeDeclarationGroupPrototypeRef=BswM_MDGP_ESH_RunRequest
          BswMModeInitValue
            BswMSwcModeInitValue: BswMSwcModeInitValueRef=RELEASED
        ESH_PostRunNested (BswMRule):
          BswMNestedExecutionOnly = true
          BswMRuleId = 34
          BswMRuleInitState = BSWM_FALSE
          BswMRuleExpressionRef = ESH_LE_PostRunToRun
          BswMRuleFalseActionList = ESH_AL_ESH_PostRunToPrepCheck
          BswMRuleTrueActionList = ESH_AL_PostRunToRun
        3 x BswMLogicalExpression:
          ESH_LE_PostRunToRun: BswMLogicalOperator=BSWM_AND, BswMArgumentRef=ESH_LE_RunRequestsOrWakeup
          ESH_LE_RunRequestsOrWakeup: BswMLogicalOperator=BSWM_OR, BswMArgumentRef=ESH_LE_RunRequested, BswMArgumentRef=ESH_LE_ValidWakeup
          ESH_LE_RunRequested: BswMLogicalOperator=BSWM_OR, BswMArgumentRef=ESH_Cond_RunRequest0IsRequested, BswMArgumentRef=ESH_Cond_RunRequest1IsRequested
        ESH_Cond_RunRequest0IsRequested (BswMModeCondition): BswMConditionType=BSWM_EQUALS, BswMConditionMode=ESH_RunRequest_0
          BswMConditionValue
            BswMModeDeclaration: BswMModeValueRef=REQUESTED
        ESH_Cond_RunRequest1IsRequested (BswMModeCondition): BswMConditionType=BSWM_EQUALS, BswMConditionMode=ESH_RunRequest_1
          BswMConditionValue
            BswMModeDeclaration: BswMModeValueRef=REQUESTED
        ESH_PostRun (BswMRule):
          BswMNestedExecutionOnly = false
          BswMRuleId = 33
          BswMRuleInitState = BSWM_FALSE
          BswMRuleExpressionRef = ESH_LE_PostRun
          BswMRuleTrueActionList = ESH_AL_ExitPostRun
        ESH_LE_PostRun (BswMLogicalExpression): BswMLogicalOperator=BSWM_AND, BswMArgumentRef=ESH_Cond_StateIsPostRun, BswMArgumentRef=ESH_Cond_ModeIsPostRun
        ESH_Cond_StateIsPostRun (BswMModeCondition): BswMConditionType=BSWM_EQUALS, BswMConditionMode=ESH_State
          BswMConditionValue
            BswMBswMode: BswMBswRequestedMode=ESH_POST_RUN
        ESH_PrepToWait (BswMRule):
          BswMNestedExecutionOnly = false
          BswMRuleId = 36
          BswMRuleInitState = BSWM_FALSE
          BswMRuleExpressionRef = ESH_LE_PrepShutdownToWaitForNvM
          BswMRuleTrueActionList = ESH_AL_PrepShutdownToWaitForNvM
        ESH_LE_PrepShutdownToWaitForNvM (BswMLogicalExpression): BswMLogicalOperator=BSWM_AND, BswMArgumentRef=ESH_Cond_StateIsPrepShutdown, BswMArgumentRef=ESH_Cond_ModeIsShutdown
        ESH_Cond_StateIsPrepShutdown (BswMModeCondition): BswMConditionType=BSWM_EQUALS, BswMConditionMode=ESH_State
          BswMConditionValue
            BswMBswMode: BswMBswRequestedMode=ESH_PREP_SHUTDOWN
        ESH_Cond_ModeIsRun (BswMModeCondition): BswMConditionType=BSWM_EQUALS, BswMConditionMode=ESH_ModeNotification
          BswMConditionValue
            BswMModeDeclaration: BswMModeValueRef=RUN
        ESH_ModeNotification (BswMModeRequestPort): BswMArbitrateOnInit=false, BswMRequestProcessing=BSWM_DEFERRED
          BswMModeRequestSource
            BswMSwcModeNotification: BswMSwcModeNotificationModeDeclarationGroupPrototypeRef=BswM_MDGP_ESH_Mode
          BswMModeInitValue
            BswMSwcModeInitValue: BswMSwcModeInitValueRef=STARTUP
        3 x BswMModeCondition, all with BswMConditionType=BSWM_EQUALS, BswMConditionMode=ESH_ModeNotification:
          ESH_Cond_ModeIsWakeup
            BswMConditionValue
              BswMModeDeclaration: BswMModeValueRef=WAKEUP
          ESH_Cond_ModeIsPostRun
            BswMConditionValue
              BswMModeDeclaration: BswMModeValueRef=POSTRUN
          ESH_Cond_ModeIsShutdown
            BswMConditionValue
              BswMModeDeclaration: BswMModeValueRef=SHUTDOWN
        CC_CN_TC37X_VCU_CAN00_07b6c9c8_TX_DISABLE (BswMRule):
          BswMNestedExecutionOnly = false
          BswMRuleId = 15
          BswMRuleInitState = BSWM_FALSE
          BswMRuleExpressionRef = CC_LE_CN_TC37X_VCU_CAN00_07b6c9c8_TX_DISABLE
          BswMRuleTrueActionList = CC_AL_CN_TC37X_VCU_CAN00_07b6c9c8_TX_Disable
        CC_LE_CN_TC37X_VCU_CAN00_07b6c9c8_TX_DISABLE (BswMLogicalExpression):
          BswMLogicalOperator = BSWM_OR
          BswMArgumentRef = CC_Cond_CanSMIndication_CN_TC37X_VCU_CAN00_07b6c9c8_NEQ_CANSM_BSWM_FULL_COMMUNICATION
          BswMArgumentRef = CC_Cond_NmIndication_CN_TC37X_VCU_CAN00_07b6c9c8_EQ_NM_STATE_BUS_SLEEP
          BswMArgumentRef = CC_Cond_NmIndication_CN_TC37X_VCU_CAN00_07b6c9c8_EQ_NM_STATE_PREPARE_BUS_SLEEP
          BswMArgumentRef = CC_Cond_DcmComIndication_CN_TC37X_VCU_CAN00_07b6c9c8_EQ_DCM_ENABLE_RX_DISABLE_TX_NORM
          BswMArgumentRef = CC_Cond_DcmComIndication_CN_TC37X_VCU_CAN00_07b6c9c8_EQ_DCM_DISABLE_RX_TX_NORMAL
          BswMArgumentRef = CC_Cond_DcmComIndication_CN_TC37X_VCU_CAN00_07b6c9c8_EQ_DCM_ENABLE_RX_DISABLE_TX_NM
          BswMArgumentRef = CC_Cond_DcmComIndication_CN_TC37X_VCU_CAN00_07b6c9c8_EQ_DCM_DISABLE_RX_TX_NM
          BswMArgumentRef = CC_Cond_DcmComIndication_CN_TC37X_VCU_CAN00_07b6c9c8_EQ_DCM_ENABLE_RX_DISABLE_TX_NORM_NM
          BswMArgumentRef = CC_Cond_DcmComIndication_CN_TC37X_VCU_CAN00_07b6c9c8_EQ_DCM_DISABLE_RX_TX_NORM_NM
        CC_Cond_CanSMIndication_CN_TC37X_VCU_CAN00_07b6c9c8_NEQ_CANSM_BSWM_FULL_COMMUNICATION (BswMModeCondition): BswMConditionType=BSWM_EQUALS_NOT, BswMConditionMode=CC_CanSMIndication_CN_TC37X_VCU_CAN00_07b6c9c8
          BswMConditionValue
            BswMBswMode: BswMBswRequestedMode=CANSM_BSWM_FULL_COMMUNICATION
        CC_CanSMIndication_CN_TC37X_VCU_CAN00_07b6c9c8 (BswMModeRequestPort): BswMArbitrateOnInit=false, BswMRequestProcessing=BSWM_IMMEDIATE
          BswMModeRequestSource
            BswMCanSMIndication: BswMCanSMChannelRef=CN_TC37X_VCU_CAN00_07b6c9c8
          BswMModeInitValue
            BswMBswModeInitValue: BswMBswModeInitValueMode=CANSM_BSWM_NO_COMMUNICATION
        CC_Cond_NmIndication_CN_TC37X_VCU_CAN00_07b6c9c8_EQ_NM_STATE_BUS_SLEEP (BswMModeCondition): BswMConditionType=BSWM_EQUALS, BswMConditionMode=CC_NmIndication_CN_TC37X_VCU_CAN00_07b6c9c8
          BswMConditionValue
            BswMBswMode: BswMBswRequestedMode=NM_STATE_BUS_SLEEP
        CC_NmIndication_CN_TC37X_VCU_CAN00_07b6c9c8 (BswMModeRequestPort): BswMArbitrateOnInit=false, BswMRequestProcessing=BSWM_IMMEDIATE
          BswMModeRequestSource
            BswMNmIndication: BswMNmChannelRef=CN_TC37X_VCU_CAN00_07b6c9c8
          BswMModeInitValue
            BswMBswModeInitValue: BswMBswModeInitValueMode=NM_STATE_BUS_SLEEP
        CC_Cond_NmIndication_CN_TC37X_VCU_CAN00_07b6c9c8_EQ_NM_STATE_PREPARE_BUS_SLEEP (BswMModeCondition): BswMConditionType=BSWM_EQUALS, BswMConditionMode=CC_NmIndication_CN_TC37X_VCU_CAN00_07b6c9c8
          BswMConditionValue
            BswMBswMode: BswMBswRequestedMode=NM_STATE_PREPARE_BUS_SLEEP
        CC_CN_TC37X_VCU_CAN00_07b6c9c8_RX (BswMRule):
          BswMNestedExecutionOnly = false
          BswMRuleId = 13
          BswMRuleInitState = BSWM_FALSE
          BswMRuleExpressionRef = CC_LE_CN_TC37X_VCU_CAN00_07b6c9c8_RX
          BswMRuleFalseActionList = CC_AL_CN_TC37X_VCU_CAN00_07b6c9c8_RX_Disable
          BswMRuleTrueActionList = CC_AL_CN_TC37X_VCU_CAN00_07b6c9c8_RX_EnableReinit
        CC_LE_CN_TC37X_VCU_CAN00_07b6c9c8_RX (BswMLogicalExpression):
          BswMLogicalOperator = BSWM_AND
          BswMArgumentRef = CC_Cond_CanSMIndication_CN_TC37X_VCU_CAN00_07b6c9c8_NEQ_CANSM_BSWM_NO_COMMUNICATION
          BswMArgumentRef = CC_Cond_DcmComIndication_CN_TC37X_VCU_CAN00_07b6c9c8_NEQ_DCM_DISABLE_RX_ENABLE_TX_NORM
          BswMArgumentRef = CC_Cond_DcmComIndication_CN_TC37X_VCU_CAN00_07b6c9c8_NEQ_DCM_DISABLE_RX_TX_NORMAL
          BswMArgumentRef = CC_Cond_DcmComIndication_CN_TC37X_VCU_CAN00_07b6c9c8_NEQ_DCM_DISABLE_RX_ENABLE_TX_NM
          BswMArgumentRef = CC_Cond_DcmComIndication_CN_TC37X_VCU_CAN00_07b6c9c8_NEQ_DCM_DISABLE_RX_TX_NM
          BswMArgumentRef = CC_Cond_DcmComIndication_CN_TC37X_VCU_CAN00_07b6c9c8_NEQ_DCM_DISABLE_RX_ENABLE_TX_NORM_NM
          BswMArgumentRef = CC_Cond_DcmComIndication_CN_TC37X_VCU_CAN00_07b6c9c8_NEQ_DCM_DISABLE_RX_TX_NORM_NM
        CC_Cond_CanSMIndication_CN_TC37X_VCU_CAN00_07b6c9c8_NEQ_CANSM_BSWM_NO_COMMUNICATION (BswMModeCondition): BswMConditionType=BSWM_EQUALS_NOT, BswMConditionMode=CC_CanSMIndication_CN_TC37X_VCU_CAN00_07b6c9c8
          BswMConditionValue
            BswMBswMode: BswMBswRequestedMode=CANSM_BSWM_NO_COMMUNICATION
        CC_CN_TC37X_VCU_CAN00_07b6c9c8_TX_ENABLE (BswMRule):
          BswMNestedExecutionOnly = false
          BswMRuleId = 16
          BswMRuleInitState = BSWM_FALSE
          BswMRuleExpressionRef = CC_LE_CN_TC37X_VCU_CAN00_07b6c9c8_TX_ENABLE_REINIT
          BswMRuleTrueActionList = CC_AL_CN_TC37X_VCU_CAN00_07b6c9c8_TX_EnableReinit
        CC_LE_CN_TC37X_VCU_CAN00_07b6c9c8_TX_ENABLE_REINIT (BswMLogicalExpression):
          BswMLogicalOperator = BSWM_AND
          BswMArgumentRef = CC_Cond_CanSMIndication_CN_TC37X_VCU_CAN00_07b6c9c8_EQ_CANSM_BSWM_FULL_COMMUNICATION
          BswMArgumentRef = CC_Cond_NmIndication_CN_TC37X_VCU_CAN00_07b6c9c8_NEQ_NM_STATE_BUS_SLEEP
          BswMArgumentRef = CC_Cond_NmIndication_CN_TC37X_VCU_CAN00_07b6c9c8_NEQ_NM_STATE_PREPARE_BUS_SLEEP
          BswMArgumentRef = CC_Cond_Generic_BusOff_CN_TC37X_VCU_CAN00_07b6c9c8_EQ_NO_COM
          BswMArgumentRef = CC_Cond_DcmComIndication_CN_TC37X_VCU_CAN00_07b6c9c8_NEQ_DCM_ENABLE_RX_DISABLE_TX_NORM
          BswMArgumentRef = CC_Cond_DcmComIndication_CN_TC37X_VCU_CAN00_07b6c9c8_NEQ_DCM_DISABLE_RX_TX_NORMAL
          BswMArgumentRef = CC_Cond_DcmComIndication_CN_TC37X_VCU_CAN00_07b6c9c8_NEQ_DCM_ENABLE_RX_DISABLE_TX_NM
          BswMArgumentRef = CC_Cond_DcmComIndication_CN_TC37X_VCU_CAN00_07b6c9c8_NEQ_DCM_DISABLE_RX_TX_NM
          BswMArgumentRef = CC_Cond_DcmComIndication_CN_TC37X_VCU_CAN00_07b6c9c8_NEQ_DCM_ENABLE_RX_DISABLE_TX_NORM_NM
          BswMArgumentRef = CC_Cond_DcmComIndication_CN_TC37X_VCU_CAN00_07b6c9c8_NEQ_DCM_DISABLE_RX_TX_NORM_NM
        4 x BswMModeCondition:
          CC_Cond_CanSMIndication_CN_TC37X_VCU_CAN00_07b6c9c8_EQ_CANSM_BSWM_FULL_COMMUNICATION: BswMConditionType=BSWM_EQUALS, BswMConditionMode=CC_CanSMIndication_CN_TC37X_VCU_CAN00_07b6c9c8
            BswMConditionValue
              BswMBswMode: BswMBswRequestedMode=CANSM_BSWM_FULL_COMMUNICATION
          CC_Cond_NmIndication_CN_TC37X_VCU_CAN00_07b6c9c8_NEQ_NM_STATE_BUS_SLEEP: BswMConditionType=BSWM_EQUALS_NOT, BswMConditionMode=CC_NmIndication_CN_TC37X_VCU_CAN00_07b6c9c8
            BswMConditionValue
              BswMBswMode: BswMBswRequestedMode=NM_STATE_BUS_SLEEP
          CC_Cond_NmIndication_CN_TC37X_VCU_CAN00_07b6c9c8_NEQ_NM_STATE_PREPARE_BUS_SLEEP: BswMConditionType=BSWM_EQUALS_NOT, BswMConditionMode=CC_NmIndication_CN_TC37X_VCU_CAN00_07b6c9c8
            BswMConditionValue
              BswMBswMode: BswMBswRequestedMode=NM_STATE_PREPARE_BUS_SLEEP
          CC_Cond_Generic_BusOff_CN_TC37X_VCU_CAN00_07b6c9c8_EQ_NO_COM: BswMConditionType=BSWM_EQUALS, BswMConditionMode=CC_Generic_BusOff_CN_TC37X_VCU_CAN00_07b6c9c8
            BswMConditionValue
              BswMBswMode: BswMBswRequestedMode=NO_COM
        CC_Generic_BusOff_CN_TC37X_VCU_CAN00_07b6c9c8 (BswMModeRequestPort): BswMArbitrateOnInit=false, BswMRequestProcessing=BSWM_IMMEDIATE
          BswMModeRequestSource
            BswMGenericRequest: BswMModeRequesterId=242, BswMRequestedModeMax=2
              NO_COM (BswMGenericRequestMode): BswMGenericRequestModeValue=0
              BUSOFF_SILENT (BswMGenericRequestMode): BswMGenericRequestModeValue=1
          BswMModeInitValue
            BswMBswModeInitValue: BswMBswModeInitValueMode=NO_COM
        CC_CN_TC37X_VCU_CAN00_07b6c9c8_TX_ENABLE_BUSOFF (BswMRule):
          BswMNestedExecutionOnly = false
          BswMRuleId = 17
          BswMRuleInitState = BSWM_FALSE
          BswMRuleExpressionRef = CC_LE_CN_TC37X_VCU_CAN00_07b6c9c8_TX_ENABLE
          BswMRuleTrueActionList = CC_AL_CN_TC37X_VCU_CAN00_07b6c9c8_TX_EnableNoinit
        CC_LE_CN_TC37X_VCU_CAN00_07b6c9c8_TX_ENABLE (BswMLogicalExpression):
          BswMLogicalOperator = BSWM_AND
          BswMArgumentRef = CC_Cond_CanSMIndication_CN_TC37X_VCU_CAN00_07b6c9c8_EQ_CANSM_BSWM_FULL_COMMUNICATION
          BswMArgumentRef = CC_Cond_NmIndication_CN_TC37X_VCU_CAN00_07b6c9c8_NEQ_NM_STATE_BUS_SLEEP
          BswMArgumentRef = CC_Cond_NmIndication_CN_TC37X_VCU_CAN00_07b6c9c8_NEQ_NM_STATE_PREPARE_BUS_SLEEP
          BswMArgumentRef = CC_Cond_Generic_BusOff_CN_TC37X_VCU_CAN00_07b6c9c8_EQ_BUSOFF_SILENT
          BswMArgumentRef = CC_Cond_DcmComIndication_CN_TC37X_VCU_CAN00_07b6c9c8_NEQ_DCM_ENABLE_RX_DISABLE_TX_NORM
          BswMArgumentRef = CC_Cond_DcmComIndication_CN_TC37X_VCU_CAN00_07b6c9c8_NEQ_DCM_DISABLE_RX_TX_NORMAL
          BswMArgumentRef = CC_Cond_DcmComIndication_CN_TC37X_VCU_CAN00_07b6c9c8_NEQ_DCM_ENABLE_RX_DISABLE_TX_NM
          BswMArgumentRef = CC_Cond_DcmComIndication_CN_TC37X_VCU_CAN00_07b6c9c8_NEQ_DCM_DISABLE_RX_TX_NM
          BswMArgumentRef = CC_Cond_DcmComIndication_CN_TC37X_VCU_CAN00_07b6c9c8_NEQ_DCM_ENABLE_RX_DISABLE_TX_NORM_NM
          BswMArgumentRef = CC_Cond_DcmComIndication_CN_TC37X_VCU_CAN00_07b6c9c8_NEQ_DCM_DISABLE_RX_TX_NORM_NM
        CC_Cond_Generic_BusOff_CN_TC37X_VCU_CAN00_07b6c9c8_EQ_BUSOFF_SILENT (BswMModeCondition): BswMConditionType=BSWM_EQUALS, BswMConditionMode=CC_Generic_BusOff_CN_TC37X_VCU_CAN00_07b6c9c8
          BswMConditionValue
            BswMBswMode: BswMBswRequestedMode=BUSOFF_SILENT
        CC_CN_TC37X_VCU_CAN00_07b6c9c8_NO_COM (BswMRule):
          BswMNestedExecutionOnly = false
          BswMRuleId = 12
          BswMRuleInitState = BSWM_TRUE
          BswMRuleExpressionRef = CC_LE_CanSMIndication_CN_TC37X_VCU_CAN00_07b6c9c8_EQ_CANSM_BSWM_NO_COMMUNICATION
          BswMRuleTrueActionList = CC_AL_CN_TC37X_VCU_CAN00_07b6c9c8_NO_COM
        CC_LE_CanSMIndication_CN_TC37X_VCU_CAN00_07b6c9c8_EQ_CANSM_BSWM_NO_COMMUNICATION (BswMLogicalExpression): BswMLogicalOperator=BSWM_AND, BswMArgumentRef=CC_Cond_CanSMIndication_CN_TC37X_VCU_CAN00_07b6c9c8_EQ_CANSM_BSWM_NO_COMMUNICATION
        CC_Cond_CanSMIndication_CN_TC37X_VCU_CAN00_07b6c9c8_EQ_CANSM_BSWM_NO_COMMUNICATION (BswMModeCondition): BswMConditionType=BSWM_EQUALS, BswMConditionMode=CC_CanSMIndication_CN_TC37X_VCU_CAN00_07b6c9c8
          BswMConditionValue
            BswMBswMode: BswMBswRequestedMode=CANSM_BSWM_NO_COMMUNICATION
        CC_CN_TC37X_VCU_CAN00_07b6c9c8_BUSOFF_SILENT (BswMRule):
          BswMNestedExecutionOnly = false
          BswMRuleId = 11
          BswMRuleInitState = BSWM_FALSE
          BswMRuleExpressionRef = CC_LE_CanSMIndication_CN_TC37X_VCU_CAN00_07b6c9c8_BUSOFF_SILENT
          BswMRuleTrueActionList = CC_AL_CN_TC37X_VCU_CAN00_07b6c9c8_BUSOFF_SILENT
        CC_LE_CanSMIndication_CN_TC37X_VCU_CAN00_07b6c9c8_BUSOFF_SILENT (BswMLogicalExpression):
          BswMLogicalOperator = BSWM_OR
          BswMArgumentRef = CC_Cond_CanSMIndication_CN_TC37X_VCU_CAN00_07b6c9c8_EQ_CANSM_BSWM_BUS_OFF
          BswMArgumentRef = CC_Cond_CanSMIndication_CN_TC37X_VCU_CAN00_07b6c9c8_EQ_CANSM_BSWM_SILENT_COMMUNICATION
        CC_Cond_CanSMIndication_CN_TC37X_VCU_CAN00_07b6c9c8_EQ_CANSM_BSWM_BUS_OFF (BswMModeCondition): BswMConditionType=BSWM_EQUALS, BswMConditionMode=CC_CanSMIndication_CN_TC37X_VCU_CAN00_07b6c9c8
          BswMConditionValue
            BswMBswMode: BswMBswRequestedMode=CANSM_BSWM_BUS_OFF
        CC_Cond_CanSMIndication_CN_TC37X_VCU_CAN00_07b6c9c8_EQ_CANSM_BSWM_SILENT_COMMUNICATION (BswMModeCondition): BswMConditionType=BSWM_EQUALS, BswMConditionMode=CC_CanSMIndication_CN_TC37X_VCU_CAN00_07b6c9c8
          BswMConditionValue
            BswMBswMode: BswMBswRequestedMode=CANSM_BSWM_SILENT_COMMUNICATION
        CC_CN_TC37X_VCU_CAN00_07b6c9c8_RX_DM (BswMRule):
          BswMNestedExecutionOnly = false
          BswMRuleId = 14
          BswMRuleInitState = BSWM_FALSE
          BswMRuleExpressionRef = CC_LE_CN_TC37X_VCU_CAN00_07b6c9c8_RX_DM
          BswMRuleFalseActionList = CC_AL_CN_TC37X_VCU_CAN00_07b6c9c8_Disable_DM
          BswMRuleTrueActionList = CC_AL_CN_TC37X_VCU_CAN00_07b6c9c8_Enable_DM
        CC_LE_CN_TC37X_VCU_CAN00_07b6c9c8_RX_DM (BswMLogicalExpression):
          BswMLogicalOperator = BSWM_AND
          BswMArgumentRef = CC_Cond_CanSMIndication_CN_TC37X_VCU_CAN00_07b6c9c8_EQ_CANSM_BSWM_FULL_COMMUNICATION
          BswMArgumentRef = CC_Cond_DcmComIndication_CN_TC37X_VCU_CAN00_07b6c9c8_NEQ_DCM_DISABLE_RX_ENABLE_TX_NORM
          BswMArgumentRef = CC_Cond_DcmComIndication_CN_TC37X_VCU_CAN00_07b6c9c8_NEQ_DCM_DISABLE_RX_TX_NORMAL
          BswMArgumentRef = CC_Cond_DcmComIndication_CN_TC37X_VCU_CAN00_07b6c9c8_NEQ_DCM_DISABLE_RX_ENABLE_TX_NM
          BswMArgumentRef = CC_Cond_DcmComIndication_CN_TC37X_VCU_CAN00_07b6c9c8_NEQ_DCM_DISABLE_RX_TX_NM
          BswMArgumentRef = CC_Cond_DcmComIndication_CN_TC37X_VCU_CAN00_07b6c9c8_NEQ_DCM_DISABLE_RX_ENABLE_TX_NORM_NM
          BswMArgumentRef = CC_Cond_DcmComIndication_CN_TC37X_VCU_CAN00_07b6c9c8_NEQ_DCM_DISABLE_RX_TX_NORM_NM
        ESH_LE_AllChannelsNoCom (BswMLogicalExpression):
          BswMLogicalOperator = BSWM_AND
          BswMArgumentRef = ESH_Cond_NoComOn_CN_TC37X_VCU_CAN00_07b6c9c8
          BswMArgumentRef = ESH_Cond_NoComOn_CN_TC37X_VCU_CAN01_70b1f95e
          BswMArgumentRef = ESH_Cond_NoComOn_CN_LIN00_b12a0454
          BswMArgumentRef = ESH_Cond_NoComOn_CN_TC37X_VCU_CAN03_9ebf9872
          BswMArgumentRef = ESH_Cond_NoComOn_CN_LIN01_c62d34c2
          BswMArgumentRef = ESH_Cond_NoComOn_CN_ATOM_CANFD_Matrix_CH_V600_202502_a4d436ac
          BswMArgumentRef = ESH_Cond_NoComOn_CN_LIN02_5f246578
          BswMArgumentRef = ESH_Cond_NoComOn_CN_TC37X_VCU_CAN12_XCP_d05a85ac
          BswMArgumentRef = ESH_Cond_NoComOn_CN_ATOM_CAN_Matrix_PT_V600_20250211_9b894f3d
        ESH_Cond_NoComOn_CN_TC37X_VCU_CAN00_07b6c9c8 (BswMModeCondition): BswMConditionType=BSWM_EQUALS, BswMConditionMode=ESH_ComMIndication_CN_TC37X_VCU_CAN00_07b6c9c8
          BswMConditionValue
            BswMBswMode: BswMBswRequestedMode=COMM_NO_COMMUNICATION
        ESH_ComMIndication_CN_TC37X_VCU_CAN00_07b6c9c8 (BswMModeRequestPort): BswMArbitrateOnInit=false, BswMRequestProcessing=BSWM_DEFERRED
          BswMModeRequestSource
            BswMComMIndication: BswMComMChannelRef=CN_TC37X_VCU_CAN00_07b6c9c8
          BswMModeInitValue
            BswMBswModeInitValue: BswMBswModeInitValueMode=COMM_NO_COMMUNICATION
        ESH_RunToPostRunNested (BswMRule):
          BswMNestedExecutionOnly = true
          BswMRuleId = 38
          BswMRuleInitState = BSWM_FALSE
          BswMRuleExpressionRef = ESH_LE_ComMNoPendingRequests
          BswMRuleTrueActionList = ESH_AL_RunToPostRun
        ESH_LE_ComMNoPendingRequests (BswMLogicalExpression): BswMLogicalOperator=BSWM_OR, BswMArgumentRef=ESH_Cond_ComMNoPendingRequests
        ESH_Cond_ComMNoPendingRequests (BswMModeCondition): BswMConditionType=BSWM_EQUALS, BswMConditionMode=ESH_ComMPendingRequests
          BswMConditionValue
            BswMBswMode: BswMBswRequestedMode=ESH_COMM_NO_REQUEST
        ESH_ComMPendingRequests (BswMModeRequestPort): BswMArbitrateOnInit=false, BswMRequestProcessing=BSWM_DEFERRED
          BswMModeRequestSource
            BswMGenericRequest: BswMModeRequesterId=232, BswMRequestedModeMax=2
              ESH_COMM_NO_REQUEST (BswMGenericRequestMode): BswMGenericRequestModeValue=0
              ESH_COMM_PENDING_REQUEST (BswMGenericRequestMode): BswMGenericRequestModeValue=1
          BswMModeInitValue
            BswMBswModeInitValue: BswMBswModeInitValueMode=ESH_COMM_NO_REQUEST
        ESH_Cond_ComMPendingRequests (BswMModeCondition): BswMConditionType=BSWM_EQUALS, BswMConditionMode=ESH_ComMPendingRequests
          BswMConditionValue
            BswMBswMode: BswMBswRequestedMode=ESH_COMM_PENDING_REQUEST
        ESH_LE_WriteNotPending (BswMLogicalExpression): BswMLogicalOperator=BSWM_OR, BswMArgumentRef=ESH_Cond_NvMWAIsNotPending, BswMArgumentRef=ESH_Cond_NvWWriteAllTimerNotRunning
        ESH_Cond_NvMWAIsNotPending (BswMModeCondition): BswMConditionType=BSWM_EQUALS_NOT, BswMConditionMode=ESH_NvMIndication
          BswMConditionValue
            BswMBswMode: BswMBswRequestedMode=NVM_REQ_PENDING
        ESH_NvMIndication (BswMModeRequestPort): BswMArbitrateOnInit=false, BswMRequestProcessing=BSWM_DEFERRED
          BswMModeRequestSource
            BswMNvMJobModeIndication: BswMNvmService=NvmWriteAll
          BswMModeInitValue
            BswMBswModeInitValue: BswMBswModeInitValueMode=NVM_REQ_OK
        ESH_Cond_NvWWriteAllTimerNotRunning (BswMModeCondition): BswMConditionType=BSWM_EQUALS_NOT, BswMConditionMode=ESH_NvM_WriteAllTimer
          BswMConditionValue
            BswMBswMode: BswMBswRequestedMode=BSWM_TIMER_STARTED
        ESH_NvM_WriteAllTimer (BswMModeRequestPort): BswMArbitrateOnInit=false, BswMRequestProcessing=BSWM_DEFERRED
          BswMModeRequestSource
            BswMTimer
          BswMModeInitValue
            BswMBswModeInitValue: BswMBswModeInitValueMode=BSWM_TIMER_STOPPED
        ESH_LE_CancelNotPending (BswMLogicalExpression): BswMLogicalOperator=BSWM_OR, BswMArgumentRef=ESH_Cond_NvMWAIsNotPending, BswMArgumentRef=ESH_Cond_NvWCancelTimerNotRunning
        ESH_Cond_NvWCancelTimerNotRunning (BswMModeCondition): BswMConditionType=BSWM_EQUALS_NOT, BswMConditionMode=ESH_NvM_CancelWriteAllTimer
          BswMConditionValue
            BswMBswMode: BswMBswRequestedMode=BSWM_TIMER_STARTED
        ESH_NvM_CancelWriteAllTimer (BswMModeRequestPort): BswMArbitrateOnInit=false, BswMRequestProcessing=BSWM_DEFERRED
          BswMModeRequestSource
            BswMTimer
          BswMModeInitValue
            BswMBswModeInitValue: BswMBswModeInitValueMode=BSWM_TIMER_STOPPED
        CC_Cond_DcmComIndication_CN_TC37X_VCU_CAN00_07b6c9c8_EQ_DCM_ENABLE_RX_DISABLE_TX_NORM (BswMModeCondition): BswMConditionType=BSWM_EQUALS, BswMConditionMode=CC_DcmComIndication_CN_TC37X_VCU_CAN00_07b6c9c8
          BswMConditionValue
            BswMBswMode: BswMBswRequestedMode=DCM_ENABLE_RX_DISABLE_TX_NORM
        CC_DcmComIndication_CN_TC37X_VCU_CAN00_07b6c9c8 (BswMModeRequestPort): BswMArbitrateOnInit=false, BswMRequestProcessing=BSWM_IMMEDIATE
          BswMModeRequestSource
            BswMDcmComModeRequest: BswMDcmComMChannelRef=CN_TC37X_VCU_CAN00_07b6c9c8
          BswMModeInitValue
            BswMBswModeInitValue: BswMBswModeInitValueMode=DCM_ENABLE_RX_TX_NORM_NM
        14 x BswMModeCondition, all with BswMConditionMode=CC_DcmComIndication_CN_TC37X_VCU_CAN00_07b6c9c8:
          CC_Cond_DcmComIndication_CN_TC37X_VCU_CAN00_07b6c9c8_EQ_DCM_DISABLE_RX_TX_NORMAL: BswMConditionType=BSWM_EQUALS
            BswMConditionValue
              BswMBswMode: BswMBswRequestedMode=DCM_DISABLE_RX_TX_NORMAL
          CC_Cond_DcmComIndication_CN_TC37X_VCU_CAN00_07b6c9c8_EQ_DCM_ENABLE_RX_DISABLE_TX_NM: BswMConditionType=BSWM_EQUALS
            BswMConditionValue
              BswMBswMode: BswMBswRequestedMode=DCM_ENABLE_RX_DISABLE_TX_NM
          CC_Cond_DcmComIndication_CN_TC37X_VCU_CAN00_07b6c9c8_EQ_DCM_DISABLE_RX_TX_NM: BswMConditionType=BSWM_EQUALS
            BswMConditionValue
              BswMBswMode: BswMBswRequestedMode=DCM_DISABLE_RX_TX_NM
          CC_Cond_DcmComIndication_CN_TC37X_VCU_CAN00_07b6c9c8_EQ_DCM_ENABLE_RX_DISABLE_TX_NORM_NM: BswMConditionType=BSWM_EQUALS
            BswMConditionValue
              BswMBswMode: BswMBswRequestedMode=DCM_ENABLE_RX_DISABLE_TX_NORM_NM
          CC_Cond_DcmComIndication_CN_TC37X_VCU_CAN00_07b6c9c8_EQ_DCM_DISABLE_RX_TX_NORM_NM: BswMConditionType=BSWM_EQUALS
            BswMConditionValue
              BswMBswMode: BswMBswRequestedMode=DCM_DISABLE_RX_TX_NORM_NM
          CC_Cond_DcmComIndication_CN_TC37X_VCU_CAN00_07b6c9c8_NEQ_DCM_DISABLE_RX_ENABLE_TX_NORM: BswMConditionType=BSWM_EQUALS_NOT
            BswMConditionValue
              BswMBswMode: BswMBswRequestedMode=DCM_DISABLE_RX_ENABLE_TX_NORM
          CC_Cond_DcmComIndication_CN_TC37X_VCU_CAN00_07b6c9c8_NEQ_DCM_DISABLE_RX_TX_NORMAL: BswMConditionType=BSWM_EQUALS_NOT
            BswMConditionValue
              BswMBswMode: BswMBswRequestedMode=DCM_DISABLE_RX_TX_NORMAL
          CC_Cond_DcmComIndication_CN_TC37X_VCU_CAN00_07b6c9c8_NEQ_DCM_DISABLE_RX_ENABLE_TX_NM: BswMConditionType=BSWM_EQUALS_NOT
            BswMConditionValue
              BswMBswMode: BswMBswRequestedMode=DCM_DISABLE_RX_ENABLE_TX_NM
          CC_Cond_DcmComIndication_CN_TC37X_VCU_CAN00_07b6c9c8_NEQ_DCM_DISABLE_RX_TX_NM: BswMConditionType=BSWM_EQUALS_NOT
            BswMConditionValue
              BswMBswMode: BswMBswRequestedMode=DCM_DISABLE_RX_TX_NM
          CC_Cond_DcmComIndication_CN_TC37X_VCU_CAN00_07b6c9c8_NEQ_DCM_DISABLE_RX_ENABLE_TX_NORM_NM: BswMConditionType=BSWM_EQUALS_NOT
            BswMConditionValue
              BswMBswMode: BswMBswRequestedMode=DCM_DISABLE_RX_ENABLE_TX_NORM_NM
          CC_Cond_DcmComIndication_CN_TC37X_VCU_CAN00_07b6c9c8_NEQ_DCM_DISABLE_RX_TX_NORM_NM: BswMConditionType=BSWM_EQUALS_NOT
            BswMConditionValue
              BswMBswMode: BswMBswRequestedMode=DCM_DISABLE_RX_TX_NORM_NM
          CC_Cond_DcmComIndication_CN_TC37X_VCU_CAN00_07b6c9c8_NEQ_DCM_ENABLE_RX_DISABLE_TX_NORM: BswMConditionType=BSWM_EQUALS_NOT
            BswMConditionValue
              BswMBswMode: BswMBswRequestedMode=DCM_ENABLE_RX_DISABLE_TX_NORM
          CC_Cond_DcmComIndication_CN_TC37X_VCU_CAN00_07b6c9c8_NEQ_DCM_ENABLE_RX_DISABLE_TX_NM: BswMConditionType=BSWM_EQUALS_NOT
            BswMConditionValue
              BswMBswMode: BswMBswRequestedMode=DCM_ENABLE_RX_DISABLE_TX_NM
          CC_Cond_DcmComIndication_CN_TC37X_VCU_CAN00_07b6c9c8_NEQ_DCM_ENABLE_RX_DISABLE_TX_NORM_NM: BswMConditionType=BSWM_EQUALS_NOT
            BswMConditionValue
              BswMBswMode: BswMBswRequestedMode=DCM_ENABLE_RX_DISABLE_TX_NORM_NM
        CC_LE_CN_TC37X_VCU_CAN00_TX_NM_DISABLE (BswMLogicalExpression):
          BswMLogicalOperator = BSWM_OR
          BswMArgumentRef = CC_Cond_DcmComIndication_CN_TC37X_VCU_CAN00_07b6c9c8_EQ_DCM_DISABLE_RX_TX_NM
          BswMArgumentRef = CC_Cond_DcmComIndication_CN_TC37X_VCU_CAN00_07b6c9c8_EQ_DCM_DISABLE_RX_TX_NORM_NM
        CC_CN_TC37X_VCU_CAN00_NM_DISABLE (BswMRule):
          BswMNestedExecutionOnly = false
          BswMRuleId = 18
          BswMRuleInitState = BSWM_FALSE
          BswMRuleExpressionRef = CC_LE_CN_TC37X_VCU_CAN00_TX_NM_DISABLE
          BswMRuleTrueActionList = CC_AL_CN_TC37X_VCU_CAN00_DISABLE_NM
        CC_LE_CN_TC37X_VCU_CAN00_TX_NM_ENABLE (BswMLogicalExpression):
          BswMLogicalOperator = BSWM_AND
          BswMArgumentRef = CC_Cond_CanSMIndication_CN_TC37X_VCU_CAN00_07b6c9c8_EQ_CANSM_BSWM_FULL_COMMUNICATION
          BswMArgumentRef = CC_Cond_NmIndication_CN_TC37X_VCU_CAN00_07b6c9c8_NEQ_NM_STATE_BUS_SLEEP
          BswMArgumentRef = CC_Cond_NmIndication_CN_TC37X_VCU_CAN00_07b6c9c8_NEQ_NM_STATE_PREPARE_BUS_SLEEP
          BswMArgumentRef = CC_Cond_Generic_BusOff_CN_TC37X_VCU_CAN00_07b6c9c8_EQ_BUSOFF_SILENT
          BswMArgumentRef = CC_Cond_DcmComIndication_CN_TC37X_VCU_CAN00_07b6c9c8_NEQ_DCM_ENABLE_RX_DISABLE_TX_NORM
          BswMArgumentRef = CC_Cond_DcmComIndication_CN_TC37X_VCU_CAN00_07b6c9c8_NEQ_DCM_DISABLE_RX_TX_NORMAL
          BswMArgumentRef = CC_Cond_DcmComIndication_CN_TC37X_VCU_CAN00_07b6c9c8_NEQ_DCM_ENABLE_RX_DISABLE_TX_NM
          BswMArgumentRef = CC_Cond_DcmComIndication_CN_TC37X_VCU_CAN00_07b6c9c8_NEQ_DCM_DISABLE_RX_TX_NM
          BswMArgumentRef = CC_Cond_DcmComIndication_CN_TC37X_VCU_CAN00_07b6c9c8_NEQ_DCM_ENABLE_RX_DISABLE_TX_NORM_NM
          BswMArgumentRef = CC_Cond_DcmComIndication_CN_TC37X_VCU_CAN00_07b6c9c8_NEQ_DCM_DISABLE_RX_TX_NORM_NM
        CC_CN_TC37X_VCU_CAN00_NM_ENABLE (BswMRule):
          BswMNestedExecutionOnly = false
          BswMRuleId = 19
          BswMRuleInitState = BSWM_FALSE
          BswMRuleExpressionRef = CC_LE_CN_TC37X_VCU_CAN00_TX_NM_ENABLE
          BswMRuleTrueActionList = CC_AL_CN_TC37X_VCU_CAN00_ENABLE_NM
        CC_CN_TC37X_VCU_CAN01_70b1f95e_RX_DM (BswMRule):
          BswMNestedExecutionOnly = false
          BswMRuleId = 23
          BswMRuleInitState = BSWM_FALSE
          BswMRuleExpressionRef = CC_LE_CN_TC37X_VCU_CAN01_70b1f95e_RX_DM
          BswMRuleFalseActionList = CC_AL_CN_TC37X_VCU_CAN01_70b1f95e_Disable_DM
          BswMRuleTrueActionList = CC_AL_CN_TC37X_VCU_CAN01_70b1f95e_Enable_DM
        CC_LE_CN_TC37X_VCU_CAN01_70b1f95e_RX_DM (BswMLogicalExpression): BswMLogicalOperator=BSWM_AND, BswMArgumentRef=CC_Cond_CanSMIndication_CN_TC37X_VCU_CAN01_70b1f95e_EQ_CANSM_BSWM_FULL_COMMUNICATION
        CC_Cond_CanSMIndication_CN_TC37X_VCU_CAN01_70b1f95e_EQ_CANSM_BSWM_FULL_COMMUNICATION (BswMModeCondition): BswMConditionType=BSWM_EQUALS, BswMConditionMode=CC_CanSMIndication_CN_TC37X_VCU_CAN01_70b1f95e
          BswMConditionValue
            BswMBswMode: BswMBswRequestedMode=CANSM_BSWM_FULL_COMMUNICATION
        CC_CanSMIndication_CN_TC37X_VCU_CAN01_70b1f95e (BswMModeRequestPort): BswMArbitrateOnInit=false, BswMRequestProcessing=BSWM_IMMEDIATE
          BswMModeRequestSource
            BswMCanSMIndication: BswMCanSMChannelRef=CN_TC37X_VCU_CAN01_70b1f95e
          BswMModeInitValue
            BswMBswModeInitValue: BswMBswModeInitValueMode=CANSM_BSWM_NO_COMMUNICATION
        CC_CN_TC37X_VCU_CAN01_70b1f95e_TX_ENABLE (BswMRule):
          BswMNestedExecutionOnly = false
          BswMRuleId = 25
          BswMRuleInitState = BSWM_FALSE
          BswMRuleExpressionRef = CC_LE_CN_TC37X_VCU_CAN01_70b1f95e_TX_ENABLE_REINIT
          BswMRuleTrueActionList = CC_AL_CN_TC37X_VCU_CAN01_70b1f95e_TX_EnableReinit
        CC_LE_CN_TC37X_VCU_CAN01_70b1f95e_TX_ENABLE_REINIT (BswMLogicalExpression):
          BswMLogicalOperator = BSWM_AND
          BswMArgumentRef = CC_Cond_CanSMIndication_CN_TC37X_VCU_CAN01_70b1f95e_EQ_CANSM_BSWM_FULL_COMMUNICATION
          BswMArgumentRef = CC_Cond_Generic_BusOff_CN_TC37X_VCU_CAN01_70b1f95e_EQ_NO_COM
        CC_Cond_Generic_BusOff_CN_TC37X_VCU_CAN01_70b1f95e_EQ_NO_COM (BswMModeCondition): BswMConditionType=BSWM_EQUALS, BswMConditionMode=CC_Generic_BusOff_CN_TC37X_VCU_CAN01_70b1f95e
          BswMConditionValue
            BswMBswMode: BswMBswRequestedMode=NO_COM
        CC_Generic_BusOff_CN_TC37X_VCU_CAN01_70b1f95e (BswMModeRequestPort): BswMArbitrateOnInit=false, BswMRequestProcessing=BSWM_IMMEDIATE
          BswMModeRequestSource
            BswMGenericRequest: BswMModeRequesterId=243, BswMRequestedModeMax=2
              NO_COM (BswMGenericRequestMode): BswMGenericRequestModeValue=0
              BUSOFF_SILENT (BswMGenericRequestMode): BswMGenericRequestModeValue=1
          BswMModeInitValue
            BswMBswModeInitValue: BswMBswModeInitValueMode=NO_COM
        CC_CN_TC37X_VCU_CAN01_70b1f95e_NO_COM (BswMRule):
          BswMNestedExecutionOnly = false
          BswMRuleId = 21
          BswMRuleInitState = BSWM_TRUE
          BswMRuleExpressionRef = CC_LE_CanSMIndication_CN_TC37X_VCU_CAN01_70b1f95e_EQ_CANSM_BSWM_NO_COMMUNICATION
          BswMRuleTrueActionList = CC_AL_CN_TC37X_VCU_CAN01_70b1f95e_NO_COM
        CC_LE_CanSMIndication_CN_TC37X_VCU_CAN01_70b1f95e_EQ_CANSM_BSWM_NO_COMMUNICATION (BswMLogicalExpression): BswMLogicalOperator=BSWM_AND, BswMArgumentRef=CC_Cond_CanSMIndication_CN_TC37X_VCU_CAN01_70b1f95e_EQ_CANSM_BSWM_NO_COMMUNICATION
        CC_Cond_CanSMIndication_CN_TC37X_VCU_CAN01_70b1f95e_EQ_CANSM_BSWM_NO_COMMUNICATION (BswMModeCondition): BswMConditionType=BSWM_EQUALS, BswMConditionMode=CC_CanSMIndication_CN_TC37X_VCU_CAN01_70b1f95e
          BswMConditionValue
            BswMBswMode: BswMBswRequestedMode=CANSM_BSWM_NO_COMMUNICATION
        CC_CN_TC37X_VCU_CAN01_70b1f95e_RX (BswMRule):
          BswMNestedExecutionOnly = false
          BswMRuleId = 22
          BswMRuleInitState = BSWM_FALSE
          BswMRuleExpressionRef = CC_LE_CN_TC37X_VCU_CAN01_70b1f95e_RX
          BswMRuleFalseActionList = CC_AL_CN_TC37X_VCU_CAN01_70b1f95e_RX_Disable
          BswMRuleTrueActionList = CC_AL_CN_TC37X_VCU_CAN01_70b1f95e_RX_EnableReinit
        CC_LE_CN_TC37X_VCU_CAN01_70b1f95e_RX (BswMLogicalExpression): BswMLogicalOperator=BSWM_AND, BswMArgumentRef=CC_Cond_CanSMIndication_CN_TC37X_VCU_CAN01_70b1f95e_NEQ_CANSM_BSWM_NO_COMMUNICATION
        CC_Cond_CanSMIndication_CN_TC37X_VCU_CAN01_70b1f95e_NEQ_CANSM_BSWM_NO_COMMUNICATION (BswMModeCondition): BswMConditionType=BSWM_EQUALS_NOT, BswMConditionMode=CC_CanSMIndication_CN_TC37X_VCU_CAN01_70b1f95e
          BswMConditionValue
            BswMBswMode: BswMBswRequestedMode=CANSM_BSWM_NO_COMMUNICATION
        CC_CN_TC37X_VCU_CAN01_70b1f95e_BUSOFF_SILENT (BswMRule):
          BswMNestedExecutionOnly = false
          BswMRuleId = 20
          BswMRuleInitState = BSWM_FALSE
          BswMRuleExpressionRef = CC_LE_CanSMIndication_CN_TC37X_VCU_CAN01_70b1f95e_BUSOFF_SILENT
          BswMRuleTrueActionList = CC_AL_CN_TC37X_VCU_CAN01_70b1f95e_BUSOFF_SILENT
        CC_LE_CanSMIndication_CN_TC37X_VCU_CAN01_70b1f95e_BUSOFF_SILENT (BswMLogicalExpression):
          BswMLogicalOperator = BSWM_OR
          BswMArgumentRef = CC_Cond_CanSMIndication_CN_TC37X_VCU_CAN01_70b1f95e_EQ_CANSM_BSWM_BUS_OFF
          BswMArgumentRef = CC_Cond_CanSMIndication_CN_TC37X_VCU_CAN01_70b1f95e_EQ_CANSM_BSWM_SILENT_COMMUNICATION
        CC_Cond_CanSMIndication_CN_TC37X_VCU_CAN01_70b1f95e_EQ_CANSM_BSWM_BUS_OFF (BswMModeCondition): BswMConditionType=BSWM_EQUALS, BswMConditionMode=CC_CanSMIndication_CN_TC37X_VCU_CAN01_70b1f95e
          BswMConditionValue
            BswMBswMode: BswMBswRequestedMode=CANSM_BSWM_BUS_OFF
        CC_Cond_CanSMIndication_CN_TC37X_VCU_CAN01_70b1f95e_EQ_CANSM_BSWM_SILENT_COMMUNICATION (BswMModeCondition): BswMConditionType=BSWM_EQUALS, BswMConditionMode=CC_CanSMIndication_CN_TC37X_VCU_CAN01_70b1f95e
          BswMConditionValue
            BswMBswMode: BswMBswRequestedMode=CANSM_BSWM_SILENT_COMMUNICATION
        CC_CN_TC37X_VCU_CAN01_70b1f95e_TX_DISABLE (BswMRule):
          BswMNestedExecutionOnly = false
          BswMRuleId = 24
          BswMRuleInitState = BSWM_FALSE
          BswMRuleExpressionRef = CC_LE_CN_TC37X_VCU_CAN01_70b1f95e_TX_DISABLE
          BswMRuleTrueActionList = CC_AL_CN_TC37X_VCU_CAN01_70b1f95e_TX_Disable
        CC_LE_CN_TC37X_VCU_CAN01_70b1f95e_TX_DISABLE (BswMLogicalExpression): BswMLogicalOperator=BSWM_OR, BswMArgumentRef=CC_Cond_CanSMIndication_CN_TC37X_VCU_CAN01_70b1f95e_NEQ_CANSM_BSWM_FULL_COMMUNICATION
        CC_Cond_CanSMIndication_CN_TC37X_VCU_CAN01_70b1f95e_NEQ_CANSM_BSWM_FULL_COMMUNICATION (BswMModeCondition): BswMConditionType=BSWM_EQUALS_NOT, BswMConditionMode=CC_CanSMIndication_CN_TC37X_VCU_CAN01_70b1f95e
          BswMConditionValue
            BswMBswMode: BswMBswRequestedMode=CANSM_BSWM_FULL_COMMUNICATION
        CC_CN_TC37X_VCU_CAN01_70b1f95e_TX_ENABLE_BUSOFF (BswMRule):
          BswMNestedExecutionOnly = false
          BswMRuleId = 26
          BswMRuleInitState = BSWM_FALSE
          BswMRuleExpressionRef = CC_LE_CN_TC37X_VCU_CAN01_70b1f95e_TX_ENABLE
          BswMRuleTrueActionList = CC_AL_CN_TC37X_VCU_CAN01_70b1f95e_TX_EnableNoinit
        CC_LE_CN_TC37X_VCU_CAN01_70b1f95e_TX_ENABLE (BswMLogicalExpression):
          BswMLogicalOperator = BSWM_AND
          BswMArgumentRef = CC_Cond_CanSMIndication_CN_TC37X_VCU_CAN01_70b1f95e_EQ_CANSM_BSWM_FULL_COMMUNICATION
          BswMArgumentRef = CC_Cond_Generic_BusOff_CN_TC37X_VCU_CAN01_70b1f95e_EQ_BUSOFF_SILENT
        CC_Cond_Generic_BusOff_CN_TC37X_VCU_CAN01_70b1f95e_EQ_BUSOFF_SILENT (BswMModeCondition): BswMConditionType=BSWM_EQUALS, BswMConditionMode=CC_Generic_BusOff_CN_TC37X_VCU_CAN01_70b1f95e
          BswMConditionValue
            BswMBswMode: BswMBswRequestedMode=BUSOFF_SILENT
        ESH_Cond_NoComOn_CN_TC37X_VCU_CAN01_70b1f95e (BswMModeCondition): BswMConditionType=BSWM_EQUALS, BswMConditionMode=ESH_ComMIndication_CN_TC37X_VCU_CAN01_70b1f95e
          BswMConditionValue
            BswMBswMode: BswMBswRequestedMode=COMM_NO_COMMUNICATION
        ESH_ComMIndication_CN_TC37X_VCU_CAN01_70b1f95e (BswMModeRequestPort): BswMArbitrateOnInit=false, BswMRequestProcessing=BSWM_DEFERRED
          BswMModeRequestSource
            BswMComMIndication: BswMComMChannelRef=CN_TC37X_VCU_CAN01_70b1f95e
          BswMModeInitValue
            BswMBswModeInitValue: BswMBswModeInitValueMode=COMM_NO_COMMUNICATION
        CC_Cond_LinSMIndication_CN_LIN00_b12a0454_EQ_LINSM_BSWM_FULL_COM (BswMModeCondition): BswMConditionType=BSWM_EQUALS, BswMConditionMode=CC_LinSMIndication_CN_LIN00_b12a0454
          BswMConditionValue
            BswMBswMode: BswMBswRequestedMode=LINSM_BSWM_FULL_COM
        CC_LinSMIndication_CN_LIN00_b12a0454 (BswMModeRequestPort): BswMArbitrateOnInit=false, BswMRequestProcessing=BSWM_IMMEDIATE
          BswMModeRequestSource
            BswMLinSMIndication: BswMLinSMChannelRef=CN_LIN00_b12a0454
          BswMModeInitValue
            BswMBswModeInitValue: BswMBswModeInitValueMode=LINSM_BSWM_NO_COM
        CC_CN_LIN00_b12a0454_StartSchedule (BswMRule):
          BswMNestedExecutionOnly = false
          BswMRuleId = 6
          BswMRuleInitState = BSWM_FALSE
          BswMRuleExpressionRef = CC_LE_CN_LIN00_b12a0454_StartSchedule
          BswMRuleTrueActionList = CC_AL_CN_LIN00_b12a0454_LinScheduleSwitch
        CC_LE_CN_LIN00_b12a0454_StartSchedule (BswMLogicalExpression): BswMLogicalOperator=BSWM_OR, BswMArgumentRef=CC_Cond_LinSMIndication_CN_LIN00_b12a0454_EQ_LINSM_BSWM_FULL_COM
        ESH_Cond_NoComOn_CN_LIN00_b12a0454 (BswMModeCondition): BswMConditionType=BSWM_EQUALS, BswMConditionMode=ESH_ComMIndication_CN_LIN00_b12a0454
          BswMConditionValue
            BswMBswMode: BswMBswRequestedMode=COMM_NO_COMMUNICATION
        ESH_ComMIndication_CN_LIN00_b12a0454 (BswMModeRequestPort): BswMArbitrateOnInit=false, BswMRequestProcessing=BSWM_DEFERRED
          BswMModeRequestSource
            BswMComMIndication: BswMComMChannelRef=CN_LIN00_b12a0454
          BswMModeInitValue
            BswMBswModeInitValue: BswMBswModeInitValueMode=COMM_NO_COMMUNICATION
        ESH_DemInit (BswMRule):
          BswMNestedExecutionOnly = true
          BswMRuleId = 31
          BswMRuleInitState = BSWM_FALSE
          BswMRuleExpressionRef = ESH_LE_DemNotInitialized
          BswMRuleTrueActionList = ESH_AL_DemInit
        ESH_LE_DemNotInitialized (BswMLogicalExpression): BswMLogicalOperator=BSWM_OR, BswMArgumentRef=ESH_Cond_DemNotInitialized
        ESH_Cond_DemNotInitialized (BswMModeCondition): BswMConditionType=BSWM_EQUALS, BswMConditionMode=ESH_DemInitStatus
          BswMConditionValue
            BswMBswMode: BswMBswRequestedMode=DEM_NOT_INITIALIZED
        ESH_DemInitStatus (BswMModeRequestPort): BswMArbitrateOnInit=false, BswMRequestProcessing=BSWM_IMMEDIATE
          BswMModeRequestSource
            BswMGenericRequest: BswMModeRequesterId=231, BswMRequestedModeMax=2
              DEM_INITIALIZED (BswMGenericRequestMode): BswMGenericRequestModeValue=0
              DEM_NOT_INITIALIZED (BswMGenericRequestMode): BswMGenericRequestModeValue=1
          BswMModeInitValue
            BswMBswModeInitValue: BswMBswModeInitValueMode=DEM_INITIALIZED
        ESH_Cond_DemPostRunRequested (BswMModeCondition): BswMConditionType=BSWM_EQUALS, BswMConditionMode=ESH_DemPostRunRequested
          BswMConditionValue
            BswMBswMode: BswMBswRequestedMode=FALSE
        ESH_DemPostRunRequested (BswMModeRequestPort): BswMArbitrateOnInit=false, BswMRequestProcessing=BSWM_DEFERRED
          BswMModeRequestSource
            BswMGenericRequest: BswMModeRequesterId=233, BswMRequestedModeMax=2
              TRUE (BswMGenericRequestMode): BswMGenericRequestModeValue=0
              FALSE (BswMGenericRequestMode): BswMGenericRequestModeValue=1
          BswMModeInitValue
            BswMBswModeInitValue: BswMBswModeInitValueMode=TRUE
        CC_CN_TC37X_VCU_CAN03_9ebf9872_RX (BswMRule):
          BswMNestedExecutionOnly = false
          BswMRuleId = 27
          BswMRuleInitState = BSWM_FALSE
          BswMRuleExpressionRef = CC_LE_CN_TC37X_VCU_CAN03_9ebf9872_RX
          BswMRuleFalseActionList = CC_AL_CN_TC37X_VCU_CAN03_9ebf9872_RX_Disable
          BswMRuleTrueActionList = CC_AL_CN_TC37X_VCU_CAN03_9ebf9872_RX_EnableNoinit
        CC_LE_CN_TC37X_VCU_CAN03_9ebf9872_RX (BswMLogicalExpression): BswMLogicalOperator=BSWM_AND, BswMArgumentRef=CC_Cond_CanSMIndication_CN_TC37X_VCU_CAN03_9ebf9872_NEQ_CANSM_BSWM_NO_COMMUNICATION
        CC_Cond_CanSMIndication_CN_TC37X_VCU_CAN03_9ebf9872_NEQ_CANSM_BSWM_NO_COMMUNICATION (BswMModeCondition): BswMConditionType=BSWM_EQUALS_NOT, BswMConditionMode=CC_CanSMIndication_CN_TC37X_VCU_CAN03_9ebf9872
          BswMConditionValue
            BswMBswMode: BswMBswRequestedMode=CANSM_BSWM_NO_COMMUNICATION
        CC_CanSMIndication_CN_TC37X_VCU_CAN03_9ebf9872 (BswMModeRequestPort): BswMArbitrateOnInit=false, BswMRequestProcessing=BSWM_IMMEDIATE
          BswMModeRequestSource
            BswMCanSMIndication: BswMCanSMChannelRef=CN_TC37X_VCU_CAN03_9ebf9872
          BswMModeInitValue
            BswMBswModeInitValue: BswMBswModeInitValueMode=CANSM_BSWM_NO_COMMUNICATION
        CC_CN_TC37X_VCU_CAN03_9ebf9872_RX_DM (BswMRule):
          BswMNestedExecutionOnly = false
          BswMRuleId = 28
          BswMRuleInitState = BSWM_FALSE
          BswMRuleExpressionRef = CC_LE_CN_TC37X_VCU_CAN03_9ebf9872_RX_DM
          BswMRuleFalseActionList = CC_AL_CN_TC37X_VCU_CAN03_9ebf9872_Disable_DM
          BswMRuleTrueActionList = CC_AL_CN_TC37X_VCU_CAN03_9ebf9872_Enable_DM
        CC_LE_CN_TC37X_VCU_CAN03_9ebf9872_RX_DM (BswMLogicalExpression): BswMLogicalOperator=BSWM_AND, BswMArgumentRef=CC_Cond_CanSMIndication_CN_TC37X_VCU_CAN03_9ebf9872_EQ_CANSM_BSWM_FULL_COMMUNICATION
        CC_Cond_CanSMIndication_CN_TC37X_VCU_CAN03_9ebf9872_EQ_CANSM_BSWM_FULL_COMMUNICATION (BswMModeCondition): BswMConditionType=BSWM_EQUALS, BswMConditionMode=CC_CanSMIndication_CN_TC37X_VCU_CAN03_9ebf9872
          BswMConditionValue
            BswMBswMode: BswMBswRequestedMode=CANSM_BSWM_FULL_COMMUNICATION
        CC_CN_TC37X_VCU_CAN03_9ebf9872_TX (BswMRule):
          BswMNestedExecutionOnly = false
          BswMRuleId = 29
          BswMRuleInitState = BSWM_FALSE
          BswMRuleExpressionRef = CC_LE_CN_TC37X_VCU_CAN03_9ebf9872_TX
          BswMRuleFalseActionList = CC_AL_CN_TC37X_VCU_CAN03_9ebf9872_TX_Disable
          BswMRuleTrueActionList = CC_AL_CN_TC37X_VCU_CAN03_9ebf9872_TX_EnableNoinit
        CC_LE_CN_TC37X_VCU_CAN03_9ebf9872_TX (BswMLogicalExpression): BswMLogicalOperator=BSWM_AND, BswMArgumentRef=CC_Cond_CanSMIndication_CN_TC37X_VCU_CAN03_9ebf9872_EQ_CANSM_BSWM_FULL_COMMUNICATION
        ESH_Cond_NoComOn_CN_TC37X_VCU_CAN03_9ebf9872 (BswMModeCondition): BswMConditionType=BSWM_EQUALS, BswMConditionMode=ESH_ComMIndication_CN_TC37X_VCU_CAN03_9ebf9872
          BswMConditionValue
            BswMBswMode: BswMBswRequestedMode=COMM_NO_COMMUNICATION
        ESH_ComMIndication_CN_TC37X_VCU_CAN03_9ebf9872 (BswMModeRequestPort): BswMArbitrateOnInit=false, BswMRequestProcessing=BSWM_DEFERRED
          BswMModeRequestSource
            BswMComMIndication: BswMComMChannelRef=CN_TC37X_VCU_CAN03_9ebf9872
          BswMModeInitValue
            BswMBswModeInitValue: BswMBswModeInitValueMode=COMM_NO_COMMUNICATION
        CC_CN_LIN01_c62d34c2_Vcu_Lin0_Schedule_0e999bb4 (BswMRule):
          BswMNestedExecutionOnly = false
          BswMRuleId = 8
          BswMRuleInitState = BSWM_FALSE
          BswMRuleExpressionRef = CC_LE_CN_LIN01_c62d34c2_Vcu_Lin0_Schedule_0e999bb4
          BswMRuleFalseActionList = CC_AL_CN_LIN01_c62d34c2_Vcu_Lin0_Schedule_0e999bb4_Disable
          BswMRuleTrueActionList = CC_AL_CN_LIN01_c62d34c2_Vcu_Lin0_Schedule_0e999bb4_Enable
        CC_LE_CN_LIN01_c62d34c2_Vcu_Lin0_Schedule_0e999bb4 (BswMLogicalExpression):
          BswMLogicalOperator = BSWM_AND
          BswMArgumentRef = CC_Cond_LinSMIndication_CN_LIN01_c62d34c2_EQ_LINSM_BSWM_FULL_COM
          BswMArgumentRef = CC_Cond_LinScheduleIndication_CHNL_8e3d5be2_Vcu_Lin0_Schedule_0e999bb4_EQ_LinSMConf_LinSMSchedule_Vcu_Lin0_Schedule_0e999bb4
        CC_Cond_LinSMIndication_CN_LIN01_c62d34c2_EQ_LINSM_BSWM_FULL_COM (BswMModeCondition): BswMConditionType=BSWM_EQUALS, BswMConditionMode=CC_LinSMIndication_CN_LIN01_c62d34c2
          BswMConditionValue
            BswMBswMode: BswMBswRequestedMode=LINSM_BSWM_FULL_COM
        CC_LinSMIndication_CN_LIN01_c62d34c2 (BswMModeRequestPort): BswMArbitrateOnInit=false, BswMRequestProcessing=BSWM_IMMEDIATE
          BswMModeRequestSource
            BswMLinSMIndication: BswMLinSMChannelRef=CN_LIN01_c62d34c2
          BswMModeInitValue
            BswMBswModeInitValue: BswMBswModeInitValueMode=LINSM_BSWM_NO_COM
        CC_Cond_LinScheduleIndication_CHNL_8e3d5be2_Vcu_Lin0_Schedule_0e999bb4_EQ_LinSMConf_LinSMSchedule_Vcu_Lin0_Schedule_0e999bb4 (BswMModeCondition): BswMConditionType=BSWM_EQUALS, BswMConditionMode=CC_LinScheduleIndication_CHNL_8e3d5be2_Vcu_Lin0_Schedule_0e999bb4
          BswMConditionValue
            BswMBswMode: BswMBswRequestedMode=LinSMConf_LinSMSchedule_Vcu_Lin0_Schedule_0e999bb4
        CC_LinScheduleIndication_CHNL_8e3d5be2_Vcu_Lin0_Schedule_0e999bb4 (BswMModeRequestPort): BswMArbitrateOnInit=false, BswMRequestProcessing=BSWM_IMMEDIATE
          BswMModeRequestSource
            BswMLinScheduleIndication: BswMLinScheduleRef=Vcu_Lin0_Schedule_0e999bb4
          BswMModeInitValue
            BswMBswModeInitValue: BswMBswModeInitValueMode=LinSMConf_LinSMSchedule_CHNL_8e3d5be2_a66eb9f7
        CC_CN_LIN01_c62d34c2_StartSchedule (BswMRule):
          BswMNestedExecutionOnly = false
          BswMRuleId = 7
          BswMRuleInitState = BSWM_FALSE
          BswMRuleExpressionRef = CC_LE_CN_LIN01_c62d34c2_StartSchedule
          BswMRuleTrueActionList = CC_AL_CN_LIN01_c62d34c2_LinScheduleSwitch
        CC_LE_CN_LIN01_c62d34c2_StartSchedule (BswMLogicalExpression): BswMLogicalOperator=BSWM_OR, BswMArgumentRef=CC_Cond_LinSMIndication_CN_LIN01_c62d34c2_EQ_LINSM_BSWM_FULL_COM
        ESH_Cond_NoComOn_CN_LIN01_c62d34c2 (BswMModeCondition): BswMConditionType=BSWM_EQUALS, BswMConditionMode=ESH_ComMIndication_CN_LIN01_c62d34c2
          BswMConditionValue
            BswMBswMode: BswMBswRequestedMode=COMM_NO_COMMUNICATION
        ESH_ComMIndication_CN_LIN01_c62d34c2 (BswMModeRequestPort): BswMArbitrateOnInit=false, BswMRequestProcessing=BSWM_DEFERRED
          BswMModeRequestSource
            BswMComMIndication: BswMComMChannelRef=CN_LIN01_c62d34c2
          BswMModeInitValue
            BswMBswModeInitValue: BswMBswModeInitValueMode=COMM_NO_COMMUNICATION
        CC_CN_ATOM_CANFD_Matrix_CH_V600_202502_a4d436ac_RX (BswMRule):
          BswMNestedExecutionOnly = false
          BswMRuleId = 0
          BswMRuleInitState = BSWM_FALSE
          BswMRuleExpressionRef = CC_LE_CN_ATOM_CANFD_Matrix_CH_V600_202502_a4d436ac_RX
          BswMRuleFalseActionList = CC_AL_CN_ATOM_CANFD_Matrix_CH_V600_202502_a4d436ac_RX_Disable
          BswMRuleTrueActionList = CC_AL_CN_ATOM_CANFD_Matrix_CH_V600_202502_a4d436ac_RX_EnableNoinit
        CC_LE_CN_ATOM_CANFD_Matrix_CH_V600_202502_a4d436ac_RX (BswMLogicalExpression):
          BswMLogicalOperator = BSWM_AND
          BswMArgumentRef = CC_Cond_CanSMIndication_CN_ATOM_CANFD_Matrix_CH_V600_202502_a4d436ac_NEQ_CANSM_BSWM_NO_COMMUNICATION
        CC_Cond_CanSMIndication_CN_ATOM_CANFD_Matrix_CH_V600_202502_a4d436ac_NEQ_CANSM_BSWM_NO_COMMUNICATION (BswMModeCondition): BswMConditionType=BSWM_EQUALS_NOT, BswMConditionMode=CC_CanSMIndication_CN_ATOM_CANFD_Matrix_CH_V600_202502_a4d436ac
          BswMConditionValue
            BswMBswMode: BswMBswRequestedMode=CANSM_BSWM_NO_COMMUNICATION
        CC_CanSMIndication_CN_ATOM_CANFD_Matrix_CH_V600_202502_a4d436ac (BswMModeRequestPort): BswMArbitrateOnInit=false, BswMRequestProcessing=BSWM_IMMEDIATE
          BswMModeRequestSource
            BswMCanSMIndication: BswMCanSMChannelRef=CN_ATOM_CANFD_Matrix_CH_V600_202502_a4d436ac
          BswMModeInitValue
            BswMBswModeInitValue: BswMBswModeInitValueMode=CANSM_BSWM_NO_COMMUNICATION
        CC_CN_ATOM_CANFD_Matrix_CH_V600_202502_a4d436ac_TX (BswMRule):
          BswMNestedExecutionOnly = false
          BswMRuleId = 2
          BswMRuleInitState = BSWM_FALSE
          BswMRuleExpressionRef = CC_LE_CN_ATOM_CANFD_Matrix_CH_V600_202502_a4d436ac_TX
          BswMRuleFalseActionList = CC_AL_CN_ATOM_CANFD_Matrix_CH_V600_202502_a4d436ac_TX_Disable
          BswMRuleTrueActionList = CC_AL_CN_ATOM_CANFD_Matrix_CH_V600_202502_a4d436ac_TX_EnableNoinit
        CC_LE_CN_ATOM_CANFD_Matrix_CH_V600_202502_a4d436ac_TX (BswMLogicalExpression):
          BswMLogicalOperator = BSWM_AND
          BswMArgumentRef = CC_Cond_CanSMIndication_CN_ATOM_CANFD_Matrix_CH_V600_202502_a4d436ac_EQ_CANSM_BSWM_FULL_COMMUNICATION
        CC_Cond_CanSMIndication_CN_ATOM_CANFD_Matrix_CH_V600_202502_a4d436ac_EQ_CANSM_BSWM_FULL_COMMUNICATION (BswMModeCondition): BswMConditionType=BSWM_EQUALS, BswMConditionMode=CC_CanSMIndication_CN_ATOM_CANFD_Matrix_CH_V600_202502_a4d436ac
          BswMConditionValue
            BswMBswMode: BswMBswRequestedMode=CANSM_BSWM_FULL_COMMUNICATION
        CC_CN_ATOM_CANFD_Matrix_CH_V600_202502_a4d436ac_RX_DM (BswMRule):
          BswMNestedExecutionOnly = false
          BswMRuleId = 1
          BswMRuleInitState = BSWM_FALSE
          BswMRuleExpressionRef = CC_LE_CN_ATOM_CANFD_Matrix_CH_V600_202502_a4d436ac_RX_DM
          BswMRuleFalseActionList = CC_AL_CN_ATOM_CANFD_Matrix_CH_V600_202502_a4d436ac_Disable_DM
          BswMRuleTrueActionList = CC_AL_CN_ATOM_CANFD_Matrix_CH_V600_202502_a4d436ac_Enable_DM
        CC_LE_CN_ATOM_CANFD_Matrix_CH_V600_202502_a4d436ac_RX_DM (BswMLogicalExpression):
          BswMLogicalOperator = BSWM_AND
          BswMArgumentRef = CC_Cond_CanSMIndication_CN_ATOM_CANFD_Matrix_CH_V600_202502_a4d436ac_EQ_CANSM_BSWM_FULL_COMMUNICATION
        ESH_Cond_NoComOn_CN_ATOM_CANFD_Matrix_CH_V600_202502_a4d436ac (BswMModeCondition): BswMConditionType=BSWM_EQUALS, BswMConditionMode=ESH_ComMIndication_CN_ATOM_CANFD_Matrix_CH_V600_202502_a4d436ac
          BswMConditionValue
            BswMBswMode: BswMBswRequestedMode=COMM_NO_COMMUNICATION
        ESH_ComMIndication_CN_ATOM_CANFD_Matrix_CH_V600_202502_a4d436ac (BswMModeRequestPort): BswMArbitrateOnInit=false, BswMRequestProcessing=BSWM_DEFERRED
          BswMModeRequestSource
            BswMComMIndication: BswMComMChannelRef=CN_ATOM_CANFD_Matrix_CH_V600_202502_a4d436ac
          BswMModeInitValue
            BswMBswModeInitValue: BswMBswModeInitValueMode=COMM_NO_COMMUNICATION
        CC_CN_LIN02_5f246578_Vcu_Lin3_Schedule_bdb0899f (BswMRule):
          BswMNestedExecutionOnly = false
          BswMRuleId = 10
          BswMRuleInitState = BSWM_FALSE
          BswMRuleExpressionRef = CC_LE_CN_LIN02_5f246578_Vcu_Lin3_Schedule_bdb0899f
          BswMRuleFalseActionList = CC_AL_CN_LIN02_5f246578_Vcu_Lin3_Schedule_bdb0899f_Disable
          BswMRuleTrueActionList = CC_AL_CN_LIN02_5f246578_Vcu_Lin3_Schedule_bdb0899f_Enable
        CC_LE_CN_LIN02_5f246578_Vcu_Lin3_Schedule_bdb0899f (BswMLogicalExpression):
          BswMLogicalOperator = BSWM_AND
          BswMArgumentRef = CC_Cond_LinSMIndication_CN_LIN02_5f246578_EQ_LINSM_BSWM_FULL_COM
          BswMArgumentRef = CC_Cond_LinScheduleIndication_CHNL_08a9294c_Vcu_Lin3_Schedule_bdb0899f_EQ_LinSMConf_LinSMSchedule_Vcu_Lin3_Schedule_bdb0899f
        CC_Cond_LinSMIndication_CN_LIN02_5f246578_EQ_LINSM_BSWM_FULL_COM (BswMModeCondition): BswMConditionType=BSWM_EQUALS, BswMConditionMode=CC_LinSMIndication_CN_LIN02_5f246578
          BswMConditionValue
            BswMBswMode: BswMBswRequestedMode=LINSM_BSWM_FULL_COM
        CC_LinSMIndication_CN_LIN02_5f246578 (BswMModeRequestPort): BswMArbitrateOnInit=false, BswMRequestProcessing=BSWM_IMMEDIATE
          BswMModeRequestSource
            BswMLinSMIndication: BswMLinSMChannelRef=CN_LIN02_5f246578
          BswMModeInitValue
            BswMBswModeInitValue: BswMBswModeInitValueMode=LINSM_BSWM_NO_COM
        CC_Cond_LinScheduleIndication_CHNL_08a9294c_Vcu_Lin3_Schedule_bdb0899f_EQ_LinSMConf_LinSMSchedule_Vcu_Lin3_Schedule_bdb0899f (BswMModeCondition): BswMConditionType=BSWM_EQUALS, BswMConditionMode=CC_LinScheduleIndication_CHNL_08a9294c_Vcu_Lin3_Schedule_bdb0899f
          BswMConditionValue
            BswMBswMode: BswMBswRequestedMode=LinSMConf_LinSMSchedule_Vcu_Lin3_Schedule_bdb0899f
        CC_LinScheduleIndication_CHNL_08a9294c_Vcu_Lin3_Schedule_bdb0899f (BswMModeRequestPort): BswMArbitrateOnInit=false, BswMRequestProcessing=BSWM_IMMEDIATE
          BswMModeRequestSource
            BswMLinScheduleIndication: BswMLinScheduleRef=Vcu_Lin3_Schedule_bdb0899f
          BswMModeInitValue
            BswMBswModeInitValue: BswMBswModeInitValueMode=LinSMConf_LinSMSchedule_CHNL_08a9294c_f4be7c2c
        CC_CN_LIN02_5f246578_StartSchedule (BswMRule):
          BswMNestedExecutionOnly = false
          BswMRuleId = 9
          BswMRuleInitState = BSWM_FALSE
          BswMRuleExpressionRef = CC_LE_CN_LIN02_5f246578_StartSchedule
          BswMRuleTrueActionList = CC_AL_CN_LIN02_5f246578_LinScheduleSwitch
        CC_LE_CN_LIN02_5f246578_StartSchedule (BswMLogicalExpression): BswMLogicalOperator=BSWM_OR, BswMArgumentRef=CC_Cond_LinSMIndication_CN_LIN02_5f246578_EQ_LINSM_BSWM_FULL_COM
        ESH_Cond_NoComOn_CN_LIN02_5f246578 (BswMModeCondition): BswMConditionType=BSWM_EQUALS, BswMConditionMode=ESH_ComMIndication_CN_LIN02_5f246578
          BswMConditionValue
            BswMBswMode: BswMBswRequestedMode=COMM_NO_COMMUNICATION
        ESH_ComMIndication_CN_LIN02_5f246578 (BswMModeRequestPort): BswMArbitrateOnInit=false, BswMRequestProcessing=BSWM_DEFERRED
          BswMModeRequestSource
            BswMComMIndication: BswMComMChannelRef=CN_LIN02_5f246578
          BswMModeInitValue
            BswMBswModeInitValue: BswMBswModeInitValueMode=COMM_NO_COMMUNICATION
        CC_CN_TC37X_VCU_CAN12_XCP_d05a85ac_TX (BswMRule):
          BswMNestedExecutionOnly = false
          BswMRuleId = 30
          BswMRuleInitState = BSWM_FALSE
          BswMRuleExpressionRef = CC_LE_CN_TC37X_VCU_CAN12_XCP_d05a85ac_TX
          BswMRuleFalseActionList = CC_AL_CN_TC37X_VCU_CAN12_XCP_d05a85ac_TX_Disable
          BswMRuleTrueActionList = CC_AL_CN_TC37X_VCU_CAN12_XCP_d05a85ac_TX_EnableNoinit
        CC_LE_CN_TC37X_VCU_CAN12_XCP_d05a85ac_TX (BswMLogicalExpression): BswMLogicalOperator=BSWM_AND, BswMArgumentRef=CC_Cond_CanSMIndication_CN_TC37X_VCU_CAN12_XCP_d05a85ac_EQ_CANSM_BSWM_FULL_COMMUNICATION
        CC_Cond_CanSMIndication_CN_TC37X_VCU_CAN12_XCP_d05a85ac_EQ_CANSM_BSWM_FULL_COMMUNICATION (BswMModeCondition): BswMConditionType=BSWM_EQUALS, BswMConditionMode=CC_CanSMIndication_CN_TC37X_VCU_CAN12_XCP_d05a85ac
          BswMConditionValue
            BswMBswMode: BswMBswRequestedMode=CANSM_BSWM_FULL_COMMUNICATION
        CC_CanSMIndication_CN_TC37X_VCU_CAN12_XCP_d05a85ac (BswMModeRequestPort): BswMArbitrateOnInit=false, BswMRequestProcessing=BSWM_IMMEDIATE
          BswMModeRequestSource
            BswMCanSMIndication: BswMCanSMChannelRef=CN_TC37X_VCU_CAN12_XCP_d05a85ac
          BswMModeInitValue
            BswMBswModeInitValue: BswMBswModeInitValueMode=CANSM_BSWM_NO_COMMUNICATION
        ESH_Cond_NoComOn_CN_TC37X_VCU_CAN12_XCP_d05a85ac (BswMModeCondition): BswMConditionType=BSWM_EQUALS, BswMConditionMode=ESH_ComMIndication_CN_TC37X_VCU_CAN12_XCP_d05a85ac
          BswMConditionValue
            BswMBswMode: BswMBswRequestedMode=COMM_NO_COMMUNICATION
        ESH_ComMIndication_CN_TC37X_VCU_CAN12_XCP_d05a85ac (BswMModeRequestPort): BswMArbitrateOnInit=false, BswMRequestProcessing=BSWM_DEFERRED
          BswMModeRequestSource
            BswMComMIndication: BswMComMChannelRef=CN_TC37X_VCU_CAN12_XCP_d05a85ac
          BswMModeInitValue
            BswMBswModeInitValue: BswMBswModeInitValueMode=COMM_NO_COMMUNICATION
        CC_CN_ATOM_CAN_Matrix_PT_V600_20250211_9b894f3d_RX (BswMRule):
          BswMNestedExecutionOnly = false
          BswMRuleId = 3
          BswMRuleInitState = BSWM_FALSE
          BswMRuleExpressionRef = CC_LE_CN_ATOM_CAN_Matrix_PT_V600_20250211_9b894f3d_RX
          BswMRuleFalseActionList = CC_AL_CN_ATOM_CAN_Matrix_PT_V600_20250211_9b894f3d_RX_Disable
          BswMRuleTrueActionList = CC_AL_CN_ATOM_CAN_Matrix_PT_V600_20250211_9b894f3d_RX_EnableNoinit
        CC_LE_CN_ATOM_CAN_Matrix_PT_V600_20250211_9b894f3d_RX (BswMLogicalExpression):
          BswMLogicalOperator = BSWM_AND
          BswMArgumentRef = CC_Cond_CanSMIndication_CN_ATOM_CAN_Matrix_PT_V600_20250211_9b894f3d_NEQ_CANSM_BSWM_NO_COMMUNICATION
        CC_Cond_CanSMIndication_CN_ATOM_CAN_Matrix_PT_V600_20250211_9b894f3d_NEQ_CANSM_BSWM_NO_COMMUNICATION (BswMModeCondition): BswMConditionType=BSWM_EQUALS_NOT, BswMConditionMode=CC_CanSMIndication_CN_ATOM_CAN_Matrix_PT_V600_20250211_9b894f3d
          BswMConditionValue
            BswMBswMode: BswMBswRequestedMode=CANSM_BSWM_NO_COMMUNICATION
        CC_CanSMIndication_CN_ATOM_CAN_Matrix_PT_V600_20250211_9b894f3d (BswMModeRequestPort): BswMArbitrateOnInit=false, BswMRequestProcessing=BSWM_IMMEDIATE
          BswMModeRequestSource
            BswMCanSMIndication: BswMCanSMChannelRef=CN_ATOM_CAN_Matrix_PT_V600_20250211_9b894f3d
          BswMModeInitValue
            BswMBswModeInitValue: BswMBswModeInitValueMode=CANSM_BSWM_NO_COMMUNICATION
        CC_CN_ATOM_CAN_Matrix_PT_V600_20250211_9b894f3d_RX_DM (BswMRule):
          BswMNestedExecutionOnly = false
          BswMRuleId = 4
          BswMRuleInitState = BSWM_FALSE
          BswMRuleExpressionRef = CC_LE_CN_ATOM_CAN_Matrix_PT_V600_20250211_9b894f3d_RX_DM
          BswMRuleFalseActionList = CC_AL_CN_ATOM_CAN_Matrix_PT_V600_20250211_9b894f3d_Disable_DM
          BswMRuleTrueActionList = CC_AL_CN_ATOM_CAN_Matrix_PT_V600_20250211_9b894f3d_Enable_DM
        CC_LE_CN_ATOM_CAN_Matrix_PT_V600_20250211_9b894f3d_RX_DM (BswMLogicalExpression):
          BswMLogicalOperator = BSWM_AND
          BswMArgumentRef = CC_Cond_CanSMIndication_CN_ATOM_CAN_Matrix_PT_V600_20250211_9b894f3d_EQ_CANSM_BSWM_FULL_COMMUNICATION
        CC_Cond_CanSMIndication_CN_ATOM_CAN_Matrix_PT_V600_20250211_9b894f3d_EQ_CANSM_BSWM_FULL_COMMUNICATION (BswMModeCondition): BswMConditionType=BSWM_EQUALS, BswMConditionMode=CC_CanSMIndication_CN_ATOM_CAN_Matrix_PT_V600_20250211_9b894f3d
          BswMConditionValue
            BswMBswMode: BswMBswRequestedMode=CANSM_BSWM_FULL_COMMUNICATION
        CC_CN_ATOM_CAN_Matrix_PT_V600_20250211_9b894f3d_TX (BswMRule):
          BswMNestedExecutionOnly = false
          BswMRuleId = 5
          BswMRuleInitState = BSWM_FALSE
          BswMRuleExpressionRef = CC_LE_CN_ATOM_CAN_Matrix_PT_V600_20250211_9b894f3d_TX
          BswMRuleFalseActionList = CC_AL_CN_ATOM_CAN_Matrix_PT_V600_20250211_9b894f3d_TX_Disable
          BswMRuleTrueActionList = CC_AL_CN_ATOM_CAN_Matrix_PT_V600_20250211_9b894f3d_TX_EnableNoinit
        CC_LE_CN_ATOM_CAN_Matrix_PT_V600_20250211_9b894f3d_TX (BswMLogicalExpression):
          BswMLogicalOperator = BSWM_AND
          BswMArgumentRef = CC_Cond_CanSMIndication_CN_ATOM_CAN_Matrix_PT_V600_20250211_9b894f3d_EQ_CANSM_BSWM_FULL_COMMUNICATION
        ESH_Cond_NoComOn_CN_ATOM_CAN_Matrix_PT_V600_20250211_9b894f3d (BswMModeCondition): BswMConditionType=BSWM_EQUALS, BswMConditionMode=ESH_ComMIndication_CN_ATOM_CAN_Matrix_PT_V600_20250211_9b894f3d
          BswMConditionValue
            BswMBswMode: BswMBswRequestedMode=COMM_NO_COMMUNICATION
        ESH_ComMIndication_CN_ATOM_CAN_Matrix_PT_V600_20250211_9b894f3d (BswMModeRequestPort): BswMArbitrateOnInit=false, BswMRequestProcessing=BSWM_DEFERRED
          BswMModeRequestSource
            BswMComMIndication: BswMComMChannelRef=CN_ATOM_CAN_Matrix_PT_V600_20250211_9b894f3d
          BswMModeInitValue
            BswMBswModeInitValue: BswMBswModeInitValueMode=COMM_NO_COMMUNICATION
      BswMModeControl: BswMInitActionListRef=INIT_AL_Initialize
        ESH_AL_RunToPostRun (BswMActionList): BswMActionListExecution=BSWM_CONDITION
          13 x BswMActionListItem, all with BswMAbortOnFail=false:
            ESH_Action_EcuMClearValidatedWakeupEvents: BswMActionListItemIndex=9, BswMActionListItemRef=BswMModeControl/ESH_Action_EcuMClearValidatedWakeupEvents
            ESH_Action_ESH_PostRun: BswMActionListItemIndex=12, BswMActionListItemRef=BswMModeControl/ESH_Action_ESH_PostRun
            ESH_Action_OnEnterPostRun: BswMActionListItemIndex=10, BswMActionListItemRef=BswMModeControl/ESH_Action_OnEnterPostRun
            ESH_Action_SwitchPostRun: BswMActionListItemIndex=11, BswMActionListItemRef=BswMModeControl/ESH_Action_SwitchPostRun
            ESH_Action_ComMDisallow_CN_TC37X_VCU_CAN00_07b6c9c8: BswMActionListItemIndex=0, BswMActionListItemRef=BswMModeControl/ESH_Action_ComMDisallow_CN_TC37X_VCU_CAN00_07b6c9c8
            ESH_Action_ComMDisallow_CN_TC37X_VCU_CAN01_70b1f95e: BswMActionListItemIndex=1, BswMActionListItemRef=BswMModeControl/ESH_Action_ComMDisallow_CN_TC37X_VCU_CAN01_70b1f95e
            ESH_Action_ComMDisallow_CN_LIN00_b12a0454: BswMActionListItemIndex=2, BswMActionListItemRef=BswMModeControl/ESH_Action_ComMDisallow_CN_LIN00_b12a0454
            ESH_Action_ComMDisallow_CN_TC37X_VCU_CAN03_9ebf9872: BswMActionListItemIndex=3, BswMActionListItemRef=BswMModeControl/ESH_Action_ComMDisallow_CN_TC37X_VCU_CAN03_9ebf9872
            ESH_Action_ComMDisallow_CN_LIN01_c62d34c2: BswMActionListItemIndex=4, BswMActionListItemRef=BswMModeControl/ESH_Action_ComMDisallow_CN_LIN01_c62d34c2
            ESH_Action_ComMDisallow_CN_ATOM_CANFD_Matrix_CH_V600_202502_a4d436ac: BswMActionListItemIndex=5, BswMActionListItemRef=BswMModeControl/ESH_Action_ComMDisallow_CN_ATOM_CANFD_Matrix_CH_V600_202502_a4d436ac
            ESH_Action_ComMDisallow_CN_LIN02_5f246578: BswMActionListItemIndex=6, BswMActionListItemRef=BswMModeControl/ESH_Action_ComMDisallow_CN_LIN02_5f246578
            ESH_Action_ComMDisallow_CN_TC37X_VCU_CAN12_XCP_d05a85ac: BswMActionListItemIndex=7, BswMActionListItemRef=BswMModeControl/ESH_Action_ComMDisallow_CN_TC37X_VCU_CAN12_XCP_d05a85ac
            ESH_Action_ComMDisallow_CN_ATOM_CAN_Matrix_PT_V600_20250211_9b894f3d: BswMActionListItemIndex=8, BswMActionListItemRef=BswMModeControl/ESH_Action_ComMDisallow_CN_ATOM_CAN_Matrix_PT_V600_20250211_9b894f3d
        ESH_Action_EcuMClearValidatedWakeupEvents (BswMAction)
          BswMAvailableActions
            BswMUserCallout: BswMUserCalloutFunction=EcuM_ClearValidatedWakeupEvent(ECUM_WKSOURCE_ALL_SOURCES), BswMCreateCallout=false, BswMUserIncludeFile=EcuM.h
        ESH_Action_ESH_PostRun (BswMAction)
          BswMAvailableActions
            BswMGenericModeSwitch: BswMGenericRequestRef=ESH_State, BswMGenericRequestModeRef=ESH_POST_RUN
        ESH_AL_WaitForNvMToShutdown (BswMActionList): BswMActionListExecution=BSWM_CONDITION
          3 x BswMActionListItem, all with BswMAbortOnFail=false:
            ESH_Action_EcuMGoToSelectedShutdownTarget: BswMActionListItemIndex=2, BswMActionListItemRef=BswMModeControl/ESH_Action_EcuMGoToSelectedShutdownTarget
            ESH_Action_OnEnterShutdown: BswMActionListItemIndex=1, BswMActionListItemRef=BswMModeControl/ESH_Action_OnEnterShutdown
            ESH_Action_WriteAllTimer_Stop: BswMActionListItemIndex=0, BswMActionListItemRef=BswMModeControl/ESH_Action_WriteAllTimer_Stop
        ESH_Action_EcuMGoToSelectedShutdownTarget (BswMAction)
          BswMAvailableActions
            BswMUserCallout: BswMUserCalloutFunction=(void)EcuM_GoToSelectedShutdownTarget(), BswMCreateCallout=false, BswMUserIncludeFile=EcuM.h
        ESH_AL_WakeupToPrep (BswMActionList): BswMActionListExecution=BSWM_CONDITION
          3 x BswMActionListItem, all with BswMAbortOnFail=false:
            ESH_Action_ESH_PrepShutdown: BswMActionListItemIndex=2, BswMActionListItemRef=BswMModeControl/ESH_Action_ESH_PrepShutdown
            ESH_Action_OnEnterPrepShutdown: BswMActionListItemIndex=0, BswMActionListItemRef=BswMModeControl/ESH_Action_OnEnterPrepShutdown
            ESH_Action_SwitchShutdown: BswMActionListItemIndex=1, BswMActionListItemRef=BswMModeControl/ESH_Action_SwitchShutdown
        ESH_Action_ESH_PrepShutdown (BswMAction)
          BswMAvailableActions
            BswMGenericModeSwitch: BswMGenericRequestRef=ESH_State, BswMGenericRequestModeRef=ESH_PREP_SHUTDOWN
        ESH_AL_WaitForNvMWakeup (BswMActionList): BswMActionListExecution=BSWM_CONDITION
          6 x BswMActionListItem, all with BswMAbortOnFail=false:
            ESH_Action_ESH_Wakeup: BswMActionListItemIndex=5, BswMActionListItemRef=BswMModeControl/ESH_Action_ESH_Wakeup
            ESH_Action_OnEnterWakeup: BswMActionListItemIndex=3, BswMActionListItemRef=BswMModeControl/ESH_Action_OnEnterWakeup
            ESH_Action_SwitchWakeup: BswMActionListItemIndex=4, BswMActionListItemRef=BswMModeControl/ESH_Action_SwitchWakeup
            ESH_Action_WriteAllTimer_Stop: BswMActionListItemIndex=0, BswMActionListItemRef=BswMModeControl/ESH_Action_WriteAllTimer_Stop
            ESH_Action_CancelWriteAllTimer_Start: BswMActionListItemIndex=1, BswMActionListItemRef=BswMModeControl/ESH_Action_CancelWriteAllTimer_Start
            ESH_Action_CancelNvMWriteAll: BswMActionListItemIndex=2, BswMActionListItemRef=BswMModeControl/ESH_Action_CancelNvMWriteAll
        ESH_Action_ESH_Wakeup (BswMAction)
          BswMAvailableActions
            BswMGenericModeSwitch: BswMGenericRequestRef=ESH_State, BswMGenericRequestModeRef=ESH_WAKEUP
        ESH_AL_WakeupToRun (BswMActionList): BswMActionListExecution=BSWM_CONDITION
          15 x BswMActionListItem, all with BswMAbortOnFail=false:
            ESH_Action_SelfRunRequestTimer_Start: BswMActionListItemIndex=11, BswMActionListItemRef=BswMModeControl/ESH_Action_SelfRunRequestTimer_Start
            ESH_Action_ESH_Run: BswMActionListItemIndex=14, BswMActionListItemRef=BswMModeControl/ESH_Action_ESH_Run
            ESH_Action_OnEnterRun: BswMActionListItemIndex=12, BswMActionListItemRef=BswMModeControl/ESH_Action_OnEnterRun
            ESH_Action_SwitchRun: BswMActionListItemIndex=13, BswMActionListItemRef=BswMModeControl/ESH_Action_SwitchRun
            ESH_Action_ComMAllow_CN_TC37X_VCU_CAN00_07b6c9c8: BswMActionListItemIndex=2, BswMActionListItemRef=BswMModeControl/ESH_Action_ComMAllow_CN_TC37X_VCU_CAN00_07b6c9c8
            ESH_Action_CancelWriteAllTimer_Stop: BswMActionListItemIndex=0, BswMActionListItemRef=BswMModeControl/ESH_Action_CancelWriteAllTimer_Stop
            ESH_Action_ComMAllow_CN_TC37X_VCU_CAN01_70b1f95e: BswMActionListItemIndex=3, BswMActionListItemRef=BswMModeControl/ESH_Action_ComMAllow_CN_TC37X_VCU_CAN01_70b1f95e
            ESH_Action_ComMAllow_CN_LIN00_b12a0454: BswMActionListItemIndex=4, BswMActionListItemRef=BswMModeControl/ESH_Action_ComMAllow_CN_LIN00_b12a0454
            ESH_DemInit: BswMActionListItemIndex=1, BswMActionListItemRef=BswMArbitration/ESH_DemInit
            ESH_Action_ComMAllow_CN_TC37X_VCU_CAN03_9ebf9872: BswMActionListItemIndex=5, BswMActionListItemRef=BswMModeControl/ESH_Action_ComMAllow_CN_TC37X_VCU_CAN03_9ebf9872
            ESH_Action_ComMAllow_CN_LIN01_c62d34c2: BswMActionListItemIndex=6, BswMActionListItemRef=BswMModeControl/ESH_Action_ComMAllow_CN_LIN01_c62d34c2
            ESH_Action_ComMAllow_CN_ATOM_CANFD_Matrix_CH_V600_202502_a4d436ac: BswMActionListItemIndex=7, BswMActionListItemRef=BswMModeControl/ESH_Action_ComMAllow_CN_ATOM_CANFD_Matrix_CH_V600_202502_a4d436ac
            ESH_Action_ComMAllow_CN_LIN02_5f246578: BswMActionListItemIndex=8, BswMActionListItemRef=BswMModeControl/ESH_Action_ComMAllow_CN_LIN02_5f246578
            ESH_Action_ComMAllow_CN_TC37X_VCU_CAN12_XCP_d05a85ac: BswMActionListItemIndex=9, BswMActionListItemRef=BswMModeControl/ESH_Action_ComMAllow_CN_TC37X_VCU_CAN12_XCP_d05a85ac
            ESH_Action_ComMAllow_CN_ATOM_CAN_Matrix_PT_V600_20250211_9b894f3d: BswMActionListItemIndex=10, BswMActionListItemRef=BswMModeControl/ESH_Action_ComMAllow_CN_ATOM_CAN_Matrix_PT_V600_20250211_9b894f3d
        ESH_Action_SelfRunRequestTimer_Start (BswMAction)
          BswMAvailableActions
            BswMTimerControl: BswMTimerAction=BSWM_TIMER_START, BswMTimerValue=10, BswMTimerRef=ESH_SelfRunRequestTimer
        ESH_Action_ESH_Run (BswMAction)
          BswMAvailableActions
            BswMGenericModeSwitch: BswMGenericRequestRef=ESH_State, BswMGenericRequestModeRef=ESH_RUN
        6 x BswMActionList, all with BswMActionListExecution=BSWM_CONDITION:
          ESH_AL_InitToWakeup
            3 x BswMActionListItem, all with BswMAbortOnFail=false:
              ESH_Action_ESH_Wakeup: BswMActionListItemIndex=2, BswMActionListItemRef=BswMModeControl/ESH_Action_ESH_Wakeup
              ESH_Action_OnEnterWakeup: BswMActionListItemIndex=0, BswMActionListItemRef=BswMModeControl/ESH_Action_OnEnterWakeup
              ESH_Action_SwitchWakeup: BswMActionListItemIndex=1, BswMActionListItemRef=BswMModeControl/ESH_Action_SwitchWakeup
          ESH_AL_PostRunToPrepShutdown
            5 x BswMActionListItem, all with BswMAbortOnFail=false:
              ESH_Action_ESH_PrepShutdown: BswMActionListItemIndex=4, BswMActionListItemRef=BswMModeControl/ESH_Action_ESH_PrepShutdown
              ESH_Action_OnEnterPrepShutdown: BswMActionListItemIndex=2, BswMActionListItemRef=BswMModeControl/ESH_Action_OnEnterPrepShutdown
              ESH_Action_SwitchShutdown: BswMActionListItemIndex=3, BswMActionListItemRef=BswMModeControl/ESH_Action_SwitchShutdown
              ESH_Action_DemShutdown: BswMActionListItemIndex=0, BswMActionListItemRef=BswMModeControl/ESH_Action_DemShutdown
              ESH_Action_DemNotInitialized: BswMActionListItemIndex=1, BswMActionListItemRef=BswMModeControl/ESH_Action_DemNotInitialized
          ESH_AL_ESH_PostRunToPrepCheck
            ESH_PostRunToPrepNested (BswMActionListItem): BswMAbortOnFail=false, BswMActionListItemIndex=0, BswMActionListItemRef=BswMArbitration/ESH_PostRunToPrepNested
          ESH_AL_PostRunToRun
            13 x BswMActionListItem, all with BswMAbortOnFail=false:
              ESH_Action_SelfRunRequestTimer_Start: BswMActionListItemIndex=9, BswMActionListItemRef=BswMModeControl/ESH_Action_SelfRunRequestTimer_Start
              ESH_Action_ESH_Run: BswMActionListItemIndex=12, BswMActionListItemRef=BswMModeControl/ESH_Action_ESH_Run
              ESH_Action_OnEnterRun: BswMActionListItemIndex=10, BswMActionListItemRef=BswMModeControl/ESH_Action_OnEnterRun
              ESH_Action_SwitchRun: BswMActionListItemIndex=11, BswMActionListItemRef=BswMModeControl/ESH_Action_SwitchRun
              ESH_Action_ComMAllow_CN_TC37X_VCU_CAN00_07b6c9c8: BswMActionListItemIndex=0, BswMActionListItemRef=BswMModeControl/ESH_Action_ComMAllow_CN_TC37X_VCU_CAN00_07b6c9c8
              ESH_Action_ComMAllow_CN_TC37X_VCU_CAN01_70b1f95e: BswMActionListItemIndex=1, BswMActionListItemRef=BswMModeControl/ESH_Action_ComMAllow_CN_TC37X_VCU_CAN01_70b1f95e
              ESH_Action_ComMAllow_CN_LIN00_b12a0454: BswMActionListItemIndex=2, BswMActionListItemRef=BswMModeControl/ESH_Action_ComMAllow_CN_LIN00_b12a0454
              ESH_Action_ComMAllow_CN_TC37X_VCU_CAN03_9ebf9872: BswMActionListItemIndex=3, BswMActionListItemRef=BswMModeControl/ESH_Action_ComMAllow_CN_TC37X_VCU_CAN03_9ebf9872
              ESH_Action_ComMAllow_CN_LIN01_c62d34c2: BswMActionListItemIndex=4, BswMActionListItemRef=BswMModeControl/ESH_Action_ComMAllow_CN_LIN01_c62d34c2
              ESH_Action_ComMAllow_CN_ATOM_CANFD_Matrix_CH_V600_202502_a4d436ac: BswMActionListItemIndex=5, BswMActionListItemRef=BswMModeControl/ESH_Action_ComMAllow_CN_ATOM_CANFD_Matrix_CH_V600_202502_a4d436ac
              ESH_Action_ComMAllow_CN_LIN02_5f246578: BswMActionListItemIndex=6, BswMActionListItemRef=BswMModeControl/ESH_Action_ComMAllow_CN_LIN02_5f246578
              ESH_Action_ComMAllow_CN_TC37X_VCU_CAN12_XCP_d05a85ac: BswMActionListItemIndex=7, BswMActionListItemRef=BswMModeControl/ESH_Action_ComMAllow_CN_TC37X_VCU_CAN12_XCP_d05a85ac
              ESH_Action_ComMAllow_CN_ATOM_CAN_Matrix_PT_V600_20250211_9b894f3d: BswMActionListItemIndex=8, BswMActionListItemRef=BswMModeControl/ESH_Action_ComMAllow_CN_ATOM_CAN_Matrix_PT_V600_20250211_9b894f3d
          ESH_AL_ExitPostRun
            5 x BswMActionListItem, all with BswMAbortOnFail=false:
              ESH_PostRunNested: BswMActionListItemIndex=3, BswMActionListItemRef=BswMArbitration/ESH_PostRunNested
              ESH_Action_EnterExclusiveArea: BswMActionListItemIndex=0, BswMActionListItemRef=BswMModeControl/ESH_Action_EnterExclusiveArea
              ESH_Action_ComMCheckPendingRequests: BswMActionListItemIndex=1, BswMActionListItemRef=BswMModeControl/ESH_Action_ComMCheckPendingRequests
              ESH_Action_ExitExclusiveArea: BswMActionListItemIndex=4, BswMActionListItemRef=BswMModeControl/ESH_Action_ExitExclusiveArea
              ESH_Action_DemPostRunRequested: BswMActionListItemIndex=2, BswMActionListItemRef=BswMModeControl/ESH_Action_DemPostRunRequested
          ESH_AL_PrepShutdownToWaitForNvM
            5 x BswMActionListItem, all with BswMAbortOnFail=false:
              ESH_Action_ESH_WaitForNvm: BswMActionListItemIndex=4, BswMActionListItemRef=BswMModeControl/ESH_Action_ESH_WaitForNvm
              ESH_Action_OnEnterWaitForNvm: BswMActionListItemIndex=3, BswMActionListItemRef=BswMModeControl/ESH_Action_OnEnterWaitForNvm
              ESH_Action_ComMCheckPendingRequests: BswMActionListItemIndex=2, BswMActionListItemRef=BswMModeControl/ESH_Action_ComMCheckPendingRequests
              ESH_Action_WriteAllTimer_Start: BswMActionListItemIndex=0, BswMActionListItemRef=BswMModeControl/ESH_Action_WriteAllTimer_Start
              ESH_Action_NvMWriteAll: BswMActionListItemIndex=1, BswMActionListItemRef=BswMModeControl/ESH_Action_NvMWriteAll
        ESH_Action_ESH_WaitForNvm (BswMAction)
          BswMAvailableActions
            BswMGenericModeSwitch: BswMGenericRequestRef=ESH_State, BswMGenericRequestModeRef=ESH_WAIT_FOR_NVM
        INIT_AL_Initialize (BswMActionList): BswMActionListExecution=BSWM_CONDITION
          29 x BswMActionListItem, all with BswMAbortOnFail=false:
            INIT_Action_EnableInterrupts: BswMActionListItemIndex=22, BswMActionListItemRef=BswMModeControl/INIT_Action_EnableInterrupts
            INIT_Action_ComM_PreInit: BswMActionListItemIndex=1, BswMActionListItemRef=BswMModeControl/INIT_Action_ComM_PreInit
            INIT_Action_Nm_PreInit: BswMActionListItemIndex=3, BswMActionListItemRef=BswMModeControl/INIT_Action_Nm_PreInit
            INIT_Action_PduR_PreInit: BswMActionListItemIndex=4, BswMActionListItemRef=BswMModeControl/INIT_Action_PduR_PreInit
            INIT_Action_Can_Init: BswMActionListItemIndex=8, BswMActionListItemRef=BswMModeControl/INIT_Action_Can_Init
            INIT_Action_CanIf_Init: BswMActionListItemIndex=9, BswMActionListItemRef=BswMModeControl/INIT_Action_CanIf_Init
            INIT_Action_Com_Init: BswMActionListItemIndex=11, BswMActionListItemRef=BswMModeControl/INIT_Action_Com_Init
            INIT_Action_PduR_Init: BswMActionListItemIndex=12, BswMActionListItemRef=BswMModeControl/INIT_Action_PduR_Init
            INIT_Action_CanSM_Init: BswMActionListItemIndex=13, BswMActionListItemRef=BswMModeControl/INIT_Action_CanSM_Init
            INIT_Action_CanNm_Init: BswMActionListItemIndex=15, BswMActionListItemRef=BswMModeControl/INIT_Action_CanNm_Init
            INIT_Action_Nm_Init: BswMActionListItemIndex=16, BswMActionListItemRef=BswMModeControl/INIT_Action_Nm_Init
            INIT_Action_ComM_Init: BswMActionListItemIndex=23, BswMActionListItemRef=BswMModeControl/INIT_Action_ComM_Init
            INIT_Action_ComM_PostInit: BswMActionListItemIndex=26, BswMActionListItemRef=BswMModeControl/INIT_Action_ComM_PostInit
            INIT_Action_Nm_PostInit: BswMActionListItemIndex=27, BswMActionListItemRef=BswMModeControl/INIT_Action_Nm_PostInit
            INIT_Action_Rte_Start: BswMActionListItemIndex=28, BswMActionListItemRef=BswMModeControl/INIT_Action_Rte_Start
            INIT_Action_Fee_Init: BswMActionListItemIndex=5, BswMActionListItemRef=BswMModeControl/INIT_Action_Fee_Init
            INIT_Action_NvM_Init: BswMActionListItemIndex=20, BswMActionListItemRef=BswMModeControl/INIT_Action_NvM_Init
            INIT_Action_NvMReadAll: BswMActionListItemIndex=21, BswMActionListItemRef=BswMModeControl/INIT_Action_NvMReadAll
            INIT_Action_CanXcp_Init: BswMActionListItemIndex=18, BswMActionListItemRef=BswMModeControl/INIT_Action_CanXcp_Init
            INIT_Action_Xcp_Init: BswMActionListItemIndex=19, BswMActionListItemRef=BswMModeControl/INIT_Action_Xcp_Init
            INIT_Action_CanTp_Init: BswMActionListItemIndex=17, BswMActionListItemRef=BswMModeControl/INIT_Action_CanTp_Init
            INIT_Action_Dcm_Init: BswMActionListItemIndex=24, BswMActionListItemRef=BswMModeControl/INIT_Action_Dcm_Init
            INIT_Action_Dem_Init: BswMActionListItemIndex=25, BswMActionListItemRef=BswMModeControl/INIT_Action_Dem_Init
            INIT_Action_LinIf_Init: BswMActionListItemIndex=10, BswMActionListItemRef=BswMModeControl/INIT_Action_LinIf_Init
            INIT_Action_LinSM_Init: BswMActionListItemIndex=14, BswMActionListItemRef=BswMModeControl/INIT_Action_LinSM_Init
            INIT_Action_LinTrcv_30_Tle7259_Init: BswMActionListItemIndex=7, BswMActionListItemRef=BswMModeControl/INIT_Action_LinTrcv_30_Tle7259_Init
            INIT_Action_Lin_Init: BswMActionListItemIndex=2, BswMActionListItemRef=BswMModeControl/INIT_Action_Lin_Init
            INIT_Action_Dem_PreInit: BswMActionListItemIndex=0, BswMActionListItemRef=BswMModeControl/INIT_Action_Dem_PreInit
            INIT_Action_Icu_17_TimerIp_Init: BswMActionListItemIndex=6, BswMActionListItemRef=BswMModeControl/INIT_Action_Icu_17_TimerIp_Init
        3 x BswMAction:
          INIT_Action_EnableInterrupts
            BswMAvailableActions
              BswMUserCallout: BswMUserCalloutFunction=BswM_AL_SetProgrammableInterrupts(), BswMCreateCallout=true
          ESH_Action_OnEnterPostRun
            BswMAvailableActions
              BswMUserCallout: BswMUserCalloutFunction=BswM_ESH_OnEnterPostRun(), BswMCreateCallout=true
          ESH_Action_SwitchPostRun
            BswMAvailableActions
              BswMRteSwitch: BswMSwitchedMode=POSTRUN, BswMRteSwitchPortRef=ESH_ModeSwitch
        ESH_ModeSwitch (BswMSwitchPort): BswMModeSwitchInterfaceRef=BswM_MSI_ESH_Mode
        8 x BswMAction:
          ESH_Action_OnEnterShutdown
            BswMAvailableActions
              BswMUserCallout: BswMUserCalloutFunction=BswM_ESH_OnEnterShutdown(), BswMCreateCallout=true
          ESH_Action_OnEnterPrepShutdown
            BswMAvailableActions
              BswMUserCallout: BswMUserCalloutFunction=BswM_ESH_OnEnterPrepShutdown(), BswMCreateCallout=true
          ESH_Action_SwitchShutdown
            BswMAvailableActions
              BswMRteSwitch: BswMSwitchedMode=SHUTDOWN, BswMRteSwitchPortRef=ESH_ModeSwitch
          ESH_Action_OnEnterWakeup
            BswMAvailableActions
              BswMUserCallout: BswMUserCalloutFunction=BswM_ESH_OnEnterWakeup(), BswMCreateCallout=true
          ESH_Action_SwitchWakeup
            BswMAvailableActions
              BswMRteSwitch: BswMSwitchedMode=WAKEUP, BswMRteSwitchPortRef=ESH_ModeSwitch
          ESH_Action_OnEnterRun
            BswMAvailableActions
              BswMUserCallout: BswMUserCalloutFunction=BswM_ESH_OnEnterRun(), BswMCreateCallout=true
          ESH_Action_SwitchRun
            BswMAvailableActions
              BswMRteSwitch: BswMSwitchedMode=RUN, BswMRteSwitchPortRef=ESH_ModeSwitch
          ESH_Action_OnEnterWaitForNvm
            BswMAvailableActions
              BswMUserCallout: BswMUserCalloutFunction=BswM_ESH_OnEnterWaitForNvm(), BswMCreateCallout=true
        CC_AL_CN_TC37X_VCU_CAN00_07b6c9c8_TX_Disable (BswMActionList): BswMActionListExecution=BSWM_TRIGGER
          CC_DisablePDUGroup_VCU_oTC37X_VCU_CAN00_Tx_f6d10bbf (BswMActionListItem): BswMAbortOnFail=false, BswMActionListItemIndex=0, BswMActionListItemRef=BswMModeControl/CC_DisablePDUGroup_VCU_oTC37X_VCU_CAN00_Tx_f6d10bbf
        CC_DisablePDUGroup_VCU_oTC37X_VCU_CAN00_Tx_f6d10bbf (BswMAction)
          BswMAvailableActions
            BswMPduGroupSwitch: BswMPduGroupSwitchReinit=false, BswMDisabledPduGroupRef=VCU_oTC37X_VCU_CAN00_Tx_f6d10bbf
        CC_AL_CN_TC37X_VCU_CAN00_07b6c9c8_RX_Disable (BswMActionList): BswMActionListExecution=BSWM_TRIGGER
          CC_DisablePDUGroup_VCU_oTC37X_VCU_CAN00_Rx_a08bac39 (BswMActionListItem): BswMAbortOnFail=false, BswMActionListItemIndex=0, BswMActionListItemRef=BswMModeControl/CC_DisablePDUGroup_VCU_oTC37X_VCU_CAN00_Rx_a08bac39
        CC_DisablePDUGroup_VCU_oTC37X_VCU_CAN00_Rx_a08bac39 (BswMAction)
          BswMAvailableActions
            BswMPduGroupSwitch: BswMPduGroupSwitchReinit=false, BswMDisabledPduGroupRef=VCU_oTC37X_VCU_CAN00_Rx_a08bac39
        CC_AL_CN_TC37X_VCU_CAN00_07b6c9c8_RX_EnableReinit (BswMActionList): BswMActionListExecution=BSWM_TRIGGER
          CC_EnablePDUGroup_VCU_oTC37X_VCU_CAN00_Rx_a08bac39 (BswMActionListItem): BswMAbortOnFail=false, BswMActionListItemIndex=0, BswMActionListItemRef=BswMModeControl/CC_EnablePDUGroup_VCU_oTC37X_VCU_CAN00_Rx_a08bac39
        CC_EnablePDUGroup_VCU_oTC37X_VCU_CAN00_Rx_a08bac39 (BswMAction)
          BswMAvailableActions
            BswMPduGroupSwitch: BswMPduGroupSwitchReinit=true, BswMEnabledPduGroupRef=VCU_oTC37X_VCU_CAN00_Rx_a08bac39
        CC_AL_CN_TC37X_VCU_CAN00_07b6c9c8_TX_EnableReinit (BswMActionList): BswMActionListExecution=BSWM_TRIGGER
          CC_EnablePDUGroup_VCU_oTC37X_VCU_CAN00_Tx_f6d10bbf (BswMActionListItem): BswMAbortOnFail=false, BswMActionListItemIndex=0, BswMActionListItemRef=BswMModeControl/CC_EnablePDUGroup_VCU_oTC37X_VCU_CAN00_Tx_f6d10bbf
        CC_EnablePDUGroup_VCU_oTC37X_VCU_CAN00_Tx_f6d10bbf (BswMAction)
          BswMAvailableActions
            BswMPduGroupSwitch: BswMPduGroupSwitchReinit=true, BswMEnabledPduGroupRef=VCU_oTC37X_VCU_CAN00_Tx_f6d10bbf
        CC_AL_CN_TC37X_VCU_CAN00_07b6c9c8_TX_EnableNoinit (BswMActionList): BswMActionListExecution=BSWM_TRIGGER
          CC_EnablePDUGroup_Noinit_VCU_oTC37X_VCU_CAN00_Tx_f6d10bbf (BswMActionListItem):
            BswMAbortOnFail = false
            BswMActionListItemIndex = 0
            BswMActionListItemRef = BswMModeControl/CC_EnablePDUGroup_Noinit_VCU_oTC37X_VCU_CAN00_Tx_f6d10bbf
        CC_EnablePDUGroup_Noinit_VCU_oTC37X_VCU_CAN00_Tx_f6d10bbf (BswMAction)
          BswMAvailableActions
            BswMPduGroupSwitch: BswMPduGroupSwitchReinit=false, BswMEnabledPduGroupRef=VCU_oTC37X_VCU_CAN00_Tx_f6d10bbf
        CC_AL_CN_TC37X_VCU_CAN00_07b6c9c8_NO_COM (BswMActionList): BswMActionListExecution=BSWM_TRIGGER
          CC_GenericSwitch_Generic_BusOff_CN_TC37X_VCU_CAN00_07b6c9c8_NO_COM (BswMActionListItem):
            BswMAbortOnFail = false
            BswMActionListItemIndex = 0
            BswMActionListItemRef = BswMModeControl/CC_GenericSwitch_Generic_BusOff_CN_TC37X_VCU_CAN00_07b6c9c8_NO_COM
        CC_GenericSwitch_Generic_BusOff_CN_TC37X_VCU_CAN00_07b6c9c8_NO_COM (BswMAction)
          BswMAvailableActions
            BswMGenericModeSwitch: BswMGenericRequestRef=CC_Generic_BusOff_CN_TC37X_VCU_CAN00_07b6c9c8, BswMGenericRequestModeRef=BswMGenericRequest/NO_COM
        CC_AL_CN_TC37X_VCU_CAN00_07b6c9c8_BUSOFF_SILENT (BswMActionList): BswMActionListExecution=BSWM_TRIGGER
          CC_GenericSwitch_Generic_BusOff_CN_TC37X_VCU_CAN00_07b6c9c8_BUSOFF_SILENT (BswMActionListItem):
            BswMAbortOnFail = false
            BswMActionListItemIndex = 0
            BswMActionListItemRef = BswMModeControl/CC_GenericSwitch_Generic_BusOff_CN_TC37X_VCU_CAN00_07b6c9c8_BUSOFF_SILENT
        CC_GenericSwitch_Generic_BusOff_CN_TC37X_VCU_CAN00_07b6c9c8_BUSOFF_SILENT (BswMAction)
          BswMAvailableActions
            BswMGenericModeSwitch: BswMGenericRequestRef=CC_Generic_BusOff_CN_TC37X_VCU_CAN00_07b6c9c8, BswMGenericRequestModeRef=BswMGenericRequest/BUSOFF_SILENT
        CC_AL_CN_TC37X_VCU_CAN00_07b6c9c8_Disable_DM (BswMActionList): BswMActionListExecution=BSWM_TRIGGER
          CC_DisableDM_VCU_oTC37X_VCU_CAN00_Rx_a08bac39 (BswMActionListItem): BswMAbortOnFail=false, BswMActionListItemIndex=0, BswMActionListItemRef=BswMModeControl/CC_DisableDM_VCU_oTC37X_VCU_CAN00_Rx_a08bac39
        CC_DisableDM_VCU_oTC37X_VCU_CAN00_Rx_a08bac39 (BswMAction)
          BswMAvailableActions
            BswMDeadlineMonitoringControl: BswMDisabledDMPduGroupRef=VCU_oTC37X_VCU_CAN00_Rx_a08bac39
        CC_AL_CN_TC37X_VCU_CAN00_07b6c9c8_Enable_DM (BswMActionList): BswMActionListExecution=BSWM_TRIGGER
          CC_EnableDM_VCU_oTC37X_VCU_CAN00_Rx_a08bac39 (BswMActionListItem): BswMAbortOnFail=false, BswMActionListItemIndex=0, BswMActionListItemRef=BswMModeControl/CC_EnableDM_VCU_oTC37X_VCU_CAN00_Rx_a08bac39
        CC_EnableDM_VCU_oTC37X_VCU_CAN00_Rx_a08bac39 (BswMAction)
          BswMAvailableActions
            BswMDeadlineMonitoringControl: BswMEnabledDMPduGroupRef=VCU_oTC37X_VCU_CAN00_Rx_a08bac39
        ESH_AL_ExitRun (BswMActionList): BswMActionListExecution=BSWM_CONDITION
          4 x BswMActionListItem, all with BswMAbortOnFail=false:
            ESH_Action_EnterExclusiveArea: BswMActionListItemIndex=0, BswMActionListItemRef=BswMModeControl/ESH_Action_EnterExclusiveArea
            ESH_Action_ComMCheckPendingRequests: BswMActionListItemIndex=1, BswMActionListItemRef=BswMModeControl/ESH_Action_ComMCheckPendingRequests
            ESH_RunToPostRunNested: BswMActionListItemIndex=2, BswMActionListItemRef=BswMArbitration/ESH_RunToPostRunNested
            ESH_Action_ExitExclusiveArea: BswMActionListItemIndex=3, BswMActionListItemRef=BswMModeControl/ESH_Action_ExitExclusiveArea
        34 x BswMAction:
          ESH_Action_EnterExclusiveArea
            BswMAvailableActions
              BswMUserCallout: BswMUserCalloutFunction=SchM_Enter_BswM_BSWM_EXCLUSIVE_AREA_0(), BswMCreateCallout=false, BswMUserIncludeFile=SchM_BswM.h
          ESH_Action_ComMCheckPendingRequests
            BswMAvailableActions
              BswMUserCallout:
                BswMUserCalloutFunction = ESH_ComM_CheckPendingRequests()
                BswMCreateCallout = true
                BswMUserCode = ComM_StateType CN_TC37X_VCU_CAN00_07b6c9c8 = COMM_NO_COM_NO_PENDING_REQUEST; ComM_StateType CN_TC37X_VCU_CAN01_70b1f95e = COMM_NO_COM_NO_PENDING_REQUEST; ComM_StateType CN_LIN00_b12a0454 = COMM_NO_COM_NO_PENDING_REQUEST; ComM_StateType CN_TC37X_VCU_CAN03_9ebf9872 = COMM_NO_COM_NO_PENDING_REQUEST; ComM_StateType CN_LIN01_c62d34c2 = COMM_NO_COM_NO_PENDING_REQUEST; ComM_StateType CN_ATOM_CANFD_Matrix_CH_V600_202502_a4d436ac = COMM_NO_COM_NO_PENDING_REQUEST; ComM_StateType CN_LIN02_5f246578 = COMM_NO_COM_NO_PENDING_REQUEST; ComM_StateType CN_TC37X_VCU_CAN12_XCP_d05a85ac = COMM_NO_COM_NO_PENDING_REQUEST; ComM_StateType CN_ATOM_CAN_Matrix_PT_V600_20250211_9b894f3d = COMM_NO_COM_NO_PENDING_REQUEST; (void)ComM_GetState(ComMConf_ComMChannel_CN_TC37X_VCU_CAN00_07b6c9c8, &CN_TC37X_VCU_CAN00_07b6c9c8); /* SBSW_BSWM_FCTCALL_LOCALVAR */ (void)ComM_GetState(ComMConf_ComMChannel_CN_TC37X_VCU_CAN01_70b1f95e, &CN_TC37X_VCU_CAN01_70b1f95e); /* SBSW_BSWM_FCTCALL_LOCALVAR */ (void)ComM_GetState(ComMConf_ComMChannel_CN_LIN00_b12a0454, &CN_LIN00_b12a0454); /* SBSW_BSWM_FCTCALL_LOCALVAR */ (void)ComM_GetState(ComMConf_ComMChannel_CN_TC37X_VCU_CAN03_9ebf9872, &CN_TC37X_VCU_CAN03_9ebf9872); /* SBSW_BSWM_FCTCALL_LOCALVAR */ (void)ComM_GetState(ComMConf_ComMChannel_CN_LIN01_c62d34c2, &CN_LIN01_c62d34c2); /* SBSW_BSWM_FCTCALL_LOCALVAR */ (void)ComM_GetState(ComMConf_ComMChannel_CN_ATOM_CANFD_Matrix_CH_V600_202502_a4d436ac, &CN_ATOM_CANFD_Matrix_CH_V600_202502_a4d436ac); /* SBSW_BSWM_FCTCALL_LOCALVAR */ (void)ComM_GetState(ComMConf_ComMChannel_CN_LIN02_5f246578, &CN_LIN02_5f246578); /* SBSW_BSWM_FCTCALL_LOCALVAR */ (void)ComM_GetState(ComMConf_ComMChannel_CN_TC37X_VCU_CAN12_XCP_d05a85ac, &CN_TC37X_VCU_CAN12_XCP_d05a85ac); /* SBSW_BSWM_FCTCALL_LOCALVAR */ (void)ComM_GetState(ComMConf_ComMChannel_CN_ATOM_CAN_Matrix_PT_V600_20250211_9b894f3d, &CN_ATOM_CAN_Matrix_PT_V600_20250211_9b894f3d); /* SBSW_BSWM_FCTCALL_LOCALVAR */ if((CN_TC37X_VCU_CAN00_07b6c9c8 != COMM_NO_COM_NO_PENDING_REQUEST) || (CN_TC37X_VCU_CAN01_70b1f95e != COMM_NO_COM_NO_PENDING_REQUEST) || (CN_LIN00_b12a0454 != COMM_NO_COM_NO_PENDING_REQUEST) || (CN_TC37X_VCU_CAN03_9ebf9872 != COMM_NO_COM_NO_PENDING_REQUEST) || (CN_LIN01_c62d34c2 != COMM_NO_COM_NO_PENDING_REQUEST) || (CN_ATOM_CANFD_Matrix_CH_V600_202502_a4d436ac != COMM_NO_COM_NO_PENDING_REQUEST) || (CN_LIN02_5f246578 != COMM_NO_COM_NO_PENDING_REQUEST) || (CN_TC37X_VCU_CAN12_XCP_d05a85ac != COMM_NO_COM_NO_PENDING_REQUEST) || (CN_ATOM_CAN_Matrix_PT_V600_20250211_9b894f3d != COMM_NO_COM_NO_PENDING_REQUEST)) { BswM_RequestMode(BSWM_GENERIC_ESH_ComMPendingRequests, BSWM_GENERICVALUE_ESH_ComMPendingRequests_ESH_COMM_PENDING_REQUEST); } else { BswM_RequestMode(BSWM_GENERIC_ESH_ComMPendingRequests, BSWM_GENERICVALUE_ESH_ComMPendingRequests_ESH_COMM_NO_REQUEST); }
          ESH_Action_ComMDisallow_CN_TC37X_VCU_CAN00_07b6c9c8
            BswMAvailableActions
              BswMComMAllowCom: BswMComAllowed=false, BswMComMAllowChannelRef=CN_TC37X_VCU_CAN00_07b6c9c8
          ESH_Action_ExitExclusiveArea
            BswMAvailableActions
              BswMUserCallout: BswMUserCalloutFunction=SchM_Exit_BswM_BSWM_EXCLUSIVE_AREA_0(), BswMCreateCallout=false, BswMUserIncludeFile=SchM_BswM.h
          ESH_Action_ComMAllow_CN_TC37X_VCU_CAN00_07b6c9c8
            BswMAvailableActions
              BswMComMAllowCom: BswMComAllowed=true, BswMComMAllowChannelRef=CN_TC37X_VCU_CAN00_07b6c9c8
          INIT_Action_ComM_PreInit
            BswMAvailableActions
              BswMUserCallout: BswMUserCalloutFunction=ComM_PreInit(ComM_Config_Ptr), BswMCreateCallout=false, BswMUserIncludeFile=ComM.h
          INIT_Action_Nm_PreInit
            BswMAvailableActions
              BswMUserCallout: BswMUserCalloutFunction=Nm_PreInit(Nm_Config_Ptr), BswMCreateCallout=false, BswMUserIncludeFile=Nm.h
          INIT_Action_PduR_PreInit
            BswMAvailableActions
              BswMUserCallout: BswMUserCalloutFunction=PduR_PreInit(PduR_Config_Ptr), BswMCreateCallout=false, BswMUserIncludeFile=PduR.h
          INIT_Action_Can_Init
            BswMAvailableActions
              BswMUserCallout: BswMUserCalloutFunction=Can_Init(Can_Config_Ptr), BswMCreateCallout=false, BswMUserIncludeFile=Can.h
          INIT_Action_CanIf_Init
            BswMAvailableActions
              BswMUserCallout: BswMUserCalloutFunction=CanIf_Init(CanIf_Config_Ptr), BswMCreateCallout=false, BswMUserIncludeFile=CanIf.h
          INIT_Action_Com_Init
            BswMAvailableActions
              BswMUserCallout: BswMUserCalloutFunction=Com_Init(Com_Config_Ptr), BswMCreateCallout=false, BswMUserIncludeFile=Com.h
          INIT_Action_PduR_Init
            BswMAvailableActions
              BswMUserCallout: BswMUserCalloutFunction=PduR_Init(PduR_Config_Ptr), BswMCreateCallout=false, BswMUserIncludeFile=PduR.h
          INIT_Action_CanSM_Init
            BswMAvailableActions
              BswMUserCallout: BswMUserCalloutFunction=CanSM_Init(CanSM_Config_Ptr), BswMCreateCallout=false, BswMUserIncludeFile=CanSM_EcuM.h
          INIT_Action_CanNm_Init
            BswMAvailableActions
              BswMUserCallout: BswMUserCalloutFunction=CanNm_Init(CanNm_Config_Ptr), BswMCreateCallout=false, BswMUserIncludeFile=CanNm.h
          INIT_Action_Nm_Init
            BswMAvailableActions
              BswMUserCallout: BswMUserCalloutFunction=Nm_Init(Nm_Config_Ptr), BswMCreateCallout=false, BswMUserIncludeFile=Nm.h
          INIT_Action_ComM_Init
            BswMAvailableActions
              BswMUserCallout: BswMUserCalloutFunction=ComM_Init(ComM_Config_Ptr), BswMCreateCallout=false, BswMUserIncludeFile=ComM.h
          INIT_Action_ComM_PostInit
            BswMAvailableActions
              BswMUserCallout: BswMUserCalloutFunction=ComM_PostInit(), BswMCreateCallout=false, BswMUserIncludeFile=ComM.h
          INIT_Action_Nm_PostInit
            BswMAvailableActions
              BswMUserCallout: BswMUserCalloutFunction=Nm_PostInit(), BswMCreateCallout=false, BswMUserIncludeFile=Nm.h
          INIT_Action_Rte_Start
            BswMAvailableActions
              BswMUserCallout: BswMUserCalloutFunction=Rte_Start(), BswMCreateCallout=false, BswMUserIncludeFile=Rte_Main.h
          INIT_Action_Fee_Init
            BswMAvailableActions
              BswMUserCallout: BswMUserCalloutFunction=Fee_Init(&Fee_Config), BswMCreateCallout=false, BswMUserIncludeFile=Fee.h
          INIT_Action_NvM_Init
            BswMAvailableActions
              BswMUserCallout: BswMUserCalloutFunction=NvM_Init(), BswMCreateCallout=false, BswMUserIncludeFile=NvM.h
          INIT_Action_NvMReadAll
            BswMAvailableActions
              BswMUserCallout: BswMUserCalloutFunction=BswM_INIT_NvMReadAll(), BswMCreateCallout=true
          INIT_Action_CanXcp_Init
            BswMAvailableActions
              BswMUserCallout: BswMUserCalloutFunction=CanXcp_Init(NULL_PTR), BswMCreateCallout=false, BswMUserIncludeFile=CanXcp.h
          INIT_Action_Xcp_Init
            BswMAvailableActions
              BswMUserCallout: BswMUserCalloutFunction=Xcp_Init(), BswMCreateCallout=false, BswMUserIncludeFile=Xcp.h
          ESH_Action_WriteAllTimer_Stop
            BswMAvailableActions
              BswMTimerControl: BswMTimerAction=BSWM_TIMER_STOP, BswMTimerValue=0, BswMTimerRef=ESH_NvM_WriteAllTimer
          ESH_Action_CancelWriteAllTimer_Start
            BswMAvailableActions
              BswMTimerControl: BswMTimerAction=BSWM_TIMER_START, BswMTimerValue=60, BswMTimerRef=ESH_NvM_CancelWriteAllTimer
          ESH_Action_CancelNvMWriteAll
            BswMAvailableActions
              BswMUserCallout: BswMUserCalloutFunction=NvM_CancelWriteAll(), BswMCreateCallout=false, BswMUserIncludeFile=NvM.h
          ESH_Action_CancelWriteAllTimer_Stop
            BswMAvailableActions
              BswMTimerControl: BswMTimerAction=BSWM_TIMER_STOP, BswMTimerValue=0, BswMTimerRef=ESH_NvM_CancelWriteAllTimer
          ESH_Action_WriteAllTimer_Start
            BswMAvailableActions
              BswMTimerControl: BswMTimerAction=BSWM_TIMER_START, BswMTimerValue=60, BswMTimerRef=ESH_NvM_WriteAllTimer
          ESH_Action_NvMWriteAll
            BswMAvailableActions
              BswMUserCallout: BswMUserCalloutFunction=NvM_WriteAll(), BswMCreateCallout=false, BswMUserIncludeFile=NvM.h
          INIT_Action_CanTp_Init
            BswMAvailableActions
              BswMUserCallout: BswMUserCalloutFunction=CanTp_Init(CanTp_Config_Ptr), BswMCreateCallout=false, BswMUserIncludeFile=CanTp.h
          INIT_Action_Dcm_Init
            BswMAvailableActions
              BswMUserCallout: BswMUserCalloutFunction=Dcm_Init(NULL_PTR), BswMCreateCallout=false, BswMUserIncludeFile=Dcm.h
          INIT_Action_Dem_Init
            BswMAvailableActions
              BswMUserCallout: BswMUserCalloutFunction=Dem_Init(Dem_Config_Ptr), BswMCreateCallout=false, BswMUserIncludeFile=Dem.h
          CC_DisableNM_VCU_oTC37X_VCU_CAN00
            BswMAvailableActions
              BswMNMControl: BswMNMAction=BSWM_NM_DISABLE, BswMComMNetworkHandleRef=CN_TC37X_VCU_CAN00_07b6c9c8
        CC_AL_CN_TC37X_VCU_CAN00_DISABLE_NM (BswMActionList): BswMActionListExecution=BSWM_TRIGGER
          CC_DisableNM_VCU_oTC37X_VCU_CAN00 (BswMActionListItem): BswMAbortOnFail=false, BswMActionListItemIndex=0, BswMActionListItemRef=BswMModeControl/CC_DisableNM_VCU_oTC37X_VCU_CAN00
        CC_AL_CN_TC37X_VCU_CAN00_ENABLE_NM (BswMActionList): BswMActionListExecution=BSWM_TRIGGER
          CC_EnableNM_VCU_oTC37X_VCU_CAN00 (BswMActionListItem): BswMAbortOnFail=false, BswMActionListItemIndex=0, BswMActionListItemRef=BswMModeControl/CC_EnableNM_VCU_oTC37X_VCU_CAN00
        CC_EnableNM_VCU_oTC37X_VCU_CAN00 (BswMAction)
          BswMAvailableActions
            BswMNMControl: BswMNMAction=BSWM_NM_ENABLE, BswMComMNetworkHandleRef=CN_TC37X_VCU_CAN00_07b6c9c8
        CC_AL_CN_TC37X_VCU_CAN01_70b1f95e_Disable_DM (BswMActionList): BswMActionListExecution=BSWM_TRIGGER
          CC_DisableDM_VCU_oTC37X_VCU_CAN01_Rx_1837cb5c (BswMActionListItem): BswMAbortOnFail=false, BswMActionListItemIndex=0, BswMActionListItemRef=BswMModeControl/CC_DisableDM_VCU_oTC37X_VCU_CAN01_Rx_1837cb5c
        CC_DisableDM_VCU_oTC37X_VCU_CAN01_Rx_1837cb5c (BswMAction)
          BswMAvailableActions
            BswMDeadlineMonitoringControl: BswMDisabledDMPduGroupRef=VCU_oTC37X_VCU_CAN01_Rx_1837cb5c
        CC_AL_CN_TC37X_VCU_CAN01_70b1f95e_Enable_DM (BswMActionList): BswMActionListExecution=BSWM_TRIGGER
          CC_EnableDM_VCU_oTC37X_VCU_CAN01_Rx_1837cb5c (BswMActionListItem): BswMAbortOnFail=false, BswMActionListItemIndex=0, BswMActionListItemRef=BswMModeControl/CC_EnableDM_VCU_oTC37X_VCU_CAN01_Rx_1837cb5c
        CC_EnableDM_VCU_oTC37X_VCU_CAN01_Rx_1837cb5c (BswMAction)
          BswMAvailableActions
            BswMDeadlineMonitoringControl: BswMEnabledDMPduGroupRef=VCU_oTC37X_VCU_CAN01_Rx_1837cb5c
        CC_AL_CN_TC37X_VCU_CAN01_70b1f95e_TX_EnableReinit (BswMActionList): BswMActionListExecution=BSWM_TRIGGER
          CC_EnablePDUGroup_VCU_oTC37X_VCU_CAN01_Tx_4e6d6cda (BswMActionListItem): BswMAbortOnFail=false, BswMActionListItemIndex=0, BswMActionListItemRef=BswMModeControl/CC_EnablePDUGroup_VCU_oTC37X_VCU_CAN01_Tx_4e6d6cda
        CC_EnablePDUGroup_VCU_oTC37X_VCU_CAN01_Tx_4e6d6cda (BswMAction)
          BswMAvailableActions
            BswMPduGroupSwitch: BswMPduGroupSwitchReinit=true, BswMEnabledPduGroupRef=VCU_oTC37X_VCU_CAN01_Tx_4e6d6cda
        CC_AL_CN_TC37X_VCU_CAN01_70b1f95e_NO_COM (BswMActionList): BswMActionListExecution=BSWM_TRIGGER
          CC_GenericSwitch_Generic_BusOff_CN_TC37X_VCU_CAN01_70b1f95e_NO_COM (BswMActionListItem):
            BswMAbortOnFail = false
            BswMActionListItemIndex = 0
            BswMActionListItemRef = BswMModeControl/CC_GenericSwitch_Generic_BusOff_CN_TC37X_VCU_CAN01_70b1f95e_NO_COM
        CC_GenericSwitch_Generic_BusOff_CN_TC37X_VCU_CAN01_70b1f95e_NO_COM (BswMAction)
          BswMAvailableActions
            BswMGenericModeSwitch: BswMGenericRequestRef=CC_Generic_BusOff_CN_TC37X_VCU_CAN01_70b1f95e, BswMGenericRequestModeRef=BswMGenericRequest/NO_COM
        CC_AL_CN_TC37X_VCU_CAN01_70b1f95e_RX_Disable (BswMActionList): BswMActionListExecution=BSWM_TRIGGER
          CC_DisablePDUGroup_VCU_oTC37X_VCU_CAN01_Rx_1837cb5c (BswMActionListItem): BswMAbortOnFail=false, BswMActionListItemIndex=0, BswMActionListItemRef=BswMModeControl/CC_DisablePDUGroup_VCU_oTC37X_VCU_CAN01_Rx_1837cb5c
        CC_DisablePDUGroup_VCU_oTC37X_VCU_CAN01_Rx_1837cb5c (BswMAction)
          BswMAvailableActions
            BswMPduGroupSwitch: BswMPduGroupSwitchReinit=false, BswMDisabledPduGroupRef=VCU_oTC37X_VCU_CAN01_Rx_1837cb5c
        CC_AL_CN_TC37X_VCU_CAN01_70b1f95e_RX_EnableReinit (BswMActionList): BswMActionListExecution=BSWM_TRIGGER
          CC_EnablePDUGroup_VCU_oTC37X_VCU_CAN01_Rx_1837cb5c (BswMActionListItem): BswMAbortOnFail=false, BswMActionListItemIndex=0, BswMActionListItemRef=BswMModeControl/CC_EnablePDUGroup_VCU_oTC37X_VCU_CAN01_Rx_1837cb5c
        CC_EnablePDUGroup_VCU_oTC37X_VCU_CAN01_Rx_1837cb5c (BswMAction)
          BswMAvailableActions
            BswMPduGroupSwitch: BswMPduGroupSwitchReinit=true, BswMEnabledPduGroupRef=VCU_oTC37X_VCU_CAN01_Rx_1837cb5c
        CC_AL_CN_TC37X_VCU_CAN01_70b1f95e_BUSOFF_SILENT (BswMActionList): BswMActionListExecution=BSWM_TRIGGER
          CC_GenericSwitch_Generic_BusOff_CN_TC37X_VCU_CAN01_70b1f95e_BUSOFF_SILENT (BswMActionListItem):
            BswMAbortOnFail = false
            BswMActionListItemIndex = 0
            BswMActionListItemRef = BswMModeControl/CC_GenericSwitch_Generic_BusOff_CN_TC37X_VCU_CAN01_70b1f95e_BUSOFF_SILENT
        CC_GenericSwitch_Generic_BusOff_CN_TC37X_VCU_CAN01_70b1f95e_BUSOFF_SILENT (BswMAction)
          BswMAvailableActions
            BswMGenericModeSwitch: BswMGenericRequestRef=CC_Generic_BusOff_CN_TC37X_VCU_CAN01_70b1f95e, BswMGenericRequestModeRef=BswMGenericRequest/BUSOFF_SILENT
        CC_AL_CN_TC37X_VCU_CAN01_70b1f95e_TX_Disable (BswMActionList): BswMActionListExecution=BSWM_TRIGGER
          CC_DisablePDUGroup_VCU_oTC37X_VCU_CAN01_Tx_4e6d6cda (BswMActionListItem): BswMAbortOnFail=false, BswMActionListItemIndex=0, BswMActionListItemRef=BswMModeControl/CC_DisablePDUGroup_VCU_oTC37X_VCU_CAN01_Tx_4e6d6cda
        CC_DisablePDUGroup_VCU_oTC37X_VCU_CAN01_Tx_4e6d6cda (BswMAction)
          BswMAvailableActions
            BswMPduGroupSwitch: BswMPduGroupSwitchReinit=false, BswMDisabledPduGroupRef=VCU_oTC37X_VCU_CAN01_Tx_4e6d6cda
        CC_AL_CN_TC37X_VCU_CAN01_70b1f95e_TX_EnableNoinit (BswMActionList): BswMActionListExecution=BSWM_TRIGGER
          CC_EnablePDUGroup_Noinit_VCU_oTC37X_VCU_CAN01_Tx_4e6d6cda (BswMActionListItem):
            BswMAbortOnFail = false
            BswMActionListItemIndex = 0
            BswMActionListItemRef = BswMModeControl/CC_EnablePDUGroup_Noinit_VCU_oTC37X_VCU_CAN01_Tx_4e6d6cda
        7 x BswMAction:
          CC_EnablePDUGroup_Noinit_VCU_oTC37X_VCU_CAN01_Tx_4e6d6cda
            BswMAvailableActions
              BswMPduGroupSwitch: BswMPduGroupSwitchReinit=false, BswMEnabledPduGroupRef=VCU_oTC37X_VCU_CAN01_Tx_4e6d6cda
          ESH_Action_ComMDisallow_CN_TC37X_VCU_CAN01_70b1f95e
            BswMAvailableActions
              BswMComMAllowCom: BswMComAllowed=false, BswMComMAllowChannelRef=CN_TC37X_VCU_CAN01_70b1f95e
          ESH_Action_ComMAllow_CN_TC37X_VCU_CAN01_70b1f95e
            BswMAvailableActions
              BswMComMAllowCom: BswMComAllowed=true, BswMComMAllowChannelRef=CN_TC37X_VCU_CAN01_70b1f95e
          CC_DisablePDUGroup_VCU_oLIN00_Tx_1dc75bd5
            BswMAvailableActions
              BswMPduGroupSwitch: BswMPduGroupSwitchReinit=false, BswMDisabledPduGroupRef=VCU_oLIN00_Tx_1dc75bd5
          CC_DisablePDUGroup_VCU_oLIN00_Rx_4b9dfc53
            BswMAvailableActions
              BswMPduGroupSwitch: BswMPduGroupSwitchReinit=false, BswMDisabledPduGroupRef=VCU_oLIN00_Rx_4b9dfc53
          CC_EnablePDUGroup_VCU_oLIN00_Tx_1dc75bd5
            BswMAvailableActions
              BswMPduGroupSwitch: BswMPduGroupSwitchReinit=true, BswMEnabledPduGroupRef=VCU_oLIN00_Tx_1dc75bd5
          CC_EnablePDUGroup_VCU_oLIN00_Rx_4b9dfc53
            BswMAvailableActions
              BswMPduGroupSwitch: BswMPduGroupSwitchReinit=true, BswMEnabledPduGroupRef=VCU_oLIN00_Rx_4b9dfc53
        CC_AL_CN_LIN00_b12a0454_LinScheduleSwitch (BswMActionList): BswMActionListExecution=BSWM_TRIGGER
          CC_LinSchdeduleSwitch_CHNL_45618847_TCU_LIN_Schedule_740f8639 (BswMActionListItem):
            BswMAbortOnFail = false
            BswMActionListItemIndex = 0
            BswMActionListItemRef = BswMModeControl/CC_LinSchdeduleSwitch_CHNL_45618847_TCU_LIN_Schedule_740f8639
        8 x BswMAction:
          INIT_Action_LinIf_Init
            BswMAvailableActions
              BswMUserCallout: BswMUserCalloutFunction=LinIf_Init(LinIf_Config_Ptr), BswMCreateCallout=false, BswMUserIncludeFile=LinIf.h
          INIT_Action_LinSM_Init
            BswMAvailableActions
              BswMUserCallout: BswMUserCalloutFunction=LinSM_Init(LinSM_Config_Ptr), BswMCreateCallout=false, BswMUserIncludeFile=LinSM.h
          ESH_Action_ComMDisallow_CN_LIN00_b12a0454
            BswMAvailableActions
              BswMComMAllowCom: BswMComAllowed=false, BswMComMAllowChannelRef=CN_LIN00_b12a0454
          ESH_Action_ComMAllow_CN_LIN00_b12a0454
            BswMAvailableActions
              BswMComMAllowCom: BswMComAllowed=true, BswMComMAllowChannelRef=CN_LIN00_b12a0454
          INIT_Action_LinTrcv_30_Tle7259_Init
            BswMAvailableActions
              BswMUserCallout:
                BswMUserCalloutFunction = LinTrcv_30_Tle7259_Init(LinTrcv_30_Tle7259_Config_Ptr)
                BswMCreateCallout = false
                BswMUserIncludeFile = LinTrcv_30_Tle7259.h
          INIT_Action_Lin_Init
            BswMAvailableActions
              BswMUserCallout: BswMUserCalloutFunction=Lin_Init(Lin_Config_Ptr), BswMCreateCallout=false, BswMUserIncludeFile=Lin.h
          CC_LinSchdeduleSwitch_CHNL_45618847_TCU_LIN_Schedule_740f8639
            BswMAvailableActions
              BswMLinScheduleSwitch: BswMLinScheduleRef=TCU_LIN_Schedule_740f8639
          INIT_Action_Dem_PreInit
            BswMAvailableActions
              BswMUserCallout: BswMUserCalloutFunction=Dem_PreInit(Dem_Config_Ptr), BswMCreateCallout=false, BswMUserIncludeFile=Dem.h
        ESH_AL_DemInit (BswMActionList): BswMActionListExecution=BSWM_CONDITION
          ESH_Action_DemInit (BswMActionListItem): BswMAbortOnFail=false, BswMActionListItemIndex=0, BswMActionListItemRef=BswMModeControl/ESH_Action_DemInit
          ESH_Action_DemInitialized (BswMActionListItem): BswMAbortOnFail=false, BswMActionListItemIndex=1, BswMActionListItemRef=BswMModeControl/ESH_Action_DemInitialized
        5 x BswMAction:
          ESH_Action_DemInit
            BswMAvailableActions
              BswMUserCallout: BswMUserCalloutFunction=Dem_Init(Dem_Config_Ptr), BswMCreateCallout=false, BswMUserIncludeFile=Dem.h
          ESH_Action_DemInitialized
            BswMAvailableActions
              BswMGenericModeSwitch: BswMGenericRequestRef=ESH_DemInitStatus, BswMGenericRequestModeRef=DEM_INITIALIZED
          ESH_Action_DemShutdown
            BswMAvailableActions
              BswMUserCallout: BswMUserCalloutFunction=Dem_Shutdown(), BswMCreateCallout=false, BswMUserIncludeFile=Dem.h
          ESH_Action_DemNotInitialized
            BswMAvailableActions
              BswMGenericModeSwitch: BswMGenericRequestRef=ESH_DemInitStatus, BswMGenericRequestModeRef=DEM_NOT_INITIALIZED
          ESH_Action_DemPostRunRequested
            BswMAvailableActions
              BswMUserCallout:
                BswMUserCalloutFunction = ESH_Dem_PostRunRequested()
                BswMCreateCallout = true
                BswMUserIncludeFile = Dem.h
                BswMUserCode = boolean isRequested = FALSE; (void)Dem_PostRunRequested(&isRequested); /* SBSW_BSWM_FCTCALL_LOCALVAR */ if (isRequested == TRUE) { BswM_RequestMode(BSWM_GENERIC_ESH_DemPostRunRequested, BSWM_GENERICVALUE_ESH_DemPostRunRequested_TRUE); } else { BswM_RequestMode(BSWM_GENERIC_ESH_DemPostRunRequested, BSWM_GENERICVALUE_ESH_DemPostRunRequested_FALSE); }
        CC_AL_CN_TC37X_VCU_CAN03_9ebf9872_RX_Disable (BswMActionList): BswMActionListExecution=BSWM_TRIGGER
          CC_DisablePDUGroup_VCU_oTC37X_VCU_CAN03_Rx_b23e03d7 (BswMActionListItem): BswMAbortOnFail=false, BswMActionListItemIndex=0, BswMActionListItemRef=BswMModeControl/CC_DisablePDUGroup_VCU_oTC37X_VCU_CAN03_Rx_b23e03d7
        CC_DisablePDUGroup_VCU_oTC37X_VCU_CAN03_Rx_b23e03d7 (BswMAction)
          BswMAvailableActions
            BswMPduGroupSwitch: BswMPduGroupSwitchReinit=false, BswMDisabledPduGroupRef=VCU_oTC37X_VCU_CAN03_Rx_b23e03d7
        CC_AL_CN_TC37X_VCU_CAN03_9ebf9872_RX_EnableNoinit (BswMActionList): BswMActionListExecution=BSWM_TRIGGER
          CC_EnablePDUGroup_VCU_oTC37X_VCU_CAN03_Rx_b23e03d7 (BswMActionListItem): BswMAbortOnFail=false, BswMActionListItemIndex=0, BswMActionListItemRef=BswMModeControl/CC_EnablePDUGroup_VCU_oTC37X_VCU_CAN03_Rx_b23e03d7
        CC_EnablePDUGroup_VCU_oTC37X_VCU_CAN03_Rx_b23e03d7 (BswMAction)
          BswMAvailableActions
            BswMPduGroupSwitch: BswMPduGroupSwitchReinit=false, BswMEnabledPduGroupRef=VCU_oTC37X_VCU_CAN03_Rx_b23e03d7
        CC_AL_CN_TC37X_VCU_CAN03_9ebf9872_Disable_DM (BswMActionList): BswMActionListExecution=BSWM_TRIGGER
          CC_DisableDM_VCU_oTC37X_VCU_CAN03_Rx_b23e03d7 (BswMActionListItem): BswMAbortOnFail=false, BswMActionListItemIndex=0, BswMActionListItemRef=BswMModeControl/CC_DisableDM_VCU_oTC37X_VCU_CAN03_Rx_b23e03d7
        CC_DisableDM_VCU_oTC37X_VCU_CAN03_Rx_b23e03d7 (BswMAction)
          BswMAvailableActions
            BswMDeadlineMonitoringControl: BswMDisabledDMPduGroupRef=VCU_oTC37X_VCU_CAN03_Rx_b23e03d7
        CC_AL_CN_TC37X_VCU_CAN03_9ebf9872_Enable_DM (BswMActionList): BswMActionListExecution=BSWM_TRIGGER
          CC_EnableDM_VCU_oTC37X_VCU_CAN03_Rx_b23e03d7 (BswMActionListItem): BswMAbortOnFail=false, BswMActionListItemIndex=0, BswMActionListItemRef=BswMModeControl/CC_EnableDM_VCU_oTC37X_VCU_CAN03_Rx_b23e03d7
        CC_EnableDM_VCU_oTC37X_VCU_CAN03_Rx_b23e03d7 (BswMAction)
          BswMAvailableActions
            BswMDeadlineMonitoringControl: BswMEnabledDMPduGroupRef=VCU_oTC37X_VCU_CAN03_Rx_b23e03d7
        CC_AL_CN_TC37X_VCU_CAN03_9ebf9872_TX_Disable (BswMActionList): BswMActionListExecution=BSWM_TRIGGER
          CC_DisablePDUGroup_VCU_oTC37X_VCU_CAN03_Tx_e464a451 (BswMActionListItem): BswMAbortOnFail=false, BswMActionListItemIndex=0, BswMActionListItemRef=BswMModeControl/CC_DisablePDUGroup_VCU_oTC37X_VCU_CAN03_Tx_e464a451
        CC_DisablePDUGroup_VCU_oTC37X_VCU_CAN03_Tx_e464a451 (BswMAction)
          BswMAvailableActions
            BswMPduGroupSwitch: BswMPduGroupSwitchReinit=false, BswMDisabledPduGroupRef=VCU_oTC37X_VCU_CAN03_Tx_e464a451
        CC_AL_CN_TC37X_VCU_CAN03_9ebf9872_TX_EnableNoinit (BswMActionList): BswMActionListExecution=BSWM_TRIGGER
          CC_EnablePDUGroup_VCU_oTC37X_VCU_CAN03_Tx_e464a451 (BswMActionListItem): BswMAbortOnFail=false, BswMActionListItemIndex=0, BswMActionListItemRef=BswMModeControl/CC_EnablePDUGroup_VCU_oTC37X_VCU_CAN03_Tx_e464a451
        3 x BswMAction:
          CC_EnablePDUGroup_VCU_oTC37X_VCU_CAN03_Tx_e464a451
            BswMAvailableActions
              BswMPduGroupSwitch: BswMPduGroupSwitchReinit=false, BswMEnabledPduGroupRef=VCU_oTC37X_VCU_CAN03_Tx_e464a451
          ESH_Action_ComMDisallow_CN_TC37X_VCU_CAN03_9ebf9872
            BswMAvailableActions
              BswMComMAllowCom: BswMComAllowed=false, BswMComMAllowChannelRef=CN_TC37X_VCU_CAN03_9ebf9872
          ESH_Action_ComMAllow_CN_TC37X_VCU_CAN03_9ebf9872
            BswMAvailableActions
              BswMComMAllowCom: BswMComAllowed=true, BswMComMAllowChannelRef=CN_TC37X_VCU_CAN03_9ebf9872
        CC_AL_CN_LIN01_c62d34c2_Vcu_Lin0_Schedule_0e999bb4_Disable (BswMActionList): BswMActionListExecution=BSWM_TRIGGER
          CC_DisablePDUGroup_VCU_oLIN01_Tx_a57b3cb0 (BswMActionListItem): BswMAbortOnFail=false, BswMActionListItemIndex=0, BswMActionListItemRef=BswMModeControl/CC_DisablePDUGroup_VCU_oLIN01_Tx_a57b3cb0
          CC_DisablePDUGroup_VCU_oLIN01_Rx_f3219b36 (BswMActionListItem): BswMAbortOnFail=false, BswMActionListItemIndex=1, BswMActionListItemRef=BswMModeControl/CC_DisablePDUGroup_VCU_oLIN01_Rx_f3219b36
        CC_DisablePDUGroup_VCU_oLIN01_Tx_a57b3cb0 (BswMAction)
          BswMAvailableActions
            BswMPduGroupSwitch: BswMPduGroupSwitchReinit=false, BswMDisabledPduGroupRef=VCU_oLIN01_Tx_a57b3cb0
        CC_DisablePDUGroup_VCU_oLIN01_Rx_f3219b36 (BswMAction)
          BswMAvailableActions
            BswMPduGroupSwitch: BswMPduGroupSwitchReinit=false, BswMDisabledPduGroupRef=VCU_oLIN01_Rx_f3219b36
        CC_AL_CN_LIN01_c62d34c2_Vcu_Lin0_Schedule_0e999bb4_Enable (BswMActionList): BswMActionListExecution=BSWM_TRIGGER
          CC_EnablePDUGroup_VCU_oLIN01_Tx_a57b3cb0 (BswMActionListItem): BswMAbortOnFail=false, BswMActionListItemIndex=0, BswMActionListItemRef=BswMModeControl/CC_EnablePDUGroup_VCU_oLIN01_Tx_a57b3cb0
          CC_EnablePDUGroup_VCU_oLIN01_Rx_f3219b36 (BswMActionListItem): BswMAbortOnFail=false, BswMActionListItemIndex=1, BswMActionListItemRef=BswMModeControl/CC_EnablePDUGroup_VCU_oLIN01_Rx_f3219b36
        CC_EnablePDUGroup_VCU_oLIN01_Tx_a57b3cb0 (BswMAction)
          BswMAvailableActions
            BswMPduGroupSwitch: BswMPduGroupSwitchReinit=true, BswMEnabledPduGroupRef=VCU_oLIN01_Tx_a57b3cb0
        CC_EnablePDUGroup_VCU_oLIN01_Rx_f3219b36 (BswMAction)
          BswMAvailableActions
            BswMPduGroupSwitch: BswMPduGroupSwitchReinit=true, BswMEnabledPduGroupRef=VCU_oLIN01_Rx_f3219b36
        CC_AL_CN_LIN01_c62d34c2_LinScheduleSwitch (BswMActionList): BswMActionListExecution=BSWM_TRIGGER
          CC_LinSchdeduleSwitch_CHNL_8e3d5be2_Vcu_Lin0_Schedule_0e999bb4 (BswMActionListItem):
            BswMAbortOnFail = false
            BswMActionListItemIndex = 0
            BswMActionListItemRef = BswMModeControl/CC_LinSchdeduleSwitch_CHNL_8e3d5be2_Vcu_Lin0_Schedule_0e999bb4
        4 x BswMAction:
          CC_LinSchdeduleSwitch_CHNL_8e3d5be2_Vcu_Lin0_Schedule_0e999bb4
            BswMAvailableActions
              BswMLinScheduleSwitch: BswMLinScheduleRef=Vcu_Lin0_Schedule_0e999bb4
          ESH_Action_ComMDisallow_CN_LIN01_c62d34c2
            BswMAvailableActions
              BswMComMAllowCom: BswMComAllowed=false, BswMComMAllowChannelRef=CN_LIN01_c62d34c2
          ESH_Action_ComMAllow_CN_LIN01_c62d34c2
            BswMAvailableActions
              BswMComMAllowCom: BswMComAllowed=true, BswMComMAllowChannelRef=CN_LIN01_c62d34c2
          INIT_Action_Icu_17_TimerIp_Init
            BswMAvailableActions
              BswMUserCallout: BswMUserCalloutFunction=Icu_17_TimerIp_Init(&Icu_17_TimerIp_Config), BswMCreateCallout=false, BswMUserIncludeFile=Icu_17_TimerIp.h
        CC_AL_CN_ATOM_CANFD_Matrix_CH_V600_202502_a4d436ac_RX_Disable (BswMActionList): BswMActionListExecution=BSWM_TRIGGER
          CC_DisablePDUGroup_VCU_oATOM_CANFD_Matrix_CH_V600_202502_Rx_5e4659c4 (BswMActionListItem):
            BswMAbortOnFail = false
            BswMActionListItemIndex = 0
            BswMActionListItemRef = BswMModeControl/CC_DisablePDUGroup_VCU_oATOM_CANFD_Matrix_CH_V600_202502_Rx_5e4659c4
        CC_DisablePDUGroup_VCU_oATOM_CANFD_Matrix_CH_V600_202502_Rx_5e4659c4 (BswMAction)
          BswMAvailableActions
            BswMPduGroupSwitch: BswMPduGroupSwitchReinit=false, BswMDisabledPduGroupRef=VCU_oATOM_CANFD_Matrix_CH_V600_202502_Rx_5e4659c4
        CC_AL_CN_ATOM_CANFD_Matrix_CH_V600_202502_a4d436ac_RX_EnableNoinit (BswMActionList): BswMActionListExecution=BSWM_TRIGGER
          CC_EnablePDUGroup_VCU_oATOM_CANFD_Matrix_CH_V600_202502_Rx_5e4659c4 (BswMActionListItem):
            BswMAbortOnFail = false
            BswMActionListItemIndex = 0
            BswMActionListItemRef = BswMModeControl/CC_EnablePDUGroup_VCU_oATOM_CANFD_Matrix_CH_V600_202502_Rx_5e4659c4
        CC_EnablePDUGroup_VCU_oATOM_CANFD_Matrix_CH_V600_202502_Rx_5e4659c4 (BswMAction)
          BswMAvailableActions
            BswMPduGroupSwitch: BswMPduGroupSwitchReinit=false, BswMEnabledPduGroupRef=VCU_oATOM_CANFD_Matrix_CH_V600_202502_Rx_5e4659c4
        CC_AL_CN_ATOM_CANFD_Matrix_CH_V600_202502_a4d436ac_TX_Disable (BswMActionList): BswMActionListExecution=BSWM_TRIGGER
          CC_DisablePDUGroup_VCU_oATOM_CANFD_Matrix_CH_V600_202502_Tx_081cfe42 (BswMActionListItem):
            BswMAbortOnFail = false
            BswMActionListItemIndex = 0
            BswMActionListItemRef = BswMModeControl/CC_DisablePDUGroup_VCU_oATOM_CANFD_Matrix_CH_V600_202502_Tx_081cfe42
        CC_DisablePDUGroup_VCU_oATOM_CANFD_Matrix_CH_V600_202502_Tx_081cfe42 (BswMAction)
          BswMAvailableActions
            BswMPduGroupSwitch: BswMPduGroupSwitchReinit=false, BswMDisabledPduGroupRef=VCU_oATOM_CANFD_Matrix_CH_V600_202502_Tx_081cfe42
        CC_AL_CN_ATOM_CANFD_Matrix_CH_V600_202502_a4d436ac_TX_EnableNoinit (BswMActionList): BswMActionListExecution=BSWM_TRIGGER
          CC_EnablePDUGroup_VCU_oATOM_CANFD_Matrix_CH_V600_202502_Tx_081cfe42 (BswMActionListItem):
            BswMAbortOnFail = false
            BswMActionListItemIndex = 0
            BswMActionListItemRef = BswMModeControl/CC_EnablePDUGroup_VCU_oATOM_CANFD_Matrix_CH_V600_202502_Tx_081cfe42
        CC_EnablePDUGroup_VCU_oATOM_CANFD_Matrix_CH_V600_202502_Tx_081cfe42 (BswMAction)
          BswMAvailableActions
            BswMPduGroupSwitch: BswMPduGroupSwitchReinit=false, BswMEnabledPduGroupRef=VCU_oATOM_CANFD_Matrix_CH_V600_202502_Tx_081cfe42
        CC_AL_CN_ATOM_CANFD_Matrix_CH_V600_202502_a4d436ac_Disable_DM (BswMActionList): BswMActionListExecution=BSWM_TRIGGER
          CC_DisableDM_VCU_oATOM_CANFD_Matrix_CH_V600_202502_Rx_5e4659c4 (BswMActionListItem):
            BswMAbortOnFail = false
            BswMActionListItemIndex = 0
            BswMActionListItemRef = BswMModeControl/CC_DisableDM_VCU_oATOM_CANFD_Matrix_CH_V600_202502_Rx_5e4659c4
        CC_DisableDM_VCU_oATOM_CANFD_Matrix_CH_V600_202502_Rx_5e4659c4 (BswMAction)
          BswMAvailableActions
            BswMDeadlineMonitoringControl: BswMDisabledDMPduGroupRef=VCU_oATOM_CANFD_Matrix_CH_V600_202502_Rx_5e4659c4
        CC_AL_CN_ATOM_CANFD_Matrix_CH_V600_202502_a4d436ac_Enable_DM (BswMActionList): BswMActionListExecution=BSWM_TRIGGER
          CC_EnableDM_VCU_oATOM_CANFD_Matrix_CH_V600_202502_Rx_5e4659c4 (BswMActionListItem):
            BswMAbortOnFail = false
            BswMActionListItemIndex = 0
            BswMActionListItemRef = BswMModeControl/CC_EnableDM_VCU_oATOM_CANFD_Matrix_CH_V600_202502_Rx_5e4659c4
        3 x BswMAction:
          CC_EnableDM_VCU_oATOM_CANFD_Matrix_CH_V600_202502_Rx_5e4659c4
            BswMAvailableActions
              BswMDeadlineMonitoringControl: BswMEnabledDMPduGroupRef=VCU_oATOM_CANFD_Matrix_CH_V600_202502_Rx_5e4659c4
          ESH_Action_ComMDisallow_CN_ATOM_CANFD_Matrix_CH_V600_202502_a4d436ac
            BswMAvailableActions
              BswMComMAllowCom: BswMComAllowed=false, BswMComMAllowChannelRef=CN_ATOM_CANFD_Matrix_CH_V600_202502_a4d436ac
          ESH_Action_ComMAllow_CN_ATOM_CANFD_Matrix_CH_V600_202502_a4d436ac
            BswMAvailableActions
              BswMComMAllowCom: BswMComAllowed=true, BswMComMAllowChannelRef=CN_ATOM_CANFD_Matrix_CH_V600_202502_a4d436ac
        CC_AL_CN_LIN02_5f246578_Vcu_Lin3_Schedule_bdb0899f_Disable (BswMActionList): BswMActionListExecution=BSWM_TRIGGER
          CC_DisablePDUGroup_VCU_oLIN02_Tx_b7ce935e (BswMActionListItem): BswMAbortOnFail=false, BswMActionListItemIndex=0, BswMActionListItemRef=BswMModeControl/CC_DisablePDUGroup_VCU_oLIN02_Tx_b7ce935e
          CC_DisablePDUGroup_VCU_oLIN02_Rx_e19434d8 (BswMActionListItem): BswMAbortOnFail=false, BswMActionListItemIndex=1, BswMActionListItemRef=BswMModeControl/CC_DisablePDUGroup_VCU_oLIN02_Rx_e19434d8
        CC_DisablePDUGroup_VCU_oLIN02_Tx_b7ce935e (BswMAction)
          BswMAvailableActions
            BswMPduGroupSwitch: BswMPduGroupSwitchReinit=false, BswMDisabledPduGroupRef=VCU_oLIN02_Tx_b7ce935e
        CC_DisablePDUGroup_VCU_oLIN02_Rx_e19434d8 (BswMAction)
          BswMAvailableActions
            BswMPduGroupSwitch: BswMPduGroupSwitchReinit=false, BswMDisabledPduGroupRef=VCU_oLIN02_Rx_e19434d8
        CC_AL_CN_LIN02_5f246578_Vcu_Lin3_Schedule_bdb0899f_Enable (BswMActionList): BswMActionListExecution=BSWM_TRIGGER
          CC_EnablePDUGroup_VCU_oLIN02_Tx_b7ce935e (BswMActionListItem): BswMAbortOnFail=false, BswMActionListItemIndex=0, BswMActionListItemRef=BswMModeControl/CC_EnablePDUGroup_VCU_oLIN02_Tx_b7ce935e
          CC_EnablePDUGroup_VCU_oLIN02_Rx_e19434d8 (BswMActionListItem): BswMAbortOnFail=false, BswMActionListItemIndex=1, BswMActionListItemRef=BswMModeControl/CC_EnablePDUGroup_VCU_oLIN02_Rx_e19434d8
        CC_EnablePDUGroup_VCU_oLIN02_Tx_b7ce935e (BswMAction)
          BswMAvailableActions
            BswMPduGroupSwitch: BswMPduGroupSwitchReinit=false, BswMEnabledPduGroupRef=VCU_oLIN02_Tx_b7ce935e
        CC_EnablePDUGroup_VCU_oLIN02_Rx_e19434d8 (BswMAction)
          BswMAvailableActions
            BswMPduGroupSwitch: BswMPduGroupSwitchReinit=false, BswMEnabledPduGroupRef=VCU_oLIN02_Rx_e19434d8
        CC_AL_CN_LIN02_5f246578_LinScheduleSwitch (BswMActionList): BswMActionListExecution=BSWM_TRIGGER
          CC_LinSchdeduleSwitch_CHNL_08a9294c_Vcu_Lin3_Schedule_bdb0899f (BswMActionListItem):
            BswMAbortOnFail = false
            BswMActionListItemIndex = 0
            BswMActionListItemRef = BswMModeControl/CC_LinSchdeduleSwitch_CHNL_08a9294c_Vcu_Lin3_Schedule_bdb0899f
        3 x BswMAction:
          CC_LinSchdeduleSwitch_CHNL_08a9294c_Vcu_Lin3_Schedule_bdb0899f
            BswMAvailableActions
              BswMLinScheduleSwitch: BswMLinScheduleRef=Vcu_Lin3_Schedule_bdb0899f
          ESH_Action_ComMDisallow_CN_LIN02_5f246578
            BswMAvailableActions
              BswMComMAllowCom: BswMComAllowed=false, BswMComMAllowChannelRef=CN_LIN02_5f246578
          ESH_Action_ComMAllow_CN_LIN02_5f246578
            BswMAvailableActions
              BswMComMAllowCom: BswMComAllowed=true, BswMComMAllowChannelRef=CN_LIN02_5f246578
        CC_AL_CN_TC37X_VCU_CAN12_XCP_d05a85ac_TX_Disable (BswMActionList): BswMActionListExecution=BSWM_TRIGGER
          CC_DisablePDUGroup_VCU_oTC37X_VCU_CAN12_XCP_Tx_7c7490e5 (BswMActionListItem): BswMAbortOnFail=false, BswMActionListItemIndex=0, BswMActionListItemRef=BswMModeControl/CC_DisablePDUGroup_VCU_oTC37X_VCU_CAN12_XCP_Tx_7c7490e5
        CC_DisablePDUGroup_VCU_oTC37X_VCU_CAN12_XCP_Tx_7c7490e5 (BswMAction)
          BswMAvailableActions
            BswMPduGroupSwitch: BswMPduGroupSwitchReinit=false, BswMDisabledPduGroupRef=VCU_oTC37X_VCU_CAN12_XCP_Tx_7c7490e5
        CC_AL_CN_TC37X_VCU_CAN12_XCP_d05a85ac_TX_EnableNoinit (BswMActionList): BswMActionListExecution=BSWM_TRIGGER
          CC_EnablePDUGroup_VCU_oTC37X_VCU_CAN12_XCP_Tx_7c7490e5 (BswMActionListItem): BswMAbortOnFail=false, BswMActionListItemIndex=0, BswMActionListItemRef=BswMModeControl/CC_EnablePDUGroup_VCU_oTC37X_VCU_CAN12_XCP_Tx_7c7490e5
        3 x BswMAction:
          CC_EnablePDUGroup_VCU_oTC37X_VCU_CAN12_XCP_Tx_7c7490e5
            BswMAvailableActions
              BswMPduGroupSwitch: BswMPduGroupSwitchReinit=false, BswMEnabledPduGroupRef=VCU_oTC37X_VCU_CAN12_XCP_Tx_7c7490e5
          ESH_Action_ComMDisallow_CN_TC37X_VCU_CAN12_XCP_d05a85ac
            BswMAvailableActions
              BswMComMAllowCom: BswMComAllowed=false, BswMComMAllowChannelRef=CN_TC37X_VCU_CAN12_XCP_d05a85ac
          ESH_Action_ComMAllow_CN_TC37X_VCU_CAN12_XCP_d05a85ac
            BswMAvailableActions
              BswMComMAllowCom: BswMComAllowed=true, BswMComMAllowChannelRef=CN_TC37X_VCU_CAN12_XCP_d05a85ac
        CC_AL_CN_ATOM_CAN_Matrix_PT_V600_20250211_9b894f3d_RX_Disable (BswMActionList): BswMActionListExecution=BSWM_TRIGGER
          CC_DisablePDUGroup_VCU_oATOM_CAN_Matrix_PT_V600_20250211_Rx_49b064ca (BswMActionListItem):
            BswMAbortOnFail = false
            BswMActionListItemIndex = 0
            BswMActionListItemRef = BswMModeControl/CC_DisablePDUGroup_VCU_oATOM_CAN_Matrix_PT_V600_20250211_Rx_49b064ca
        CC_DisablePDUGroup_VCU_oATOM_CAN_Matrix_PT_V600_20250211_Rx_49b064ca (BswMAction)
          BswMAvailableActions
            BswMPduGroupSwitch: BswMPduGroupSwitchReinit=false, BswMDisabledPduGroupRef=VCU_oATOM_CAN_Matrix_PT_V600_20250211_Rx_49b064ca
        CC_AL_CN_ATOM_CAN_Matrix_PT_V600_20250211_9b894f3d_RX_EnableNoinit (BswMActionList): BswMActionListExecution=BSWM_TRIGGER
          CC_EnablePDUGroup_VCU_oATOM_CAN_Matrix_PT_V600_20250211_Rx_49b064ca (BswMActionListItem):
            BswMAbortOnFail = false
            BswMActionListItemIndex = 0
            BswMActionListItemRef = BswMModeControl/CC_EnablePDUGroup_VCU_oATOM_CAN_Matrix_PT_V600_20250211_Rx_49b064ca
        CC_EnablePDUGroup_VCU_oATOM_CAN_Matrix_PT_V600_20250211_Rx_49b064ca (BswMAction)
          BswMAvailableActions
            BswMPduGroupSwitch: BswMPduGroupSwitchReinit=false, BswMEnabledPduGroupRef=VCU_oATOM_CAN_Matrix_PT_V600_20250211_Rx_49b064ca
        CC_AL_CN_ATOM_CAN_Matrix_PT_V600_20250211_9b894f3d_Disable_DM (BswMActionList): BswMActionListExecution=BSWM_TRIGGER
          CC_DisableDM_VCU_oATOM_CAN_Matrix_PT_V600_20250211_Rx_49b064ca (BswMActionListItem):
            BswMAbortOnFail = false
            BswMActionListItemIndex = 0
            BswMActionListItemRef = BswMModeControl/CC_DisableDM_VCU_oATOM_CAN_Matrix_PT_V600_20250211_Rx_49b064ca
        CC_DisableDM_VCU_oATOM_CAN_Matrix_PT_V600_20250211_Rx_49b064ca (BswMAction)
          BswMAvailableActions
            BswMDeadlineMonitoringControl: BswMDisabledDMPduGroupRef=VCU_oATOM_CAN_Matrix_PT_V600_20250211_Rx_49b064ca
        CC_AL_CN_ATOM_CAN_Matrix_PT_V600_20250211_9b894f3d_Enable_DM (BswMActionList): BswMActionListExecution=BSWM_TRIGGER
          CC_EnableDM_VCU_oATOM_CAN_Matrix_PT_V600_20250211_Rx_49b064ca (BswMActionListItem):
            BswMAbortOnFail = false
            BswMActionListItemIndex = 0
            BswMActionListItemRef = BswMModeControl/CC_EnableDM_VCU_oATOM_CAN_Matrix_PT_V600_20250211_Rx_49b064ca
        CC_EnableDM_VCU_oATOM_CAN_Matrix_PT_V600_20250211_Rx_49b064ca (BswMAction)
          BswMAvailableActions
            BswMDeadlineMonitoringControl: BswMEnabledDMPduGroupRef=VCU_oATOM_CAN_Matrix_PT_V600_20250211_Rx_49b064ca
        CC_AL_CN_ATOM_CAN_Matrix_PT_V600_20250211_9b894f3d_TX_Disable (BswMActionList): BswMActionListExecution=BSWM_TRIGGER
          CC_DisablePDUGroup_VCU_oATOM_CAN_Matrix_PT_V600_20250211_Tx_1feac34c (BswMActionListItem):
            BswMAbortOnFail = false
            BswMActionListItemIndex = 0
            BswMActionListItemRef = BswMModeControl/CC_DisablePDUGroup_VCU_oATOM_CAN_Matrix_PT_V600_20250211_Tx_1feac34c
        CC_DisablePDUGroup_VCU_oATOM_CAN_Matrix_PT_V600_20250211_Tx_1feac34c (BswMAction)
          BswMAvailableActions
            BswMPduGroupSwitch: BswMPduGroupSwitchReinit=false, BswMDisabledPduGroupRef=VCU_oATOM_CAN_Matrix_PT_V600_20250211_Tx_1feac34c
        CC_AL_CN_ATOM_CAN_Matrix_PT_V600_20250211_9b894f3d_TX_EnableNoinit (BswMActionList): BswMActionListExecution=BSWM_TRIGGER
          CC_EnablePDUGroup_VCU_oATOM_CAN_Matrix_PT_V600_20250211_Tx_1feac34c (BswMActionListItem):
            BswMAbortOnFail = false
            BswMActionListItemIndex = 0
            BswMActionListItemRef = BswMModeControl/CC_EnablePDUGroup_VCU_oATOM_CAN_Matrix_PT_V600_20250211_Tx_1feac34c
        3 x BswMAction:
          CC_EnablePDUGroup_VCU_oATOM_CAN_Matrix_PT_V600_20250211_Tx_1feac34c
            BswMAvailableActions
              BswMPduGroupSwitch: BswMPduGroupSwitchReinit=false, BswMEnabledPduGroupRef=VCU_oATOM_CAN_Matrix_PT_V600_20250211_Tx_1feac34c
          ESH_Action_ComMDisallow_CN_ATOM_CAN_Matrix_PT_V600_20250211_9b894f3d
            BswMAvailableActions
              BswMComMAllowCom: BswMComAllowed=false, BswMComMAllowChannelRef=CN_ATOM_CAN_Matrix_PT_V600_20250211_9b894f3d
          ESH_Action_ComMAllow_CN_ATOM_CAN_Matrix_PT_V600_20250211_9b894f3d
            BswMAvailableActions
              BswMComMAllowCom: BswMComAllowed=true, BswMComMAllowChannelRef=CN_ATOM_CAN_Matrix_PT_V600_20250211_9b894f3d
      ESH_RunRequest (BswMRteModeDclGroup): BswMInitMode=RELEASED
        RELEASED (BswMRteMode): BswMModePhysicalValue=0
        REQUESTED (BswMRteMode): BswMModePhysicalValue=1
      ESH_Mode (BswMRteModeDclGroup): BswMInitMode=STARTUP
        5 x BswMRteMode:
          STARTUP: BswMModePhysicalValue=0
          RUN: BswMModePhysicalValue=1
          POSTRUN: BswMModePhysicalValue=2
          WAKEUP: BswMModePhysicalValue=3
          SHUTDOWN: BswMModePhysicalValue=4
      BswMDataTypeMappingSets: BswMDataTypeMappingSetRef=BswMMappingSet
