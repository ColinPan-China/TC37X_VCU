AUTOSAR XML (schema 00048)
package /Adc
  module config Adc: implementation-config-variant=VARIANT-POST-BUILD, module-description=Adc_Impl
    AdcConfigSet: AdcSyncClockDisable=false, AdcSystemClock=McuClockReferencePointConfig
      AdcGlobalInputClass_0 (AdcGlobalInputClass): AdcChConvMode=ADC_NOISE_REDUCTION_STEPS_0, AdcChPreChargeClkCycles=ADC_INPUT_PRECHARGE_CYCLES_0, AdcChSESPSEnable=false, AdcChSampleTime=0
      AdcGlobalInputClass_1 (AdcGlobalInputClass): AdcChConvMode=ADC_NOISE_REDUCTION_STEPS_0, AdcChPreChargeClkCycles=ADC_INPUT_PRECHARGE_CYCLES_0, AdcChSESPSEnable=false, AdcChSampleTime=0
      6 x AdcHwUnit, all with AdcAnalogClockSyncDelay=0, AdcCalibrationSampleTime=ADC_CAL_TIME_2_TIMES_TADCI, AdcClockSource=ADC_SYSTEM_CLK, AdcIdlePrechargeEnable=false, AdcInputBufferEnable=false, AdcMSBDoubleClkEnable=false, AdcPostCalibrationDisable=false, AdcPrechargeReference=ADC_VDD_VSM_USED, AdcPrescale=4, AdcReferencePrechargePhases=ADC_PRECHARGE_PHASE_1, AdcRequestSource0ConvMode=ADC_WAIT_FOR_START_MODE, AdcRequestSource1ConvMode=ADC_WAIT_FOR_START_MODE, AdcRequestSource2ConvMode=ADC_WAIT_FOR_START_MODE, AdcSampleSyncEnable=false, AdcSyncConvMode=ADC_STAND_ALONE:
        AdcHwUnit_0: AdcHwUnitId=HWUNIT_ADC0
          8 x AdcChannel, all with AdcBWDEnable=false, AdcBWDPrechargeLevel=ADC_BWD_PRECH_VAGND, AdcInputClassSelection=ADC_HWUNIT_CLASS_0, AdcSyncConvChannelEnable=false:
            AN{0..7}: AdcAnChannelNum=G0CH{0..7}, AdcChannelId={0..7}
          AdcGroup_0 (AdcGroup):
            AdcChannel0Alias = 0
            AdcChannel1Alias = 1
            AdcGroupAccessMode = ADC_ACCESS_MODE_SINGLE
            AdcGroupConversionMode = ADC_CONV_MODE_ONESHOT
            AdcGroupId = 0
            AdcGroupTriggSrc = ADC_TRIGG_SRC_SW
            AdcHwExtGateSelect = ADC_GATE_NONE
            AdcHwExtTrigSelect = ADC_TRIG_NONE
            AdcHwGateSignal = ADC_GATE_LVL_HIGH
            AdcNotification = IoHwAb_AdcNotification0
            AdcResRegDefinition = {0..7}
            AdcStreamingBufferMode = ADC_STREAM_BUFFER_LINEAR
            AdcStreamingNumSamples = 1
            AdcGroupDefinition = AN{0..7}
          AdcHwUnitInputClass_0 (AdcHwUnitInputClass): AdcChConvMode=ADC_NOISE_REDUCTION_STEPS_0, AdcChPreChargeClkCycles=ADC_INPUT_PRECHARGE_CYCLES_0, AdcChSESPSEnable=false, AdcChSampleTime=10
          AdcHwUnitInputClass_1 (AdcHwUnitInputClass): AdcChConvMode=ADC_NOISE_REDUCTION_STEPS_0, AdcChPreChargeClkCycles=ADC_INPUT_PRECHARGE_CYCLES_0, AdcChSESPSEnable=false, AdcChSampleTime=10
        AdcHwUnit_1: AdcHwUnitId=HWUNIT_ADC1
          8 x AdcChannel, all with AdcBWDEnable=false, AdcBWDPrechargeLevel=ADC_BWD_PRECH_VAGND, AdcInputClassSelection=ADC_HWUNIT_CLASS_0, AdcSyncConvChannelEnable=false:
            AN10: AdcAnChannelNum=G1CH2, AdcChannelId=2
            AN11: AdcAnChannelNum=G1CH3, AdcChannelId=3
            AN12: AdcAnChannelNum=G1CH4, AdcChannelId=4
            AN13: AdcAnChannelNum=G1CH5, AdcChannelId=5
            AN14: AdcAnChannelNum=G1CH6, AdcChannelId=6
            AN15: AdcAnChannelNum=G1CH7, AdcChannelId=7
            AN8: AdcAnChannelNum=G1CH0, AdcChannelId=0
            AN9: AdcAnChannelNum=G1CH1, AdcChannelId=1
          AdcGroup_1 (AdcGroup):
            AdcChannel0Alias = 0
            AdcChannel1Alias = 1
            AdcGroupAccessMode = ADC_ACCESS_MODE_SINGLE
            AdcGroupConversionMode = ADC_CONV_MODE_ONESHOT
            AdcGroupId = 32
            AdcGroupTriggSrc = ADC_TRIGG_SRC_SW
            AdcHwExtGateSelect = ADC_GATE_NONE
            AdcHwExtTrigSelect = ADC_TRIG_NONE
            AdcHwGateSignal = ADC_GATE_LVL_HIGH
            AdcNotification = IoHwAb_AdcNotification32
            AdcResRegDefinition = {0..7}
            AdcStreamingBufferMode = ADC_STREAM_BUFFER_LINEAR
            AdcStreamingNumSamples = 1
            AdcGroupDefinition = AN{8..15}
          AdcHwUnitInputClass_0 (AdcHwUnitInputClass): AdcChConvMode=ADC_NOISE_REDUCTION_STEPS_0, AdcChPreChargeClkCycles=ADC_INPUT_PRECHARGE_CYCLES_0, AdcChSESPSEnable=false, AdcChSampleTime=10
          AdcHwUnitInputClass_1 (AdcHwUnitInputClass): AdcChConvMode=ADC_NOISE_REDUCTION_STEPS_0, AdcChPreChargeClkCycles=ADC_INPUT_PRECHARGE_CYCLES_0, AdcChSESPSEnable=false, AdcChSampleTime=10
        AdcHwUnit_2: AdcHwUnitId=HWUNIT_ADC2
          8 x AdcChannel, all with AdcBWDEnable=false, AdcBWDPrechargeLevel=ADC_BWD_PRECH_VAGND, AdcInputClassSelection=ADC_HWUNIT_CLASS_0, AdcSyncConvChannelEnable=false:
            AdcChannel_G2CH{0..7}: AdcAnChannelNum=G2CH{0..7}, AdcChannelId={0..7}
          AdcGroup_2 (AdcGroup):
            AdcChannel0Alias = 0
            AdcChannel1Alias = 1
            AdcGroupAccessMode = ADC_ACCESS_MODE_SINGLE
            AdcGroupConversionMode = ADC_CONV_MODE_ONESHOT
            AdcGroupId = 64
            AdcGroupTriggSrc = ADC_TRIGG_SRC_SW
            AdcHwExtGateSelect = ADC_GATE_NONE
            AdcHwExtTrigSelect = ADC_TRIG_NONE
            AdcHwGateSignal = ADC_GATE_LVL_HIGH
            AdcNotification = IoHwAb_AdcNotification64
            AdcResRegDefinition = {0..7}
            AdcStreamingBufferMode = ADC_STREAM_BUFFER_LINEAR
            AdcStreamingNumSamples = 1
            AdcGroupDefinition = AdcChannel_G2CH{0..7}
          AdcHwUnitInputClass_0 (AdcHwUnitInputClass): AdcChConvMode=ADC_NOISE_REDUCTION_STEPS_0, AdcChPreChargeClkCycles=ADC_INPUT_PRECHARGE_CYCLES_0, AdcChSESPSEnable=false, AdcChSampleTime=10
          AdcHwUnitInputClass_1 (AdcHwUnitInputClass): AdcChConvMode=ADC_NOISE_REDUCTION_STEPS_0, AdcChPreChargeClkCycles=ADC_INPUT_PRECHARGE_CYCLES_0, AdcChSESPSEnable=false, AdcChSampleTime=10
        AdcHwUnit_3: AdcHwUnitId=HWUNIT_ADC3
          8 x AdcChannel, all with AdcBWDEnable=false, AdcBWDPrechargeLevel=ADC_BWD_PRECH_VAGND, AdcInputClassSelection=ADC_HWUNIT_CLASS_0, AdcSyncConvChannelEnable=false:
            AdcChannel_G3CH{0..7}: AdcAnChannelNum=G3CH{0..7}, AdcChannelId={0..7}
          AdcGroup_3 (AdcGroup):
            AdcChannel0Alias = 0
            AdcChannel1Alias = 1
            AdcGroupAccessMode = ADC_ACCESS_MODE_SINGLE
            AdcGroupConversionMode = ADC_CONV_MODE_ONESHOT
            AdcGroupId = 96
            AdcGroupTriggSrc = ADC_TRIGG_SRC_SW
            AdcHwExtGateSelect = ADC_GATE_NONE
            AdcHwExtTrigSelect = ADC_TRIG_NONE
            AdcHwGateSignal = ADC_GATE_LVL_HIGH
            AdcNotification = IoHwAb_AdcNotification96
            AdcResRegDefinition = {0..7}
            AdcStreamingBufferMode = ADC_STREAM_BUFFER_LINEAR
            AdcStreamingNumSamples = 1
            AdcGroupDefinition = AdcChannel_G3CH{0..7}
          AdcHwUnitInputClass_0 (AdcHwUnitInputClass): AdcChConvMode=ADC_NOISE_REDUCTION_STEPS_0, AdcChPreChargeClkCycles=ADC_INPUT_PRECHARGE_CYCLES_0, AdcChSESPSEnable=false, AdcChSampleTime=0
          AdcHwUnitInputClass_1 (AdcHwUnitInputClass): AdcChConvMode=ADC_NOISE_REDUCTION_STEPS_0, AdcChPreChargeClkCycles=ADC_INPUT_PRECHARGE_CYCLES_0, AdcChSESPSEnable=false, AdcChSampleTime=0
        AdcHwUnit_4: AdcHwUnitId=HWUNIT_ADC11
          8 x AdcChannel, all with AdcBWDEnable=false, AdcBWDPrechargeLevel=ADC_BWD_PRECH_VAGND, AdcInputClassSelection=ADC_HWUNIT_CLASS_0, AdcSyncConvChannelEnable=false:
            AdcChannel_G11CH{0..7}: AdcAnChannelNum=G11CH{0..7}, AdcChannelId={0..7}
          AdcGroup_11 (AdcGroup):
            AdcChannel0Alias = 0
            AdcChannel1Alias = 1
            AdcGroupAccessMode = ADC_ACCESS_MODE_SINGLE
            AdcGroupConversionMode = ADC_CONV_MODE_ONESHOT
            AdcGroupId = 352
            AdcGroupTriggSrc = ADC_TRIGG_SRC_SW
            AdcHwExtGateSelect = ADC_GATE_NONE
            AdcHwExtTrigSelect = ADC_TRIG_NONE
            AdcHwGateSignal = ADC_GATE_LVL_HIGH
            AdcNotification = IoHwAb_AdcNotification352
            AdcResRegDefinition = {0..7}
            AdcStreamingBufferMode = ADC_STREAM_BUFFER_LINEAR
            AdcStreamingNumSamples = 1
            AdcGroupDefinition = AdcChannel_G11CH{0..7}
          AdcHwUnitInputClass_0 (AdcHwUnitInputClass): AdcChConvMode=ADC_NOISE_REDUCTION_STEPS_0, AdcChPreChargeClkCycles=ADC_INPUT_PRECHARGE_CYCLES_0, AdcChSESPSEnable=false, AdcChSampleTime=0
          AdcHwUnitInputClass_1 (AdcHwUnitInputClass): AdcChConvMode=ADC_NOISE_REDUCTION_STEPS_0, AdcChPreChargeClkCycles=ADC_INPUT_PRECHARGE_CYCLES_0, AdcChSESPSEnable=false, AdcChSampleTime=0
        AdcHwUnit_5: AdcHwUnitId=HWUNIT_ADC8
          8 x AdcChannel, all with AdcBWDEnable=false, AdcBWDPrechargeLevel=ADC_BWD_PRECH_VAGND, AdcInputClassSelection=ADC_HWUNIT_CLASS_0, AdcSyncConvChannelEnable=false:
            AdcChannel_G8CH{0..7}: AdcAnChannelNum=G8CH{0..7}, AdcChannelId={0..7}
          AdcGroup_8 (AdcGroup):
            AdcChannel0Alias = 0
            AdcChannel1Alias = 1
            AdcGroupAccessMode = ADC_ACCESS_MODE_SINGLE
            AdcGroupConversionMode = ADC_CONV_MODE_ONESHOT
            AdcGroupId = 256
            AdcGroupTriggSrc = ADC_TRIGG_SRC_SW
            AdcHwExtGateSelect = ADC_GATE_NONE
            AdcHwExtTrigSelect = ADC_TRIG_NONE
            AdcHwGateSignal = ADC_GATE_LVL_HIGH
            AdcNotification = IoHwAb_AdcNotification256
            AdcResRegDefinition = {0..7}
            AdcStreamingBufferMode = ADC_STREAM_BUFFER_LINEAR
            AdcStreamingNumSamples = 1
            AdcResRegDefinition = {8..15}
            AdcGroupDefinition = AdcChannel_G8CH{0..15}
          AdcHwUnitInputClass_0 (AdcHwUnitInputClass): AdcChConvMode=ADC_NOISE_REDUCTION_STEPS_0, AdcChPreChargeClkCycles=ADC_INPUT_PRECHARGE_CYCLES_0, AdcChSESPSEnable=false, AdcChSampleTime=0
          AdcHwUnitInputClass_1 (AdcHwUnitInputClass): AdcChConvMode=ADC_NOISE_REDUCTION_STEPS_0, AdcChPreChargeClkCycles=ADC_INPUT_PRECHARGE_CYCLES_0, AdcChSESPSEnable=false, AdcChSampleTime=0
          8 x AdcChannel, all with AdcBWDEnable=false, AdcBWDPrechargeLevel=ADC_BWD_PRECH_VAGND, AdcInputClassSelection=ADC_HWUNIT_CLASS_0, AdcSyncConvChannelEnable=false:
            AdcChannel_G8CH{8..15}: AdcAnChannelNum=G8CH{8..15}, AdcChannelId={8..15}
    AdcDemEventParameterRefs_0 (AdcDemEventParameterRefs)
    AdcGeneral:
      AdcDeInitApi = false
      AdcDevErrorDetect = false
      AdcEnableLimitCheck = false
      AdcEnableQueuing = false
      AdcEnableStartStopGroupApi = true
      AdcGrpNotifCapability = true
      AdcHwTriggerApi = false
      AdcInitCheckApi = true
      AdcInitDeInitApiMode = ADC_MCAL_SUPERVISOR
      AdcMaxChConvTimeCount = 6000
      AdcMultiCoreErrorDetect = false
      AdcPriorityImplementation = ADC_PRIORITY_NONE
      AdcReadGroupApi = true
      AdcResultAlignment = ADC_ALIGN_RIGHT
      AdcResultHandlingImplementation = ADC_INTERRUPT_MODE_RESULT_HANDLING
      AdcRuntimeApiMode = ADC_MCAL_SUPERVISOR
      AdcSafetyEnable = false
      AdcSleepMode = ADC_SLEEP_MODE_ACCEPT
      AdcStartupCalibApi = true
      AdcSupplyVoltage = ADC_VOLTAGE_5V
      AdcSyncConvEnable = false
      AdcTriggerOneConversionEnable = false
      AdcVersionInfoApi = false
    AdcPublishedInformation: AdcChannelValueSigned=false, AdcGroupFirstChannelFixed=false, AdcMaxChannelResolution=12
    CommonPublishedInformation:
      ArMajorVersion = 4
      ArMinorVersion = 2
      ArPatchVersion = 2
      ModuleId = 123
      Release = _TRICORE_TC377
      SwMajorVersion = 10
      SwMinorVersion = 40
      SwPatchVersion = 0
      VendorId = 17
