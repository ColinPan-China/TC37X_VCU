AUTOSAR XML (schema 00048)
package /ActiveEcuC
  module config EthTrcv: implementation-config-variant=VARIANT-PRE-COMPILE, module-description=EthTrcv_Impl
    EthTrcvGeneral:
      EthTrcvDevErrorDetect = true
      EthTrcvGetBaudRateApi = true
      EthTrcvGetDuplexModeApi = true
      EthTrcvGetLinkStateApi = true
      EthTrcvGetTransceiverModeApi = true
      EthTrcvMaxTrcvsSupported = 1
      EthTrcvSetTransceiverModeApi = true
      EthTrcvStartAutoNegotiationApi = true
      EthTrcvVersionInfoApi = true
      EthTrcvIndex = 0
      EthTrcvRuntimeMeasurementSupport = false
      EthTrcvWakeUpSupport = ETHTRCV_WAKEUP_NOT_SUPPORTED
      EthTrcvHwAccessLoopCount = 0
      EthTrcvSafeBswChecks = false
      EthTrcvCableDiagLoopCount = 10000
      EthTrcvMainFunctionPeriod = 0.02
      EthTrcvWakeUpCalloutIncludeFiles = RTL8211FI.h
    EthTrcvConfigSet
      EthTrcvConfig:
        EthTrcvSpeed = TRCV_SPEED_1000
        EthTrcvAutoNegotiationEnabled = true
        EthTrcvIdx = 0
        EthTrcvConnNeg = ETHTRCV_CONN_NEG_AUTO
        EthTrcvPhySignalQualityMeanValueLength = 100
        EthTrcvSoftResetOnInit = false
        EthTrcvGenericDriverRef = EthTrcvGenericDriver
        EthTrcvMgmtInterface
          EthTrcvMiiInterface: EthTrcvMiiIdx=1, EthTrcvMiiSelection=RGMII, EthTrcvCtrlRef=EthCtrlConfig
      EthTrcvGenericDriver: EthTrcvGenericDriverName=Gen, EthTrcvGenericDriverVendorId=30
