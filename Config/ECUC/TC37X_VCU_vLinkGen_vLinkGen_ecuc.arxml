AUTOSAR XML (schema 00048)
package /ActiveEcuC
  module config vLinkGen: implementation-config-variant=VARIANT-PRE-COMPILE, module-description=vLinkGen_Impl
    vLinkGenMemLayout
      vLinkGenLinkerSections
        MSR_CODE (vLinkGenLinkerCodeSection): vLinkGenLinkerCodeSectionName=MSR_CODE, vLinkGenLinkerCodeSectionFast=false, vLinkGenLinkerCodeSectionAlignment=0
        MSR_CONST (vLinkGenLinkerConstSection): vLinkGenLinkerConstSectionName=MSR_CONST, vLinkGenLinkerConstSectionFast=false, vLinkGenLinkerConstSectionAlignment=0
        MSR_PBCFG_CONST (vLinkGenLinkerConstSection): vLinkGenLinkerConstSectionName=MSR_PBCFG_CONST, vLinkGenLinkerConstSectionFast=false, vLinkGenLinkerConstSectionAlignment=0
        4 x vLinkGenLinkerVarSection, all with vLinkGenLinkerVarSectionFast=false, vLinkGenLinkerVarSectionAlignment=0:
          MSR_PBCFG_VAR: vLinkGenLinkerVarSectionName=MSR_PBCFG_VAR
          MSR_VAR_CLEARED: vLinkGenLinkerVarSectionName=MSR_VAR_CLEARED
          MSR_VAR_INIT: vLinkGenLinkerVarSectionName=MSR_VAR_INIT
          MSR_VAR_NO_INIT: vLinkGenLinkerVarSectionName=MSR_VAR_NO_INIT
        MSR_CONST_FAST (vLinkGenLinkerConstSection): vLinkGenLinkerConstSectionFast=true, vLinkGenLinkerConstSectionName=MSR_CONST_FAST, vLinkGenLinkerConstSectionAlignment=0
        3 x vLinkGenLinkerVarSection, all with vLinkGenLinkerVarSectionFast=true, vLinkGenLinkerVarSectionAlignment=0:
          MSR_VAR_FAST_CLEARED: vLinkGenLinkerVarSectionName=MSR_VAR_FAST_CLEARED
          MSR_VAR_FAST_INIT: vLinkGenLinkerVarSectionName=MSR_VAR_FAST_INIT
          MSR_VAR_FAST_NO_INIT: vLinkGenLinkerVarSectionName=MSR_VAR_FAST_NO_INIT
        MSR_PBCFG_CONST_FAST (vLinkGenLinkerConstSection): vLinkGenLinkerConstSectionFast=true, vLinkGenLinkerConstSectionName=MSR_PBCFG_CONST_FAST, vLinkGenLinkerConstSectionAlignment=0
        7 x vLinkGenLinkerVarSection, all with vLinkGenLinkerVarSectionAlignment=0:
          MSR_PBCFG_VAR_FAST: vLinkGenLinkerVarSectionFast=true, vLinkGenLinkerVarSectionName=MSR_PBCFG_VAR_FAST
          MSR_PBCFG_VAR_FAST_NO_INIT: vLinkGenLinkerVarSectionFast=true, vLinkGenLinkerVarSectionName=MSR_PBCFG_VAR_FAST_NO_INIT
          MSR_PBCFG_VAR_NO_INIT: vLinkGenLinkerVarSectionName=MSR_PBCFG_VAR_NO_INIT, vLinkGenLinkerVarSectionFast=false
          MSR_VAR_SAVED_ZONE_INIT: vLinkGenLinkerVarSectionName=MSR_VAR_SAVED_ZONE_INIT, vLinkGenLinkerVarSectionFast=false
          MSR_VAR_SAVED_ZONE_NO_INIT: vLinkGenLinkerVarSectionName=MSR_VAR_SAVED_ZONE_NO_INIT, vLinkGenLinkerVarSectionFast=false
          MSR_VAR_SAVED_ZONE_FAST_INIT: vLinkGenLinkerVarSectionFast=true, vLinkGenLinkerVarSectionName=MSR_VAR_SAVED_ZONE_FAST_INIT
          MSR_VAR_SAVED_ZONE_FAST_NO_INIT: vLinkGenLinkerVarSectionFast=true, vLinkGenLinkerVarSectionName=MSR_VAR_SAVED_ZONE_FAST_NO_INIT
        brsStartup (vLinkGenLinkerCodeSection): vLinkGenLinkerCodeSectionName=brsStartup, vLinkGenLinkerCodeSectionAlignment=8, vLinkGenLinkerCodeSectionFast=false
        BMHD0 (vLinkGenLinkerConstSection): vLinkGenLinkerConstSectionName=BMHD0, vLinkGenLinkerConstSectionAlignment=32, vLinkGenLinkerConstSectionFast=false
        7 x vLinkGenLinkerSpecSection, all with vLinkGenLinkerSpecSectionPad=0, vLinkGenLinkerSpecSectionAlignment=0:
          text: vLinkGenLinkerSpecSectionValue=[.]text*
          rodata: vLinkGenLinkerSpecSectionValue=[.]rodata*
          zrodata: vLinkGenLinkerSpecSectionValue=[.]zrodata*
          data: vLinkGenLinkerSpecSectionValue=[.]data*
          zdata: vLinkGenLinkerSpecSectionValue=[.]zdata*
          bss: vLinkGenLinkerSpecSectionValue=[.]bss*
          zbss: vLinkGenLinkerSpecSectionValue=[.]zbss*
        6 x vLinkGenLinkerCodeSection, all with vLinkGenLinkerCodeSectionFast=false, vLinkGenLinkerCodeSectionModule=Os:
          OS_CODE: vLinkGenLinkerCodeSectionName=OS_CODE, vLinkGenLinkerCodeSectionAlignment=0
          OS_OS_COREINITHOOK_CODE: vLinkGenLinkerCodeSectionName=OS_OS_COREINITHOOK_CODE, vLinkGenLinkerCodeSectionAlignment=0
          OS_INTVEC_CODE: vLinkGenLinkerCodeSectionName=OS_INTVEC_CODE, vLinkGenLinkerCodeSectionAlignment=8192
          OS_EXCVEC_CORE0_CODE: vLinkGenLinkerCodeSectionName=OS_EXCVEC_CORE0_CODE, vLinkGenLinkerCodeSectionAlignment=256
          OS_INTVEC_CORE0_CODE: vLinkGenLinkerCodeSectionName=OS_INTVEC_CORE0_CODE, vLinkGenLinkerCodeSectionAlignment=8192
          OS_ERRORHOOK_CODE: vLinkGenLinkerCodeSectionName=OS_ERRORHOOK_CODE, vLinkGenLinkerCodeSectionAlignment=0
        9 x vLinkGenLinkerConstSection, all with vLinkGenLinkerConstSectionModule=Os:
          OS_CONST: vLinkGenLinkerConstSectionName=OS_CONST, vLinkGenLinkerConstSectionFast=false, vLinkGenLinkerConstSectionAlignment=0
          OS_INTVEC_CONST: vLinkGenLinkerConstSectionName=OS_INTVEC_CONST, vLinkGenLinkerConstSectionFast=false, vLinkGenLinkerConstSectionAlignment=0
          OS_GLOBALSHARED_CONST: vLinkGenLinkerConstSectionName=OS_GLOBALSHARED_CONST, vLinkGenLinkerConstSectionFast=false, vLinkGenLinkerConstSectionAlignment=0
          OS_CONST_FAST: vLinkGenLinkerConstSectionName=OS_CONST_FAST, vLinkGenLinkerConstSectionFast=true, vLinkGenLinkerConstSectionAlignment=0
          OS_GLOBALSHARED_CONST_FAST: vLinkGenLinkerConstSectionName=OS_GLOBALSHARED_CONST_FAST, vLinkGenLinkerConstSectionFast=true, vLinkGenLinkerConstSectionAlignment=0
          OS_CORE0_CONST: vLinkGenLinkerConstSectionName=OS_CORE0_CONST, vLinkGenLinkerConstSectionFast=false, vLinkGenLinkerConstSectionAlignment=0
          OS_CORE0_CONST_FAST: vLinkGenLinkerConstSectionName=OS_CORE0_CONST_FAST, vLinkGenLinkerConstSectionFast=true, vLinkGenLinkerConstSectionAlignment=0
          OS_EXCVEC_CORE0_CONST: vLinkGenLinkerConstSectionName=OS_EXCVEC_CORE0_CONST, vLinkGenLinkerConstSectionFast=false, vLinkGenLinkerConstSectionAlignment=256
          OS_INTVEC_CORE0_CONST: vLinkGenLinkerConstSectionName=OS_INTVEC_CORE0_CONST, vLinkGenLinkerConstSectionFast=false, vLinkGenLinkerConstSectionAlignment=8192
        34 x vLinkGenLinkerVarSection, all with vLinkGenLinkerVarSectionAlignment=0, vLinkGenLinkerVarSectionModule=Os:
          OS_VAR_NOCACHE: vLinkGenLinkerVarSectionName=OS_VAR_NOCACHE, vLinkGenLinkerVarSectionFast=false
          OS_VAR_NOCACHE_NOINIT: vLinkGenLinkerVarSectionName=OS_VAR_NOCACHE_NOINIT, vLinkGenLinkerVarSectionFast=false
          OS_VAR_FAST_NOCACHE: vLinkGenLinkerVarSectionName=OS_VAR_FAST_NOCACHE, vLinkGenLinkerVarSectionFast=true
          OS_VAR_FAST_NOCACHE_NOINIT: vLinkGenLinkerVarSectionName=OS_VAR_FAST_NOCACHE_NOINIT, vLinkGenLinkerVarSectionFast=true
          OS_GLOBALSHARED_VAR_NOINIT: vLinkGenLinkerVarSectionName=OS_GLOBALSHARED_VAR_NOINIT, vLinkGenLinkerVarSectionFast=false
          OS_GLOBALSHARED_VAR: vLinkGenLinkerVarSectionName=OS_GLOBALSHARED_VAR, vLinkGenLinkerVarSectionFast=false
          OS_GLOBALSHARED_VAR_ZERO_INIT: vLinkGenLinkerVarSectionName=OS_GLOBALSHARED_VAR_ZERO_INIT, vLinkGenLinkerVarSectionFast=false
          OS_GLOBALSHARED_VAR_NOCACHE_NOINIT: vLinkGenLinkerVarSectionName=OS_GLOBALSHARED_VAR_NOCACHE_NOINIT, vLinkGenLinkerVarSectionFast=false
          OS_GLOBALSHARED_VAR_NOCACHE: vLinkGenLinkerVarSectionName=OS_GLOBALSHARED_VAR_NOCACHE, vLinkGenLinkerVarSectionFast=false
          OS_GLOBALSHARED_VAR_NOCACHE_ZERO_INIT: vLinkGenLinkerVarSectionName=OS_GLOBALSHARED_VAR_NOCACHE_ZERO_INIT, vLinkGenLinkerVarSectionFast=false
          OS_GLOBALSHARED_VAR_FAST_NOINIT: vLinkGenLinkerVarSectionName=OS_GLOBALSHARED_VAR_FAST_NOINIT, vLinkGenLinkerVarSectionFast=true
          OS_GLOBALSHARED_VAR_FAST: vLinkGenLinkerVarSectionName=OS_GLOBALSHARED_VAR_FAST, vLinkGenLinkerVarSectionFast=true
          OS_GLOBALSHARED_VAR_FAST_ZERO_INIT: vLinkGenLinkerVarSectionName=OS_GLOBALSHARED_VAR_FAST_ZERO_INIT, vLinkGenLinkerVarSectionFast=true
          OS_GLOBALSHARED_VAR_FAST_NOCACHE_NOINIT: vLinkGenLinkerVarSectionName=OS_GLOBALSHARED_VAR_FAST_NOCACHE_NOINIT, vLinkGenLinkerVarSectionFast=true
          OS_GLOBALSHARED_VAR_FAST_NOCACHE: vLinkGenLinkerVarSectionName=OS_GLOBALSHARED_VAR_FAST_NOCACHE, vLinkGenLinkerVarSectionFast=true
          OS_GLOBALSHARED_VAR_FAST_NOCACHE_ZERO_INIT: vLinkGenLinkerVarSectionName=OS_GLOBALSHARED_VAR_FAST_NOCACHE_ZERO_INIT, vLinkGenLinkerVarSectionFast=true
          OS_GLOBALSHARED_VAR_ZERO_INIT_bss: vLinkGenLinkerVarSectionName=OS_GLOBALSHARED_VAR_ZERO_INIT_bss, vLinkGenLinkerVarSectionFast=false
          OS_GLOBALSHARED_VAR_NOCACHE_ZERO_INIT_bss: vLinkGenLinkerVarSectionName=OS_GLOBALSHARED_VAR_NOCACHE_ZERO_INIT_bss, vLinkGenLinkerVarSectionFast=false
          OS_GLOBALSHARED_VAR_FAST_ZERO_INIT_bss: vLinkGenLinkerVarSectionName=OS_GLOBALSHARED_VAR_FAST_ZERO_INIT_bss, vLinkGenLinkerVarSectionFast=true
          OS_GLOBALSHARED_VAR_FAST_NOCACHE_ZERO_INIT_bss: vLinkGenLinkerVarSectionName=OS_GLOBALSHARED_VAR_FAST_NOCACHE_ZERO_INIT_bss, vLinkGenLinkerVarSectionFast=true
          OS_CORESTATUS_CORE0_VAR_NOCACHE_NOINIT: vLinkGenLinkerVarSectionName=OS_CORESTATUS_CORE0_VAR_NOCACHE_NOINIT, vLinkGenLinkerVarSectionFast=false
          OS_CORESTATUS_CORE0_VAR_FAST_NOCACHE_NOINIT: vLinkGenLinkerVarSectionName=OS_CORESTATUS_CORE0_VAR_FAST_NOCACHE_NOINIT, vLinkGenLinkerVarSectionFast=true
          OS_CORE0_VAR: vLinkGenLinkerVarSectionName=OS_CORE0_VAR, vLinkGenLinkerVarSectionFast=false
          OS_CORE0_VAR_NOCACHE: vLinkGenLinkerVarSectionName=OS_CORE0_VAR_NOCACHE, vLinkGenLinkerVarSectionFast=false
          OS_CORE0_VAR_NOINIT: vLinkGenLinkerVarSectionName=OS_CORE0_VAR_NOINIT, vLinkGenLinkerVarSectionFast=false
          OS_CORE0_VAR_NOCACHE_NOINIT: vLinkGenLinkerVarSectionName=OS_CORE0_VAR_NOCACHE_NOINIT, vLinkGenLinkerVarSectionFast=false
          OS_PUBLIC_CORE0_VAR_NOINIT: vLinkGenLinkerVarSectionName=OS_PUBLIC_CORE0_VAR_NOINIT, vLinkGenLinkerVarSectionFast=false
          OS_BARRIER_CORE0_VAR_NOCACHE_NOINIT: vLinkGenLinkerVarSectionName=OS_BARRIER_CORE0_VAR_NOCACHE_NOINIT, vLinkGenLinkerVarSectionFast=false
          OS_CORE0_VAR_FAST: vLinkGenLinkerVarSectionName=OS_CORE0_VAR_FAST, vLinkGenLinkerVarSectionFast=true
          OS_CORE0_VAR_FAST_NOCACHE: vLinkGenLinkerVarSectionName=OS_CORE0_VAR_FAST_NOCACHE, vLinkGenLinkerVarSectionFast=true
          OS_CORE0_VAR_FAST_NOINIT: vLinkGenLinkerVarSectionName=OS_CORE0_VAR_FAST_NOINIT, vLinkGenLinkerVarSectionFast=true
          OS_CORE0_VAR_FAST_NOCACHE_NOINIT: vLinkGenLinkerVarSectionName=OS_CORE0_VAR_FAST_NOCACHE_NOINIT, vLinkGenLinkerVarSectionFast=true
          OS_PUBLIC_CORE0_VAR_FAST_NOINIT: vLinkGenLinkerVarSectionName=OS_PUBLIC_CORE0_VAR_FAST_NOINIT, vLinkGenLinkerVarSectionFast=true
          OS_BARRIER_CORE0_VAR_FAST_NOCACHE_NOINIT: vLinkGenLinkerVarSectionName=OS_BARRIER_CORE0_VAR_FAST_NOCACHE_NOINIT, vLinkGenLinkerVarSectionFast=true
        3 x vLinkGenLinkerStackSection, all with vLinkGenLinkerStackSectionAlignment=8, vLinkGenLinkerStackSectionModule=Os:
          OS_STACK_OSCORE0_KERNEL_VAR_NOINIT: vLinkGenLinkerStackSectionName=OS_STACK_OSCORE0_KERNEL_VAR_NOINIT
          OS_STACK_OSCORE0_INIT_VAR_NOINIT: vLinkGenLinkerStackSectionName=OS_STACK_OSCORE0_INIT_VAR_NOINIT
          OS_STACK_OSCORE0_ERROR_VAR_NOINIT: vLinkGenLinkerStackSectionName=OS_STACK_OSCORE0_ERROR_VAR_NOINIT
        OS_SystemApplication_OsCore0_CONST (vLinkGenLinkerConstSection):
          vLinkGenLinkerConstSectionName = OS_SystemApplication_OsCore0_CONST
          vLinkGenLinkerConstSectionFast = false
          vLinkGenLinkerConstSectionAlignment = 0
          vLinkGenLinkerConstSectionModule = Os
        OS_SystemApplication_OsCore0_CONST_FAST (vLinkGenLinkerConstSection):
          vLinkGenLinkerConstSectionName = OS_SystemApplication_OsCore0_CONST_FAST
          vLinkGenLinkerConstSectionFast = true
          vLinkGenLinkerConstSectionAlignment = 0
          vLinkGenLinkerConstSectionModule = Os
        16 x vLinkGenLinkerVarSection, all with vLinkGenLinkerVarSectionAlignment=0, vLinkGenLinkerVarSectionModule=Os:
          OS_SystemApplication_OsCore0_VAR_NOINIT: vLinkGenLinkerVarSectionName=OS_SystemApplication_OsCore0_VAR_NOINIT, vLinkGenLinkerVarSectionFast=false
          OS_SystemApplication_OsCore0_VAR: vLinkGenLinkerVarSectionName=OS_SystemApplication_OsCore0_VAR, vLinkGenLinkerVarSectionFast=false
          OS_SystemApplication_OsCore0_VAR_ZERO_INIT: vLinkGenLinkerVarSectionName=OS_SystemApplication_OsCore0_VAR_ZERO_INIT, vLinkGenLinkerVarSectionFast=false
          OS_SystemApplication_OsCore0_VAR_NOCACHE_NOINIT: vLinkGenLinkerVarSectionName=OS_SystemApplication_OsCore0_VAR_NOCACHE_NOINIT, vLinkGenLinkerVarSectionFast=false
          OS_SystemApplication_OsCore0_VAR_NOCACHE: vLinkGenLinkerVarSectionName=OS_SystemApplication_OsCore0_VAR_NOCACHE, vLinkGenLinkerVarSectionFast=false
          OS_SystemApplication_OsCore0_VAR_NOCACHE_ZERO_INIT: vLinkGenLinkerVarSectionName=OS_SystemApplication_OsCore0_VAR_NOCACHE_ZERO_INIT, vLinkGenLinkerVarSectionFast=false
          OS_SystemApplication_OsCore0_VAR_FAST_NOINIT: vLinkGenLinkerVarSectionName=OS_SystemApplication_OsCore0_VAR_FAST_NOINIT, vLinkGenLinkerVarSectionFast=true
          OS_SystemApplication_OsCore0_VAR_FAST: vLinkGenLinkerVarSectionName=OS_SystemApplication_OsCore0_VAR_FAST, vLinkGenLinkerVarSectionFast=true
          OS_SystemApplication_OsCore0_VAR_FAST_ZERO_INIT: vLinkGenLinkerVarSectionName=OS_SystemApplication_OsCore0_VAR_FAST_ZERO_INIT, vLinkGenLinkerVarSectionFast=true
          OS_SystemApplication_OsCore0_VAR_FAST_NOCACHE_NOINIT: vLinkGenLinkerVarSectionName=OS_SystemApplication_OsCore0_VAR_FAST_NOCACHE_NOINIT, vLinkGenLinkerVarSectionFast=true
          OS_SystemApplication_OsCore0_VAR_FAST_NOCACHE: vLinkGenLinkerVarSectionName=OS_SystemApplication_OsCore0_VAR_FAST_NOCACHE, vLinkGenLinkerVarSectionFast=true
          OS_SystemApplication_OsCore0_VAR_FAST_NOCACHE_ZERO_INIT: vLinkGenLinkerVarSectionName=OS_SystemApplication_OsCore0_VAR_FAST_NOCACHE_ZERO_INIT, vLinkGenLinkerVarSectionFast=true
          OS_SystemApplication_OsCore0_VAR_ZERO_INIT_bss: vLinkGenLinkerVarSectionName=OS_SystemApplication_OsCore0_VAR_ZERO_INIT_bss, vLinkGenLinkerVarSectionFast=false
          OS_SystemApplication_OsCore0_VAR_NOCACHE_ZERO_INIT_bss: vLinkGenLinkerVarSectionName=OS_SystemApplication_OsCore0_VAR_NOCACHE_ZERO_INIT_bss, vLinkGenLinkerVarSectionFast=false
          OS_SystemApplication_OsCore0_VAR_FAST_ZERO_INIT_bss: vLinkGenLinkerVarSectionName=OS_SystemApplication_OsCore0_VAR_FAST_ZERO_INIT_bss, vLinkGenLinkerVarSectionFast=true
          OS_SystemApplication_OsCore0_VAR_FAST_NOCACHE_ZERO_INIT_bss: vLinkGenLinkerVarSectionName=OS_SystemApplication_OsCore0_VAR_FAST_NOCACHE_ZERO_INIT_bss, vLinkGenLinkerVarSectionFast=true
        OS_STACK_OSCORE0_TASK_PRIO4294967295_VAR_NOINIT (vLinkGenLinkerStackSection):
          vLinkGenLinkerStackSectionName = OS_STACK_OSCORE0_TASK_PRIO4294967295_VAR_NOINIT
          vLinkGenLinkerStackSectionAlignment = 8
          vLinkGenLinkerStackSectionModule = Os
        OS_STACK_OSCORE0_ISR_CORE_VAR_NOINIT (vLinkGenLinkerStackSection): vLinkGenLinkerStackSectionName=OS_STACK_OSCORE0_ISR_CORE_VAR_NOINIT, vLinkGenLinkerStackSectionAlignment=8, vLinkGenLinkerStackSectionModule=Os
        OS_Default_Init_Task_CODE (vLinkGenLinkerCodeSection):
          vLinkGenLinkerCodeSectionName = OS_Default_Init_Task_CODE
          vLinkGenLinkerCodeSectionFast = false
          vLinkGenLinkerCodeSectionAlignment = 0
          vLinkGenLinkerCodeSectionModule = Os
        OS_Default_Init_Task_Trusted_CODE (vLinkGenLinkerCodeSection):
          vLinkGenLinkerCodeSectionName = OS_Default_Init_Task_Trusted_CODE
          vLinkGenLinkerCodeSectionFast = false
          vLinkGenLinkerCodeSectionAlignment = 0
          vLinkGenLinkerCodeSectionModule = Os
        OS_STACK_OSCORE0_TASK_PRIO49_VAR_NOINIT (vLinkGenLinkerStackSection):
          vLinkGenLinkerStackSectionName = OS_STACK_OSCORE0_TASK_PRIO49_VAR_NOINIT
          vLinkGenLinkerStackSectionAlignment = 8
          vLinkGenLinkerStackSectionModule = Os
        OS_STACK_OSCORE0_TASK_PRIO50_VAR_NOINIT (vLinkGenLinkerStackSection):
          vLinkGenLinkerStackSectionName = OS_STACK_OSCORE0_TASK_PRIO50_VAR_NOINIT
          vLinkGenLinkerStackSectionAlignment = 8
          vLinkGenLinkerStackSectionModule = Os
        OS_OsApplication_CONST (vLinkGenLinkerConstSection):
          vLinkGenLinkerConstSectionName = OS_OsApplication_CONST
          vLinkGenLinkerConstSectionFast = false
          vLinkGenLinkerConstSectionAlignment = 0
          vLinkGenLinkerConstSectionModule = Os
        OS_OsApplication_CONST_FAST (vLinkGenLinkerConstSection):
          vLinkGenLinkerConstSectionName = OS_OsApplication_CONST_FAST
          vLinkGenLinkerConstSectionFast = true
          vLinkGenLinkerConstSectionAlignment = 0
          vLinkGenLinkerConstSectionModule = Os
        16 x vLinkGenLinkerVarSection, all with vLinkGenLinkerVarSectionAlignment=0, vLinkGenLinkerVarSectionModule=Os:
          OS_OsApplication_VAR_NOINIT: vLinkGenLinkerVarSectionName=OS_OsApplication_VAR_NOINIT, vLinkGenLinkerVarSectionFast=false
          OS_OsApplication_VAR: vLinkGenLinkerVarSectionName=OS_OsApplication_VAR, vLinkGenLinkerVarSectionFast=false
          OS_OsApplication_VAR_ZERO_INIT: vLinkGenLinkerVarSectionName=OS_OsApplication_VAR_ZERO_INIT, vLinkGenLinkerVarSectionFast=false
          OS_OsApplication_VAR_NOCACHE_NOINIT: vLinkGenLinkerVarSectionName=OS_OsApplication_VAR_NOCACHE_NOINIT, vLinkGenLinkerVarSectionFast=false
          OS_OsApplication_VAR_NOCACHE: vLinkGenLinkerVarSectionName=OS_OsApplication_VAR_NOCACHE, vLinkGenLinkerVarSectionFast=false
          OS_OsApplication_VAR_NOCACHE_ZERO_INIT: vLinkGenLinkerVarSectionName=OS_OsApplication_VAR_NOCACHE_ZERO_INIT, vLinkGenLinkerVarSectionFast=false
          OS_OsApplication_VAR_FAST_NOINIT: vLinkGenLinkerVarSectionName=OS_OsApplication_VAR_FAST_NOINIT, vLinkGenLinkerVarSectionFast=true
          OS_OsApplication_VAR_FAST: vLinkGenLinkerVarSectionName=OS_OsApplication_VAR_FAST, vLinkGenLinkerVarSectionFast=true
          OS_OsApplication_VAR_FAST_ZERO_INIT: vLinkGenLinkerVarSectionName=OS_OsApplication_VAR_FAST_ZERO_INIT, vLinkGenLinkerVarSectionFast=true
          OS_OsApplication_VAR_FAST_NOCACHE_NOINIT: vLinkGenLinkerVarSectionName=OS_OsApplication_VAR_FAST_NOCACHE_NOINIT, vLinkGenLinkerVarSectionFast=true
          OS_OsApplication_VAR_FAST_NOCACHE: vLinkGenLinkerVarSectionName=OS_OsApplication_VAR_FAST_NOCACHE, vLinkGenLinkerVarSectionFast=true
          OS_OsApplication_VAR_FAST_NOCACHE_ZERO_INIT: vLinkGenLinkerVarSectionName=OS_OsApplication_VAR_FAST_NOCACHE_ZERO_INIT, vLinkGenLinkerVarSectionFast=true
          OS_OsApplication_VAR_ZERO_INIT_bss: vLinkGenLinkerVarSectionName=OS_OsApplication_VAR_ZERO_INIT_bss, vLinkGenLinkerVarSectionFast=false
          OS_OsApplication_VAR_NOCACHE_ZERO_INIT_bss: vLinkGenLinkerVarSectionName=OS_OsApplication_VAR_NOCACHE_ZERO_INIT_bss, vLinkGenLinkerVarSectionFast=false
          OS_OsApplication_VAR_FAST_ZERO_INIT_bss: vLinkGenLinkerVarSectionName=OS_OsApplication_VAR_FAST_ZERO_INIT_bss, vLinkGenLinkerVarSectionFast=true
          OS_OsApplication_VAR_FAST_NOCACHE_ZERO_INIT_bss: vLinkGenLinkerVarSectionName=OS_OsApplication_VAR_FAST_NOCACHE_ZERO_INIT_bss, vLinkGenLinkerVarSectionFast=true
        3 x vLinkGenLinkerCodeSection, all with vLinkGenLinkerCodeSectionFast=false, vLinkGenLinkerCodeSectionAlignment=0, vLinkGenLinkerCodeSectionModule=Os:
          OS_Bsw_Task_CODE: vLinkGenLinkerCodeSectionName=OS_Bsw_Task_CODE
          OS_AswTask_CODE: vLinkGenLinkerCodeSectionName=OS_AswTask_CODE
          OS_Asw_Init_CODE: vLinkGenLinkerCodeSectionName=OS_Asw_Init_CODE
        OS_STACK_OSCORE0_TASK_PRIO63_VAR_NOINIT (vLinkGenLinkerStackSection):
          vLinkGenLinkerStackSectionName = OS_STACK_OSCORE0_TASK_PRIO63_VAR_NOINIT
          vLinkGenLinkerStackSectionAlignment = 8
          vLinkGenLinkerStackSectionModule = Os
        OS_STACK_BSW_TASK_VAR_NOINIT (vLinkGenLinkerStackSection): vLinkGenLinkerStackSectionName=OS_STACK_BSW_TASK_VAR_NOINIT, vLinkGenLinkerStackSectionAlignment=8, vLinkGenLinkerStackSectionModule=Os
        OS_CanIsr_0_CODE (vLinkGenLinkerCodeSection):
          vLinkGenLinkerCodeSectionName = OS_CanIsr_0_CODE
          vLinkGenLinkerCodeSectionFast = false
          vLinkGenLinkerCodeSectionAlignment = 0
          vLinkGenLinkerCodeSectionModule = Os
        OS_STACK_ASWTASK_VAR_NOINIT (vLinkGenLinkerStackSection): vLinkGenLinkerStackSectionName=OS_STACK_ASWTASK_VAR_NOINIT, vLinkGenLinkerStackSectionAlignment=8, vLinkGenLinkerStackSectionModule=Os
        OS_SHUTDOWNHOOK_CODE (vLinkGenLinkerCodeSection):
          vLinkGenLinkerCodeSectionName = OS_SHUTDOWNHOOK_CODE
          vLinkGenLinkerCodeSectionFast = false
          vLinkGenLinkerCodeSectionAlignment = 0
          vLinkGenLinkerCodeSectionModule = Os
        OS_STACK_OSCORE0_SHUTDOWN_VAR_NOINIT (vLinkGenLinkerStackSection): vLinkGenLinkerStackSectionName=OS_STACK_OSCORE0_SHUTDOWN_VAR_NOINIT, vLinkGenLinkerStackSectionAlignment=8, vLinkGenLinkerStackSectionModule=Os
        22 x vLinkGenLinkerCodeSection, all with vLinkGenLinkerCodeSectionFast=false, vLinkGenLinkerCodeSectionModule=Os:
          OS_CanIsr_1_CODE: vLinkGenLinkerCodeSectionName=OS_CanIsr_1_CODE, vLinkGenLinkerCodeSectionAlignment=0
          OS_ADC{0..3}SR0_ISR_CODE: vLinkGenLinkerCodeSectionName=OS_ADC{0..3}SR0_ISR_CODE, vLinkGenLinkerCodeSectionAlignment=0
          OS_ADC11SR0_ISR_CODE: vLinkGenLinkerCodeSectionName=OS_ADC11SR0_ISR_CODE, vLinkGenLinkerCodeSectionAlignment=0
          OS_ASCLIN2ERR_ISR_CODE: vLinkGenLinkerCodeSectionName=OS_ASCLIN2ERR_ISR_CODE, vLinkGenLinkerCodeSectionAlignment=0
          OS_ASCLIN2RX_ISR_CODE: vLinkGenLinkerCodeSectionName=OS_ASCLIN2RX_ISR_CODE, vLinkGenLinkerCodeSectionAlignment=0
          OS_ASCLIN2TX_ISR_CODE: vLinkGenLinkerCodeSectionName=OS_ASCLIN2TX_ISR_CODE, vLinkGenLinkerCodeSectionAlignment=0
          OS_ASCLIN1TX_ISR_CODE: vLinkGenLinkerCodeSectionName=OS_ASCLIN1TX_ISR_CODE, vLinkGenLinkerCodeSectionAlignment=0
          OS_ASCLIN1RX_ISR_CODE: vLinkGenLinkerCodeSectionName=OS_ASCLIN1RX_ISR_CODE, vLinkGenLinkerCodeSectionAlignment=0
          OS_ASCLIN1ERR_ISR_CODE: vLinkGenLinkerCodeSectionName=OS_ASCLIN1ERR_ISR_CODE, vLinkGenLinkerCodeSectionAlignment=0
          OS_QSPI3ERR_ISR_CODE: vLinkGenLinkerCodeSectionName=OS_QSPI3ERR_ISR_CODE, vLinkGenLinkerCodeSectionAlignment=0
          OS_QSPI3PT_ISR_CODE: vLinkGenLinkerCodeSectionName=OS_QSPI3PT_ISR_CODE, vLinkGenLinkerCodeSectionAlignment=0
          OS_DMACH10SR_ISR_CODE: vLinkGenLinkerCodeSectionName=OS_DMACH10SR_ISR_CODE, vLinkGenLinkerCodeSectionAlignment=0
          OS_DMACH11SR_ISR_CODE: vLinkGenLinkerCodeSectionName=OS_DMACH11SR_ISR_CODE, vLinkGenLinkerCodeSectionAlignment=0
          OS_CanIsr_4_CODE: vLinkGenLinkerCodeSectionName=OS_CanIsr_4_CODE, vLinkGenLinkerCodeSectionAlignment=0
          OS_ADC8SR0_ISR_CODE: vLinkGenLinkerCodeSectionName=OS_ADC8SR0_ISR_CODE, vLinkGenLinkerCodeSectionAlignment=0
          OS_GTMTOM1SR3_ISR_CODE: vLinkGenLinkerCodeSectionName=OS_GTMTOM1SR3_ISR_CODE, vLinkGenLinkerCodeSectionAlignment=0
          OS_GTMTOM1SR4_ISR_CODE: vLinkGenLinkerCodeSectionName=OS_GTMTOM1SR4_ISR_CODE, vLinkGenLinkerCodeSectionAlignment=0
          OS_EXCVEC_CORE1_CODE: vLinkGenLinkerCodeSectionName=OS_EXCVEC_CORE1_CODE, vLinkGenLinkerCodeSectionAlignment=256
          OS_INTVEC_CORE1_CODE: vLinkGenLinkerCodeSectionName=OS_INTVEC_CORE1_CODE, vLinkGenLinkerCodeSectionAlignment=8192
        6 x vLinkGenLinkerConstSection, all with vLinkGenLinkerConstSectionModule=Os:
          OS_CORE1_CONST: vLinkGenLinkerConstSectionName=OS_CORE1_CONST, vLinkGenLinkerConstSectionFast=false, vLinkGenLinkerConstSectionAlignment=0
          OS_CORE1_CONST_FAST: vLinkGenLinkerConstSectionName=OS_CORE1_CONST_FAST, vLinkGenLinkerConstSectionFast=true, vLinkGenLinkerConstSectionAlignment=0
          OS_EXCVEC_CORE1_CONST: vLinkGenLinkerConstSectionName=OS_EXCVEC_CORE1_CONST, vLinkGenLinkerConstSectionFast=false, vLinkGenLinkerConstSectionAlignment=256
          OS_INTVEC_CORE1_CONST: vLinkGenLinkerConstSectionName=OS_INTVEC_CORE1_CONST, vLinkGenLinkerConstSectionFast=false, vLinkGenLinkerConstSectionAlignment=8192
          OS_SystemApplication_OsCore1_CONST: vLinkGenLinkerConstSectionName=OS_SystemApplication_OsCore1_CONST, vLinkGenLinkerConstSectionFast=false, vLinkGenLinkerConstSectionAlignment=0
          OS_SystemApplication_OsCore1_CONST_FAST: vLinkGenLinkerConstSectionName=OS_SystemApplication_OsCore1_CONST_FAST, vLinkGenLinkerConstSectionFast=true, vLinkGenLinkerConstSectionAlignment=0
        5 x vLinkGenLinkerStackSection, all with vLinkGenLinkerStackSectionAlignment=8, vLinkGenLinkerStackSectionModule=Os:
          OS_STACK_OSCORE1_KERNEL_VAR_NOINIT: vLinkGenLinkerStackSectionName=OS_STACK_OSCORE1_KERNEL_VAR_NOINIT
          OS_STACK_OSCORE1_INIT_VAR_NOINIT: vLinkGenLinkerStackSectionName=OS_STACK_OSCORE1_INIT_VAR_NOINIT
          OS_STACK_OSCORE1_ERROR_VAR_NOINIT: vLinkGenLinkerStackSectionName=OS_STACK_OSCORE1_ERROR_VAR_NOINIT
          OS_STACK_OSCORE1_SHUTDOWN_VAR_NOINIT: vLinkGenLinkerStackSectionName=OS_STACK_OSCORE1_SHUTDOWN_VAR_NOINIT
          OS_STACK_OSCORE1_TASK_PRIO4294967295_VAR_NOINIT: vLinkGenLinkerStackSectionName=OS_STACK_OSCORE1_TASK_PRIO4294967295_VAR_NOINIT
        32 x vLinkGenLinkerVarSection, all with vLinkGenLinkerVarSectionAlignment=0, vLinkGenLinkerVarSectionModule=Os:
          OS_CORESTATUS_CORE1_VAR_NOCACHE_NOINIT: vLinkGenLinkerVarSectionName=OS_CORESTATUS_CORE1_VAR_NOCACHE_NOINIT, vLinkGenLinkerVarSectionFast=false
          OS_CORESTATUS_CORE1_VAR_FAST_NOCACHE_NOINIT: vLinkGenLinkerVarSectionName=OS_CORESTATUS_CORE1_VAR_FAST_NOCACHE_NOINIT, vLinkGenLinkerVarSectionFast=true
          OS_CORE1_VAR: vLinkGenLinkerVarSectionName=OS_CORE1_VAR, vLinkGenLinkerVarSectionFast=false
          OS_CORE1_VAR_NOCACHE: vLinkGenLinkerVarSectionName=OS_CORE1_VAR_NOCACHE, vLinkGenLinkerVarSectionFast=false
          OS_CORE1_VAR_NOINIT: vLinkGenLinkerVarSectionName=OS_CORE1_VAR_NOINIT, vLinkGenLinkerVarSectionFast=false
          OS_CORE1_VAR_NOCACHE_NOINIT: vLinkGenLinkerVarSectionName=OS_CORE1_VAR_NOCACHE_NOINIT, vLinkGenLinkerVarSectionFast=false
          OS_PUBLIC_CORE1_VAR_NOINIT: vLinkGenLinkerVarSectionName=OS_PUBLIC_CORE1_VAR_NOINIT, vLinkGenLinkerVarSectionFast=false
          OS_BARRIER_CORE1_VAR_NOCACHE_NOINIT: vLinkGenLinkerVarSectionName=OS_BARRIER_CORE1_VAR_NOCACHE_NOINIT, vLinkGenLinkerVarSectionFast=false
          OS_CORE1_VAR_FAST: vLinkGenLinkerVarSectionName=OS_CORE1_VAR_FAST, vLinkGenLinkerVarSectionFast=true
          OS_CORE1_VAR_FAST_NOCACHE: vLinkGenLinkerVarSectionName=OS_CORE1_VAR_FAST_NOCACHE, vLinkGenLinkerVarSectionFast=true
          OS_CORE1_VAR_FAST_NOINIT: vLinkGenLinkerVarSectionName=OS_CORE1_VAR_FAST_NOINIT, vLinkGenLinkerVarSectionFast=true
          OS_CORE1_VAR_FAST_NOCACHE_NOINIT: vLinkGenLinkerVarSectionName=OS_CORE1_VAR_FAST_NOCACHE_NOINIT, vLinkGenLinkerVarSectionFast=true
          OS_PUBLIC_CORE1_VAR_FAST_NOINIT: vLinkGenLinkerVarSectionName=OS_PUBLIC_CORE1_VAR_FAST_NOINIT, vLinkGenLinkerVarSectionFast=true
          OS_BARRIER_CORE1_VAR_FAST_NOCACHE_NOINIT: vLinkGenLinkerVarSectionName=OS_BARRIER_CORE1_VAR_FAST_NOCACHE_NOINIT, vLinkGenLinkerVarSectionFast=true
          OS_CORESTATUS_CORE2_VAR_NOCACHE_NOINIT: vLinkGenLinkerVarSectionName=OS_CORESTATUS_CORE2_VAR_NOCACHE_NOINIT, vLinkGenLinkerVarSectionFast=false
          OS_CORESTATUS_CORE2_VAR_FAST_NOCACHE_NOINIT: vLinkGenLinkerVarSectionName=OS_CORESTATUS_CORE2_VAR_FAST_NOCACHE_NOINIT, vLinkGenLinkerVarSectionFast=true
          OS_SystemApplication_OsCore1_VAR_NOINIT: vLinkGenLinkerVarSectionName=OS_SystemApplication_OsCore1_VAR_NOINIT, vLinkGenLinkerVarSectionFast=false
          OS_SystemApplication_OsCore1_VAR: vLinkGenLinkerVarSectionName=OS_SystemApplication_OsCore1_VAR, vLinkGenLinkerVarSectionFast=false
          OS_SystemApplication_OsCore1_VAR_ZERO_INIT: vLinkGenLinkerVarSectionName=OS_SystemApplication_OsCore1_VAR_ZERO_INIT, vLinkGenLinkerVarSectionFast=false
          OS_SystemApplication_OsCore1_VAR_NOCACHE_NOINIT: vLinkGenLinkerVarSectionName=OS_SystemApplication_OsCore1_VAR_NOCACHE_NOINIT, vLinkGenLinkerVarSectionFast=false
          OS_SystemApplication_OsCore1_VAR_NOCACHE: vLinkGenLinkerVarSectionName=OS_SystemApplication_OsCore1_VAR_NOCACHE, vLinkGenLinkerVarSectionFast=false
          OS_SystemApplication_OsCore1_VAR_NOCACHE_ZERO_INIT: vLinkGenLinkerVarSectionName=OS_SystemApplication_OsCore1_VAR_NOCACHE_ZERO_INIT, vLinkGenLinkerVarSectionFast=false
          OS_SystemApplication_OsCore1_VAR_FAST_NOINIT: vLinkGenLinkerVarSectionName=OS_SystemApplication_OsCore1_VAR_FAST_NOINIT, vLinkGenLinkerVarSectionFast=true
          OS_SystemApplication_OsCore1_VAR_FAST: vLinkGenLinkerVarSectionName=OS_SystemApplication_OsCore1_VAR_FAST, vLinkGenLinkerVarSectionFast=true
          OS_SystemApplication_OsCore1_VAR_FAST_ZERO_INIT: vLinkGenLinkerVarSectionName=OS_SystemApplication_OsCore1_VAR_FAST_ZERO_INIT, vLinkGenLinkerVarSectionFast=true
          OS_SystemApplication_OsCore1_VAR_FAST_NOCACHE_NOINIT: vLinkGenLinkerVarSectionName=OS_SystemApplication_OsCore1_VAR_FAST_NOCACHE_NOINIT, vLinkGenLinkerVarSectionFast=true
          OS_SystemApplication_OsCore1_VAR_FAST_NOCACHE: vLinkGenLinkerVarSectionName=OS_SystemApplication_OsCore1_VAR_FAST_NOCACHE, vLinkGenLinkerVarSectionFast=true
          OS_SystemApplication_OsCore1_VAR_FAST_NOCACHE_ZERO_INIT: vLinkGenLinkerVarSectionName=OS_SystemApplication_OsCore1_VAR_FAST_NOCACHE_ZERO_INIT, vLinkGenLinkerVarSectionFast=true
          OS_SystemApplication_OsCore1_VAR_ZERO_INIT_bss: vLinkGenLinkerVarSectionName=OS_SystemApplication_OsCore1_VAR_ZERO_INIT_bss, vLinkGenLinkerVarSectionFast=false
          OS_SystemApplication_OsCore1_VAR_NOCACHE_ZERO_INIT_bss: vLinkGenLinkerVarSectionName=OS_SystemApplication_OsCore1_VAR_NOCACHE_ZERO_INIT_bss, vLinkGenLinkerVarSectionFast=false
          OS_SystemApplication_OsCore1_VAR_FAST_ZERO_INIT_bss: vLinkGenLinkerVarSectionName=OS_SystemApplication_OsCore1_VAR_FAST_ZERO_INIT_bss, vLinkGenLinkerVarSectionFast=true
          OS_SystemApplication_OsCore1_VAR_FAST_NOCACHE_ZERO_INIT_bss: vLinkGenLinkerVarSectionName=OS_SystemApplication_OsCore1_VAR_FAST_NOCACHE_ZERO_INIT_bss, vLinkGenLinkerVarSectionFast=true
        OS_EXCVEC_CORE2_CODE (vLinkGenLinkerCodeSection):
          vLinkGenLinkerCodeSectionName = OS_EXCVEC_CORE2_CODE
          vLinkGenLinkerCodeSectionFast = false
          vLinkGenLinkerCodeSectionAlignment = 256
          vLinkGenLinkerCodeSectionModule = Os
        OS_INTVEC_CORE2_CODE (vLinkGenLinkerCodeSection):
          vLinkGenLinkerCodeSectionName = OS_INTVEC_CORE2_CODE
          vLinkGenLinkerCodeSectionFast = false
          vLinkGenLinkerCodeSectionAlignment = 8192
          vLinkGenLinkerCodeSectionModule = Os
        6 x vLinkGenLinkerConstSection, all with vLinkGenLinkerConstSectionModule=Os:
          OS_CORE2_CONST: vLinkGenLinkerConstSectionName=OS_CORE2_CONST, vLinkGenLinkerConstSectionFast=false, vLinkGenLinkerConstSectionAlignment=0
          OS_CORE2_CONST_FAST: vLinkGenLinkerConstSectionName=OS_CORE2_CONST_FAST, vLinkGenLinkerConstSectionFast=true, vLinkGenLinkerConstSectionAlignment=0
          OS_EXCVEC_CORE2_CONST: vLinkGenLinkerConstSectionName=OS_EXCVEC_CORE2_CONST, vLinkGenLinkerConstSectionFast=false, vLinkGenLinkerConstSectionAlignment=256
          OS_INTVEC_CORE2_CONST: vLinkGenLinkerConstSectionName=OS_INTVEC_CORE2_CONST, vLinkGenLinkerConstSectionFast=false, vLinkGenLinkerConstSectionAlignment=8192
          OS_SystemApplication_OsCore2_CONST: vLinkGenLinkerConstSectionName=OS_SystemApplication_OsCore2_CONST, vLinkGenLinkerConstSectionFast=false, vLinkGenLinkerConstSectionAlignment=0
          OS_SystemApplication_OsCore2_CONST_FAST: vLinkGenLinkerConstSectionName=OS_SystemApplication_OsCore2_CONST_FAST, vLinkGenLinkerConstSectionFast=true, vLinkGenLinkerConstSectionAlignment=0
        4 x vLinkGenLinkerStackSection, all with vLinkGenLinkerStackSectionAlignment=8, vLinkGenLinkerStackSectionModule=Os:
          OS_STACK_OSCORE2_KERNEL_VAR_NOINIT: vLinkGenLinkerStackSectionName=OS_STACK_OSCORE2_KERNEL_VAR_NOINIT
          OS_STACK_OSCORE2_INIT_VAR_NOINIT: vLinkGenLinkerStackSectionName=OS_STACK_OSCORE2_INIT_VAR_NOINIT
          OS_STACK_OSCORE2_ERROR_VAR_NOINIT: vLinkGenLinkerStackSectionName=OS_STACK_OSCORE2_ERROR_VAR_NOINIT
          OS_STACK_OSCORE2_SHUTDOWN_VAR_NOINIT: vLinkGenLinkerStackSectionName=OS_STACK_OSCORE2_SHUTDOWN_VAR_NOINIT
        28 x vLinkGenLinkerVarSection, all with vLinkGenLinkerVarSectionAlignment=0, vLinkGenLinkerVarSectionModule=Os:
          OS_CORE2_VAR: vLinkGenLinkerVarSectionName=OS_CORE2_VAR, vLinkGenLinkerVarSectionFast=false
          OS_CORE2_VAR_NOCACHE: vLinkGenLinkerVarSectionName=OS_CORE2_VAR_NOCACHE, vLinkGenLinkerVarSectionFast=false
          OS_CORE2_VAR_NOINIT: vLinkGenLinkerVarSectionName=OS_CORE2_VAR_NOINIT, vLinkGenLinkerVarSectionFast=false
          OS_CORE2_VAR_NOCACHE_NOINIT: vLinkGenLinkerVarSectionName=OS_CORE2_VAR_NOCACHE_NOINIT, vLinkGenLinkerVarSectionFast=false
          OS_PUBLIC_CORE2_VAR_NOINIT: vLinkGenLinkerVarSectionName=OS_PUBLIC_CORE2_VAR_NOINIT, vLinkGenLinkerVarSectionFast=false
          OS_BARRIER_CORE2_VAR_NOCACHE_NOINIT: vLinkGenLinkerVarSectionName=OS_BARRIER_CORE2_VAR_NOCACHE_NOINIT, vLinkGenLinkerVarSectionFast=false
          OS_CORE2_VAR_FAST: vLinkGenLinkerVarSectionName=OS_CORE2_VAR_FAST, vLinkGenLinkerVarSectionFast=true
          OS_CORE2_VAR_FAST_NOCACHE: vLinkGenLinkerVarSectionName=OS_CORE2_VAR_FAST_NOCACHE, vLinkGenLinkerVarSectionFast=true
          OS_CORE2_VAR_FAST_NOINIT: vLinkGenLinkerVarSectionName=OS_CORE2_VAR_FAST_NOINIT, vLinkGenLinkerVarSectionFast=true
          OS_CORE2_VAR_FAST_NOCACHE_NOINIT: vLinkGenLinkerVarSectionName=OS_CORE2_VAR_FAST_NOCACHE_NOINIT, vLinkGenLinkerVarSectionFast=true
          OS_PUBLIC_CORE2_VAR_FAST_NOINIT: vLinkGenLinkerVarSectionName=OS_PUBLIC_CORE2_VAR_FAST_NOINIT, vLinkGenLinkerVarSectionFast=true
          OS_BARRIER_CORE2_VAR_FAST_NOCACHE_NOINIT: vLinkGenLinkerVarSectionName=OS_BARRIER_CORE2_VAR_FAST_NOCACHE_NOINIT, vLinkGenLinkerVarSectionFast=true
          OS_SystemApplication_OsCore2_VAR_NOINIT: vLinkGenLinkerVarSectionName=OS_SystemApplication_OsCore2_VAR_NOINIT, vLinkGenLinkerVarSectionFast=false
          OS_SystemApplication_OsCore2_VAR: vLinkGenLinkerVarSectionName=OS_SystemApplication_OsCore2_VAR, vLinkGenLinkerVarSectionFast=false
          OS_SystemApplication_OsCore2_VAR_ZERO_INIT: vLinkGenLinkerVarSectionName=OS_SystemApplication_OsCore2_VAR_ZERO_INIT, vLinkGenLinkerVarSectionFast=false
          OS_SystemApplication_OsCore2_VAR_NOCACHE_NOINIT: vLinkGenLinkerVarSectionName=OS_SystemApplication_OsCore2_VAR_NOCACHE_NOINIT, vLinkGenLinkerVarSectionFast=false
          OS_SystemApplication_OsCore2_VAR_NOCACHE: vLinkGenLinkerVarSectionName=OS_SystemApplication_OsCore2_VAR_NOCACHE, vLinkGenLinkerVarSectionFast=false
          OS_SystemApplication_OsCore2_VAR_NOCACHE_ZERO_INIT: vLinkGenLinkerVarSectionName=OS_SystemApplication_OsCore2_VAR_NOCACHE_ZERO_INIT, vLinkGenLinkerVarSectionFast=false
          OS_SystemApplication_OsCore2_VAR_FAST_NOINIT: vLinkGenLinkerVarSectionName=OS_SystemApplication_OsCore2_VAR_FAST_NOINIT, vLinkGenLinkerVarSectionFast=true
          OS_SystemApplication_OsCore2_VAR_FAST: vLinkGenLinkerVarSectionName=OS_SystemApplication_OsCore2_VAR_FAST, vLinkGenLinkerVarSectionFast=true
          OS_SystemApplication_OsCore2_VAR_FAST_ZERO_INIT: vLinkGenLinkerVarSectionName=OS_SystemApplication_OsCore2_VAR_FAST_ZERO_INIT, vLinkGenLinkerVarSectionFast=true
          OS_SystemApplication_OsCore2_VAR_FAST_NOCACHE_NOINIT: vLinkGenLinkerVarSectionName=OS_SystemApplication_OsCore2_VAR_FAST_NOCACHE_NOINIT, vLinkGenLinkerVarSectionFast=true
          OS_SystemApplication_OsCore2_VAR_FAST_NOCACHE: vLinkGenLinkerVarSectionName=OS_SystemApplication_OsCore2_VAR_FAST_NOCACHE, vLinkGenLinkerVarSectionFast=true
          OS_SystemApplication_OsCore2_VAR_FAST_NOCACHE_ZERO_INIT: vLinkGenLinkerVarSectionName=OS_SystemApplication_OsCore2_VAR_FAST_NOCACHE_ZERO_INIT, vLinkGenLinkerVarSectionFast=true
          OS_SystemApplication_OsCore2_VAR_ZERO_INIT_bss: vLinkGenLinkerVarSectionName=OS_SystemApplication_OsCore2_VAR_ZERO_INIT_bss, vLinkGenLinkerVarSectionFast=false
          OS_SystemApplication_OsCore2_VAR_NOCACHE_ZERO_INIT_bss: vLinkGenLinkerVarSectionName=OS_SystemApplication_OsCore2_VAR_NOCACHE_ZERO_INIT_bss, vLinkGenLinkerVarSectionFast=false
          OS_SystemApplication_OsCore2_VAR_FAST_ZERO_INIT_bss: vLinkGenLinkerVarSectionName=OS_SystemApplication_OsCore2_VAR_FAST_ZERO_INIT_bss, vLinkGenLinkerVarSectionFast=true
          OS_SystemApplication_OsCore2_VAR_FAST_NOCACHE_ZERO_INIT_bss: vLinkGenLinkerVarSectionName=OS_SystemApplication_OsCore2_VAR_FAST_NOCACHE_ZERO_INIT_bss, vLinkGenLinkerVarSectionFast=true
        OS_STACK_OSCORE2_TASK_PRIO4294967295_VAR_NOINIT (vLinkGenLinkerStackSection):
          vLinkGenLinkerStackSectionName = OS_STACK_OSCORE2_TASK_PRIO4294967295_VAR_NOINIT
          vLinkGenLinkerStackSectionAlignment = 8
          vLinkGenLinkerStackSectionModule = Os
        3 x vLinkGenLinkerCodeSection, all with vLinkGenLinkerCodeSectionFast=false, vLinkGenLinkerCodeSectionAlignment=0, vLinkGenLinkerCodeSectionModule=Os:
          OS_Default_Init_Task_Core2_Trusted_CODE: vLinkGenLinkerCodeSectionName=OS_Default_Init_Task_Core2_Trusted_CODE
          OS_Default_Init_Task_Core2_CODE: vLinkGenLinkerCodeSectionName=OS_Default_Init_Task_Core2_CODE
          OS_Default_Init_Task_Core1_CODE: vLinkGenLinkerCodeSectionName=OS_Default_Init_Task_Core1_CODE
        3 x vLinkGenLinkerStackSection, all with vLinkGenLinkerStackSectionAlignment=8, vLinkGenLinkerStackSectionModule=Os:
          OS_STACK_OSCORE1_TASK_PRIO50_VAR_NOINIT: vLinkGenLinkerStackSectionName=OS_STACK_OSCORE1_TASK_PRIO50_VAR_NOINIT
          OS_STACK_OSCORE2_TASK_PRIO50_VAR_NOINIT: vLinkGenLinkerStackSectionName=OS_STACK_OSCORE2_TASK_PRIO50_VAR_NOINIT
          OS_STACK_OSCORE2_TASK_PRIO49_VAR_NOINIT: vLinkGenLinkerStackSectionName=OS_STACK_OSCORE2_TASK_PRIO49_VAR_NOINIT
        OS_Default_Init_Task_Core1_Trusted_CODE (vLinkGenLinkerCodeSection):
          vLinkGenLinkerCodeSectionName = OS_Default_Init_Task_Core1_Trusted_CODE
          vLinkGenLinkerCodeSectionFast = false
          vLinkGenLinkerCodeSectionAlignment = 0
          vLinkGenLinkerCodeSectionModule = Os
        3 x vLinkGenLinkerStackSection, all with vLinkGenLinkerStackSectionAlignment=8, vLinkGenLinkerStackSectionModule=Os:
          OS_STACK_OSCORE1_TASK_PRIO49_VAR_NOINIT: vLinkGenLinkerStackSectionName=OS_STACK_OSCORE1_TASK_PRIO49_VAR_NOINIT
          OS_STACK_OSCORE1_ISR_CORE_VAR_NOINIT: vLinkGenLinkerStackSectionName=OS_STACK_OSCORE1_ISR_CORE_VAR_NOINIT
          OS_STACK_OSCORE2_ISR_CORE_VAR_NOINIT: vLinkGenLinkerStackSectionName=OS_STACK_OSCORE2_ISR_CORE_VAR_NOINIT
        3 x vLinkGenLinkerCodeSection, all with vLinkGenLinkerCodeSectionFast=false, vLinkGenLinkerCodeSectionAlignment=0, vLinkGenLinkerCodeSectionModule=Os:
          OS_Core1_BswTask_CODE: vLinkGenLinkerCodeSectionName=OS_Core1_BswTask_CODE
          OS_Core1_AswTask_CODE: vLinkGenLinkerCodeSectionName=OS_Core1_AswTask_CODE
          OS_Core1_AswInit_CODE: vLinkGenLinkerCodeSectionName=OS_Core1_AswInit_CODE
        3 x vLinkGenLinkerStackSection, all with vLinkGenLinkerStackSectionAlignment=8, vLinkGenLinkerStackSectionModule=Os:
          OS_STACK_OSCORE1_TASK_PRIO{51..53}_VAR_NOINIT: vLinkGenLinkerStackSectionName=OS_STACK_OSCORE1_TASK_PRIO{51..53}_VAR_NOINIT
        3 x vLinkGenLinkerCodeSection, all with vLinkGenLinkerCodeSectionFast=false, vLinkGenLinkerCodeSectionAlignment=0, vLinkGenLinkerCodeSectionModule=Os:
          OS_Core2_BswTask_CODE: vLinkGenLinkerCodeSectionName=OS_Core2_BswTask_CODE
          OS_Core2_AswTask_CODE: vLinkGenLinkerCodeSectionName=OS_Core2_AswTask_CODE
          OS_Core2_AswInit_CODE: vLinkGenLinkerCodeSectionName=OS_Core2_AswInit_CODE
        3 x vLinkGenLinkerStackSection, all with vLinkGenLinkerStackSectionAlignment=8, vLinkGenLinkerStackSectionModule=Os:
          OS_STACK_OSCORE2_TASK_PRIO{51..53}_VAR_NOINIT: vLinkGenLinkerStackSectionName=OS_STACK_OSCORE2_TASK_PRIO{51..53}_VAR_NOINIT
        OS_Core0_BswTask_CODE (vLinkGenLinkerCodeSection):
          vLinkGenLinkerCodeSectionName = OS_Core0_BswTask_CODE
          vLinkGenLinkerCodeSectionFast = false
          vLinkGenLinkerCodeSectionAlignment = 0
          vLinkGenLinkerCodeSectionModule = Os
        OS_STACK_OSCORE0_TASK_PRIO66_VAR_NOINIT (vLinkGenLinkerStackSection):
          vLinkGenLinkerStackSectionName = OS_STACK_OSCORE0_TASK_PRIO66_VAR_NOINIT
          vLinkGenLinkerStackSectionAlignment = 8
          vLinkGenLinkerStackSectionModule = Os
        OS_CanIsr_3_CODE (vLinkGenLinkerCodeSection):
          vLinkGenLinkerCodeSectionName = OS_CanIsr_3_CODE
          vLinkGenLinkerCodeSectionFast = false
          vLinkGenLinkerCodeSectionAlignment = 0
          vLinkGenLinkerCodeSectionModule = Os
      3 x vLinkGenLogicalConstGroup, all with vLinkGenConstGroupPosition=5, vLinkGenConstGroupRegion=RegionBlock_PFlash0_Cached:
        MSR_CODE
          MSR_CODE (vLinkGenConstSectionGroup):
            vLinkGenConstSectionGroupPosition = 0
            vLinkGenConstSectionGroupInit = NONE
            vLinkGenConstSectionGroupInitStage = ONE
            vLinkGenConstSectionGroupFlag = vLinkGenConstGroupFlags/ORDERED
            vLinkGenConstSectionGroupFlag = vLinkGenConstGroupFlags/CONTIGUOUS
            vLinkGenConstSectionGroupFlag = vLinkGenConstGroupFlags/FILL
            vLinkGenConstSectionGroupFlag = vLinkGenConstGroupFlags/READ
            vLinkGenConstSectionGroupFlag = vLinkGenConstGroupFlags/EXECUTE
            vLinkGenConstSectionGroupRef = vLinkGenLinkerSections/MSR_CODE
        MSR_CONST
          MSR_CONST (vLinkGenConstSectionGroup):
            vLinkGenConstSectionGroupPosition = 0
            vLinkGenConstSectionGroupInit = NONE
            vLinkGenConstSectionGroupInitStage = ONE
            vLinkGenConstSectionGroupFlag = vLinkGenConstGroupFlags/ORDERED
            vLinkGenConstSectionGroupFlag = vLinkGenConstGroupFlags/CONTIGUOUS
            vLinkGenConstSectionGroupFlag = vLinkGenConstGroupFlags/FILL
            vLinkGenConstSectionGroupFlag = vLinkGenConstGroupFlags/READ
            vLinkGenConstSectionGroupFlag = vLinkGenConstGroupFlags/EXECUTE
            vLinkGenConstSectionGroupRef = vLinkGenLinkerSections/MSR_CONST
            vLinkGenConstSectionGroupRef = MSR_CONST_FAST
        MSR_PBCFG_CONST
          MSR_PBCFG_CONST (vLinkGenConstSectionGroup):
            vLinkGenConstSectionGroupPosition = 0
            vLinkGenConstSectionGroupInit = NONE
            vLinkGenConstSectionGroupInitStage = ONE
            vLinkGenConstSectionGroupFlag = vLinkGenConstGroupFlags/ORDERED
            vLinkGenConstSectionGroupFlag = vLinkGenConstGroupFlags/CONTIGUOUS
            vLinkGenConstSectionGroupFlag = vLinkGenConstGroupFlags/FILL
            vLinkGenConstSectionGroupFlag = vLinkGenConstGroupFlags/READ
            vLinkGenConstSectionGroupFlag = vLinkGenConstGroupFlags/EXECUTE
            vLinkGenConstSectionGroupRef = vLinkGenLinkerSections/MSR_PBCFG_CONST
            vLinkGenConstSectionGroupRef = MSR_PBCFG_CONST_FAST
      3 x vLinkGenLogicalVarGroup, all with vLinkGenVarGroupPosition=5, vLinkGenVarGroupInitCore=0, vLinkGenVarGroupRegion=RegionBlock_0_DSPR_Core0, vLinkGenVarGroupRomRegion=RegionBlock_PFlash0_Cached:
        MSR_VAR
          3 x vLinkGenVarSectionGroup, all with vLinkGenVarSectionGroupPosition=0, vLinkGenVarSectionGroupInitStage=ONE, vLinkGenVarSectionGroupAlignment=16, vLinkGenVarSectionGroupFlag=vLinkGenVarGroupFlags/ORDERED, vLinkGenVarSectionGroupFlag=vLinkGenVarGroupFlags/CONTIGUOUS, vLinkGenVarSectionGroupFlag=vLinkGenVarGroupFlags/FILL, vLinkGenVarSectionGroupFlag=vLinkGenVarGroupFlags/READ, vLinkGenVarSectionGroupFlag=vLinkGenVarGroupFlags/WRITE:
            MSR_VAR_CLEARED: vLinkGenVarSectionGroupInit=ZERO_INIT, vLinkGenVarSectionGroupEndAlignment=4, vLinkGenVarSectionGroupRef=vLinkGenLinkerSections/MSR_VAR_CLEARED, vLinkGenVarSectionGroupRef=MSR_VAR_FAST_CLEARED
            MSR_VAR_INIT: vLinkGenVarSectionGroupInit=INIT, vLinkGenVarSectionGroupEndAlignment=4, vLinkGenVarSectionGroupRef=vLinkGenLinkerSections/MSR_VAR_INIT, vLinkGenVarSectionGroupRef=MSR_VAR_FAST_INIT
            MSR_VAR_NO_INIT: vLinkGenVarSectionGroupInit=NONE, vLinkGenVarSectionGroupRef=vLinkGenLinkerSections/MSR_VAR_NO_INIT, vLinkGenVarSectionGroupRef=MSR_VAR_FAST_NO_INIT
        MSR_PBCFG_VAR
          MSR_PBCFG_VAR_INIT (vLinkGenVarSectionGroup):
            vLinkGenVarSectionGroupInit = INIT
            vLinkGenVarSectionGroupPosition = 0
            vLinkGenVarSectionGroupInitStage = ONE
            vLinkGenVarSectionGroupAlignment = 16
            vLinkGenVarSectionGroupEndAlignment = 4
            vLinkGenVarSectionGroupFlag = vLinkGenVarGroupFlags/ORDERED
            vLinkGenVarSectionGroupFlag = vLinkGenVarGroupFlags/CONTIGUOUS
            vLinkGenVarSectionGroupFlag = vLinkGenVarGroupFlags/FILL
            vLinkGenVarSectionGroupFlag = vLinkGenVarGroupFlags/READ
            vLinkGenVarSectionGroupFlag = vLinkGenVarGroupFlags/WRITE
            vLinkGenVarSectionGroupRef = vLinkGenLinkerSections/MSR_PBCFG_VAR
            vLinkGenVarSectionGroupRef = MSR_PBCFG_VAR_FAST
          MSR_PBCFG_VAR_NO_INIT (vLinkGenVarSectionGroup):
            vLinkGenVarSectionGroupInit = NONE
            vLinkGenVarSectionGroupPosition = 0
            vLinkGenVarSectionGroupInitStage = ONE
            vLinkGenVarSectionGroupAlignment = 16
            vLinkGenVarSectionGroupFlag = vLinkGenVarGroupFlags/ORDERED
            vLinkGenVarSectionGroupFlag = vLinkGenVarGroupFlags/CONTIGUOUS
            vLinkGenVarSectionGroupFlag = vLinkGenVarGroupFlags/FILL
            vLinkGenVarSectionGroupFlag = vLinkGenVarGroupFlags/READ
            vLinkGenVarSectionGroupFlag = vLinkGenVarGroupFlags/WRITE
            vLinkGenVarSectionGroupRef = vLinkGenLinkerSections/MSR_PBCFG_VAR_NO_INIT
            vLinkGenVarSectionGroupRef = MSR_PBCFG_VAR_FAST_NO_INIT
        MSR_VAR_SAVED_ZONE
          MSR_VAR_SAVED_ZONE_INIT (vLinkGenVarSectionGroup):
            vLinkGenVarSectionGroupInit = INIT
            vLinkGenVarSectionGroupPosition = 0
            vLinkGenVarSectionGroupInitStage = ONE
            vLinkGenVarSectionGroupAlignment = 16
            vLinkGenVarSectionGroupEndAlignment = 4
            vLinkGenVarSectionGroupFlag = vLinkGenVarGroupFlags/ORDERED
            vLinkGenVarSectionGroupFlag = vLinkGenVarGroupFlags/CONTIGUOUS
            vLinkGenVarSectionGroupFlag = vLinkGenVarGroupFlags/FILL
            vLinkGenVarSectionGroupFlag = vLinkGenVarGroupFlags/READ
            vLinkGenVarSectionGroupFlag = vLinkGenVarGroupFlags/WRITE
            vLinkGenVarSectionGroupRef = vLinkGenLinkerSections/MSR_VAR_SAVED_ZONE_INIT
            vLinkGenVarSectionGroupRef = MSR_VAR_SAVED_ZONE_FAST_INIT
          MSR_VAR_SAVED_ZONE_NO_INIT (vLinkGenVarSectionGroup):
            vLinkGenVarSectionGroupInit = NONE
            vLinkGenVarSectionGroupPosition = 0
            vLinkGenVarSectionGroupInitStage = ONE
            vLinkGenVarSectionGroupAlignment = 16
            vLinkGenVarSectionGroupFlag = vLinkGenVarGroupFlags/ORDERED
            vLinkGenVarSectionGroupFlag = vLinkGenVarGroupFlags/CONTIGUOUS
            vLinkGenVarSectionGroupFlag = vLinkGenVarGroupFlags/FILL
            vLinkGenVarSectionGroupFlag = vLinkGenVarGroupFlags/READ
            vLinkGenVarSectionGroupFlag = vLinkGenVarGroupFlags/WRITE
            vLinkGenVarSectionGroupRef = vLinkGenLinkerSections/MSR_VAR_SAVED_ZONE_NO_INIT
            vLinkGenVarSectionGroupRef = MSR_VAR_SAVED_ZONE_FAST_NO_INIT
      5 x vLinkGenMemoryRegion:
        MemRegion_DSPR_Core0: vLinkGenMemoryRegionAddrOffset=0, vLinkGenMemoryRegionSize=245760, vLinkGenMemoryRegionAddress=1879048192, vLinkGenMemoryRegionHwRegion=DSPR0
          RegionBlock_0_DSPR_Core0 (vLinkGenMemoryRegionBlock):
            vLinkGenMemoryRegionBlockPosition = 0
            vLinkGenMemoryRegionBlockSize = 245760
            vLinkGenMemoryRegionBlockAddress = 1879048192
            vLinkGenMemoryRegionBlockBoundary = LOWER
            vLinkGenMemoryRegionBlockInitStage = NONE
        MemRegion_DSPR_Core1: vLinkGenMemoryRegionAddrOffset=0, vLinkGenMemoryRegionSize=245760, vLinkGenMemoryRegionAddress=1610612736, vLinkGenMemoryRegionHwRegion=DSPR1
          RegionBlock_0_DSPR_Core1 (vLinkGenMemoryRegionBlock):
            vLinkGenMemoryRegionBlockPosition = 0
            vLinkGenMemoryRegionBlockSize = 245760
            vLinkGenMemoryRegionBlockAddress = 1610612736
            vLinkGenMemoryRegionBlockBoundary = LOWER
            vLinkGenMemoryRegionBlockInitStage = NONE
        MemRegion_DSPR_Core2: vLinkGenMemoryRegionAddrOffset=0, vLinkGenMemoryRegionSize=98304, vLinkGenMemoryRegionAddress=1342177280, vLinkGenMemoryRegionHwRegion=DSPR2
          RegionBlock_0_DSPR_Core2 (vLinkGenMemoryRegionBlock):
            vLinkGenMemoryRegionBlockPosition = 0
            vLinkGenMemoryRegionBlockSize = 98304
            vLinkGenMemoryRegionBlockAddress = 1342177280
            vLinkGenMemoryRegionBlockBoundary = LOWER
            vLinkGenMemoryRegionBlockInitStage = NONE
        MemRegion_PFlash0_Cached: vLinkGenMemoryRegionAddrOffset=1048576, vLinkGenMemoryRegionSize=2097152, vLinkGenMemoryRegionAddress=2148532224, vLinkGenMemoryRegionHwRegion=PFlash0_Cached
          RegionBlock_Startup_Cached (vLinkGenMemoryRegionBlock):
            vLinkGenMemoryRegionBlockSize = 1536
            vLinkGenMemoryRegionBlockPosition = 0
            vLinkGenMemoryRegionBlockAddress = 2148532224
            vLinkGenMemoryRegionBlockBoundary = LOWER
            vLinkGenMemoryRegionBlockInitStage = NONE
          RegionBlock_PFlash0_Cached (vLinkGenMemoryRegionBlock):
            vLinkGenMemoryRegionBlockPosition = 1
            vLinkGenMemoryRegionBlockSize = 2095616
            vLinkGenMemoryRegionBlockAddress = 2148533760
            vLinkGenMemoryRegionBlockBoundary = LOWER
            vLinkGenMemoryRegionBlockInitStage = NONE
        MemRegion_BMHD0: vLinkGenMemoryRegionAddrOffset=0, vLinkGenMemoryRegionSize=512, vLinkGenMemoryRegionAddress=2940207104, vLinkGenMemoryRegionHwRegion=BMHD0
          RegionBlock_BMHD0 (vLinkGenMemoryRegionBlock):
            vLinkGenMemoryRegionBlockPosition = 0
            vLinkGenMemoryRegionBlockSize = 512
            vLinkGenMemoryRegionBlockAddress = 2940207104
            vLinkGenMemoryRegionBlockBoundary = LOWER
            vLinkGenMemoryRegionBlockInitStage = NONE
      22 x vLinkGenLogicalConstGroup:
        OS_CODE: vLinkGenConstGroupPosition=900, vLinkGenConstGroupRegion=RegionBlock_PFlash0_Cached, vLinkGenConstGroupModule=Os
          OS_CODE (vLinkGenConstSectionGroup):
            vLinkGenConstSectionGroupPosition = 0
            vLinkGenConstSectionGroupInit = NONE
            vLinkGenConstSectionGroupInitStage = ONE
            vLinkGenConstSectionGroupGapSize = 16
            vLinkGenConstSectionGroupFlag = vLinkGenConstGroupFlags/ORDERED
            vLinkGenConstSectionGroupFlag = vLinkGenConstGroupFlags/CONTIGUOUS
            vLinkGenConstSectionGroupFlag = vLinkGenConstGroupFlags/FILL
            vLinkGenConstSectionGroupFlag = vLinkGenConstGroupFlags/READ
            vLinkGenConstSectionGroupFlag = vLinkGenConstGroupFlags/EXECUTE
            vLinkGenConstSectionGroupRef = vLinkGenLinkerSections/OS_CODE
            vLinkGenConstSectionGroupRef = OS_OS_COREINITHOOK_CODE
        OS_CONST: vLinkGenConstGroupPosition=910, vLinkGenConstGroupRegion=RegionBlock_PFlash0_Cached, vLinkGenConstGroupModule=Os
          OS_CONST (vLinkGenConstSectionGroup):
            vLinkGenConstSectionGroupPosition = 0
            vLinkGenConstSectionGroupInit = NONE
            vLinkGenConstSectionGroupInitStage = ONE
            vLinkGenConstSectionGroupGapSize = 16
            vLinkGenConstSectionGroupFlag = vLinkGenConstGroupFlags/ORDERED
            vLinkGenConstSectionGroupFlag = vLinkGenConstGroupFlags/CONTIGUOUS
            vLinkGenConstSectionGroupFlag = vLinkGenConstGroupFlags/FILL
            vLinkGenConstSectionGroupFlag = vLinkGenConstGroupFlags/READ
            vLinkGenConstSectionGroupFlag = vLinkGenConstGroupFlags/EXECUTE
            vLinkGenConstSectionGroupRef = vLinkGenLinkerSections/OS_CONST
            vLinkGenConstSectionGroupRef = OS_CONST_FAST
            vLinkGenConstSectionGroupRef = OS_CORE0_CONST
            vLinkGenConstSectionGroupRef = OS_CORE0_CONST_FAST
            vLinkGenConstSectionGroupRef = OS_SystemApplication_OsCore0_CONST
            vLinkGenConstSectionGroupRef = OS_SystemApplication_OsCore0_CONST_FAST
            vLinkGenConstSectionGroupRef = OS_CORE1_CONST
            vLinkGenConstSectionGroupRef = OS_CORE1_CONST_FAST
            vLinkGenConstSectionGroupRef = OS_SystemApplication_OsCore1_CONST
            vLinkGenConstSectionGroupRef = OS_SystemApplication_OsCore1_CONST_FAST
            vLinkGenConstSectionGroupRef = OS_CORE2_CONST
            vLinkGenConstSectionGroupRef = OS_CORE2_CONST_FAST
            vLinkGenConstSectionGroupRef = OS_SystemApplication_OsCore2_CONST
            vLinkGenConstSectionGroupRef = OS_SystemApplication_OsCore2_CONST_FAST
        OS_INTVEC_CODE: vLinkGenConstGroupPosition=5, vLinkGenConstGroupRegion=RegionBlock_PFlash0_Cached, vLinkGenConstGroupModule=Os
          OS_INTVEC_CODE (vLinkGenConstSectionGroup):
            vLinkGenConstSectionGroupPosition = 0
            vLinkGenConstSectionGroupInit = NONE
            vLinkGenConstSectionGroupInitStage = ONE
            vLinkGenConstSectionGroupGapSize = 16
            vLinkGenConstSectionGroupAlignment = 8192
            vLinkGenConstSectionGroupEndAlignment = 8
            vLinkGenConstSectionGroupFlag = vLinkGenConstGroupFlags/ORDERED
            vLinkGenConstSectionGroupFlag = vLinkGenConstGroupFlags/CONTIGUOUS
            vLinkGenConstSectionGroupFlag = vLinkGenConstGroupFlags/FILL
            vLinkGenConstSectionGroupFlag = vLinkGenConstGroupFlags/READ
            vLinkGenConstSectionGroupFlag = vLinkGenConstGroupFlags/EXECUTE
            vLinkGenConstSectionGroupRef = vLinkGenLinkerSections/OS_INTVEC_CODE
        OS_INTVEC_CORE0_CODE: vLinkGenConstGroupPosition=5, vLinkGenConstGroupRegion=RegionBlock_PFlash0_Cached, vLinkGenConstGroupModule=Os
          OS_INTVEC_CORE0_CODE (vLinkGenConstSectionGroup):
            vLinkGenConstSectionGroupPosition = 0
            vLinkGenConstSectionGroupInit = NONE
            vLinkGenConstSectionGroupInitStage = ONE
            vLinkGenConstSectionGroupGapSize = 16
            vLinkGenConstSectionGroupAlignment = 8192
            vLinkGenConstSectionGroupEndAlignment = 8
            vLinkGenConstSectionGroupFlag = vLinkGenConstGroupFlags/ORDERED
            vLinkGenConstSectionGroupFlag = vLinkGenConstGroupFlags/CONTIGUOUS
            vLinkGenConstSectionGroupFlag = vLinkGenConstGroupFlags/FILL
            vLinkGenConstSectionGroupFlag = vLinkGenConstGroupFlags/READ
            vLinkGenConstSectionGroupFlag = vLinkGenConstGroupFlags/EXECUTE
            vLinkGenConstSectionGroupRef = vLinkGenLinkerSections/OS_INTVEC_CORE0_CODE
        OS_EXCVEC_CORE0_CODE: vLinkGenConstGroupPosition=5, vLinkGenConstGroupRegion=RegionBlock_PFlash0_Cached, vLinkGenConstGroupModule=Os
          OS_EXCVEC_CORE0_CODE (vLinkGenConstSectionGroup):
            vLinkGenConstSectionGroupPosition = 0
            vLinkGenConstSectionGroupInit = NONE
            vLinkGenConstSectionGroupInitStage = ONE
            vLinkGenConstSectionGroupGapSize = 16
            vLinkGenConstSectionGroupAlignment = 256
            vLinkGenConstSectionGroupEndAlignment = 8
            vLinkGenConstSectionGroupFlag = vLinkGenConstGroupFlags/ORDERED
            vLinkGenConstSectionGroupFlag = vLinkGenConstGroupFlags/CONTIGUOUS
            vLinkGenConstSectionGroupFlag = vLinkGenConstGroupFlags/FILL
            vLinkGenConstSectionGroupFlag = vLinkGenConstGroupFlags/READ
            vLinkGenConstSectionGroupFlag = vLinkGenConstGroupFlags/EXECUTE
            vLinkGenConstSectionGroupRef = vLinkGenLinkerSections/OS_EXCVEC_CORE0_CODE
        OS_INTVEC_CORE1_CODE: vLinkGenConstGroupPosition=5, vLinkGenConstGroupRegion=RegionBlock_PFlash0_Cached, vLinkGenConstGroupModule=Os
          OS_INTVEC_CORE1_CODE (vLinkGenConstSectionGroup):
            vLinkGenConstSectionGroupPosition = 0
            vLinkGenConstSectionGroupInit = NONE
            vLinkGenConstSectionGroupInitStage = ONE
            vLinkGenConstSectionGroupGapSize = 16
            vLinkGenConstSectionGroupAlignment = 8192
            vLinkGenConstSectionGroupEndAlignment = 8
            vLinkGenConstSectionGroupFlag = vLinkGenConstGroupFlags/ORDERED
            vLinkGenConstSectionGroupFlag = vLinkGenConstGroupFlags/CONTIGUOUS
            vLinkGenConstSectionGroupFlag = vLinkGenConstGroupFlags/FILL
            vLinkGenConstSectionGroupFlag = vLinkGenConstGroupFlags/READ
            vLinkGenConstSectionGroupFlag = vLinkGenConstGroupFlags/EXECUTE
            vLinkGenConstSectionGroupRef = vLinkGenLinkerSections/OS_INTVEC_CORE1_CODE
        OS_EXCVEC_CORE1_CODE: vLinkGenConstGroupPosition=5, vLinkGenConstGroupRegion=RegionBlock_PFlash0_Cached, vLinkGenConstGroupModule=Os
          OS_EXCVEC_CORE1_CODE (vLinkGenConstSectionGroup):
            vLinkGenConstSectionGroupPosition = 0
            vLinkGenConstSectionGroupInit = NONE
            vLinkGenConstSectionGroupInitStage = ONE
            vLinkGenConstSectionGroupGapSize = 16
            vLinkGenConstSectionGroupAlignment = 256
            vLinkGenConstSectionGroupEndAlignment = 8
            vLinkGenConstSectionGroupFlag = vLinkGenConstGroupFlags/ORDERED
            vLinkGenConstSectionGroupFlag = vLinkGenConstGroupFlags/CONTIGUOUS
            vLinkGenConstSectionGroupFlag = vLinkGenConstGroupFlags/FILL
            vLinkGenConstSectionGroupFlag = vLinkGenConstGroupFlags/READ
            vLinkGenConstSectionGroupFlag = vLinkGenConstGroupFlags/EXECUTE
            vLinkGenConstSectionGroupRef = vLinkGenLinkerSections/OS_EXCVEC_CORE1_CODE
        OS_INTVEC_CORE2_CODE: vLinkGenConstGroupPosition=5, vLinkGenConstGroupRegion=RegionBlock_PFlash0_Cached, vLinkGenConstGroupModule=Os
          OS_INTVEC_CORE2_CODE (vLinkGenConstSectionGroup):
            vLinkGenConstSectionGroupPosition = 0
            vLinkGenConstSectionGroupInit = NONE
            vLinkGenConstSectionGroupInitStage = ONE
            vLinkGenConstSectionGroupGapSize = 16
            vLinkGenConstSectionGroupAlignment = 8192
            vLinkGenConstSectionGroupEndAlignment = 8
            vLinkGenConstSectionGroupFlag = vLinkGenConstGroupFlags/ORDERED
            vLinkGenConstSectionGroupFlag = vLinkGenConstGroupFlags/CONTIGUOUS
            vLinkGenConstSectionGroupFlag = vLinkGenConstGroupFlags/FILL
            vLinkGenConstSectionGroupFlag = vLinkGenConstGroupFlags/READ
            vLinkGenConstSectionGroupFlag = vLinkGenConstGroupFlags/EXECUTE
            vLinkGenConstSectionGroupRef = vLinkGenLinkerSections/OS_INTVEC_CORE2_CODE
        OS_EXCVEC_CORE2_CODE: vLinkGenConstGroupPosition=5, vLinkGenConstGroupRegion=RegionBlock_PFlash0_Cached, vLinkGenConstGroupModule=Os
          OS_EXCVEC_CORE2_CODE (vLinkGenConstSectionGroup):
            vLinkGenConstSectionGroupPosition = 0
            vLinkGenConstSectionGroupInit = NONE
            vLinkGenConstSectionGroupInitStage = ONE
            vLinkGenConstSectionGroupGapSize = 16
            vLinkGenConstSectionGroupAlignment = 256
            vLinkGenConstSectionGroupEndAlignment = 8
            vLinkGenConstSectionGroupFlag = vLinkGenConstGroupFlags/ORDERED
            vLinkGenConstSectionGroupFlag = vLinkGenConstGroupFlags/CONTIGUOUS
            vLinkGenConstSectionGroupFlag = vLinkGenConstGroupFlags/FILL
            vLinkGenConstSectionGroupFlag = vLinkGenConstGroupFlags/READ
            vLinkGenConstSectionGroupFlag = vLinkGenConstGroupFlags/EXECUTE
            vLinkGenConstSectionGroupRef = vLinkGenLinkerSections/OS_EXCVEC_CORE2_CODE
        OS_INTVEC_CONST: vLinkGenConstGroupPosition=5, vLinkGenConstGroupRegion=RegionBlock_PFlash0_Cached, vLinkGenConstGroupModule=Os
          OS_INTVEC_CONST (vLinkGenConstSectionGroup):
            vLinkGenConstSectionGroupPosition = 0
            vLinkGenConstSectionGroupInit = NONE
            vLinkGenConstSectionGroupInitStage = ONE
            vLinkGenConstSectionGroupGapSize = 16
            vLinkGenConstSectionGroupAlignment = 8192
            vLinkGenConstSectionGroupEndAlignment = 8
            vLinkGenConstSectionGroupFlag = vLinkGenConstGroupFlags/ORDERED
            vLinkGenConstSectionGroupFlag = vLinkGenConstGroupFlags/CONTIGUOUS
            vLinkGenConstSectionGroupFlag = vLinkGenConstGroupFlags/FILL
            vLinkGenConstSectionGroupFlag = vLinkGenConstGroupFlags/READ
            vLinkGenConstSectionGroupFlag = vLinkGenConstGroupFlags/EXECUTE
            vLinkGenConstSectionGroupRef = vLinkGenLinkerSections/OS_INTVEC_CONST
        OS_INTVEC_CORE0_CONST: vLinkGenConstGroupPosition=5, vLinkGenConstGroupRegion=RegionBlock_PFlash0_Cached, vLinkGenConstGroupModule=Os
          OS_INTVEC_CORE0_CONST (vLinkGenConstSectionGroup):
            vLinkGenConstSectionGroupPosition = 0
            vLinkGenConstSectionGroupInit = NONE
            vLinkGenConstSectionGroupInitStage = ONE
            vLinkGenConstSectionGroupGapSize = 16
            vLinkGenConstSectionGroupAlignment = 8192
            vLinkGenConstSectionGroupEndAlignment = 8
            vLinkGenConstSectionGroupFlag = vLinkGenConstGroupFlags/ORDERED
            vLinkGenConstSectionGroupFlag = vLinkGenConstGroupFlags/CONTIGUOUS
            vLinkGenConstSectionGroupFlag = vLinkGenConstGroupFlags/FILL
            vLinkGenConstSectionGroupFlag = vLinkGenConstGroupFlags/READ
            vLinkGenConstSectionGroupFlag = vLinkGenConstGroupFlags/EXECUTE
            vLinkGenConstSectionGroupRef = vLinkGenLinkerSections/OS_INTVEC_CORE0_CONST
        OS_EXCVEC_CORE0_CONST: vLinkGenConstGroupPosition=5, vLinkGenConstGroupRegion=RegionBlock_PFlash0_Cached, vLinkGenConstGroupModule=Os
          OS_EXCVEC_CORE0_CONST (vLinkGenConstSectionGroup):
            vLinkGenConstSectionGroupPosition = 0
            vLinkGenConstSectionGroupInit = NONE
            vLinkGenConstSectionGroupInitStage = ONE
            vLinkGenConstSectionGroupGapSize = 16
            vLinkGenConstSectionGroupAlignment = 256
            vLinkGenConstSectionGroupEndAlignment = 8
            vLinkGenConstSectionGroupFlag = vLinkGenConstGroupFlags/ORDERED
            vLinkGenConstSectionGroupFlag = vLinkGenConstGroupFlags/CONTIGUOUS
            vLinkGenConstSectionGroupFlag = vLinkGenConstGroupFlags/FILL
            vLinkGenConstSectionGroupFlag = vLinkGenConstGroupFlags/READ
            vLinkGenConstSectionGroupFlag = vLinkGenConstGroupFlags/EXECUTE
            vLinkGenConstSectionGroupRef = vLinkGenLinkerSections/OS_EXCVEC_CORE0_CONST
        OS_INTVEC_CORE1_CONST: vLinkGenConstGroupPosition=5, vLinkGenConstGroupRegion=RegionBlock_PFlash0_Cached, vLinkGenConstGroupModule=Os
          OS_INTVEC_CORE1_CONST (vLinkGenConstSectionGroup):
            vLinkGenConstSectionGroupPosition = 0
            vLinkGenConstSectionGroupInit = NONE
            vLinkGenConstSectionGroupInitStage = ONE
            vLinkGenConstSectionGroupGapSize = 16
            vLinkGenConstSectionGroupAlignment = 8192
            vLinkGenConstSectionGroupEndAlignment = 8
            vLinkGenConstSectionGroupFlag = vLinkGenConstGroupFlags/ORDERED
            vLinkGenConstSectionGroupFlag = vLinkGenConstGroupFlags/CONTIGUOUS
            vLinkGenConstSectionGroupFlag = vLinkGenConstGroupFlags/FILL
            vLinkGenConstSectionGroupFlag = vLinkGenConstGroupFlags/READ
            vLinkGenConstSectionGroupFlag = vLinkGenConstGroupFlags/EXECUTE
            vLinkGenConstSectionGroupRef = vLinkGenLinkerSections/OS_INTVEC_CORE1_CONST
        OS_EXCVEC_CORE1_CONST: vLinkGenConstGroupPosition=5, vLinkGenConstGroupRegion=RegionBlock_PFlash0_Cached, vLinkGenConstGroupModule=Os
          OS_EXCVEC_CORE1_CONST (vLinkGenConstSectionGroup):
            vLinkGenConstSectionGroupPosition = 0
            vLinkGenConstSectionGroupInit = NONE
            vLinkGenConstSectionGroupInitStage = ONE
            vLinkGenConstSectionGroupGapSize = 16
            vLinkGenConstSectionGroupAlignment = 256
            vLinkGenConstSectionGroupEndAlignment = 8
            vLinkGenConstSectionGroupFlag = vLinkGenConstGroupFlags/ORDERED
            vLinkGenConstSectionGroupFlag = vLinkGenConstGroupFlags/CONTIGUOUS
            vLinkGenConstSectionGroupFlag = vLinkGenConstGroupFlags/FILL
            vLinkGenConstSectionGroupFlag = vLinkGenConstGroupFlags/READ
            vLinkGenConstSectionGroupFlag = vLinkGenConstGroupFlags/EXECUTE
            vLinkGenConstSectionGroupRef = vLinkGenLinkerSections/OS_EXCVEC_CORE1_CONST
        OS_INTVEC_CORE2_CONST: vLinkGenConstGroupPosition=5, vLinkGenConstGroupRegion=RegionBlock_PFlash0_Cached, vLinkGenConstGroupModule=Os
          OS_INTVEC_CORE2_CONST (vLinkGenConstSectionGroup):
            vLinkGenConstSectionGroupPosition = 0
            vLinkGenConstSectionGroupInit = NONE
            vLinkGenConstSectionGroupInitStage = ONE
            vLinkGenConstSectionGroupGapSize = 16
            vLinkGenConstSectionGroupAlignment = 8192
            vLinkGenConstSectionGroupEndAlignment = 8
            vLinkGenConstSectionGroupFlag = vLinkGenConstGroupFlags/ORDERED
            vLinkGenConstSectionGroupFlag = vLinkGenConstGroupFlags/CONTIGUOUS
            vLinkGenConstSectionGroupFlag = vLinkGenConstGroupFlags/FILL
            vLinkGenConstSectionGroupFlag = vLinkGenConstGroupFlags/READ
            vLinkGenConstSectionGroupFlag = vLinkGenConstGroupFlags/EXECUTE
            vLinkGenConstSectionGroupRef = vLinkGenLinkerSections/OS_INTVEC_CORE2_CONST
        OS_EXCVEC_CORE2_CONST: vLinkGenConstGroupPosition=5, vLinkGenConstGroupRegion=RegionBlock_PFlash0_Cached, vLinkGenConstGroupModule=Os
          OS_EXCVEC_CORE2_CONST (vLinkGenConstSectionGroup):
            vLinkGenConstSectionGroupPosition = 0
            vLinkGenConstSectionGroupInit = NONE
            vLinkGenConstSectionGroupInitStage = ONE
            vLinkGenConstSectionGroupGapSize = 16
            vLinkGenConstSectionGroupAlignment = 256
            vLinkGenConstSectionGroupEndAlignment = 8
            vLinkGenConstSectionGroupFlag = vLinkGenConstGroupFlags/ORDERED
            vLinkGenConstSectionGroupFlag = vLinkGenConstGroupFlags/CONTIGUOUS
            vLinkGenConstSectionGroupFlag = vLinkGenConstGroupFlags/FILL
            vLinkGenConstSectionGroupFlag = vLinkGenConstGroupFlags/READ
            vLinkGenConstSectionGroupFlag = vLinkGenConstGroupFlags/EXECUTE
            vLinkGenConstSectionGroupRef = vLinkGenLinkerSections/OS_EXCVEC_CORE2_CONST
        OS_USER_CODE: vLinkGenConstGroupPosition=5, vLinkGenConstGroupRegion=RegionBlock_PFlash0_Cached, vLinkGenConstGroupModule=Os
          OS_USER_CODE (vLinkGenConstSectionGroup):
            vLinkGenConstSectionGroupPosition = 0
            vLinkGenConstSectionGroupInit = NONE
            vLinkGenConstSectionGroupInitStage = ONE
            vLinkGenConstSectionGroupGapSize = 16
            vLinkGenConstSectionGroupFlag = vLinkGenConstGroupFlags/ORDERED
            vLinkGenConstSectionGroupFlag = vLinkGenConstGroupFlags/CONTIGUOUS
            vLinkGenConstSectionGroupFlag = vLinkGenConstGroupFlags/FILL
            vLinkGenConstSectionGroupFlag = vLinkGenConstGroupFlags/READ
            vLinkGenConstSectionGroupFlag = vLinkGenConstGroupFlags/EXECUTE
            vLinkGenConstSectionGroupRef = OS_ERRORHOOK_CODE
            vLinkGenConstSectionGroupRef = OS_Default_Init_Task_CODE
            vLinkGenConstSectionGroupRef = OS_Default_Init_Task_Trusted_CODE
            vLinkGenConstSectionGroupRef = OS_Bsw_Task_CODE
            vLinkGenConstSectionGroupRef = OS_AswTask_CODE
            vLinkGenConstSectionGroupRef = OS_Asw_Init_CODE
            vLinkGenConstSectionGroupRef = OS_CanIsr_0_CODE
            vLinkGenConstSectionGroupRef = OS_SHUTDOWNHOOK_CODE
            vLinkGenConstSectionGroupRef = OS_CanIsr_1_CODE
            vLinkGenConstSectionGroupRef = OS_ADC{0..3}SR0_ISR_CODE
            vLinkGenConstSectionGroupRef = OS_ADC11SR0_ISR_CODE
            vLinkGenConstSectionGroupRef = OS_ASCLIN2ERR_ISR_CODE
            vLinkGenConstSectionGroupRef = OS_ASCLIN2RX_ISR_CODE
            vLinkGenConstSectionGroupRef = OS_ASCLIN2TX_ISR_CODE
            vLinkGenConstSectionGroupRef = OS_ASCLIN1TX_ISR_CODE
            vLinkGenConstSectionGroupRef = OS_ASCLIN1RX_ISR_CODE
            vLinkGenConstSectionGroupRef = OS_ASCLIN1ERR_ISR_CODE
            vLinkGenConstSectionGroupRef = OS_QSPI3ERR_ISR_CODE
            vLinkGenConstSectionGroupRef = OS_QSPI3PT_ISR_CODE
            vLinkGenConstSectionGroupRef = OS_DMACH10SR_ISR_CODE
            vLinkGenConstSectionGroupRef = OS_DMACH11SR_ISR_CODE
            vLinkGenConstSectionGroupRef = OS_CanIsr_4_CODE
            vLinkGenConstSectionGroupRef = OS_ADC8SR0_ISR_CODE
            vLinkGenConstSectionGroupRef = OS_GTMTOM1SR3_ISR_CODE
            vLinkGenConstSectionGroupRef = OS_GTMTOM1SR4_ISR_CODE
            vLinkGenConstSectionGroupRef = OS_Default_Init_Task_Core2_Trusted_CODE
            vLinkGenConstSectionGroupRef = OS_Default_Init_Task_Core2_CODE
            vLinkGenConstSectionGroupRef = OS_Default_Init_Task_Core1_CODE
            vLinkGenConstSectionGroupRef = OS_Default_Init_Task_Core1_Trusted_CODE
            vLinkGenConstSectionGroupRef = OS_Core1_BswTask_CODE
            vLinkGenConstSectionGroupRef = OS_Core1_AswTask_CODE
            vLinkGenConstSectionGroupRef = OS_Core1_AswInit_CODE
            vLinkGenConstSectionGroupRef = OS_Core2_BswTask_CODE
            vLinkGenConstSectionGroupRef = OS_Core2_AswTask_CODE
            vLinkGenConstSectionGroupRef = OS_Core2_AswInit_CODE
            vLinkGenConstSectionGroupRef = OS_Core0_BswTask_CODE
            vLinkGenConstSectionGroupRef = OS_CanIsr_3_CODE
        OS_USER_CONST: vLinkGenConstGroupPosition=5, vLinkGenConstGroupRegion=RegionBlock_PFlash0_Cached, vLinkGenConstGroupModule=Os
          OS_USER_CONST (vLinkGenConstSectionGroup):
            vLinkGenConstSectionGroupPosition = 0
            vLinkGenConstSectionGroupInit = NONE
            vLinkGenConstSectionGroupInitStage = ONE
            vLinkGenConstSectionGroupGapSize = 16
            vLinkGenConstSectionGroupFlag = vLinkGenConstGroupFlags/ORDERED
            vLinkGenConstSectionGroupFlag = vLinkGenConstGroupFlags/CONTIGUOUS
            vLinkGenConstSectionGroupFlag = vLinkGenConstGroupFlags/FILL
            vLinkGenConstSectionGroupFlag = vLinkGenConstGroupFlags/READ
            vLinkGenConstSectionGroupFlag = vLinkGenConstGroupFlags/EXECUTE
            vLinkGenConstSectionGroupRef = OS_OsApplication_CONST
            vLinkGenConstSectionGroupRef = OS_OsApplication_CONST_FAST
        OS_GLOBALSHARED_CONST: vLinkGenConstGroupPosition=5, vLinkGenConstGroupRegion=RegionBlock_PFlash0_Cached, vLinkGenConstGroupModule=Os
          OS_GLOBALSHARED_CONST (vLinkGenConstSectionGroup):
            vLinkGenConstSectionGroupPosition = 0
            vLinkGenConstSectionGroupInit = NONE
            vLinkGenConstSectionGroupInitStage = ONE
            vLinkGenConstSectionGroupGapSize = 16
            vLinkGenConstSectionGroupFlag = vLinkGenConstGroupFlags/ORDERED
            vLinkGenConstSectionGroupFlag = vLinkGenConstGroupFlags/CONTIGUOUS
            vLinkGenConstSectionGroupFlag = vLinkGenConstGroupFlags/FILL
            vLinkGenConstSectionGroupFlag = vLinkGenConstGroupFlags/READ
            vLinkGenConstSectionGroupFlag = vLinkGenConstGroupFlags/EXECUTE
            vLinkGenConstSectionGroupRef = vLinkGenLinkerSections/OS_GLOBALSHARED_CONST
            vLinkGenConstSectionGroupRef = OS_GLOBALSHARED_CONST_FAST
        Const_Default: vLinkGenConstGroupPosition=1000, vLinkGenConstGroupRegion=RegionBlock_PFlash0_Cached
          3 x vLinkGenConstSectionGroup, all with vLinkGenConstSectionGroupPosition=0, vLinkGenConstSectionGroupInit=NONE, vLinkGenConstSectionGroupInitStage=ONE, vLinkGenConstSectionGroupFlag=vLinkGenConstGroupFlags/ORDERED, vLinkGenConstSectionGroupFlag=vLinkGenConstGroupFlags/CONTIGUOUS, vLinkGenConstSectionGroupFlag=vLinkGenConstGroupFlags/FILL, vLinkGenConstSectionGroupFlag=vLinkGenConstGroupFlags/READ, vLinkGenConstSectionGroupFlag=vLinkGenConstGroupFlags/EXECUTE:
            text: vLinkGenConstSectionGroupRef=vLinkGenLinkerSections/text
            rodata: vLinkGenConstSectionGroupRef=vLinkGenLinkerSections/rodata
            zrodata: vLinkGenConstSectionGroupRef=vLinkGenLinkerSections/zrodata
        BMHD0: vLinkGenConstGroupPosition=5, vLinkGenConstGroupRegion=RegionBlock_BMHD0
          BMHD0 (vLinkGenConstSectionGroup):
            vLinkGenConstSectionGroupAlignment = 4
            vLinkGenConstSectionGroupPosition = 0
            vLinkGenConstSectionGroupInit = NONE
            vLinkGenConstSectionGroupInitStage = ONE
            vLinkGenConstSectionGroupFlag = vLinkGenConstGroupFlags/ORDERED
            vLinkGenConstSectionGroupFlag = vLinkGenConstGroupFlags/CONTIGUOUS
            vLinkGenConstSectionGroupFlag = vLinkGenConstGroupFlags/FILL
            vLinkGenConstSectionGroupFlag = vLinkGenConstGroupFlags/READ
            vLinkGenConstSectionGroupFlag = vLinkGenConstGroupFlags/EXECUTE
            vLinkGenConstSectionGroupRef = vLinkGenLinkerSections/BMHD0
        Startup_Code: vLinkGenConstGroupPosition=0, vLinkGenConstGroupRegion=RegionBlock_Startup_Cached
          Startup_Code (vLinkGenConstSectionGroup):
            vLinkGenConstSectionGroupAlignment = 4
            vLinkGenConstSectionGroupPosition = 0
            vLinkGenConstSectionGroupInit = NONE
            vLinkGenConstSectionGroupInitStage = ONE
            vLinkGenConstSectionGroupFlag = vLinkGenConstGroupFlags/ORDERED
            vLinkGenConstSectionGroupFlag = vLinkGenConstGroupFlags/CONTIGUOUS
            vLinkGenConstSectionGroupFlag = vLinkGenConstGroupFlags/FILL
            vLinkGenConstSectionGroupFlag = vLinkGenConstGroupFlags/READ
            vLinkGenConstSectionGroupFlag = vLinkGenConstGroupFlags/EXECUTE
            vLinkGenConstSectionGroupRef = brsStartup
      15 x vLinkGenLogicalVarGroup:
        OS_STACKS_CORE0_VAR: vLinkGenVarGroupPosition=0, vLinkGenVarGroupRegion=RegionBlock_0_DSPR_Core0, vLinkGenVarGroupModule=Os
          OS_STACKS_CORE0_VAR_NOINIT (vLinkGenVarSectionGroup):
            vLinkGenVarSectionGroupPosition = 0
            vLinkGenVarSectionGroupInit = NONE
            vLinkGenVarSectionGroupInitStage = ONE
            vLinkGenVarSectionGroupGapSize = 16
            vLinkGenVarSectionGroupAlignment = 16
            vLinkGenVarSectionGroupFlag = vLinkGenVarGroupFlags/ORDERED
            vLinkGenVarSectionGroupFlag = vLinkGenVarGroupFlags/CONTIGUOUS
            vLinkGenVarSectionGroupFlag = vLinkGenVarGroupFlags/FILL
            vLinkGenVarSectionGroupFlag = vLinkGenVarGroupFlags/READ
            vLinkGenVarSectionGroupFlag = vLinkGenVarGroupFlags/WRITE
            vLinkGenVarSectionGroupRef = OS_STACK_OSCORE0_KERNEL_VAR_NOINIT
            vLinkGenVarSectionGroupRef = OS_STACK_OSCORE0_INIT_VAR_NOINIT
            vLinkGenVarSectionGroupRef = OS_STACK_OSCORE0_ERROR_VAR_NOINIT
            vLinkGenVarSectionGroupRef = OS_STACK_OSCORE0_TASK_PRIO4294967295_VAR_NOINIT
            vLinkGenVarSectionGroupRef = OS_STACK_OSCORE0_ISR_CORE_VAR_NOINIT
            vLinkGenVarSectionGroupRef = OS_STACK_OSCORE0_TASK_PRIO49_VAR_NOINIT
            vLinkGenVarSectionGroupRef = OS_STACK_OSCORE0_TASK_PRIO50_VAR_NOINIT
            vLinkGenVarSectionGroupRef = OS_STACK_OSCORE0_TASK_PRIO63_VAR_NOINIT
            vLinkGenVarSectionGroupRef = OS_STACK_BSW_TASK_VAR_NOINIT
            vLinkGenVarSectionGroupRef = OS_STACK_ASWTASK_VAR_NOINIT
            vLinkGenVarSectionGroupRef = OS_STACK_OSCORE0_SHUTDOWN_VAR_NOINIT
            vLinkGenVarSectionGroupRef = OS_STACK_OSCORE0_TASK_PRIO66_VAR_NOINIT
        OS_STACKS_CORE1_VAR: vLinkGenVarGroupPosition=0, vLinkGenVarGroupRegion=RegionBlock_0_DSPR_Core1, vLinkGenVarGroupModule=Os
          OS_STACKS_CORE1_VAR_NOINIT (vLinkGenVarSectionGroup):
            vLinkGenVarSectionGroupPosition = 0
            vLinkGenVarSectionGroupInit = NONE
            vLinkGenVarSectionGroupInitStage = ONE
            vLinkGenVarSectionGroupGapSize = 16
            vLinkGenVarSectionGroupAlignment = 16
            vLinkGenVarSectionGroupFlag = vLinkGenVarGroupFlags/ORDERED
            vLinkGenVarSectionGroupFlag = vLinkGenVarGroupFlags/CONTIGUOUS
            vLinkGenVarSectionGroupFlag = vLinkGenVarGroupFlags/FILL
            vLinkGenVarSectionGroupFlag = vLinkGenVarGroupFlags/READ
            vLinkGenVarSectionGroupFlag = vLinkGenVarGroupFlags/WRITE
            vLinkGenVarSectionGroupRef = OS_STACK_OSCORE1_KERNEL_VAR_NOINIT
            vLinkGenVarSectionGroupRef = OS_STACK_OSCORE1_INIT_VAR_NOINIT
            vLinkGenVarSectionGroupRef = OS_STACK_OSCORE1_ERROR_VAR_NOINIT
            vLinkGenVarSectionGroupRef = OS_STACK_OSCORE1_SHUTDOWN_VAR_NOINIT
            vLinkGenVarSectionGroupRef = OS_STACK_OSCORE1_TASK_PRIO4294967295_VAR_NOINIT
            vLinkGenVarSectionGroupRef = OS_STACK_OSCORE1_TASK_PRIO50_VAR_NOINIT
            vLinkGenVarSectionGroupRef = OS_STACK_OSCORE1_TASK_PRIO49_VAR_NOINIT
            vLinkGenVarSectionGroupRef = OS_STACK_OSCORE1_ISR_CORE_VAR_NOINIT
            vLinkGenVarSectionGroupRef = OS_STACK_OSCORE1_TASK_PRIO{51..53}_VAR_NOINIT
        OS_STACKS_CORE2_VAR: vLinkGenVarGroupPosition=0, vLinkGenVarGroupRegion=RegionBlock_0_DSPR_Core2, vLinkGenVarGroupModule=Os
          OS_STACKS_CORE2_VAR_NOINIT (vLinkGenVarSectionGroup):
            vLinkGenVarSectionGroupPosition = 0
            vLinkGenVarSectionGroupInit = NONE
            vLinkGenVarSectionGroupInitStage = ONE
            vLinkGenVarSectionGroupGapSize = 16
            vLinkGenVarSectionGroupAlignment = 16
            vLinkGenVarSectionGroupFlag = vLinkGenVarGroupFlags/ORDERED
            vLinkGenVarSectionGroupFlag = vLinkGenVarGroupFlags/CONTIGUOUS
            vLinkGenVarSectionGroupFlag = vLinkGenVarGroupFlags/FILL
            vLinkGenVarSectionGroupFlag = vLinkGenVarGroupFlags/READ
            vLinkGenVarSectionGroupFlag = vLinkGenVarGroupFlags/WRITE
            vLinkGenVarSectionGroupRef = OS_STACK_OSCORE2_KERNEL_VAR_NOINIT
            vLinkGenVarSectionGroupRef = OS_STACK_OSCORE2_INIT_VAR_NOINIT
            vLinkGenVarSectionGroupRef = OS_STACK_OSCORE2_ERROR_VAR_NOINIT
            vLinkGenVarSectionGroupRef = OS_STACK_OSCORE2_SHUTDOWN_VAR_NOINIT
            vLinkGenVarSectionGroupRef = OS_STACK_OSCORE2_TASK_PRIO4294967295_VAR_NOINIT
            vLinkGenVarSectionGroupRef = OS_STACK_OSCORE2_TASK_PRIO50_VAR_NOINIT
            vLinkGenVarSectionGroupRef = OS_STACK_OSCORE2_TASK_PRIO49_VAR_NOINIT
            vLinkGenVarSectionGroupRef = OS_STACK_OSCORE2_ISR_CORE_VAR_NOINIT
            vLinkGenVarSectionGroupRef = OS_STACK_OSCORE2_TASK_PRIO{51..53}_VAR_NOINIT
        OS_DATA_CORE0_VAR: vLinkGenVarGroupInitCore=0, vLinkGenVarGroupPosition=5, vLinkGenVarGroupRegion=RegionBlock_0_DSPR_Core0, vLinkGenVarGroupRomRegion=RegionBlock_PFlash0_Cached, vLinkGenVarGroupModule=Os
          8 x vLinkGenVarSectionGroup, all with vLinkGenVarSectionGroupPosition=0, vLinkGenVarSectionGroupInitStage=ONE, vLinkGenVarSectionGroupGapSize=16, vLinkGenVarSectionGroupAlignment=16, vLinkGenVarSectionGroupFlag=vLinkGenVarGroupFlags/ORDERED, vLinkGenVarSectionGroupFlag=vLinkGenVarGroupFlags/CONTIGUOUS, vLinkGenVarSectionGroupFlag=vLinkGenVarGroupFlags/FILL, vLinkGenVarSectionGroupFlag=vLinkGenVarGroupFlags/READ, vLinkGenVarSectionGroupFlag=vLinkGenVarGroupFlags/WRITE:
            OS_DATA_CORE0_VAR_NOINIT: vLinkGenVarSectionGroupInit=NONE, vLinkGenVarSectionGroupRef=OS_CORE0_VAR_NOINIT, vLinkGenVarSectionGroupRef=OS_CORE0_VAR_NOCACHE_NOINIT, vLinkGenVarSectionGroupRef=OS_SystemApplication_OsCore0_VAR_NOINIT, vLinkGenVarSectionGroupRef=OS_SystemApplication_OsCore0_VAR_NOCACHE_NOINIT
            OS_DATA_CORE0_VAR_FAST_NOINIT: vLinkGenVarSectionGroupInit=NONE, vLinkGenVarSectionGroupRef=OS_CORE0_VAR_FAST_NOINIT, vLinkGenVarSectionGroupRef=OS_CORE0_VAR_FAST_NOCACHE_NOINIT, vLinkGenVarSectionGroupRef=OS_SystemApplication_OsCore0_VAR_FAST_NOINIT, vLinkGenVarSectionGroupRef=OS_SystemApplication_OsCore0_VAR_FAST_NOCACHE_NOINIT
            OS_DATA_CORE0_VAR_INIT: vLinkGenVarSectionGroupInit=INIT, vLinkGenVarSectionGroupEndAlignment=4, vLinkGenVarSectionGroupRef=OS_CORE0_VAR, vLinkGenVarSectionGroupRef=OS_CORE0_VAR_NOCACHE, vLinkGenVarSectionGroupRef=OS_SystemApplication_OsCore0_VAR, vLinkGenVarSectionGroupRef=OS_SystemApplication_OsCore0_VAR_NOCACHE
            OS_DATA_CORE0_VAR_FAST_INIT: vLinkGenVarSectionGroupInit=INIT, vLinkGenVarSectionGroupEndAlignment=4, vLinkGenVarSectionGroupRef=OS_CORE0_VAR_FAST, vLinkGenVarSectionGroupRef=OS_CORE0_VAR_FAST_NOCACHE, vLinkGenVarSectionGroupRef=OS_SystemApplication_OsCore0_VAR_FAST, vLinkGenVarSectionGroupRef=OS_SystemApplication_OsCore0_VAR_FAST_NOCACHE
            OS_DATA_CORE0_VAR_ZERO_INIT: vLinkGenVarSectionGroupInit=ZERO_INIT, vLinkGenVarSectionGroupEndAlignment=4, vLinkGenVarSectionGroupRef=OS_SystemApplication_OsCore0_VAR_ZERO_INIT, vLinkGenVarSectionGroupRef=OS_SystemApplication_OsCore0_VAR_NOCACHE_ZERO_INIT
            OS_DATA_CORE0_VAR_FAST_ZERO_INIT: vLinkGenVarSectionGroupInit=ZERO_INIT, vLinkGenVarSectionGroupEndAlignment=4, vLinkGenVarSectionGroupRef=OS_SystemApplication_OsCore0_VAR_FAST_ZERO_INIT, vLinkGenVarSectionGroupRef=OS_SystemApplication_OsCore0_VAR_FAST_NOCACHE_ZERO_INIT
            OS_DATA_CORE0_VAR_ZERO_INIT_bss: vLinkGenVarSectionGroupInit=ZERO_INIT, vLinkGenVarSectionGroupEndAlignment=4, vLinkGenVarSectionGroupRef=OS_SystemApplication_OsCore0_VAR_ZERO_INIT_bss, vLinkGenVarSectionGroupRef=OS_SystemApplication_OsCore0_VAR_NOCACHE_ZERO_INIT_bss
            OS_DATA_CORE0_VAR_FAST_ZERO_INIT_bss: vLinkGenVarSectionGroupInit=ZERO_INIT, vLinkGenVarSectionGroupEndAlignment=4, vLinkGenVarSectionGroupRef=OS_SystemApplication_OsCore0_VAR_FAST_ZERO_INIT_bss, vLinkGenVarSectionGroupRef=OS_SystemApplication_OsCore0_VAR_FAST_NOCACHE_ZERO_INIT_bss
        OS_DATA_CORE1_VAR: vLinkGenVarGroupInitCore=1, vLinkGenVarGroupPosition=5, vLinkGenVarGroupRegion=RegionBlock_0_DSPR_Core1, vLinkGenVarGroupRomRegion=RegionBlock_PFlash0_Cached, vLinkGenVarGroupModule=Os
          8 x vLinkGenVarSectionGroup, all with vLinkGenVarSectionGroupPosition=0, vLinkGenVarSectionGroupInitStage=ONE, vLinkGenVarSectionGroupGapSize=16, vLinkGenVarSectionGroupAlignment=16, vLinkGenVarSectionGroupFlag=vLinkGenVarGroupFlags/ORDERED, vLinkGenVarSectionGroupFlag=vLinkGenVarGroupFlags/CONTIGUOUS, vLinkGenVarSectionGroupFlag=vLinkGenVarGroupFlags/FILL, vLinkGenVarSectionGroupFlag=vLinkGenVarGroupFlags/READ, vLinkGenVarSectionGroupFlag=vLinkGenVarGroupFlags/WRITE:
            OS_DATA_CORE1_VAR_NOINIT: vLinkGenVarSectionGroupInit=NONE, vLinkGenVarSectionGroupRef=OS_CORE1_VAR_NOINIT, vLinkGenVarSectionGroupRef=OS_CORE1_VAR_NOCACHE_NOINIT, vLinkGenVarSectionGroupRef=OS_SystemApplication_OsCore1_VAR_NOINIT, vLinkGenVarSectionGroupRef=OS_SystemApplication_OsCore1_VAR_NOCACHE_NOINIT
            OS_DATA_CORE1_VAR_FAST_NOINIT: vLinkGenVarSectionGroupInit=NONE, vLinkGenVarSectionGroupRef=OS_CORE1_VAR_FAST_NOINIT, vLinkGenVarSectionGroupRef=OS_CORE1_VAR_FAST_NOCACHE_NOINIT, vLinkGenVarSectionGroupRef=OS_SystemApplication_OsCore1_VAR_FAST_NOINIT, vLinkGenVarSectionGroupRef=OS_SystemApplication_OsCore1_VAR_FAST_NOCACHE_NOINIT
            OS_DATA_CORE1_VAR_INIT: vLinkGenVarSectionGroupInit=INIT, vLinkGenVarSectionGroupEndAlignment=4, vLinkGenVarSectionGroupRef=OS_CORE1_VAR, vLinkGenVarSectionGroupRef=OS_CORE1_VAR_NOCACHE, vLinkGenVarSectionGroupRef=OS_SystemApplication_OsCore1_VAR, vLinkGenVarSectionGroupRef=OS_SystemApplication_OsCore1_VAR_NOCACHE
            OS_DATA_CORE1_VAR_FAST_INIT: vLinkGenVarSectionGroupInit=INIT, vLinkGenVarSectionGroupEndAlignment=4, vLinkGenVarSectionGroupRef=OS_CORE1_VAR_FAST, vLinkGenVarSectionGroupRef=OS_CORE1_VAR_FAST_NOCACHE, vLinkGenVarSectionGroupRef=OS_SystemApplication_OsCore1_VAR_FAST, vLinkGenVarSectionGroupRef=OS_SystemApplication_OsCore1_VAR_FAST_NOCACHE
            OS_DATA_CORE1_VAR_ZERO_INIT: vLinkGenVarSectionGroupInit=ZERO_INIT, vLinkGenVarSectionGroupEndAlignment=4, vLinkGenVarSectionGroupRef=OS_SystemApplication_OsCore1_VAR_ZERO_INIT, vLinkGenVarSectionGroupRef=OS_SystemApplication_OsCore1_VAR_NOCACHE_ZERO_INIT
            OS_DATA_CORE1_VAR_FAST_ZERO_INIT: vLinkGenVarSectionGroupInit=ZERO_INIT, vLinkGenVarSectionGroupEndAlignment=4, vLinkGenVarSectionGroupRef=OS_SystemApplication_OsCore1_VAR_FAST_ZERO_INIT, vLinkGenVarSectionGroupRef=OS_SystemApplication_OsCore1_VAR_FAST_NOCACHE_ZERO_INIT
            OS_DATA_CORE1_VAR_ZERO_INIT_bss: vLinkGenVarSectionGroupInit=ZERO_INIT, vLinkGenVarSectionGroupEndAlignment=4, vLinkGenVarSectionGroupRef=OS_SystemApplication_OsCore1_VAR_ZERO_INIT_bss, vLinkGenVarSectionGroupRef=OS_SystemApplication_OsCore1_VAR_NOCACHE_ZERO_INIT_bss
            OS_DATA_CORE1_VAR_FAST_ZERO_INIT_bss: vLinkGenVarSectionGroupInit=ZERO_INIT, vLinkGenVarSectionGroupEndAlignment=4, vLinkGenVarSectionGroupRef=OS_SystemApplication_OsCore1_VAR_FAST_ZERO_INIT_bss, vLinkGenVarSectionGroupRef=OS_SystemApplication_OsCore1_VAR_FAST_NOCACHE_ZERO_INIT_bss
        OS_DATA_CORE2_VAR: vLinkGenVarGroupInitCore=2, vLinkGenVarGroupPosition=5, vLinkGenVarGroupRegion=RegionBlock_0_DSPR_Core2, vLinkGenVarGroupRomRegion=RegionBlock_PFlash0_Cached, vLinkGenVarGroupModule=Os
          8 x vLinkGenVarSectionGroup, all with vLinkGenVarSectionGroupPosition=0, vLinkGenVarSectionGroupInitStage=ONE, vLinkGenVarSectionGroupGapSize=16, vLinkGenVarSectionGroupAlignment=16, vLinkGenVarSectionGroupFlag=vLinkGenVarGroupFlags/ORDERED, vLinkGenVarSectionGroupFlag=vLinkGenVarGroupFlags/CONTIGUOUS, vLinkGenVarSectionGroupFlag=vLinkGenVarGroupFlags/FILL, vLinkGenVarSectionGroupFlag=vLinkGenVarGroupFlags/READ, vLinkGenVarSectionGroupFlag=vLinkGenVarGroupFlags/WRITE:
            OS_DATA_CORE2_VAR_NOINIT: vLinkGenVarSectionGroupInit=NONE, vLinkGenVarSectionGroupRef=OS_CORE2_VAR_NOINIT, vLinkGenVarSectionGroupRef=OS_CORE2_VAR_NOCACHE_NOINIT, vLinkGenVarSectionGroupRef=OS_SystemApplication_OsCore2_VAR_NOINIT, vLinkGenVarSectionGroupRef=OS_SystemApplication_OsCore2_VAR_NOCACHE_NOINIT
            OS_DATA_CORE2_VAR_FAST_NOINIT: vLinkGenVarSectionGroupInit=NONE, vLinkGenVarSectionGroupRef=OS_CORE2_VAR_FAST_NOINIT, vLinkGenVarSectionGroupRef=OS_CORE2_VAR_FAST_NOCACHE_NOINIT, vLinkGenVarSectionGroupRef=OS_SystemApplication_OsCore2_VAR_FAST_NOINIT, vLinkGenVarSectionGroupRef=OS_SystemApplication_OsCore2_VAR_FAST_NOCACHE_NOINIT
            OS_DATA_CORE2_VAR_INIT: vLinkGenVarSectionGroupInit=INIT, vLinkGenVarSectionGroupEndAlignment=4, vLinkGenVarSectionGroupRef=OS_CORE2_VAR, vLinkGenVarSectionGroupRef=OS_CORE2_VAR_NOCACHE, vLinkGenVarSectionGroupRef=OS_SystemApplication_OsCore2_VAR, vLinkGenVarSectionGroupRef=OS_SystemApplication_OsCore2_VAR_NOCACHE
            OS_DATA_CORE2_VAR_FAST_INIT: vLinkGenVarSectionGroupInit=INIT, vLinkGenVarSectionGroupEndAlignment=4, vLinkGenVarSectionGroupRef=OS_CORE2_VAR_FAST, vLinkGenVarSectionGroupRef=OS_CORE2_VAR_FAST_NOCACHE, vLinkGenVarSectionGroupRef=OS_SystemApplication_OsCore2_VAR_FAST, vLinkGenVarSectionGroupRef=OS_SystemApplication_OsCore2_VAR_FAST_NOCACHE
            OS_DATA_CORE2_VAR_ZERO_INIT: vLinkGenVarSectionGroupInit=ZERO_INIT, vLinkGenVarSectionGroupEndAlignment=4, vLinkGenVarSectionGroupRef=OS_SystemApplication_OsCore2_VAR_ZERO_INIT, vLinkGenVarSectionGroupRef=OS_SystemApplication_OsCore2_VAR_NOCACHE_ZERO_INIT
            OS_DATA_CORE2_VAR_FAST_ZERO_INIT: vLinkGenVarSectionGroupInit=ZERO_INIT, vLinkGenVarSectionGroupEndAlignment=4, vLinkGenVarSectionGroupRef=OS_SystemApplication_OsCore2_VAR_FAST_ZERO_INIT, vLinkGenVarSectionGroupRef=OS_SystemApplication_OsCore2_VAR_FAST_NOCACHE_ZERO_INIT
            OS_DATA_CORE2_VAR_ZERO_INIT_bss: vLinkGenVarSectionGroupInit=ZERO_INIT, vLinkGenVarSectionGroupEndAlignment=4, vLinkGenVarSectionGroupRef=OS_SystemApplication_OsCore2_VAR_ZERO_INIT_bss, vLinkGenVarSectionGroupRef=OS_SystemApplication_OsCore2_VAR_NOCACHE_ZERO_INIT_bss
            OS_DATA_CORE2_VAR_FAST_ZERO_INIT_bss: vLinkGenVarSectionGroupInit=ZERO_INIT, vLinkGenVarSectionGroupEndAlignment=4, vLinkGenVarSectionGroupRef=OS_SystemApplication_OsCore2_VAR_FAST_ZERO_INIT_bss, vLinkGenVarSectionGroupRef=OS_SystemApplication_OsCore2_VAR_FAST_NOCACHE_ZERO_INIT_bss
        OS_DATA_SHARED_VAR: vLinkGenVarGroupInitCore=0, vLinkGenVarGroupPosition=5, vLinkGenVarGroupRegion=RegionBlock_0_DSPR_Core0, vLinkGenVarGroupRomRegion=RegionBlock_PFlash0_Cached, vLinkGenVarGroupModule=Os
          4 x vLinkGenVarSectionGroup, all with vLinkGenVarSectionGroupPosition=0, vLinkGenVarSectionGroupInitStage=ONE, vLinkGenVarSectionGroupGapSize=16, vLinkGenVarSectionGroupAlignment=16, vLinkGenVarSectionGroupFlag=vLinkGenVarGroupFlags/ORDERED, vLinkGenVarSectionGroupFlag=vLinkGenVarGroupFlags/CONTIGUOUS, vLinkGenVarSectionGroupFlag=vLinkGenVarGroupFlags/FILL, vLinkGenVarSectionGroupFlag=vLinkGenVarGroupFlags/READ, vLinkGenVarSectionGroupFlag=vLinkGenVarGroupFlags/WRITE:
            OS_DATA_SHARED_VAR_NOINIT: vLinkGenVarSectionGroupInit=NONE, vLinkGenVarSectionGroupRef=OS_VAR_NOCACHE_NOINIT, vLinkGenVarSectionGroupRef=OS_CORESTATUS_CORE0_VAR_NOCACHE_NOINIT, vLinkGenVarSectionGroupRef=OS_PUBLIC_CORE0_VAR_NOINIT, vLinkGenVarSectionGroupRef=OS_BARRIER_CORE0_VAR_NOCACHE_NOINIT, vLinkGenVarSectionGroupRef=OS_CORESTATUS_CORE1_VAR_NOCACHE_NOINIT, vLinkGenVarSectionGroupRef=OS_PUBLIC_CORE1_VAR_NOINIT, vLinkGenVarSectionGroupRef=OS_BARRIER_CORE1_VAR_NOCACHE_NOINIT, vLinkGenVarSectionGroupRef=OS_CORESTATUS_CORE2_VAR_NOCACHE_NOINIT, vLinkGenVarSectionGroupRef=OS_PUBLIC_CORE2_VAR_NOINIT, vLinkGenVarSectionGroupRef=OS_BARRIER_CORE2_VAR_NOCACHE_NOINIT
            OS_DATA_SHARED_VAR_FAST_NOINIT: vLinkGenVarSectionGroupInit=NONE, vLinkGenVarSectionGroupRef=OS_VAR_FAST_NOCACHE_NOINIT, vLinkGenVarSectionGroupRef=OS_CORESTATUS_CORE0_VAR_FAST_NOCACHE_NOINIT, vLinkGenVarSectionGroupRef=OS_PUBLIC_CORE0_VAR_FAST_NOINIT, vLinkGenVarSectionGroupRef=OS_BARRIER_CORE0_VAR_FAST_NOCACHE_NOINIT, vLinkGenVarSectionGroupRef=OS_CORESTATUS_CORE1_VAR_FAST_NOCACHE_NOINIT, vLinkGenVarSectionGroupRef=OS_PUBLIC_CORE1_VAR_FAST_NOINIT, vLinkGenVarSectionGroupRef=OS_BARRIER_CORE1_VAR_FAST_NOCACHE_NOINIT, vLinkGenVarSectionGroupRef=OS_CORESTATUS_CORE2_VAR_FAST_NOCACHE_NOINIT, vLinkGenVarSectionGroupRef=OS_PUBLIC_CORE2_VAR_FAST_NOINIT, vLinkGenVarSectionGroupRef=OS_BARRIER_CORE2_VAR_FAST_NOCACHE_NOINIT
            OS_DATA_SHARED_VAR_INIT: vLinkGenVarSectionGroupInit=INIT, vLinkGenVarSectionGroupEndAlignment=4, vLinkGenVarSectionGroupRef=OS_VAR_NOCACHE
            OS_DATA_SHARED_VAR_FAST_INIT: vLinkGenVarSectionGroupInit=INIT, vLinkGenVarSectionGroupEndAlignment=4, vLinkGenVarSectionGroupRef=OS_VAR_FAST_NOCACHE
        OS_GLOBALSHARED_VAR: vLinkGenVarGroupInitCore=0, vLinkGenVarGroupPosition=5, vLinkGenVarGroupRegion=RegionBlock_0_DSPR_Core0, vLinkGenVarGroupRomRegion=RegionBlock_PFlash0_Cached, vLinkGenVarGroupModule=Os
          8 x vLinkGenVarSectionGroup, all with vLinkGenVarSectionGroupPosition=0, vLinkGenVarSectionGroupInitStage=ONE, vLinkGenVarSectionGroupGapSize=16, vLinkGenVarSectionGroupAlignment=16, vLinkGenVarSectionGroupFlag=vLinkGenVarGroupFlags/ORDERED, vLinkGenVarSectionGroupFlag=vLinkGenVarGroupFlags/CONTIGUOUS, vLinkGenVarSectionGroupFlag=vLinkGenVarGroupFlags/FILL, vLinkGenVarSectionGroupFlag=vLinkGenVarGroupFlags/READ, vLinkGenVarSectionGroupFlag=vLinkGenVarGroupFlags/WRITE:
            OS_GLOBALSHARED_VAR_NOINIT: vLinkGenVarSectionGroupInit=NONE, vLinkGenVarSectionGroupRef=vLinkGenLinkerSections/OS_GLOBALSHARED_VAR_NOINIT, vLinkGenVarSectionGroupRef=OS_GLOBALSHARED_VAR_NOCACHE_NOINIT
            OS_GLOBALSHARED_VAR_FAST_NOINIT: vLinkGenVarSectionGroupInit=NONE, vLinkGenVarSectionGroupRef=vLinkGenLinkerSections/OS_GLOBALSHARED_VAR_FAST_NOINIT, vLinkGenVarSectionGroupRef=OS_GLOBALSHARED_VAR_FAST_NOCACHE_NOINIT
            OS_GLOBALSHARED_VAR_INIT: vLinkGenVarSectionGroupInit=INIT, vLinkGenVarSectionGroupEndAlignment=4, vLinkGenVarSectionGroupRef=vLinkGenLinkerSections/OS_GLOBALSHARED_VAR, vLinkGenVarSectionGroupRef=OS_GLOBALSHARED_VAR_NOCACHE
            OS_GLOBALSHARED_VAR_FAST_INIT: vLinkGenVarSectionGroupInit=INIT, vLinkGenVarSectionGroupEndAlignment=4, vLinkGenVarSectionGroupRef=OS_GLOBALSHARED_VAR_FAST, vLinkGenVarSectionGroupRef=OS_GLOBALSHARED_VAR_FAST_NOCACHE
            OS_GLOBALSHARED_VAR_ZERO_INIT: vLinkGenVarSectionGroupInit=ZERO_INIT, vLinkGenVarSectionGroupEndAlignment=4, vLinkGenVarSectionGroupRef=vLinkGenLinkerSections/OS_GLOBALSHARED_VAR_ZERO_INIT, vLinkGenVarSectionGroupRef=OS_GLOBALSHARED_VAR_NOCACHE_ZERO_INIT
            OS_GLOBALSHARED_VAR_FAST_ZERO_INIT: vLinkGenVarSectionGroupInit=ZERO_INIT, vLinkGenVarSectionGroupEndAlignment=4, vLinkGenVarSectionGroupRef=vLinkGenLinkerSections/OS_GLOBALSHARED_VAR_FAST_ZERO_INIT, vLinkGenVarSectionGroupRef=OS_GLOBALSHARED_VAR_FAST_NOCACHE_ZERO_INIT
            OS_GLOBALSHARED_VAR_ZERO_INIT_bss: vLinkGenVarSectionGroupInit=ZERO_INIT, vLinkGenVarSectionGroupEndAlignment=4, vLinkGenVarSectionGroupRef=vLinkGenLinkerSections/OS_GLOBALSHARED_VAR_ZERO_INIT_bss, vLinkGenVarSectionGroupRef=OS_GLOBALSHARED_VAR_NOCACHE_ZERO_INIT_bss
            OS_GLOBALSHARED_VAR_FAST_ZERO_INIT_bss: vLinkGenVarSectionGroupInit=ZERO_INIT, vLinkGenVarSectionGroupEndAlignment=4, vLinkGenVarSectionGroupRef=vLinkGenLinkerSections/OS_GLOBALSHARED_VAR_FAST_ZERO_INIT_bss, vLinkGenVarSectionGroupRef=OS_GLOBALSHARED_VAR_FAST_NOCACHE_ZERO_INIT_bss
        Data_Default: vLinkGenVarGroupInitCore=0, vLinkGenVarGroupPosition=1000, vLinkGenVarGroupRegion=RegionBlock_0_DSPR_Core0, vLinkGenVarGroupRomRegion=RegionBlock_PFlash0_Cached
          4 x vLinkGenVarSectionGroup, all with vLinkGenVarSectionGroupPosition=0, vLinkGenVarSectionGroupInitStage=ONE, vLinkGenVarSectionGroupAlignment=16, vLinkGenVarSectionGroupEndAlignment=4, vLinkGenVarSectionGroupFlag=vLinkGenVarGroupFlags/ORDERED, vLinkGenVarSectionGroupFlag=vLinkGenVarGroupFlags/CONTIGUOUS, vLinkGenVarSectionGroupFlag=vLinkGenVarGroupFlags/FILL, vLinkGenVarSectionGroupFlag=vLinkGenVarGroupFlags/READ, vLinkGenVarSectionGroupFlag=vLinkGenVarGroupFlags/WRITE:
            data: vLinkGenVarSectionGroupInit=INIT, vLinkGenVarSectionGroupRef=vLinkGenLinkerSections/data
            zdata: vLinkGenVarSectionGroupInit=INIT, vLinkGenVarSectionGroupRef=vLinkGenLinkerSections/zdata
            bss: vLinkGenVarSectionGroupInit=ZERO_INIT, vLinkGenVarSectionGroupRef=vLinkGenLinkerSections/bss
            zbss: vLinkGenVarSectionGroupInit=ZERO_INIT, vLinkGenVarSectionGroupRef=vLinkGenLinkerSections/zbss
        STACK_C0: vLinkGenVarGroupInitCore=0, vLinkGenVarGroupPosition=5, vLinkGenVarGroupRegion=RegionBlock_0_DSPR_Core0
          STACK_C0 (vLinkGenVarSectionGroup):
            vLinkGenVarSectionGroupAlignment = 4
            vLinkGenVarSectionGroupEndAlignment = 4
            vLinkGenVarSectionGroupSize = 1024
            vLinkGenVarSectionGroupInit = ZERO_INIT
            vLinkGenVarSectionGroupInitStage = EARLY
            vLinkGenVarSectionGroupPosition = 0
            vLinkGenVarSectionGroupFlag = vLinkGenVarGroupFlags/ORDERED
            vLinkGenVarSectionGroupFlag = vLinkGenVarGroupFlags/CONTIGUOUS
            vLinkGenVarSectionGroupFlag = vLinkGenVarGroupFlags/FILL
            vLinkGenVarSectionGroupFlag = vLinkGenVarGroupFlags/READ
            vLinkGenVarSectionGroupFlag = vLinkGenVarGroupFlags/WRITE
        STACK_C1: vLinkGenVarGroupInitCore=1, vLinkGenVarGroupPosition=5, vLinkGenVarGroupRegion=RegionBlock_0_DSPR_Core1
          STACK_C1 (vLinkGenVarSectionGroup):
            vLinkGenVarSectionGroupAlignment = 4
            vLinkGenVarSectionGroupEndAlignment = 4
            vLinkGenVarSectionGroupSize = 1024
            vLinkGenVarSectionGroupInit = ZERO_INIT
            vLinkGenVarSectionGroupInitStage = EARLY
            vLinkGenVarSectionGroupPosition = 0
            vLinkGenVarSectionGroupFlag = vLinkGenVarGroupFlags/ORDERED
            vLinkGenVarSectionGroupFlag = vLinkGenVarGroupFlags/CONTIGUOUS
            vLinkGenVarSectionGroupFlag = vLinkGenVarGroupFlags/FILL
            vLinkGenVarSectionGroupFlag = vLinkGenVarGroupFlags/READ
            vLinkGenVarSectionGroupFlag = vLinkGenVarGroupFlags/WRITE
        STACK_C2: vLinkGenVarGroupInitCore=2, vLinkGenVarGroupPosition=5, vLinkGenVarGroupRegion=RegionBlock_0_DSPR_Core2
          STACK_C2 (vLinkGenVarSectionGroup):
            vLinkGenVarSectionGroupAlignment = 4
            vLinkGenVarSectionGroupEndAlignment = 4
            vLinkGenVarSectionGroupSize = 1024
            vLinkGenVarSectionGroupInit = ZERO_INIT
            vLinkGenVarSectionGroupInitStage = EARLY
            vLinkGenVarSectionGroupPosition = 0
            vLinkGenVarSectionGroupFlag = vLinkGenVarGroupFlags/ORDERED
            vLinkGenVarSectionGroupFlag = vLinkGenVarGroupFlags/CONTIGUOUS
            vLinkGenVarSectionGroupFlag = vLinkGenVarGroupFlags/FILL
            vLinkGenVarSectionGroupFlag = vLinkGenVarGroupFlags/READ
            vLinkGenVarSectionGroupFlag = vLinkGenVarGroupFlags/WRITE
        CSA_CORE0: vLinkGenVarGroupPosition=5, vLinkGenVarGroupRegion=RegionBlock_0_DSPR_Core0
          CSA_CORE0 (vLinkGenVarSectionGroup):
            vLinkGenVarSectionGroupAlignment = 64
            vLinkGenVarSectionGroupSize = 32768
            vLinkGenVarSectionGroupPosition = 0
            vLinkGenVarSectionGroupInit = NONE
            vLinkGenVarSectionGroupInitStage = ONE
            vLinkGenVarSectionGroupFlag = vLinkGenVarGroupFlags/ORDERED
            vLinkGenVarSectionGroupFlag = vLinkGenVarGroupFlags/CONTIGUOUS
            vLinkGenVarSectionGroupFlag = vLinkGenVarGroupFlags/FILL
            vLinkGenVarSectionGroupFlag = vLinkGenVarGroupFlags/READ
            vLinkGenVarSectionGroupFlag = vLinkGenVarGroupFlags/WRITE
        CSA_CORE1: vLinkGenVarGroupPosition=5, vLinkGenVarGroupRegion=RegionBlock_0_DSPR_Core1
          CSA_CORE1 (vLinkGenVarSectionGroup):
            vLinkGenVarSectionGroupAlignment = 64
            vLinkGenVarSectionGroupSize = 8192
            vLinkGenVarSectionGroupPosition = 0
            vLinkGenVarSectionGroupInit = NONE
            vLinkGenVarSectionGroupInitStage = ONE
            vLinkGenVarSectionGroupFlag = vLinkGenVarGroupFlags/ORDERED
            vLinkGenVarSectionGroupFlag = vLinkGenVarGroupFlags/CONTIGUOUS
            vLinkGenVarSectionGroupFlag = vLinkGenVarGroupFlags/FILL
            vLinkGenVarSectionGroupFlag = vLinkGenVarGroupFlags/READ
            vLinkGenVarSectionGroupFlag = vLinkGenVarGroupFlags/WRITE
        CSA_CORE2: vLinkGenVarGroupPosition=5, vLinkGenVarGroupRegion=RegionBlock_0_DSPR_Core2
          CSA_CORE2 (vLinkGenVarSectionGroup):
            vLinkGenVarSectionGroupAlignment = 64
            vLinkGenVarSectionGroupSize = 8192
            vLinkGenVarSectionGroupPosition = 0
            vLinkGenVarSectionGroupInit = NONE
            vLinkGenVarSectionGroupInitStage = ONE
            vLinkGenVarSectionGroupFlag = vLinkGenVarGroupFlags/ORDERED
            vLinkGenVarSectionGroupFlag = vLinkGenVarGroupFlags/CONTIGUOUS
            vLinkGenVarSectionGroupFlag = vLinkGenVarGroupFlags/FILL
            vLinkGenVarSectionGroupFlag = vLinkGenVarGroupFlags/READ
            vLinkGenVarSectionGroupFlag = vLinkGenVarGroupFlags/WRITE
      3 x vLinkGenLogicalSymbolGroup, all with vLinkGenSymbolGroupPosition=5:
        Startup_Labels
          7 x vLinkGenLinkerSymbol, all with vLinkGenLinkerSymbolValue=brsStartupEntry, vLinkGenLinkerSymbolPosition=0:
            Startup_Labels1: vLinkGenLinkerSymbolName=_RESET
            Startup_Labels2: vLinkGenLinkerSymbolName=_start
            Startup_Labels3: vLinkGenLinkerSymbolName=StartupEntry
            Startup_Labels4: vLinkGenLinkerSymbolName=_brsStartupEntry
            Startup_Labels5: vLinkGenLinkerSymbolName=_start_tc0
            Startup_Labels6: vLinkGenLinkerSymbolName=_start_tc1
            Startup_Labels7: vLinkGenLinkerSymbolName=_start_tc2
        CSA_LABELS
          6 x vLinkGenLinkerSymbol, all with vLinkGenLinkerSymbolPosition=0:
            CSA_LABELS1: vLinkGenLinkerSymbolName=__CSA_BEGIN_CPU0_, vLinkGenLinkerSymbolValue=_CSA_CORE0_START
            CSA_LABELS2: vLinkGenLinkerSymbolName=__CSA_END_CPU0_, vLinkGenLinkerSymbolValue=_CSA_CORE0_LIMIT
            CSA_LABELS3: vLinkGenLinkerSymbolName=__CSA_BEGIN_CPU1_, vLinkGenLinkerSymbolValue=_CSA_CORE1_START
            CSA_LABELS4: vLinkGenLinkerSymbolName=__CSA_END_CPU1_, vLinkGenLinkerSymbolValue=_CSA_CORE1_LIMIT
            CSA_LABELS5: vLinkGenLinkerSymbolName=__CSA_BEGIN_CPU2_, vLinkGenLinkerSymbolValue=_CSA_CORE2_START
            CSA_LABELS6: vLinkGenLinkerSymbolName=__CSA_END_CPU2_, vLinkGenLinkerSymbolValue=_CSA_CORE2_LIMIT
        Startup_Stack
          3 x vLinkGenLinkerSymbol, all with vLinkGenLinkerSymbolPosition=0:
            Startup_Stack_c{0..2}: vLinkGenLinkerSymbolName=__STARTUPSTACK_CORE{0..2}, vLinkGenLinkerSymbolValue=_STACK_C{0..2}_LIMIT
      OS_OsApplication_VAR (vLinkGenLogicalVarGroup):
        vLinkGenVarGroupPosition = 5
        vLinkGenVarGroupInitCore = 0
        vLinkGenVarGroupRegion = RegionBlock_0_DSPR_Core0
        vLinkGenVarGroupModule = Os
        vLinkGenVarGroupRomRegion = RegionBlock_PFlash0_Cached
        8 x vLinkGenVarSectionGroup, all with vLinkGenVarSectionGroupPosition=0, vLinkGenVarSectionGroupInitStage=ONE, vLinkGenVarSectionGroupGapSize=16, vLinkGenVarSectionGroupAlignment=16, vLinkGenVarSectionGroupFlag=vLinkGenVarGroupFlags/ORDERED, vLinkGenVarSectionGroupFlag=vLinkGenVarGroupFlags/CONTIGUOUS, vLinkGenVarSectionGroupFlag=vLinkGenVarGroupFlags/FILL, vLinkGenVarSectionGroupFlag=vLinkGenVarGroupFlags/READ, vLinkGenVarSectionGroupFlag=vLinkGenVarGroupFlags/WRITE:
          OS_OsApplication_VAR_NOINIT: vLinkGenVarSectionGroupInit=NONE, vLinkGenVarSectionGroupRef=vLinkGenLinkerSections/OS_OsApplication_VAR_NOINIT, vLinkGenVarSectionGroupRef=OS_OsApplication_VAR_NOCACHE_NOINIT
          OS_OsApplication_VAR_FAST_NOINIT: vLinkGenVarSectionGroupInit=NONE, vLinkGenVarSectionGroupRef=vLinkGenLinkerSections/OS_OsApplication_VAR_FAST_NOINIT, vLinkGenVarSectionGroupRef=OS_OsApplication_VAR_FAST_NOCACHE_NOINIT
          OS_OsApplication_VAR_INIT: vLinkGenVarSectionGroupInit=INIT, vLinkGenVarSectionGroupEndAlignment=4, vLinkGenVarSectionGroupRef=vLinkGenLinkerSections/OS_OsApplication_VAR, vLinkGenVarSectionGroupRef=OS_OsApplication_VAR_NOCACHE
          OS_OsApplication_VAR_FAST_INIT: vLinkGenVarSectionGroupInit=INIT, vLinkGenVarSectionGroupEndAlignment=4, vLinkGenVarSectionGroupRef=OS_OsApplication_VAR_FAST, vLinkGenVarSectionGroupRef=OS_OsApplication_VAR_FAST_NOCACHE
          OS_OsApplication_VAR_ZERO_INIT: vLinkGenVarSectionGroupInit=ZERO_INIT, vLinkGenVarSectionGroupEndAlignment=4, vLinkGenVarSectionGroupRef=vLinkGenLinkerSections/OS_OsApplication_VAR_ZERO_INIT, vLinkGenVarSectionGroupRef=OS_OsApplication_VAR_NOCACHE_ZERO_INIT
          OS_OsApplication_VAR_FAST_ZERO_INIT: vLinkGenVarSectionGroupInit=ZERO_INIT, vLinkGenVarSectionGroupEndAlignment=4, vLinkGenVarSectionGroupRef=vLinkGenLinkerSections/OS_OsApplication_VAR_FAST_ZERO_INIT, vLinkGenVarSectionGroupRef=OS_OsApplication_VAR_FAST_NOCACHE_ZERO_INIT
          OS_OsApplication_VAR_ZERO_INIT_bss: vLinkGenVarSectionGroupInit=ZERO_INIT, vLinkGenVarSectionGroupEndAlignment=4, vLinkGenVarSectionGroupRef=vLinkGenLinkerSections/OS_OsApplication_VAR_ZERO_INIT_bss, vLinkGenVarSectionGroupRef=OS_OsApplication_VAR_NOCACHE_ZERO_INIT_bss
          OS_OsApplication_VAR_FAST_ZERO_INIT_bss: vLinkGenVarSectionGroupInit=ZERO_INIT, vLinkGenVarSectionGroupEndAlignment=4, vLinkGenVarSectionGroupRef=vLinkGenLinkerSections/OS_OsApplication_VAR_FAST_ZERO_INIT_bss, vLinkGenVarSectionGroupRef=OS_OsApplication_VAR_FAST_NOCACHE_ZERO_INIT_bss
    vLinkGenGeneral: vLinkGenEntrySymbol=brsStartupEntry, vLinkGenFileGeneration=STANDARD
    vLinkGenPublishedInformation: vLinkGenDefaultVarGroupAlignment=16, vLinkGenGeneration=2, vLinkGenDuplicatedLabels=false
      vLinkGenRegionBlockFlags
        RESERVED (vLinkGenRegionBlockFlag)
      vLinkGenConstGroupFlags
        7 x vLinkGenConstGroupFlag:
          ORDERED
          CONTIGUOUS
          FILL
          NOCOPY
          EXECUTE
          READ
          WRITE
      vLinkGenConstSectionFlags
        KEEP (vLinkGenConstSectionFlag)
      vLinkGenVarGroupFlags
        7 x vLinkGenVarGroupFlag:
          ORDERED
          CONTIGUOUS
          FILL
          NOCOPY
          EXECUTE
          READ
          WRITE
      vLinkGenVarSectionFlags
        KEEP (vLinkGenVarSectionFlag)
