AUTOSAR XML (schema 00048)
package /ActiveEcuC
  module config Can: implementation-config-variant=VARIANT-PRE-COMPILE, module-description=Can_Impl
    CanGeneral:
      CanIndex = 0
      CanChangeBaudrateApi = false
      CanDevErrorDetection = true
      CanHardwareCancellation = false
      CanIdenticalIdCancellation = false
      CanMainFunctionBusoffPeriod = 0.01
      CanMainFunctionModePeriod = 0.01
      CanMainFunctionWakeupPeriod = 0.01
      CanMultiplexedTransmission = false
      CanSetBaudrateApi = false
      CanTimeoutDuration = 0.01
      CanVersionInfoApi = false
      CanGenericPrecopy = false
      CanHardwareLoopCheck = true
      CanSecureTempBuffer = false
      CanRxFullCANSupport = true
      CanTxFullCANSupport = true
      CanRxBasicCANSupport = true
      CanUseNestedCANInterrupts = false
      CanHardwareCancelByAppl = false
      CanIndividualProcessing = false
      CanGenericConfirmation = false
      CanGenericConfirmationAPI2 = false
      CanRxQueue = false
      CanSupportMixedID = true
      CanRxQueueSize = 10
      CanMultipleBasicCANObjects = false
      CanMultipleBasicCANTxObjects = false
      CanHardwareHandleType = UINT8
      CanOptimizeOneController = false
      CanInterruptCategory = CATEGORY2
      CanGetStatus = false
      CanInterruptLock = DRIVER
      CanWakeupSupport = false
      CanRamCheck = None
      CanOverrunNotification = DET
      CanReinitStart = false
      CanGenericPreTransmit = false
      CanFdSupport = BRS
      CanRuntimeMeasurementSupport = false
      CanMaxRxDataLen = 8
      CanMaxTxDataLen = 8
      CanUsePeripheralAccessApi = false
      CanMirrorModeSupport = false
      CanUseOsInterruptControl = true
      CanSafeBswChecks = false
      CanSilentModeSupport = false
      CanHwTxFifoSupport = false
      CanMcanRevision = M_CAN_REV_315
      CanCheckWakeupCanRetType = false
      CanFdHardwareBufferOptimization = true
      CanEccInit = true
      CanUseVirtualAddressing = false
      CanCounterRef = SystemTimer_Core0
      CanMainFunctionRWPeriods
    CanConfigSet
      CN_TC37X_VCU_CAN01_2f90d2fb_Rx (CanHardwareObject):
        CanHandleType = BASIC
        CanIdType = STANDARD
        CanIdValue = 0
        CanObjectType = RECEIVE
        CanObjectId = 31
        CanHwProcessing = false
        CanObjectHwSize = 6
        CanObjectHwHandle = 0
        CanMaxDataLen = 8
        CanFdPaddingValue = 0
        CanObjectMultiplexedTransmission = false
        CanObjectHwFifo = false
        CanControllerRef = CT_TC37X_VCU_CAN01_55ccbf7a
        CanFilterMaskRef = CT_TC37X_VCU_CAN01_55ccbf7a/CanFilterMask
      CT_TC37X_VCU_CAN01_55ccbf7a (CanController):
        CanControllerActivation = true
        CanBusoffProcessing = INTERRUPT
        CanControllerBaseAddress = 4028663040
        CanControllerId = 4
        CanRxProcessing = INTERRUPT
        CanTxProcessing = INTERRUPT
        CanWakeupProcessing = INTERRUPT
        CanWakeupSupport = false
        CanWakeupSourceId = 0
        CanBasisAddressEnum = M_CAN1
        CanTxBufferElementSize = ES_8
        CanRxBufferElementSize = ES_8
        CanRxFifo0ElementSize = ES_8
        CanRxFifo1ElementSize = ES_8
        CanMaxNrOfRxFifo0Elements = 64
        CanMaxNrOfRxFifo1Elements = 64
        CanMaxNrOfRxBuffers = 64
        CanMaxNrOfTxBuffers = 32
        CanIsTTCAN = false
        CanInterruptPriority = 49
        CanIOPort = b_001
        CanControllerDefaultBaudrate = CT_TC37X_VCU_CAN01_55ccbf7a/CanControllerBaudrateConfig
        CanControllerSystemRef = CT_TC37X_VCU_CAN01
        CanWakeupSourceRef = CN_TC37X_VCU_CAN01_70b1f95e
        CanCpuClockRef = McuClockReferencePoint_CAN
        CanControllerBaudrateConfig:
          CanControllerBaudRate = 500
          CanControllerBaudRateConfigID = 0
          CanControllerPropSeg = 4
          CanControllerSeg1 = 55
          CanControllerSeg2 = 20
          CanControllerSyncJumpWidth = 1
          CanBaudrateClock = 80000
          CanBaudratePrescaler = 2
        CanFilterMask: CanFilterMaskValue=0, CanFilterCodeValue=0, IsLocked=false
      3 x CanHardwareObject, all with CanHandleType=BASIC, CanIdValue=0, CanIdType=STANDARD, CanHwProcessing=false, CanMaxDataLen=8, CanFdPaddingValue=0, CanObjectMultiplexedTransmission=false, CanObjectHwFifo=false:
        CN_TC37X_VCU_CAN01_70b1f95e_Tx: CanObjectType=TRANSMIT, CanObjectId=30, CanObjectHwSize=1, CanObjectHwHandle=0, CanControllerRef=CT_TC37X_VCU_CAN01_55ccbf7a
        CN_ATOM_CANFD_Matrix_CH_V600_202502_64375107_Rx: CanObjectType=RECEIVE, CanObjectId=6, CanObjectHwSize=6, CanObjectHwHandle=0, CanControllerRef=CT_ATOM_CANFD_Matrix_CH_V600_202502_37050292, CanFilterMaskRef=CT_ATOM_CANFD_Matrix_CH_V600_202502_37050292/CanFilterMask
        CN_ATOM_CANFD_Matrix_CH_V600_202502_a4d436ac_Tx: CanObjectType=TRANSMIT, CanObjectId=5, CanObjectHwSize=1, CanObjectHwHandle=5, CanControllerRef=CT_ATOM_CANFD_Matrix_CH_V600_202502_37050292
      CT_ATOM_CANFD_Matrix_CH_V600_202502_37050292 (CanController):
        CanControllerActivation = true
        CanBusoffProcessing = INTERRUPT
        CanControllerBaseAddress = 4028727552
        CanControllerId = 0
        CanRxProcessing = INTERRUPT
        CanTxProcessing = INTERRUPT
        CanWakeupProcessing = INTERRUPT
        CanWakeupSupport = false
        CanWakeupSourceId = 0
        CanBasisAddressEnum = M_CAN4
        CanTxBufferElementSize = ES_8
        CanRxBufferElementSize = ES_8
        CanRxFifo0ElementSize = ES_8
        CanRxFifo1ElementSize = ES_8
        CanMaxNrOfRxFifo0Elements = 64
        CanMaxNrOfRxFifo1Elements = 64
        CanMaxNrOfRxBuffers = 64
        CanMaxNrOfTxBuffers = 32
        CanIsTTCAN = false
        CanIOPort = b_010
        CanControllerDefaultBaudrate = CT_ATOM_CANFD_Matrix_CH_V600_202502_37050292/CanControllerBaudrateConfig
        CanControllerSystemRef = CT_ATOM_CANFD_Matrix_CH_V600_202502
        CanWakeupSourceRef = CN_ATOM_CANFD_Matrix_CH_V600_202502_a4d436ac
        CanCpuClockRef = McuClockReferencePoint_CAN
        CanControllerBaudrateConfig:
          CanControllerBaudRate = 500
          CanControllerBaudRateConfigID = 0
          CanControllerPropSeg = 4
          CanControllerSeg1 = 55
          CanControllerSeg2 = 20
          CanControllerSyncJumpWidth = 1
          CanBaudrateClock = 80000
          CanBaudratePrescaler = 2
          CanControllerFdBaudrateConfig:
            CanControllerFdBaudRate = 2000
            CanControllerPropSeg = 2
            CanControllerSeg1 = 12
            CanControllerSeg2 = 5
            CanControllerSyncJumpWidth = 5
            CanControllerTxBitRateSwitch = true
            CanBaudratePrescaler = 2
        CanFilterMask: CanFilterMaskValue=0, CanFilterCodeValue=0, IsLocked=false
      3 x CanHardwareObject, all with CanObjectType=TRANSMIT, CanIdType=STANDARD, CanHwProcessing=false, CanObjectHwSize=1, CanMaxDataLen=8, CanFdPaddingValue=0, CanObjectMultiplexedTransmission=false, CanObjectHwFifo=false:
        CN_ATOM_CANFD_Matrix_CH_Tx_94h: CanHandleType=FULL, CanIdValue=148, CanObjectId=0, CanObjectHwHandle=0, CanControllerRef=CT_ATOM_CANFD_Matrix_CH_V600_202502_37050292
        CN_ATOM_CANFD_Matrix_CH_Tx_95h: CanHandleType=FULL, CanIdValue=149, CanObjectId=1, CanObjectHwHandle=1, CanControllerRef=CT_ATOM_CANFD_Matrix_CH_V600_202502_37050292
        CN_ATOM_CAN_Matrix_PT_V600_20250211_9b894f3d_Tx: CanHandleType=BASIC, CanIdValue=0, CanObjectId=17, CanObjectHwHandle=10, CanControllerRef=CT_ATOM_CAN_Matrix_PT_V600_20250211_08587b03
      CT_ATOM_CAN_Matrix_PT_V600_20250211_08587b03 (CanController):
        CanControllerActivation = true
        CanBusoffProcessing = INTERRUPT
        CanControllerBaseAddress = 4028665088
        CanControllerId = 1
        CanRxProcessing = INTERRUPT
        CanTxProcessing = INTERRUPT
        CanWakeupProcessing = INTERRUPT
        CanWakeupSupport = false
        CanWakeupSourceId = 0
        CanBasisAddressEnum = M_CAN3
        CanTxBufferElementSize = ES_8
        CanRxBufferElementSize = ES_8
        CanRxFifo0ElementSize = ES_8
        CanRxFifo1ElementSize = ES_8
        CanMaxNrOfRxFifo0Elements = 64
        CanMaxNrOfRxFifo1Elements = 64
        CanMaxNrOfRxBuffers = 64
        CanMaxNrOfTxBuffers = 32
        CanIsTTCAN = false
        CanIOPort = b_000
        CanControllerDefaultBaudrate = CT_ATOM_CAN_Matrix_PT_V600_20250211_08587b03/CanControllerBaudrateConfig
        CanControllerSystemRef = CT_ATOM_CAN_Matrix_PT_V600_20250211
        CanWakeupSourceRef = CN_ATOM_CAN_Matrix_PT_V600_20250211_9b894f3d
        CanCpuClockRef = McuClockReferencePoint_CAN
        CanControllerBaudrateConfig:
          CanControllerBaudRate = 500
          CanControllerBaudRateConfigID = 0
          CanControllerPropSeg = 3
          CanControllerSeg1 = 2
          CanControllerSeg2 = 2
          CanControllerSyncJumpWidth = 2
          CanBaudrateClock = 80000
          CanBaudratePrescaler = 20
        CanFilterMask: CanFilterMaskValue=0, CanFilterCodeValue=0, IsLocked=false
      4 x CanHardwareObject, all with CanIdType=STANDARD, CanHwProcessing=false, CanMaxDataLen=8, CanFdPaddingValue=0, CanObjectMultiplexedTransmission=false, CanObjectHwFifo=false:
        CN_ATOM_CAN_Matrix_PT_V600_20250211_bde8b0ce_Rx: CanHandleType=BASIC, CanIdValue=0, CanObjectType=RECEIVE, CanObjectId=24, CanObjectHwSize=6, CanObjectHwHandle=0, CanControllerRef=CT_ATOM_CAN_Matrix_PT_V600_20250211_08587b03, CanFilterMaskRef=CT_ATOM_CAN_Matrix_PT_V600_20250211_08587b03/CanFilterMask
        CN_ATOM_CAN_PT_Tx_95h: CanHandleType=FULL, CanIdValue=149, CanObjectType=TRANSMIT, CanObjectId=7, CanObjectHwSize=1, CanObjectHwHandle=0, CanControllerRef=CT_ATOM_CAN_Matrix_PT_V600_20250211_08587b03
        CN_ATOM_CAN_PT_Tx_96h: CanHandleType=FULL, CanIdValue=150, CanObjectType=TRANSMIT, CanObjectId=8, CanObjectHwSize=1, CanObjectHwHandle=1, CanControllerRef=CT_ATOM_CAN_Matrix_PT_V600_20250211_08587b03
        CN_ATOM_CAN_XCP_bbd3e829_Rx: CanHandleType=BASIC, CanIdValue=0, CanObjectType=RECEIVE, CanObjectId=26, CanObjectHwSize=6, CanObjectHwHandle=0, CanControllerRef=CT_ATOM_CAN_XCP_40afa023, CanFilterMaskRef=CT_ATOM_CAN_XCP_40afa023/CanFilterMask
      CT_ATOM_CAN_XCP_40afa023 (CanController):
        CanControllerActivation = true
        CanBusoffProcessing = INTERRUPT
        CanControllerBaseAddress = 4028729600
        CanControllerId = 2
        CanRxProcessing = INTERRUPT
        CanTxProcessing = INTERRUPT
        CanWakeupProcessing = INTERRUPT
        CanWakeupSupport = false
        CanWakeupSourceId = 0
        CanBasisAddressEnum = M_CAN6
        CanTxBufferElementSize = ES_8
        CanRxBufferElementSize = ES_8
        CanRxFifo0ElementSize = ES_8
        CanRxFifo1ElementSize = ES_8
        CanMaxNrOfRxFifo0Elements = 64
        CanMaxNrOfRxFifo1Elements = 64
        CanMaxNrOfRxBuffers = 64
        CanMaxNrOfTxBuffers = 32
        CanIsTTCAN = false
        CanIOPort = b_010
        CanControllerDefaultBaudrate = CT_ATOM_CAN_XCP_40afa023/CanControllerBaudrateConfig
        CanControllerSystemRef = CT_ATOM_CAN_XCP
        CanWakeupSourceRef = CN_ATOM_CAN_XCP_f42a46d4
        CanCpuClockRef = McuClockReferencePoint_CAN
        CanControllerBaudrateConfig:
          CanControllerBaudRate = 500
          CanControllerBaudRateConfigID = 0
          CanControllerPropSeg = 3
          CanControllerSeg1 = 2
          CanControllerSeg2 = 2
          CanControllerSyncJumpWidth = 1
          CanBaudrateClock = 80000
          CanBaudratePrescaler = 20
        CanFilterMask: CanFilterMaskValue=0, CanFilterCodeValue=0, IsLocked=false
      CN_ATOM_CAN_XCP_f42a46d4_Tx (CanHardwareObject):
        CanHandleType = BASIC
        CanIdValue = 0
        CanObjectType = TRANSMIT
        CanIdType = STANDARD
        CanObjectId = 25
        CanHwProcessing = false
        CanObjectHwSize = 1
        CanObjectHwHandle = 0
        CanMaxDataLen = 8
        CanFdPaddingValue = 0
        CanObjectMultiplexedTransmission = false
        CanObjectHwFifo = false
        CanControllerRef = CT_ATOM_CAN_XCP_40afa023
      CT_J1939_bms_92f0044b (CanController):
        CanControllerActivation = true
        CanBusoffProcessing = INTERRUPT
        CanControllerBaseAddress = 4028662016
        CanControllerId = 3
        CanRxProcessing = INTERRUPT
        CanTxProcessing = INTERRUPT
        CanWakeupProcessing = INTERRUPT
        CanWakeupSupport = false
        CanWakeupSourceId = 0
        CanBasisAddressEnum = M_CAN0
        CanTxBufferElementSize = ES_8
        CanRxBufferElementSize = ES_8
        CanRxFifo0ElementSize = ES_8
        CanRxFifo1ElementSize = ES_8
        CanMaxNrOfRxFifo0Elements = 64
        CanMaxNrOfRxFifo1Elements = 64
        CanMaxNrOfRxBuffers = 64
        CanMaxNrOfTxBuffers = 32
        CanIsTTCAN = true
        CanIOPort = b_001
        CanControllerDefaultBaudrate = CT_J1939_bms_92f0044b/CanControllerBaudrateConfig
        CanControllerSystemRef = CT_J1939_bms
        CanWakeupSourceRef = CN_J1939_bms_dea99804
        CanCpuClockRef = McuClockReferencePoint_CAN
        CanControllerBaudrateConfig:
          CanControllerBaudRate = 250
          CanControllerBaudRateConfigID = 0
          CanControllerPropSeg = 69
          CanControllerSeg1 = 170
          CanControllerSeg2 = 80
          CanControllerSyncJumpWidth = 43
          CanBaudrateClock = 80000
          CanBaudratePrescaler = 1
        CanFilterMask: CanFilterMaskValue=2147483648, CanFilterCodeValue=0, IsLocked=false
      20 x CanHardwareObject, all with CanHwProcessing=false, CanMaxDataLen=8, CanFdPaddingValue=0, CanObjectMultiplexedTransmission=false, CanObjectHwFifo=false:
        CN_J1939_bms_dea99804_Tx: CanHandleType=BASIC, CanIdValue=0, CanObjectType=TRANSMIT, CanIdType=EXTENDED, CanObjectId=28, CanObjectHwSize=1, CanObjectHwHandle=1, CanControllerRef=CT_J1939_bms_92f0044b
        CN_J1939_bms_96c04df9_Rx: CanHandleType=BASIC, CanIdType=EXTENDED, CanIdValue=0, CanObjectType=RECEIVE, CanObjectId=29, CanObjectHwSize=6, CanObjectHwHandle=0, CanControllerRef=CT_J1939_bms_92f0044b, CanFilterMaskRef=CT_J1939_bms_92f0044b/CanFilterMask
        CN_J1939_bms_101956F4h_Tx: CanHandleType=FULL, CanIdValue=270096116, CanObjectType=TRANSMIT, CanIdType=EXTENDED, CanObjectId=27, CanObjectHwSize=1, CanObjectHwHandle=0, CanControllerRef=CT_J1939_bms_92f0044b
        CN_ATOM_CANFD_Matrix_CH_Tx_D1h: CanHandleType=FULL, CanIdValue=209, CanObjectType=TRANSMIT, CanIdType=STANDARD, CanObjectId=2, CanObjectHwSize=1, CanObjectHwHandle=2, CanControllerRef=CT_ATOM_CANFD_Matrix_CH_V600_202502_37050292
        CN_ATOM_CANFD_Matrix_CH_Tx_D2h: CanHandleType=FULL, CanIdValue=210, CanObjectType=TRANSMIT, CanIdType=STANDARD, CanObjectId=3, CanObjectHwSize=1, CanObjectHwHandle=3, CanControllerRef=CT_ATOM_CANFD_Matrix_CH_V600_202502_37050292
        CN_ATOM_CANFD_Matrix_CH_Tx_D3h: CanHandleType=FULL, CanIdValue=211, CanObjectType=TRANSMIT, CanIdType=STANDARD, CanObjectId=4, CanObjectHwSize=1, CanObjectHwHandle=4, CanControllerRef=CT_ATOM_CANFD_Matrix_CH_V600_202502_37050292
        CN_ATOM_CAN_PT_Tx_D1h: CanHandleType=FULL, CanIdValue=209, CanObjectType=TRANSMIT, CanIdType=STANDARD, CanObjectId=9, CanObjectHwSize=1, CanObjectHwHandle=2, CanControllerRef=CT_ATOM_CAN_Matrix_PT_V600_20250211_08587b03
        CN_ATOM_CAN_PT_Tx_D2h: CanHandleType=FULL, CanIdValue=210, CanObjectType=TRANSMIT, CanIdType=STANDARD, CanObjectId=10, CanObjectHwSize=1, CanObjectHwHandle=3, CanControllerRef=CT_ATOM_CAN_Matrix_PT_V600_20250211_08587b03
        CN_ATOM_CAN_PT_Tx_D6h: CanHandleType=FULL, CanIdValue=214, CanObjectType=TRANSMIT, CanIdType=STANDARD, CanObjectId=11, CanObjectHwSize=1, CanObjectHwHandle=4, CanControllerRef=CT_ATOM_CAN_Matrix_PT_V600_20250211_08587b03
        CN_ATOM_CAN_PT_Tx_121h: CanHandleType=FULL, CanIdValue=289, CanObjectType=TRANSMIT, CanIdType=STANDARD, CanObjectId=12, CanObjectHwSize=1, CanObjectHwHandle=5, CanControllerRef=CT_ATOM_CAN_Matrix_PT_V600_20250211_08587b03
        CanHardwareObject_MCU_01_oATOM_CAN_Matrix_PT_V600_20250211_a575570e_Rx: CanHandleType=FULL, CanIdType=STANDARD, CanIdValue=152, CanObjectId=18, CanObjectType=RECEIVE, CanObjectHwSize=1, CanObjectHwHandle=0, CanCommonCANNode=A, CanControllerRef=CT_ATOM_CAN_Matrix_PT_V600_20250211_08587b03
        CanHardwareObject_MCU_02_oATOM_CAN_Matrix_PT_V600_20250211_0c5263e7_Rx: CanHandleType=FULL, CanIdType=STANDARD, CanIdValue=243, CanObjectId=22, CanObjectType=RECEIVE, CanObjectHwSize=1, CanObjectHwHandle=4, CanCommonCANNode=A, CanControllerRef=CT_ATOM_CAN_Matrix_PT_V600_20250211_08587b03
        CanHardwareObject_BMS_status_01_oATOM_CAN_Matrix_PT_V600_20250211_e1a63e78_Rx: CanHandleType=FULL, CanIdType=STANDARD, CanIdValue=193, CanObjectId=20, CanObjectType=RECEIVE, CanObjectHwSize=1, CanObjectHwHandle=2, CanCommonCANNode=A, CanControllerRef=CT_ATOM_CAN_Matrix_PT_V600_20250211_08587b03
        CanHardwareObject_BMS_status_02_oATOM_CAN_Matrix_PT_V600_20250211_bc716bc5_Rx: CanHandleType=FULL, CanIdType=STANDARD, CanIdValue=194, CanObjectId=21, CanObjectType=RECEIVE, CanObjectHwSize=1, CanObjectHwHandle=3, CanCommonCANNode=A, CanControllerRef=CT_ATOM_CAN_Matrix_PT_V600_20250211_08587b03
        CanHardwareObject_IBS_Status_05_oATOM_CAN_Matrix_PT_V600_20250211_3b732231_Rx: CanHandleType=FULL, CanIdType=STANDARD, CanIdValue=187, CanObjectId=19, CanObjectType=RECEIVE, CanObjectHwSize=1, CanObjectHwHandle=1, CanCommonCANNode=A, CanControllerRef=CT_ATOM_CAN_Matrix_PT_V600_20250211_08587b03
        CanHardwareObject_IVI_03_oATOM_CAN_Matrix_PT_V600_20250211_d0d400f2_Rx: CanHandleType=FULL, CanIdType=STANDARD, CanIdValue=249, CanObjectId=23, CanObjectType=RECEIVE, CanObjectHwSize=1, CanObjectHwHandle=5, CanCommonCANNode=A, CanControllerRef=CT_ATOM_CAN_Matrix_PT_V600_20250211_08587b03
        CN_ATOM_CAN_PT_Tx_220h: CanHandleType=FULL, CanIdValue=544, CanObjectType=TRANSMIT, CanIdType=STANDARD, CanObjectId=13, CanObjectHwSize=1, CanObjectHwHandle=6, CanControllerRef=CT_ATOM_CAN_Matrix_PT_V600_20250211_08587b03
        CN_ATOM_CAN_PT_Tx_221h: CanHandleType=FULL, CanIdValue=545, CanObjectType=TRANSMIT, CanIdType=STANDARD, CanObjectId=14, CanObjectHwSize=1, CanObjectHwHandle=7, CanControllerRef=CT_ATOM_CAN_Matrix_PT_V600_20250211_08587b03
        CN_ATOM_CAN_PT_Tx_224h: CanHandleType=FULL, CanIdValue=548, CanObjectType=TRANSMIT, CanIdType=STANDARD, CanObjectId=15, CanObjectHwSize=1, CanObjectHwHandle=8, CanControllerRef=CT_ATOM_CAN_Matrix_PT_V600_20250211_08587b03
        CN_ATOM_CAN_PT_Tx_225h: CanHandleType=FULL, CanIdValue=549, CanObjectType=TRANSMIT, CanIdType=STANDARD, CanObjectId=16, CanObjectHwSize=1, CanObjectHwHandle=9, CanControllerRef=CT_ATOM_CAN_Matrix_PT_V600_20250211_08587b03
