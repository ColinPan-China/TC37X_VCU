AUTOSAR XML (schema 00048)
package /ActiveEcuC
  module config Can: implementation-config-variant=VARIANT-PRE-COMPILE, module-description=Can_Impl
    CanGeneral:
      CanIndex = 0
      CanChangeBaudrateApi = false
      CanDevErrorDetection = true
      CanHardwareCancellation = false
      CanIdenticalIdCancellation = false
      CanMainFunctionBusoffPeriod = 0.01
      CanMainFunctionModePeriod = 0.01
      CanMainFunctionWakeupPeriod = 0.01
      CanMultiplexedTransmission = false
      CanSetBaudrateApi = false
      CanTimeoutDuration = 0.01
      CanVersionInfoApi = false
      CanGenericPrecopy = false
      CanHardwareLoopCheck = true
      CanSecureTempBuffer = false
      CanRxFullCANSupport = true
      CanTxFullCANSupport = true
      CanRxBasicCANSupport = true
      CanUseNestedCANInterrupts = false
      CanHardwareCancelByAppl = false
      CanIndividualProcessing = false
      CanGenericConfirmation = false
      CanGenericConfirmationAPI2 = false
      CanRxQueue = false
      CanSupportMixedID = false
      CanRxQueueSize = 10
      CanMultipleBasicCANObjects = false
      CanMultipleBasicCANTxObjects = false
      CanHardwareHandleType = UINT8
      CanOptimizeOneController = true
      CanInterruptCategory = CATEGORY2
      CanGetStatus = false
      CanInterruptLock = DRIVER
      CanWakeupSupport = false
      CanRamCheck = None
      CanOverrunNotification = DET
      CanReinitStart = false
      CanGenericPreTransmit = false
      CanFdSupport = BRS
      CanRuntimeMeasurementSupport = false
      CanMaxRxDataLen = 8
      CanMaxTxDataLen = 8
      CanUsePeripheralAccessApi = false
      CanMirrorModeSupport = false
      CanUseOsInterruptControl = true
      CanSafeBswChecks = false
      CanSilentModeSupport = false
      CanHwTxFifoSupport = false
      CanMcanRevision = M_CAN_REV_315
      CanCheckWakeupCanRetType = false
      CanFdHardwareBufferOptimization = true
      CanEccInit = true
      CanUseVirtualAddressing = false
      CanCounterRef = SystemTimer
      CanMainFunctionRWPeriods
    CanConfigSet
      CT_TC37X_VCU_CAN00_22cb8fec (CanController):
        CanControllerActivation = true
        CanBusoffProcessing = INTERRUPT
        CanControllerBaseAddress = 4028662016
        CanControllerId = 0
        CanRxProcessing = INTERRUPT
        CanTxProcessing = INTERRUPT
        CanWakeupProcessing = INTERRUPT
        CanWakeupSupport = false
        CanWakeupSourceId = 0
        CanBasisAddressEnum = M_CAN0
        CanTxBufferElementSize = ES_8
        CanRxBufferElementSize = ES_8
        CanRxFifo0ElementSize = ES_8
        CanRxFifo1ElementSize = ES_8
        CanMaxNrOfRxFifo0Elements = 64
        CanMaxNrOfRxFifo1Elements = 64
        CanMaxNrOfRxBuffers = 64
        CanMaxNrOfTxBuffers = 32
        CanIsTTCAN = true
        CanInterruptPriority = 48
        CanIOPort = b_001
        CanControllerDefaultBaudrate = CanControllerBaudrateConfig
        CanControllerSystemRef = CT_TC37X_VCU_CAN00
        CanWakeupSourceRef = CN_TC37X_VCU_CAN00_07b6c9c8
        CanCpuClockRef = McuClockReferencePoint_CAN
        CanControllerBaudrateConfig:
          CanControllerBaudRate = 500
          CanControllerBaudRateConfigID = 0
          CanControllerPropSeg = 4
          CanControllerSeg1 = 55
          CanControllerSeg2 = 20
          CanControllerSyncJumpWidth = 1
          CanBaudrateClock = 80000
          CanBaudratePrescaler = 2
          CanControllerFdBaudrateConfig:
            CanControllerFdBaudRate = 2000
            CanControllerPropSeg = 4
            CanControllerSeg1 = 10
            CanControllerSeg2 = 5
            CanControllerSyncJumpWidth = 5
            CanControllerTxBitRateSwitch = false
            CanBaudratePrescaler = 2
        CanFilterMask: CanFilterMaskValue=0, CanFilterCodeValue=0, IsLocked=false
      5 x CanHardwareObject, all with CanIdType=STANDARD, CanHwProcessing=false, CanMaxDataLen=8, CanFdPaddingValue=0, CanObjectMultiplexedTransmission=false, CanObjectHwFifo=false, CanControllerRef=CT_TC37X_VCU_CAN00_22cb8fec:
        CN_TC37X_VCU_CAN00_07b6c9c8_Tx: CanHandleType=BASIC, CanIdValue=0, CanObjectType=TRANSMIT, CanObjectId=1, CanObjectHwSize=1, CanObjectHwHandle=1
        CN_TC37X_VCU_CAN00_c052b9c5_Rx: CanHandleType=BASIC, CanIdValue=0, CanObjectType=RECEIVE, CanObjectId=4, CanObjectHwSize=6, CanObjectHwHandle=0, CanFilterMaskRef=CanFilterMask
        CanHardwareObject_VcuRxMsg1_oTC37X_VCU_CAN00_c149044d_Rx: CanHandleType=FULL, CanIdValue=512, CanObjectId=2, CanObjectType=RECEIVE, CanObjectHwSize=1, CanObjectHwHandle=0, CanCommonCANNode=A
        CanHardwareObject_VcuRxMsg2_oTC37X_VCU_CAN00_de1782b6_Rx: CanHandleType=FULL, CanIdValue=513, CanObjectId=3, CanObjectType=RECEIVE, CanObjectHwSize=1, CanObjectHwHandle=1, CanCommonCANNode=A
        CanHardwareObject_TX0: CanHandleType=FULL, CanIdValue=1308, CanObjectId=0, CanObjectType=TRANSMIT, CanObjectHwSize=1, CanObjectHwHandle=0
