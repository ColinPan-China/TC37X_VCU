AUTOSAR XML (schema 00048)
package /ActiveEcuC
  module config Can: implementation-config-variant=VARIANT-PRE-COMPILE, module-description=Can_Impl
    CanGeneral:
      CanIndex = 0
      CanChangeBaudrateApi = false
      CanDevErrorDetection = true
      CanHardwareCancellation = false
      CanIdenticalIdCancellation = false
      CanMainFunctionBusoffPeriod = 0.01
      CanMainFunctionModePeriod = 0.01
      CanMainFunctionWakeupPeriod = 0.01
      CanMultiplexedTransmission = false
      CanSetBaudrateApi = false
      CanTimeoutDuration = 0.01
      CanVersionInfoApi = false
      CanGenericPrecopy = false
      CanHardwareLoopCheck = true
      CanSecureTempBuffer = false
      CanRxFullCANSupport = false
      CanTxFullCANSupport = true
      CanRxBasicCANSupport = true
      CanUseNestedCANInterrupts = false
      CanHardwareCancelByAppl = false
      CanIndividualProcessing = false
      CanGenericConfirmation = false
      CanGenericConfirmationAPI2 = false
      CanRxQueue = false
      CanSupportMixedID = true
      CanRxQueueSize = 10
      CanMultipleBasicCANObjects = false
      CanMultipleBasicCANTxObjects = false
      CanHardwareHandleType = UINT8
      CanOptimizeOneController = false
      CanInterruptCategory = CATEGORY2
      CanGetStatus = false
      CanInterruptLock = DRIVER
      CanWakeupSupport = false
      CanRamCheck = None
      CanOverrunNotification = DET
      CanReinitStart = false
      CanGenericPreTransmit = false
      CanFdSupport = BRS
      CanRuntimeMeasurementSupport = false
      CanMaxRxDataLen = 8
      CanMaxTxDataLen = 8
      CanUsePeripheralAccessApi = false
      CanMirrorModeSupport = false
      CanUseOsInterruptControl = true
      CanSafeBswChecks = false
      CanSilentModeSupport = false
      CanHwTxFifoSupport = false
      CanMcanRevision = M_CAN_REV_315
      CanCheckWakeupCanRetType = false
      CanFdHardwareBufferOptimization = true
      CanEccInit = true
      CanUseVirtualAddressing = false
      CanCounterRef = SystemTimer
      CanMainFunctionRWPeriods
    CanConfigSet
      CN_TC37X_VCU_CAN01_2f90d2fb_Rx (CanHardwareObject):
        CanHandleType = BASIC
        CanIdType = STANDARD
        CanIdValue = 0
        CanObjectType = RECEIVE
        CanObjectId = 13
        CanHwProcessing = false
        CanObjectHwSize = 6
        CanObjectHwHandle = 0
        CanMaxDataLen = 8
        CanFdPaddingValue = 0
        CanObjectMultiplexedTransmission = false
        CanObjectHwFifo = false
        CanControllerRef = CT_TC37X_VCU_CAN01_55ccbf7a
        CanFilterMaskRef = CT_TC37X_VCU_CAN01_55ccbf7a/CanFilterMask
      CT_TC37X_VCU_CAN01_55ccbf7a (CanController):
        CanControllerActivation = true
        CanBusoffProcessing = INTERRUPT
        CanControllerBaseAddress = 4028663040
        CanControllerId = 4
        CanRxProcessing = INTERRUPT
        CanTxProcessing = INTERRUPT
        CanWakeupProcessing = INTERRUPT
        CanWakeupSupport = false
        CanWakeupSourceId = 0
        CanBasisAddressEnum = M_CAN1
        CanTxBufferElementSize = ES_8
        CanRxBufferElementSize = ES_8
        CanRxFifo0ElementSize = ES_8
        CanRxFifo1ElementSize = ES_8
        CanMaxNrOfRxFifo0Elements = 64
        CanMaxNrOfRxFifo1Elements = 64
        CanMaxNrOfRxBuffers = 64
        CanMaxNrOfTxBuffers = 32
        CanIsTTCAN = false
        CanInterruptPriority = 49
        CanIOPort = b_001
        CanControllerDefaultBaudrate = CT_TC37X_VCU_CAN01_55ccbf7a/CanControllerBaudrateConfig
        CanControllerSystemRef = CT_TC37X_VCU_CAN01
        CanWakeupSourceRef = CN_TC37X_VCU_CAN01_70b1f95e
        CanCpuClockRef = McuClockReferencePoint_CAN
        CanControllerBaudrateConfig:
          CanControllerBaudRate = 500
          CanControllerBaudRateConfigID = 0
          CanControllerPropSeg = 4
          CanControllerSeg1 = 55
          CanControllerSeg2 = 20
          CanControllerSyncJumpWidth = 1
          CanBaudrateClock = 80000
          CanBaudratePrescaler = 2
        CanFilterMask: CanFilterMaskValue=0, CanFilterCodeValue=0, IsLocked=false
      3 x CanHardwareObject, all with CanHandleType=BASIC, CanIdValue=0, CanIdType=STANDARD, CanHwProcessing=false, CanObjectHwHandle=0, CanMaxDataLen=8, CanFdPaddingValue=0, CanObjectMultiplexedTransmission=false, CanObjectHwFifo=false:
        CN_TC37X_VCU_CAN01_70b1f95e_Tx: CanObjectType=TRANSMIT, CanObjectId=12, CanObjectHwSize=1, CanControllerRef=CT_TC37X_VCU_CAN01_55ccbf7a
        CN_TC37X_VCU_CAN03_2b6502c6_Rx: CanObjectType=RECEIVE, CanObjectId=15, CanObjectHwSize=6, CanControllerRef=CT_TC37X_VCU_CAN03_bbc2de56, CanFilterMaskRef=CT_TC37X_VCU_CAN03_bbc2de56/CanFilterMask
        CN_TC37X_VCU_CAN03_9ebf9872_Tx: CanObjectType=TRANSMIT, CanObjectId=14, CanObjectHwSize=1, CanControllerRef=CT_TC37X_VCU_CAN03_bbc2de56
      CT_TC37X_VCU_CAN03_bbc2de56 (CanController):
        CanControllerActivation = true
        CanBusoffProcessing = INTERRUPT
        CanControllerBaseAddress = 4028664064
        CanControllerId = 5
        CanRxProcessing = INTERRUPT
        CanTxProcessing = INTERRUPT
        CanWakeupProcessing = INTERRUPT
        CanWakeupSupport = false
        CanWakeupSourceId = 0
        CanBasisAddressEnum = M_CAN2
        CanTxBufferElementSize = ES_8
        CanRxBufferElementSize = ES_8
        CanRxFifo0ElementSize = ES_8
        CanRxFifo1ElementSize = ES_8
        CanMaxNrOfRxFifo0Elements = 64
        CanMaxNrOfRxFifo1Elements = 64
        CanMaxNrOfRxBuffers = 64
        CanMaxNrOfTxBuffers = 32
        CanIsTTCAN = false
        CanIOPort = b_001
        CanControllerDefaultBaudrate = CT_TC37X_VCU_CAN03_bbc2de56/CanControllerBaudrateConfig
        CanControllerSystemRef = CT_TC37X_VCU_CAN03
        CanWakeupSourceRef = CN_TC37X_VCU_CAN03_9ebf9872
        CanCpuClockRef = McuClockReferencePoint_CAN
        CanControllerBaudrateConfig:
          CanControllerBaudRate = 500
          CanControllerBaudRateConfigID = 0
          CanControllerPropSeg = 4
          CanControllerSeg1 = 55
          CanControllerSeg2 = 20
          CanControllerSyncJumpWidth = 1
          CanBaudrateClock = 80000
          CanBaudratePrescaler = 2
        CanFilterMask: CanFilterMaskValue=0, CanFilterCodeValue=0, IsLocked=false
      CN_ATOM_CANFD_Matrix_CH_V600_202502_64375107_Rx (CanHardwareObject):
        CanHandleType = BASIC
        CanIdType = STANDARD
        CanIdValue = 0
        CanObjectType = RECEIVE
        CanObjectId = 3
        CanHwProcessing = false
        CanObjectHwSize = 6
        CanObjectHwHandle = 0
        CanMaxDataLen = 8
        CanFdPaddingValue = 0
        CanObjectMultiplexedTransmission = false
        CanObjectHwFifo = false
        CanControllerRef = CT_ATOM_CANFD_Matrix_CH_V600_202502_37050292
        CanFilterMaskRef = CT_ATOM_CANFD_Matrix_CH_V600_202502_37050292/CanFilterMask
      CN_ATOM_CANFD_Matrix_CH_V600_202502_a4d436ac_Tx (CanHardwareObject):
        CanHandleType = BASIC
        CanIdValue = 0
        CanObjectType = TRANSMIT
        CanIdType = STANDARD
        CanObjectId = 2
        CanHwProcessing = false
        CanObjectHwSize = 1
        CanObjectHwHandle = 2
        CanMaxDataLen = 8
        CanFdPaddingValue = 0
        CanObjectMultiplexedTransmission = false
        CanObjectHwFifo = false
        CanControllerRef = CT_ATOM_CANFD_Matrix_CH_V600_202502_37050292
      CT_ATOM_CANFD_Matrix_CH_V600_202502_37050292 (CanController):
        CanControllerActivation = true
        CanBusoffProcessing = INTERRUPT
        CanControllerBaseAddress = 4028727552
        CanControllerId = 0
        CanRxProcessing = INTERRUPT
        CanTxProcessing = INTERRUPT
        CanWakeupProcessing = INTERRUPT
        CanWakeupSupport = false
        CanWakeupSourceId = 0
        CanBasisAddressEnum = M_CAN4
        CanTxBufferElementSize = ES_8
        CanRxBufferElementSize = ES_8
        CanRxFifo0ElementSize = ES_8
        CanRxFifo1ElementSize = ES_8
        CanMaxNrOfRxFifo0Elements = 64
        CanMaxNrOfRxFifo1Elements = 64
        CanMaxNrOfRxBuffers = 64
        CanMaxNrOfTxBuffers = 32
        CanIsTTCAN = false
        CanIOPort = b_010
        CanControllerDefaultBaudrate = CT_ATOM_CANFD_Matrix_CH_V600_202502_37050292/CanControllerBaudrateConfig
        CanControllerSystemRef = CT_ATOM_CANFD_Matrix_CH_V600_202502
        CanWakeupSourceRef = CN_ATOM_CANFD_Matrix_CH_V600_202502_a4d436ac
        CanCpuClockRef = McuClockReferencePoint_CAN
        CanControllerBaudrateConfig:
          CanControllerBaudRate = 500
          CanControllerBaudRateConfigID = 0
          CanControllerPropSeg = 4
          CanControllerSeg1 = 55
          CanControllerSeg2 = 20
          CanControllerSyncJumpWidth = 1
          CanBaudrateClock = 80000
          CanBaudratePrescaler = 2
          CanControllerFdBaudrateConfig:
            CanControllerFdBaudRate = 2000
            CanControllerPropSeg = 2
            CanControllerSeg1 = 12
            CanControllerSeg2 = 5
            CanControllerSyncJumpWidth = 5
            CanControllerTxBitRateSwitch = true
            CanBaudratePrescaler = 2
        CanFilterMask: CanFilterMaskValue=0, CanFilterCodeValue=0, IsLocked=false
      3 x CanHardwareObject, all with CanObjectType=TRANSMIT, CanIdType=STANDARD, CanHwProcessing=false, CanObjectHwSize=1, CanMaxDataLen=8, CanFdPaddingValue=0, CanObjectMultiplexedTransmission=false, CanObjectHwFifo=false:
        CN_ATOM_CANFD_Matrix_CH_V600_202502_a4d436ac_Tx_94h: CanHandleType=FULL, CanIdValue=148, CanObjectId=0, CanObjectHwHandle=0, CanControllerRef=CT_ATOM_CANFD_Matrix_CH_V600_202502_37050292
        CN_ATOM_CANFD_Matrix_CH_V600_202502_a4d436ac_Tx_95h: CanHandleType=FULL, CanIdValue=149, CanObjectId=1, CanObjectHwHandle=1, CanControllerRef=CT_ATOM_CANFD_Matrix_CH_V600_202502_37050292
        CN_ATOM_CAN_Matrix_PT_V600_20250211_9b894f3d_Tx: CanHandleType=BASIC, CanIdValue=0, CanObjectId=6, CanObjectHwHandle=2, CanControllerRef=CT_ATOM_CAN_Matrix_PT_V600_20250211_08587b03
      CT_ATOM_CAN_Matrix_PT_V600_20250211_08587b03 (CanController):
        CanControllerActivation = true
        CanBusoffProcessing = INTERRUPT
        CanControllerBaseAddress = 4028665088
        CanControllerId = 1
        CanRxProcessing = INTERRUPT
        CanTxProcessing = INTERRUPT
        CanWakeupProcessing = INTERRUPT
        CanWakeupSupport = false
        CanWakeupSourceId = 0
        CanBasisAddressEnum = M_CAN3
        CanTxBufferElementSize = ES_8
        CanRxBufferElementSize = ES_8
        CanRxFifo0ElementSize = ES_8
        CanRxFifo1ElementSize = ES_8
        CanMaxNrOfRxFifo0Elements = 64
        CanMaxNrOfRxFifo1Elements = 64
        CanMaxNrOfRxBuffers = 64
        CanMaxNrOfTxBuffers = 32
        CanIsTTCAN = false
        CanIOPort = b_000
        CanControllerDefaultBaudrate = CT_ATOM_CAN_Matrix_PT_V600_20250211_08587b03/CanControllerBaudrateConfig
        CanControllerSystemRef = CT_ATOM_CAN_Matrix_PT_V600_20250211
        CanWakeupSourceRef = CN_ATOM_CAN_Matrix_PT_V600_20250211_9b894f3d
        CanCpuClockRef = McuClockReferencePoint_CAN
        CanControllerBaudrateConfig:
          CanControllerBaudRate = 500
          CanControllerBaudRateConfigID = 0
          CanControllerPropSeg = 3
          CanControllerSeg1 = 2
          CanControllerSeg2 = 2
          CanControllerSyncJumpWidth = 2
          CanBaudrateClock = 80000
          CanBaudratePrescaler = 20
        CanFilterMask: CanFilterMaskValue=0, CanFilterCodeValue=0, IsLocked=false
      4 x CanHardwareObject, all with CanIdType=STANDARD, CanHwProcessing=false, CanMaxDataLen=8, CanFdPaddingValue=0, CanObjectMultiplexedTransmission=false, CanObjectHwFifo=false:
        CN_ATOM_CAN_Matrix_PT_V600_20250211_bde8b0ce_Rx: CanHandleType=BASIC, CanIdValue=0, CanObjectType=RECEIVE, CanObjectId=7, CanObjectHwSize=6, CanObjectHwHandle=0, CanControllerRef=CT_ATOM_CAN_Matrix_PT_V600_20250211_08587b03, CanFilterMaskRef=CT_ATOM_CAN_Matrix_PT_V600_20250211_08587b03/CanFilterMask
        CN_ATOM_CAN_PT_Tx_95h: CanHandleType=FULL, CanIdValue=149, CanObjectType=TRANSMIT, CanObjectId=4, CanObjectHwSize=1, CanObjectHwHandle=0, CanControllerRef=CT_ATOM_CAN_Matrix_PT_V600_20250211_08587b03
        CN_ATOM_CAN_PT_Tx_96h: CanHandleType=FULL, CanIdValue=150, CanObjectType=TRANSMIT, CanObjectId=5, CanObjectHwSize=1, CanObjectHwHandle=1, CanControllerRef=CT_ATOM_CAN_Matrix_PT_V600_20250211_08587b03
        CN_ATOM_CAN_XCP_bbd3e829_Rx: CanHandleType=BASIC, CanIdValue=0, CanObjectType=RECEIVE, CanObjectId=9, CanObjectHwSize=6, CanObjectHwHandle=0, CanControllerRef=CT_ATOM_CAN_XCP_40afa023, CanFilterMaskRef=CT_ATOM_CAN_XCP_40afa023/CanFilterMask
      CT_ATOM_CAN_XCP_40afa023 (CanController):
        CanControllerActivation = true
        CanBusoffProcessing = INTERRUPT
        CanControllerBaseAddress = 4028729600
        CanControllerId = 2
        CanRxProcessing = INTERRUPT
        CanTxProcessing = INTERRUPT
        CanWakeupProcessing = INTERRUPT
        CanWakeupSupport = false
        CanWakeupSourceId = 0
        CanBasisAddressEnum = M_CAN6
        CanTxBufferElementSize = ES_8
        CanRxBufferElementSize = ES_8
        CanRxFifo0ElementSize = ES_8
        CanRxFifo1ElementSize = ES_8
        CanMaxNrOfRxFifo0Elements = 64
        CanMaxNrOfRxFifo1Elements = 64
        CanMaxNrOfRxBuffers = 64
        CanMaxNrOfTxBuffers = 32
        CanIsTTCAN = false
        CanIOPort = b_010
        CanControllerDefaultBaudrate = CT_ATOM_CAN_XCP_40afa023/CanControllerBaudrateConfig
        CanControllerSystemRef = CT_ATOM_CAN_XCP
        CanWakeupSourceRef = CN_ATOM_CAN_XCP_f42a46d4
        CanCpuClockRef = McuClockReferencePoint_CAN
        CanControllerBaudrateConfig:
          CanControllerBaudRate = 500
          CanControllerBaudRateConfigID = 0
          CanControllerPropSeg = 3
          CanControllerSeg1 = 2
          CanControllerSeg2 = 2
          CanControllerSyncJumpWidth = 1
          CanBaudrateClock = 80000
          CanBaudratePrescaler = 20
        CanFilterMask: CanFilterMaskValue=0, CanFilterCodeValue=0, IsLocked=false
      CN_ATOM_CAN_XCP_f42a46d4_Tx (CanHardwareObject):
        CanHandleType = BASIC
        CanIdValue = 0
        CanObjectType = TRANSMIT
        CanIdType = STANDARD
        CanObjectId = 8
        CanHwProcessing = false
        CanObjectHwSize = 1
        CanObjectHwHandle = 0
        CanMaxDataLen = 8
        CanFdPaddingValue = 0
        CanObjectMultiplexedTransmission = false
        CanObjectHwFifo = false
        CanControllerRef = CT_ATOM_CAN_XCP_40afa023
      CT_J1939_bms_92f0044b (CanController):
        CanControllerActivation = true
        CanBusoffProcessing = INTERRUPT
        CanControllerBaseAddress = 4028662016
        CanControllerId = 3
        CanRxProcessing = INTERRUPT
        CanTxProcessing = INTERRUPT
        CanWakeupProcessing = INTERRUPT
        CanWakeupSupport = false
        CanWakeupSourceId = 0
        CanBasisAddressEnum = M_CAN0
        CanTxBufferElementSize = ES_8
        CanRxBufferElementSize = ES_8
        CanRxFifo0ElementSize = ES_8
        CanRxFifo1ElementSize = ES_8
        CanMaxNrOfRxFifo0Elements = 64
        CanMaxNrOfRxFifo1Elements = 64
        CanMaxNrOfRxBuffers = 64
        CanMaxNrOfTxBuffers = 32
        CanIsTTCAN = true
        CanIOPort = b_001
        CanControllerDefaultBaudrate = CT_J1939_bms_92f0044b/CanControllerBaudrateConfig
        CanControllerSystemRef = CT_J1939_bms
        CanWakeupSourceRef = CN_J1939_bms_dea99804
        CanCpuClockRef = McuClockReferencePoint_CAN
        CanControllerBaudrateConfig:
          CanControllerBaudRate = 500
          CanControllerBaudRateConfigID = 0
          CanControllerPropSeg = 3
          CanControllerSeg1 = 2
          CanControllerSeg2 = 2
          CanControllerSyncJumpWidth = 1
          CanBaudrateClock = 80000
          CanBaudratePrescaler = 20
        CanFilterMask: CanFilterMaskValue=2147483648, CanFilterCodeValue=0, IsLocked=false
      CN_J1939_bms_dea99804_Tx (CanHardwareObject):
        CanHandleType = BASIC
        CanIdValue = 0
        CanObjectType = TRANSMIT
        CanIdType = EXTENDED
        CanObjectId = 10
        CanHwProcessing = false
        CanObjectHwSize = 1
        CanObjectHwHandle = 0
        CanMaxDataLen = 8
        CanFdPaddingValue = 0
        CanObjectMultiplexedTransmission = false
        CanObjectHwFifo = false
        CanControllerRef = CT_J1939_bms_92f0044b
      CN_J1939_bms_96c04df9_Rx (CanHardwareObject):
        CanHandleType = BASIC
        CanIdType = EXTENDED
        CanIdValue = 0
        CanObjectType = RECEIVE
        CanObjectId = 11
        CanHwProcessing = false
        CanObjectHwSize = 6
        CanObjectHwHandle = 0
        CanMaxDataLen = 8
        CanFdPaddingValue = 0
        CanObjectMultiplexedTransmission = false
        CanObjectHwFifo = false
        CanControllerRef = CT_J1939_bms_92f0044b
        CanFilterMaskRef = CT_J1939_bms_92f0044b/CanFilterMask
