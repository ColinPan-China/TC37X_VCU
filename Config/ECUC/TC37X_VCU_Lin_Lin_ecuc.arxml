AUTOSAR XML (schema 00048)
package /ActiveEcuC
  module config Lin: implementation-config-variant=VARIANT-PRE-COMPILE
    LinGlobalConfig
      CN_LIN00_b12a0454 (LinChannel):  # LIN00
        LinChannelBaudRate = 19200
        LinChannelId = 0
        LinChannelWakeupSupport = true
        LinChannelEcuMWakeupSource = CN_LIN00_b12a0454
        LinClockRef = McuClockReferencePoint_0
      CN_LIN01_c62d34c2 (LinChannel):  # LIN01
        LinChannelBaudRate = 19200
        LinChannelId = 1
        LinChannelWakeupSupport = true
        LinChannelEcuMWakeupSource = CN_LIN01_c62d34c2
        LinClockRef = McuClockReferencePoint_0
    LinGeneral: LinDevErrorDetect=false, LinIndex=0, LinTimeoutDuration=0, LinVersionInfoApi=false
