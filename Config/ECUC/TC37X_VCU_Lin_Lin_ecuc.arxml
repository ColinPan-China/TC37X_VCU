AUTOSAR XML (schema 00048)
package /ActiveEcuC
  module config Lin: implementation-config-variant=VARIANT-PRE-COMPILE
    LinGlobalConfig
      3 x LinChannel, all with LinChannelBaudRate=19200, LinChannelWakeupSupport=false, LinClockRef=McuClockReferencePoint_0:
        CN_ATOM_HWLIN3_8ac1b423: LinChannelId=1, LinChannelEcuMWakeupSource=CN_ATOM_HWLIN3_8ac1b423
        CN_ATOM_HWLIN4_14a52180: LinChannelId=2, LinChannelEcuMWakeupSource=CN_ATOM_HWLIN4_14a52180
        CN_ATOM_HWLIN1_64cfd50f: LinChannelId=0, LinChannelEcuMWakeupSource=CN_ATOM_HWLIN1_64cfd50f
    LinGeneral: LinDevErrorDetect=false, LinIndex=0, LinTimeoutDuration=0, LinVersionInfoApi=false
