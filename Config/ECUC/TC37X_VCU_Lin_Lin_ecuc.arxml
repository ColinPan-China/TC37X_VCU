AUTOSAR XML (schema 00048)
package /ActiveEcuC
  module config Lin: implementation-config-variant=VARIANT-PRE-COMPILE
    LinGlobalConfig
      3 x LinChannel, all with LinChannelBaudRate=19200, LinClockRef=McuClockReferencePoint_0:
        CN_LIN00_b12a0454: LinChannelId=0, LinChannelWakeupSupport=true, LinChannelEcuMWakeupSource=CN_LIN00_b12a0454  # LIN00
        CN_LIN01_c62d34c2: LinChannelId=1, LinChannelWakeupSupport=true, LinChannelEcuMWakeupSource=CN_LIN01_c62d34c2  # LIN01
        CN_LIN02_5f246578: LinChannelId=2, LinChannelWakeupSupport=false, LinChannelEcuMWakeupSource=CN_LIN02_5f246578  # LIN02
    LinGeneral: LinDevErrorDetect=false, LinIndex=0, LinTimeoutDuration=0, LinVersionInfoApi=false
