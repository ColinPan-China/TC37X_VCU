AUTOSAR XML (schema 00048)
package /Icu
  module config Icu: implementation-config-variant=VARIANT-POST-BUILD, module-description=Icu_Impl
    CommonPublishedInformation:
      ArMajorVersion = 4
      ArMinorVersion = 2
      ArPatchVersion = 2
      ModuleId = 122
      Release = _TRICORE_TC377
      SwMajorVersion = 10
      SwMinorVersion = 40
      SwPatchVersion = 1
      VendorApiInfix = TimerIp
      VendorId = 17
    IcuConfigSet: IcuMaxChannel=2
      IcuChannel_P34_2 (IcuChannel): IcuAssignedHwUnit=GTM, IcuChannelId=0, IcuDefaultStartEdge=ICU_BOTH_EDGES, IcuMeasurementMode=ICU_MODE_SIGNAL_MEASUREMENT, IcuWakeupCapability=false
        GtmTimerInputConfiguration_0 (GtmTimerInputConfiguration): GtmTimerUsed=McuGtmTimChannelAllocationConf_4
          TimChannelFilterConfig:
            TimChFilterCounterFreqSelect = GTM_CONFIGURABLE_CLOCK_0
            TimChFilterModeForFallingEdge = IMMEDIATE_EDGE_PROPAGATION_MODE
            TimChFilterModeForRisingEdge = IMMEDIATE_EDGE_PROPAGATION_MODE
            TimChFilterTimeForFallingEdge = 0
            TimChFilterTimeForRisingEdge = 0
            TimChannelFilterEnable = false
          TimChannelGeneral:
            OverflowISRThreshold = 0
            TimChannelClockSelect = GTM_CONFIGURABLE_CLOCK_0
            TimChannelGpr0InputSelect = TIMEBASE_TBU_TS0
            TimChannelInputSelect = INPUT_OF_CURRENT_TIM_CHANNEL
            TimChannelPortPinSelect = SEL8_PORT34_PIN2
            TimInterruptMode = GTM_INTERRUPT_LEVEL_MODE
        IcuSignalMeasurement: IcuSignalMeasurementProperty=ICU_DUTY_CYCLE
      IcuChannel_P34_4 (IcuChannel): IcuAssignedHwUnit=GTM, IcuChannelId=1, IcuDefaultStartEdge=ICU_BOTH_EDGES, IcuMeasurementMode=ICU_MODE_SIGNAL_MEASUREMENT, IcuWakeupCapability=false
        GtmTimerInputConfiguration_0 (GtmTimerInputConfiguration): GtmTimerUsed=McuGtmTimChannelAllocationConf_6
          TimChannelFilterConfig:
            TimChFilterCounterFreqSelect = GTM_CONFIGURABLE_CLOCK_0
            TimChFilterModeForFallingEdge = IMMEDIATE_EDGE_PROPAGATION_MODE
            TimChFilterModeForRisingEdge = IMMEDIATE_EDGE_PROPAGATION_MODE
            TimChFilterTimeForFallingEdge = 0
            TimChFilterTimeForRisingEdge = 0
            TimChannelFilterEnable = false
          TimChannelGeneral:
            OverflowISRThreshold = 0
            TimChannelClockSelect = GTM_CONFIGURABLE_CLOCK_0
            TimChannelGpr0InputSelect = TIMEBASE_TBU_TS0
            TimChannelInputSelect = INPUT_OF_CURRENT_TIM_CHANNEL
            TimChannelPortPinSelect = SEL8_PORT34_PIN4
            TimInterruptMode = GTM_INTERRUPT_LEVEL_MODE
        IcuSignalMeasurement: IcuSignalMeasurementProperty=ICU_DUTY_CYCLE
    IcuGeneral:
      IcuDevErrorDetect = false
      IcuIndex = 0
      IcuInitDeInitApiMode = ICU_MCAL_SUPERVISOR
      IcuMultiCoreErrorDetect = false
      IcuReportWakeupSource = false
      IcuRuntimeApiMode = ICU_MCAL_SUPERVISOR
      IcuSafetyEnable = false
    IcuOptionalApis:
      IcuDeInitApi = false
      IcuDisableWakeupApi = false
      IcuEdgeCountApi = true
      IcuEdgeDetectApi = true
      IcuEnableWakeupApi = true
      IcuGetDutyCycleValuesApi = true
      IcuGetInputStateApi = true
      IcuGetTimeElapsedApi = false
      IcuGetVersionInfoApi = false
      IcuIncrementalInterfaceApi = false
      IcuInitCheckApi = true
      IcuSetModeApi = true
      IcuSignalMeasurementApi = true
      IcuTimestampApi = false
      IcuWakeupFunctionalityApi = true
