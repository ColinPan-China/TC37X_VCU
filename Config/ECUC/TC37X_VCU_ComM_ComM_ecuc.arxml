AUTOSAR XML (schema 00048)
package /ActiveEcuC
  module config ComM: implementation-config-variant=VARIANT-PRE-COMPILE, module-description=ComM_Impl
    ComMGeneral:
      ComMPncIdCounting = COMM_PNC_ID_COUNT_FROM_NM_MESSAGE
      ComMPncSupport = true
      ComMDevErrorDetect = true
      ComMEcuGroupClassification = 3
      ComMModeLimitationEnabled = false
      ComMSynchronousWakeUp = true
      ComMTMinFullComModeDuration = 5
      ComMVersionInfoApi = false
      ComMWakeupInhibitionEnabled = false
      ComMSafeBswChecks = false
      ComMPncGatewayEnabled = true
      ComMPncToChannelRoutingLimitationEnabled = false
      ComM0PncVectorAvoidance = true
      ComMGeneration: ComMOutOfBoundsWriteSanitizer=false, ComMOutOfBoundsReadSanitizer=false
    ComMConfigSet: ComMPncEnabled=true
      CN_TC37X_VCU_CAN01_70b1f95e (ComMChannel):
        ComMBusType = COMM_BUS_TYPE_CAN
        ComMChannelId = 3
        ComMFullCommRequestNotificationEnabled = false
        ComMMainFunctionPeriod = 0.02
        ComMNoCom = false
        ComMNoWakeup = false
        ComMNetworkManagement: ComMNmVariant=FULL, ComMPncNmRequest=false
        CN_TC37X_VCU_CAN01_a952cd2b (ComMUserPerChannel): ComMUserChannel=CN_TC37X_VCU_CAN01_5e76994c
      CN_TC37X_VCU_CAN01_5e76994c (ComMUser): ComMUserIdentifier=3, ComMUserModeNotification=false
      CN_ATOM_CANFD_Matrix_CH_V600_202502_15d11ab0 (ComMUser): ComMUserIdentifier=0, ComMUserModeNotification=false
      CN_ATOM_CANFD_Matrix_CH_V600_202502_a4d436ac (ComMChannel):
        ComMBusType = COMM_BUS_TYPE_CAN
        ComMChannelId = 0
        ComMFullCommRequestNotificationEnabled = false
        ComMMainFunctionPeriod = 0.02
        ComMNoCom = false
        ComMNoWakeup = false
        ComMPncGatewayType = COMM_GATEWAY_TYPE_PASSIVE
        ComMNetworkManagement: ComMNmVariant=FULL, ComMPncNmRequest=false
        CN_ATOM_CANFD_Matrix_CH_V600_202502_1a7e52a0 (ComMUserPerChannel): ComMUserChannel=CN_ATOM_CANFD_Matrix_CH_V600_202502_15d11ab0
      CN_ATOM_CAN_Matrix_PT_V600_20250211_9b894f3d (ComMChannel):
        ComMBusType = COMM_BUS_TYPE_CAN
        ComMChannelId = 1
        ComMFullCommRequestNotificationEnabled = false
        ComMMainFunctionPeriod = 0.02
        ComMNoCom = false
        ComMNoWakeup = false
        ComMPncGatewayType = COMM_GATEWAY_TYPE_PASSIVE
        CN_ATOM_CAN_Matrix_PT_V600_20250211_52ffc045 (ComMUserPerChannel): ComMUserChannel=CN_ATOM_CAN_Matrix_PT_V600_20250211_cc0efb79
        ComMNetworkManagement: ComMNmVariant=FULL, ComMPncNmRequest=false
      CN_ATOM_CAN_Matrix_PT_V600_20250211_cc0efb79 (ComMUser): ComMUserIdentifier=1, ComMUserModeNotification=false
      CN_ATOM_CAN_XCP_ca35a39e (ComMUser): ComMUserIdentifier=2, ComMUserModeNotification=false
      CN_ATOM_CAN_XCP_f42a46d4 (ComMChannel):
        ComMBusType = COMM_BUS_TYPE_CAN
        ComMChannelId = 2
        ComMFullCommRequestNotificationEnabled = false
        ComMMainFunctionPeriod = 0.02
        ComMNoCom = false
        ComMNoWakeup = false
        CN_ATOM_CAN_XCP_f53c4f32 (ComMUserPerChannel): ComMUserChannel=CN_ATOM_CAN_XCP_ca35a39e
        ComMNetworkManagement: ComMNmVariant=LIGHT, ComMPncNmRequest=false, ComMNmLightTimeout=2
      CN_J1939_bms_d26c50b6 (ComMUser): ComMUserIdentifier=4, ComMUserModeNotification=false
      3 x ComMChannel, all with ComMFullCommRequestNotificationEnabled=false, ComMMainFunctionPeriod=0.02, ComMNoCom=false, ComMNoWakeup=false:
        CN_J1939_bms_dea99804: ComMBusType=COMM_BUS_TYPE_CAN, ComMChannelId=4
          ComMNetworkManagement: ComMNmVariant=LIGHT, ComMPncNmRequest=false, ComMNmLightTimeout=2
          CN_J1939_bms_1895c90d (ComMUserPerChannel): ComMUserChannel=CN_J1939_bms_d26c50b6
        CN_ATOM_HWLIN3_8ac1b423: ComMBusType=COMM_BUS_TYPE_LIN, ComMChannelId=6
          ComMNetworkManagement: ComMNmVariant=LIGHT, ComMPncNmRequest=false, ComMNmLightTimeout=2
          CN_ATOM_HWLIN3_bc0d691b (ComMUserPerChannel): ComMUserChannel=CN_ATOM_HWLIN3_b56380a6
        CN_ATOM_HWLIN1_64cfd50f: ComMBusType=COMM_BUS_TYPE_LIN, ComMChannelId=5
          ComMNetworkManagement: ComMNmVariant=LIGHT, ComMPncNmRequest=false, ComMNmLightTimeout=2
          CN_ATOM_HWLIN1_76c31f97 (ComMUserPerChannel): ComMUserChannel=CN_ATOM_HWLIN1_b196509b
      CN_ATOM_HWLIN1_b196509b (ComMUser): ComMUserIdentifier=5, ComMUserModeNotification=false
      CN_ATOM_HWLIN3_b56380a6 (ComMUser): ComMUserIdentifier=6, ComMUserModeNotification=false
      CN_ATOM_HWLIN4_14a52180 (ComMChannel):
        ComMBusType = COMM_BUS_TYPE_LIN
        ComMChannelId = 7
        ComMFullCommRequestNotificationEnabled = false
        ComMMainFunctionPeriod = 0.02
        ComMNoCom = false
        ComMNoWakeup = false
        ComMNetworkManagement: ComMNmVariant=LIGHT, ComMPncNmRequest=false, ComMNmLightTimeout=2
        CN_ATOM_HWLIN4_5d49cf88 (ComMUserPerChannel): ComMUserChannel=CN_ATOM_HWLIN4_57bf9bdf
      4 x ComMUser, all with ComMUserModeNotification=false:
        CN_ATOM_HWLIN4_57bf9bdf: ComMUserIdentifier=7
        ComMUser_PNC24: ComMUserIdentifier=8
        ComMUser_PNC26: ComMUserIdentifier=9
        ComMUser_PNC31: ComMUserIdentifier=10
      3 x ComMPnc, all with ComMChannelPerPnc=CN_ATOM_CAN_Matrix_PT_V600_20250211_9b894f3d, ComMChannelPerPnc=CN_ATOM_CANFD_Matrix_CH_V600_202502_a4d436ac:
        ComMPnc_24: ComMPncId=24, ComMUserPerPnc=ComMUser_PNC24
          5 x ComMPncComSignal:
            ComMPncComSignal_TX: ComMPncComSignalDirection=TX, ComMPncComSignalKind=EIRA, ComMPncComSignalRef=PT_TxNM_PNCData_oNM_VCU_oATOM_CAN_Matrix_PT_V600_20250211_5a3fd28e_Tx, ComMPncComSignalChannelRef=CN_ATOM_CAN_Matrix_PT_V600_20250211_9b894f3d
            ComMPncComSignal_RX: ComMPncComSignalDirection=RX, ComMPncComSignalKind=EIRA, ComMPncComSignalRef=PNC_ComSignal_Rx, ComMPncComSignalChannelRef=CN_ATOM_CAN_Matrix_PT_V600_20250211_9b894f3d
            ComMPncComSignal: ComMPncComSignalDirection=TX, ComMPncComSignalKind=EIRA, ComMPncComSignalRef=CH_TxNM_PNCData_oNM_VCU_oATOM_CANFD_Matrix_CH_V600_202502_859d1767_Tx, ComMPncComSignalChannelRef=CN_ATOM_CANFD_Matrix_CH_V600_202502_a4d436ac
            ComMPncComSignal_001: ComMPncComSignalDirection=RX, ComMPncComSignalKind=ERA, ComMPncComSignalRef=PNC_ERA_PT_ComSignal_Rx, ComMPncComSignalChannelRef=CN_ATOM_CAN_Matrix_PT_V600_20250211_9b894f3d
            ComMPncComSignal_002: ComMPncComSignalDirection=RX, ComMPncComSignalKind=ERA, ComMPncComSignalRef=PNC_ERA_CH_ComSignal_Rx, ComMPncComSignalChannelRef=CN_ATOM_CANFD_Matrix_CH_V600_202502_a4d436ac
        ComMPnc_31: ComMPncId=31, ComMUserPerPnc=ComMUser_PNC31
          5 x ComMPncComSignal:
            ComMPncComSignal_TX: ComMPncComSignalDirection=TX, ComMPncComSignalKind=EIRA, ComMPncComSignalRef=PT_TxNM_PNCData_oNM_VCU_oATOM_CAN_Matrix_PT_V600_20250211_5a3fd28e_Tx, ComMPncComSignalChannelRef=CN_ATOM_CAN_Matrix_PT_V600_20250211_9b894f3d
            ComMPncComSignal_RX: ComMPncComSignalDirection=RX, ComMPncComSignalKind=EIRA, ComMPncComSignalRef=PNC_ComSignal_Rx, ComMPncComSignalChannelRef=CN_ATOM_CAN_Matrix_PT_V600_20250211_9b894f3d
            ComMPncComSignal: ComMPncComSignalDirection=TX, ComMPncComSignalKind=EIRA, ComMPncComSignalRef=CH_TxNM_PNCData_oNM_VCU_oATOM_CANFD_Matrix_CH_V600_202502_859d1767_Tx, ComMPncComSignalChannelRef=CN_ATOM_CANFD_Matrix_CH_V600_202502_a4d436ac
            ComMPncComSignal_001: ComMPncComSignalDirection=RX, ComMPncComSignalKind=ERA, ComMPncComSignalRef=PNC_ERA_PT_ComSignal_Rx, ComMPncComSignalChannelRef=CN_ATOM_CAN_Matrix_PT_V600_20250211_9b894f3d
            ComMPncComSignal_002: ComMPncComSignalDirection=RX, ComMPncComSignalKind=ERA, ComMPncComSignalRef=PNC_ERA_CH_ComSignal_Rx, ComMPncComSignalChannelRef=CN_ATOM_CANFD_Matrix_CH_V600_202502_a4d436ac
        ComMPnc_26: ComMPncId=26, ComMUserPerPnc=ComMUser_PNC26
          5 x ComMPncComSignal:
            ComMPncComSignal_TX: ComMPncComSignalDirection=TX, ComMPncComSignalKind=EIRA, ComMPncComSignalRef=PT_TxNM_PNCData_oNM_VCU_oATOM_CAN_Matrix_PT_V600_20250211_5a3fd28e_Tx, ComMPncComSignalChannelRef=CN_ATOM_CAN_Matrix_PT_V600_20250211_9b894f3d
            ComMPncComSignal_RX: ComMPncComSignalDirection=RX, ComMPncComSignalKind=EIRA, ComMPncComSignalRef=PNC_ComSignal_Rx, ComMPncComSignalChannelRef=CN_ATOM_CAN_Matrix_PT_V600_20250211_9b894f3d
            ComMPncComSignal: ComMPncComSignalDirection=TX, ComMPncComSignalKind=EIRA, ComMPncComSignalRef=CH_TxNM_PNCData_oNM_VCU_oATOM_CANFD_Matrix_CH_V600_202502_859d1767_Tx, ComMPncComSignalChannelRef=CN_ATOM_CANFD_Matrix_CH_V600_202502_a4d436ac
            ComMPncComSignal_001: ComMPncComSignalDirection=RX, ComMPncComSignalKind=ERA, ComMPncComSignalRef=PNC_ERA_PT_ComSignal_Rx, ComMPncComSignalChannelRef=CN_ATOM_CAN_Matrix_PT_V600_20250211_9b894f3d
            ComMPncComSignal_002: ComMPncComSignalDirection=RX, ComMPncComSignalKind=ERA, ComMPncComSignalRef=PNC_ERA_CH_ComSignal_Rx, ComMPncComSignalChannelRef=CN_ATOM_CANFD_Matrix_CH_V600_202502_a4d436ac
