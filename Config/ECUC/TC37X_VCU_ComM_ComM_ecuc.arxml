AUTOSAR XML (schema 00048)
package /ActiveEcuC
  module config ComM: implementation-config-variant=VARIANT-PRE-COMPILE, module-description=ComM_Impl
    ComMGeneral:
      ComMPncIdCounting = COMM_PNC_ID_COUNT_FROM_NM_MESSAGE
      ComMPncSupport = false
      ComMDevErrorDetect = true
      ComMEcuGroupClassification = 3
      ComMModeLimitationEnabled = false
      ComMSynchronousWakeUp = true
      ComMTMinFullComModeDuration = 5
      ComMVersionInfoApi = false
      ComMWakeupInhibitionEnabled = false
      ComMSafeBswChecks = false
      ComMGeneration: ComMOutOfBoundsWriteSanitizer=false, ComMOutOfBoundsReadSanitizer=false
    ComMConfigSet: ComMPncEnabled=false
      CN_TC37X_VCU_CAN00_b1b4f272 (ComMUser): ComMUserIdentifier=2, ComMUserModeNotification=false
      CN_TC37X_VCU_CAN00_07b6c9c8 (ComMChannel):
        ComMBusType = COMM_BUS_TYPE_CAN
        ComMChannelId = 2
        ComMFullCommRequestNotificationEnabled = false
        ComMMainFunctionPeriod = 0.02
        ComMNoCom = false
        ComMNoWakeup = false
        ComMNetworkManagement: ComMNmVariant=FULL, ComMPncNmRequest=false
        CN_TC37X_VCU_CAN00_cc35f66d (ComMUserPerChannel): ComMUserChannel=CN_TC37X_VCU_CAN00_b1b4f272
      CN_TC37X_VCU_CAN01_70b1f95e (ComMChannel):
        ComMBusType = COMM_BUS_TYPE_CAN
        ComMChannelId = 3
        ComMFullCommRequestNotificationEnabled = false
        ComMMainFunctionPeriod = 0.02
        ComMNoCom = false
        ComMNoWakeup = false
        ComMNetworkManagement: ComMNmVariant=FULL, ComMPncNmRequest=false
        CN_TC37X_VCU_CAN01_a952cd2b (ComMUserPerChannel): ComMUserChannel=CN_TC37X_VCU_CAN01_5e76994c
      CN_TC37X_VCU_CAN01_5e76994c (ComMUser): ComMUserIdentifier=3, ComMUserModeNotification=false
      CN_LIN00_984dfd9e (ComMUser): ComMUserIdentifier=6, ComMUserModeNotification=false
      CN_LIN00_b12a0454 (ComMChannel):
        ComMBusType = COMM_BUS_TYPE_LIN
        ComMChannelId = 6
        ComMFullCommRequestNotificationEnabled = false
        ComMMainFunctionPeriod = 0.02
        ComMNoCom = false
        ComMNoWakeup = false
        ComMNetworkManagement: ComMNmVariant=LIGHT, ComMPncNmRequest=false, ComMNmLightTimeout=2
        CN_LIN00_8453a76d (ComMUserPerChannel): ComMUserChannel=CN_LIN00_984dfd9e
      CN_TC37X_VCU_CAN03_9ebf9872 (ComMChannel):
        ComMBusType = COMM_BUS_TYPE_CAN
        ComMChannelId = 4
        ComMFullCommRequestNotificationEnabled = false
        ComMMainFunctionPeriod = 0.02
        ComMNoCom = false
        ComMNoWakeup = false
        ComMNetworkManagement: ComMNmVariant=FULL, ComMPncNmRequest=false
        CN_TC37X_VCU_CAN03_639cbba7 (ComMUserPerChannel): ComMUserChannel=CN_TC37X_VCU_CAN03_5a834971
      CN_TC37X_VCU_CAN03_5a834971 (ComMUser): ComMUserIdentifier=4, ComMUserModeNotification=false
      CN_LIN01_778f96a0 (ComMUser): ComMUserIdentifier=7, ComMUserModeNotification=false
      CN_LIN01_c62d34c2 (ComMChannel):
        ComMBusType = COMM_BUS_TYPE_LIN
        ComMChannelId = 7
        ComMFullCommRequestNotificationEnabled = false
        ComMMainFunctionPeriod = 0.02
        ComMNoCom = false
        ComMNoWakeup = false
        ComMNetworkManagement: ComMNmVariant=LIGHT, ComMPncNmRequest=false, ComMNmLightTimeout=2
        CN_LIN01_e1349c2b (ComMUserPerChannel): ComMUserChannel=CN_LIN01_778f96a0
      CN_ATOM_CANFD_Matrix_CH_V600_202502_15d11ab0 (ComMUser): ComMUserIdentifier=0, ComMUserModeNotification=false
      CN_ATOM_CANFD_Matrix_CH_V600_202502_a4d436ac (ComMChannel):
        ComMBusType = COMM_BUS_TYPE_CAN
        ComMChannelId = 0
        ComMFullCommRequestNotificationEnabled = false
        ComMMainFunctionPeriod = 0.02
        ComMNoCom = false
        ComMNoWakeup = false
        ComMNetworkManagement: ComMNmVariant=FULL, ComMPncNmRequest=false
        CN_ATOM_CANFD_Matrix_CH_V600_202502_1a7e52a0 (ComMUserPerChannel): ComMUserChannel=CN_ATOM_CANFD_Matrix_CH_V600_202502_15d11ab0
      CN_LIN02_5f246578 (ComMChannel):
        ComMBusType = COMM_BUS_TYPE_LIN
        ComMChannelId = 8
        ComMFullCommRequestNotificationEnabled = false
        ComMMainFunctionPeriod = 0.02
        ComMNoCom = false
        ComMNoWakeup = false
        ComMNetworkManagement: ComMNmVariant=LIGHT, ComMPncNmRequest=false, ComMNmLightTimeout=2
        CN_LIN02_4e9dd1e1 (ComMUserPerChannel): ComMUserChannel=CN_LIN02_9cb82da3
      CN_LIN02_9cb82da3 (ComMUser): ComMUserIdentifier=8, ComMUserModeNotification=false
      CN_TC37X_VCU_CAN12_XCP_0532158c (ComMUser): ComMUserIdentifier=5, ComMUserModeNotification=false
      CN_TC37X_VCU_CAN12_XCP_d05a85ac (ComMChannel):
        ComMBusType = COMM_BUS_TYPE_CAN
        ComMChannelId = 5
        ComMFullCommRequestNotificationEnabled = false
        ComMMainFunctionPeriod = 0.02
        ComMNoCom = false
        ComMNoWakeup = false
        ComMNetworkManagement: ComMNmVariant=LIGHT, ComMPncNmRequest=false, ComMNmLightTimeout=2
        CN_TC37X_VCU_CAN12_XCP_dd89418b (ComMUserPerChannel): ComMUserChannel=CN_TC37X_VCU_CAN12_XCP_0532158c
      CN_ATOM_CAN_Matrix_PT_V600_20250211_9b894f3d (ComMChannel):
        ComMBusType = COMM_BUS_TYPE_CAN
        ComMChannelId = 1
        ComMFullCommRequestNotificationEnabled = false
        ComMMainFunctionPeriod = 0.02
        ComMNoCom = false
        ComMNoWakeup = false
        CN_ATOM_CAN_Matrix_PT_V600_20250211_52ffc045 (ComMUserPerChannel): ComMUserChannel=CN_ATOM_CAN_Matrix_PT_V600_20250211_cc0efb79
        ComMNetworkManagement: ComMNmVariant=FULL, ComMPncNmRequest=false
      CN_ATOM_CAN_Matrix_PT_V600_20250211_cc0efb79 (ComMUser): ComMUserIdentifier=1, ComMUserModeNotification=false
