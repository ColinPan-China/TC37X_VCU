AUTOSAR XML (schema 00048)
package /ActiveEcuC
  module config ComM: implementation-config-variant=VARIANT-PRE-COMPILE, module-description=ComM_Impl
    ComMGeneral:
      ComMPncIdCounting = COMM_PNC_ID_COUNT_FROM_NM_MESSAGE
      ComMPncSupport = true
      ComMDevErrorDetect = true
      ComMEcuGroupClassification = 3
      ComMModeLimitationEnabled = false
      ComMSynchronousWakeUp = true
      ComMTMinFullComModeDuration = 5
      ComMVersionInfoApi = false
      ComMWakeupInhibitionEnabled = false
      ComMSafeBswChecks = false
      ComMPncToChannelRoutingLimitationEnabled = false
      ComMPncGatewayEnabled = false
      ComMPncExtendedFunctionalityEnabled = false
      ComMGeneration: ComMOutOfBoundsWriteSanitizer=false, ComMOutOfBoundsReadSanitizer=false
    ComMConfigSet: ComMPncEnabled=true
      CN_TC37X_VCU_CAN00_b1b4f272 (ComMUser): ComMUserIdentifier=1, ComMUserModeNotification=false
      CN_TC37X_VCU_CAN00_07b6c9c8 (ComMChannel):
        ComMBusType = COMM_BUS_TYPE_CAN
        ComMChannelId = 1
        ComMFullCommRequestNotificationEnabled = false
        ComMMainFunctionPeriod = 0.02
        ComMNoCom = false
        ComMNoWakeup = false
        ComMPncGatewayType = COMM_GATEWAY_TYPE_NONE
        ComMNetworkManagement: ComMNmVariant=FULL, ComMPncNmRequest=false
        CN_TC37X_VCU_CAN00_cc35f66d (ComMUserPerChannel): ComMUserChannel=CN_TC37X_VCU_CAN00_b1b4f272
      CN_TC37X_VCU_CAN01_70b1f95e (ComMChannel):
        ComMBusType = COMM_BUS_TYPE_CAN
        ComMChannelId = 2
        ComMFullCommRequestNotificationEnabled = false
        ComMMainFunctionPeriod = 0.02
        ComMNoCom = false
        ComMNoWakeup = false
        ComMPncGatewayType = COMM_GATEWAY_TYPE_NONE
        ComMNetworkManagement: ComMNmVariant=FULL, ComMPncNmRequest=false
        CN_TC37X_VCU_CAN01_a952cd2b (ComMUserPerChannel): ComMUserChannel=CN_TC37X_VCU_CAN01_5e76994c
      CN_TC37X_VCU_CAN01_5e76994c (ComMUser): ComMUserIdentifier=2, ComMUserModeNotification=false
      CN_LIN00_984dfd9e (ComMUser): ComMUserIdentifier=4, ComMUserModeNotification=false
      CN_LIN00_b12a0454 (ComMChannel):
        ComMBusType = COMM_BUS_TYPE_LIN
        ComMChannelId = 4
        ComMFullCommRequestNotificationEnabled = false
        ComMMainFunctionPeriod = 0.02
        ComMNoCom = false
        ComMNoWakeup = false
        ComMNetworkManagement: ComMNmVariant=LIGHT, ComMPncNmRequest=false, ComMNmLightTimeout=2
        CN_LIN00_8453a76d (ComMUserPerChannel): ComMUserChannel=CN_LIN00_984dfd9e
      CN_KAMA_FP_EPT_0303_275b3e6e (ComMChannel):
        ComMBusType = COMM_BUS_TYPE_CAN
        ComMChannelId = 0
        ComMFullCommRequestNotificationEnabled = false
        ComMMainFunctionPeriod = 0.02
        ComMNoCom = false
        ComMNoWakeup = false
        ComMNetworkManagement: ComMNmVariant=LIGHT, ComMPncNmRequest=false, ComMNmLightTimeout=2
        CN_KAMA_FP_EPT_0303_a7b96f1e (ComMUserPerChannel): ComMUserChannel=CN_KAMA_FP_EPT_0303_b67fd6a6
      CN_KAMA_FP_EPT_0303_b67fd6a6 (ComMUser): ComMUserIdentifier=0, ComMUserModeNotification=false
      3 x ComMPnc:
        ComMPnc_31: ComMPncId=31, ComMChannelPerPnc=CN_TC37X_VCU_CAN00_07b6c9c8, ComMUserPerPnc=ComMUser_PNC31
          ComMPncComSignal_Rx (ComMPncComSignal):
            ComMPncComSignalDirection = RX
            ComMPncComSignalKind = EIRA
            ComMPncComSignalRef = PNC_Can00_ComSignal_Rx
            ComMPncComSignalChannelRef = CN_TC37X_VCU_CAN00_07b6c9c8
          ComMPncComSignal_Tx (ComMPncComSignal):
            ComMPncComSignalDirection = TX
            ComMPncComSignalKind = EIRA
            ComMPncComSignalRef = VCU_Tx_51Ch_NM_PNCData_oVCU_Tx_51Ch_NM_oTC37X_VCU_CAN00_c1eb5e4b_Tx
            ComMPncComSignalChannelRef = CN_TC37X_VCU_CAN00_07b6c9c8
        ComMPnc_26: ComMPncId=26, ComMChannelPerPnc=CN_TC37X_VCU_CAN00_07b6c9c8, ComMUserPerPnc=ComMUser_PNC26
          ComMPncComSignal_Rx (ComMPncComSignal):
            ComMPncComSignalDirection = RX
            ComMPncComSignalKind = EIRA
            ComMPncComSignalRef = PNC_Can00_ComSignal_Rx
            ComMPncComSignalChannelRef = CN_TC37X_VCU_CAN00_07b6c9c8
          ComMPncComSignal_Tx (ComMPncComSignal):
            ComMPncComSignalDirection = TX
            ComMPncComSignalKind = EIRA
            ComMPncComSignalRef = VCU_Tx_51Ch_NM_PNCData_oVCU_Tx_51Ch_NM_oTC37X_VCU_CAN00_c1eb5e4b_Tx
            ComMPncComSignalChannelRef = CN_TC37X_VCU_CAN00_07b6c9c8
        ComMPnc_24: ComMPncId=24, ComMUserPerPnc=ComMUser_PNC24, ComMChannelPerPnc=CN_TC37X_VCU_CAN01_70b1f95e
          ComMPncComSignal_Rx (ComMPncComSignal):
            ComMPncComSignalDirection = RX
            ComMPncComSignalKind = EIRA
            ComMPncComSignalRef = PNC_Can00_ComSignal_Rx
            ComMPncComSignalChannelRef = CN_TC37X_VCU_CAN01_70b1f95e
          ComMPncComSignal_Tx (ComMPncComSignal):
            ComMPncComSignalDirection = TX
            ComMPncComSignalKind = EIRA
            ComMPncComSignalRef = VCU_Tx_51Ch_NM_UserData_oVCU_Tx_51Ch_NM_oTC37X_VCU_CAN01_eace6dfa_Tx
            ComMPncComSignalChannelRef = CN_TC37X_VCU_CAN01_70b1f95e
      3 x ComMUser, all with ComMUserModeNotification=false:
        ComMUser_PNC24: ComMUserIdentifier=5
        ComMUser_PNC26: ComMUserIdentifier=6
        ComMUser_PNC31: ComMUserIdentifier=7
      CN_TC37X_VCU_CAN03_9ebf9872 (ComMChannel):
        ComMBusType = COMM_BUS_TYPE_CAN
        ComMChannelId = 3
        ComMFullCommRequestNotificationEnabled = false
        ComMMainFunctionPeriod = 0.02
        ComMNoCom = false
        ComMNoWakeup = false
        ComMNetworkManagement: ComMNmVariant=FULL, ComMPncNmRequest=false
        CN_TC37X_VCU_CAN03_639cbba7 (ComMUserPerChannel): ComMUserChannel=CN_TC37X_VCU_CAN03_5a834971
      CN_TC37X_VCU_CAN03_5a834971 (ComMUser): ComMUserIdentifier=3, ComMUserModeNotification=false
      ComMChannel_ETH (ComMChannel):
        ComMBusType = COMM_BUS_TYPE_ETH
        ComMChannelId = 5
        ComMFullCommRequestNotificationEnabled = false
        ComMMainFunctionPeriod = 0.02
        ComMNoCom = false
        ComMNoWakeup = false
        ComMNetworkManagement: ComMNmVariant=LIGHT, ComMPncNmRequest=false, ComMNmLightTimeout=2
        ComMUserPerChannel: ComMUserChannel=ComMUser_ETH
      ComMUser_ETH (ComMUser): ComMUserIdentifier=8, ComMUserModeNotification=false
