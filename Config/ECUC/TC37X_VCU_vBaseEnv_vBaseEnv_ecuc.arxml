AUTOSAR XML (schema 00049)
package /ActiveEcuC
  module config vBaseEnv: implementation-config-variant=VARIANT-PRE-COMPILE, module-description=vBaseEnv_Impl
    vBaseEnvGeneral: vBaseEnvTestedDerivativeRef=TC377T
      18 x vBaseEnvMemLayoutHwRegion:
        DSPR0
        PSPR0
        DSPR1
        PSPR1
        DSPR2
        PSPR2
        PFlash0_Cached
        PFlash0_NonCached
        PFlash1_Cached
        PFlash1_NonCached
        LMU0_Cached
        LMU0_NonCached
        LMU1_Cached
        LMU1_NonCached
        BMHD{0..3}
      6 x vBaseEnvDerivativeInformation, all with vBaseEnvCpuCoreAmount=3, vBaseEnvCpuMaxFrequency=300000000, vBaseEnvAvailableChannels_Flexray=2, vBaseEnvCpuCore=TC162, vBaseEnvAvailableChannels_Hyperbus=0, vBaseEnvAvailableChannels_I2c=0, vBaseEnvAvailableChannels_Spi=0:
        TC377T: vBaseEnvTestedDerivative=TC37x, vBaseEnvTestedDerivativeDescription=Infineon Aurix 2G TC37x Family, vBaseEnvAvailableChannels_Can=12, vBaseEnvAvailableChannels_Ethernet=2, vBaseEnvAvailableChannels_Lin=12
          vBaseEnvAdditionalParameters: vBaseEnvWatchdogGroup=B, vBaseEnvPllGroup=B, vBaseEnvPortGroup=B, vBaseEnvResetGroup=B, vBaseEnvDerivativeGroup=TC3xx
          26 x vBaseEnvMemLayoutHwRegion:
            DSPR0: vBaseEnvHwRegionStartAddress=1879048192, vBaseEnvHwRegionSize=245760, vBaseEnvHwRegionType=RAM
            PSPR0: vBaseEnvHwRegionStartAddress=1880096768, vBaseEnvHwRegionSize=65536, vBaseEnvHwRegionType=RAM
            DSPR1: vBaseEnvHwRegionStartAddress=1610612736, vBaseEnvHwRegionSize=245760, vBaseEnvHwRegionType=RAM
            PSPR1: vBaseEnvHwRegionStartAddress=1611661312, vBaseEnvHwRegionSize=65536, vBaseEnvHwRegionType=RAM
            DSPR2: vBaseEnvHwRegionStartAddress=1342177280, vBaseEnvHwRegionSize=98304, vBaseEnvHwRegionType=RAM
            PSPR2: vBaseEnvHwRegionStartAddress=1343225856, vBaseEnvHwRegionSize=65536, vBaseEnvHwRegionType=RAM
            PFlash0_Cached: vBaseEnvHwRegionStartAddress=2147483648, vBaseEnvHwRegionSize=3145728, vBaseEnvHwRegionType=ROM
            PFlash0_NonCached: vBaseEnvHwRegionStartAddress=2684354560, vBaseEnvHwRegionSize=3145728, vBaseEnvHwRegionType=ROM
            PFlash1_Cached: vBaseEnvHwRegionStartAddress=2150629376, vBaseEnvHwRegionSize=3145728, vBaseEnvHwRegionType=ROM
            PFlash1_NonCached: vBaseEnvHwRegionStartAddress=2687500288, vBaseEnvHwRegionSize=3145728, vBaseEnvHwRegionType=ROM
            BMHD0: vBaseEnvHwRegionStartAddress=2940207104, vBaseEnvHwRegionSize=512, vBaseEnvHwRegionType=ROM
            BMHD1: vBaseEnvHwRegionStartAddress=2940207616, vBaseEnvHwRegionSize=512, vBaseEnvHwRegionType=ROM
            BMHD2: vBaseEnvHwRegionStartAddress=2940208128, vBaseEnvHwRegionSize=512, vBaseEnvHwRegionType=ROM
            BMHD3: vBaseEnvHwRegionStartAddress=2940208640, vBaseEnvHwRegionSize=512, vBaseEnvHwRegionType=ROM
            OLDA_Cached: vBaseEnvHwRegionStartAddress=2413821952, vBaseEnvHwRegionSize=524288, vBaseEnvHwRegionType=RAM
            OLDA_NonCached: vBaseEnvHwRegionStartAddress=2950692864, vBaseEnvHwRegionSize=524288, vBaseEnvHwRegionType=RAM
            DLMU0_Cached: vBaseEnvHwRegionStartAddress=2415919104, vBaseEnvHwRegionSize=65536, vBaseEnvHwRegionType=RAM
            DLMU0_NonCached: vBaseEnvHwRegionStartAddress=2952790016, vBaseEnvHwRegionSize=65536, vBaseEnvHwRegionType=RAM
            DLMU1_Cached: vBaseEnvHwRegionStartAddress=2415984640, vBaseEnvHwRegionSize=65536, vBaseEnvHwRegionType=RAM
            DLMU1_NonCached: vBaseEnvHwRegionStartAddress=2952855552, vBaseEnvHwRegionSize=65536, vBaseEnvHwRegionType=RAM
            DLMU2_Cached: vBaseEnvHwRegionStartAddress=2416050176, vBaseEnvHwRegionSize=65536, vBaseEnvHwRegionType=RAM
            DLMU2_NonCached: vBaseEnvHwRegionStartAddress=2952921088, vBaseEnvHwRegionSize=65536, vBaseEnvHwRegionType=RAM
            DAM0_Cached: vBaseEnvHwRegionStartAddress=2420113408, vBaseEnvHwRegionSize=32768, vBaseEnvHwRegionType=RAM
            DAM0_NonCached: vBaseEnvHwRegionStartAddress=2956984320, vBaseEnvHwRegionSize=32768, vBaseEnvHwRegionType=RAM
            DFlash0: vBaseEnvHwRegionStartAddress=2936012800, vBaseEnvHwRegionSize=131072, vBaseEnvHwRegionType=ROM
            DFlash1: vBaseEnvHwRegionStartAddress=2948595712, vBaseEnvHwRegionSize=131072, vBaseEnvHwRegionType=ROM
        TC375T: vBaseEnvTestedDerivative=TC37x, vBaseEnvTestedDerivativeDescription=Infineon Aurix 2G TC37x Family, vBaseEnvAvailableChannels_Can=12, vBaseEnvAvailableChannels_Ethernet=2, vBaseEnvAvailableChannels_Lin=12
          vBaseEnvAdditionalParameters: vBaseEnvWatchdogGroup=B, vBaseEnvPllGroup=B, vBaseEnvPortGroup=B, vBaseEnvResetGroup=B, vBaseEnvDerivativeGroup=TC3xx
          26 x vBaseEnvMemLayoutHwRegion:
            DSPR0: vBaseEnvHwRegionStartAddress=1879048192, vBaseEnvHwRegionSize=245760, vBaseEnvHwRegionType=RAM
            PSPR0: vBaseEnvHwRegionStartAddress=1880096768, vBaseEnvHwRegionSize=65536, vBaseEnvHwRegionType=RAM
            DSPR1: vBaseEnvHwRegionStartAddress=1610612736, vBaseEnvHwRegionSize=245760, vBaseEnvHwRegionType=RAM
            PSPR1: vBaseEnvHwRegionStartAddress=1611661312, vBaseEnvHwRegionSize=65536, vBaseEnvHwRegionType=RAM
            DSPR2: vBaseEnvHwRegionStartAddress=1342177280, vBaseEnvHwRegionSize=98304, vBaseEnvHwRegionType=RAM
            PSPR2: vBaseEnvHwRegionStartAddress=1343225856, vBaseEnvHwRegionSize=65536, vBaseEnvHwRegionType=RAM
            PFlash0_Cached: vBaseEnvHwRegionStartAddress=2147483648, vBaseEnvHwRegionSize=3145728, vBaseEnvHwRegionType=ROM
            PFlash0_NonCached: vBaseEnvHwRegionStartAddress=2684354560, vBaseEnvHwRegionSize=3145728, vBaseEnvHwRegionType=ROM
            PFlash1_Cached: vBaseEnvHwRegionStartAddress=2150629376, vBaseEnvHwRegionSize=3145728, vBaseEnvHwRegionType=ROM
            PFlash1_NonCached: vBaseEnvHwRegionStartAddress=2687500288, vBaseEnvHwRegionSize=3145728, vBaseEnvHwRegionType=ROM
            BMHD0: vBaseEnvHwRegionStartAddress=2940207104, vBaseEnvHwRegionSize=512, vBaseEnvHwRegionType=ROM
            BMHD1: vBaseEnvHwRegionStartAddress=2940207616, vBaseEnvHwRegionSize=512, vBaseEnvHwRegionType=ROM
            BMHD2: vBaseEnvHwRegionStartAddress=2940208128, vBaseEnvHwRegionSize=512, vBaseEnvHwRegionType=ROM
            BMHD3: vBaseEnvHwRegionStartAddress=2940208640, vBaseEnvHwRegionSize=512, vBaseEnvHwRegionType=ROM
            OLDA_Cached: vBaseEnvHwRegionStartAddress=2413821952, vBaseEnvHwRegionSize=524288, vBaseEnvHwRegionType=RAM
            OLDA_NonCached: vBaseEnvHwRegionStartAddress=2950692864, vBaseEnvHwRegionSize=524288, vBaseEnvHwRegionType=RAM
            DLMU0_Cached: vBaseEnvHwRegionStartAddress=2415919104, vBaseEnvHwRegionSize=65536, vBaseEnvHwRegionType=RAM
            DLMU0_NonCached: vBaseEnvHwRegionStartAddress=2952790016, vBaseEnvHwRegionSize=65536, vBaseEnvHwRegionType=RAM
            DLMU1_Cached: vBaseEnvHwRegionStartAddress=2415984640, vBaseEnvHwRegionSize=65536, vBaseEnvHwRegionType=RAM
            DLMU1_NonCached: vBaseEnvHwRegionStartAddress=2952855552, vBaseEnvHwRegionSize=65536, vBaseEnvHwRegionType=RAM
            DLMU2_Cached: vBaseEnvHwRegionStartAddress=2416050176, vBaseEnvHwRegionSize=65536, vBaseEnvHwRegionType=RAM
            DLMU2_NonCached: vBaseEnvHwRegionStartAddress=2952921088, vBaseEnvHwRegionSize=65536, vBaseEnvHwRegionType=RAM
            DAM0_Cached: vBaseEnvHwRegionStartAddress=2420113408, vBaseEnvHwRegionSize=32768, vBaseEnvHwRegionType=RAM
            DAM0_NonCached: vBaseEnvHwRegionStartAddress=2956984320, vBaseEnvHwRegionSize=32768, vBaseEnvHwRegionType=RAM
            DFlash0: vBaseEnvHwRegionStartAddress=2936012800, vBaseEnvHwRegionSize=131072, vBaseEnvHwRegionType=ROM
            DFlash1: vBaseEnvHwRegionStartAddress=2948595712, vBaseEnvHwRegionSize=131072, vBaseEnvHwRegionType=ROM
        TC370T: vBaseEnvTestedDerivative=TC37x, vBaseEnvTestedDerivativeDescription=Infineon Aurix 2G TC37x Family, vBaseEnvAvailableChannels_Can=8, vBaseEnvAvailableChannels_Ethernet=1, vBaseEnvAvailableChannels_Lin=12
          vBaseEnvAdditionalParameters: vBaseEnvWatchdogGroup=B, vBaseEnvPllGroup=B, vBaseEnvPortGroup=B, vBaseEnvResetGroup=B, vBaseEnvDerivativeGroup=TC3xx
          26 x vBaseEnvMemLayoutHwRegion:
            DSPR0: vBaseEnvHwRegionStartAddress=1879048192, vBaseEnvHwRegionSize=245760, vBaseEnvHwRegionType=RAM
            PSPR0: vBaseEnvHwRegionStartAddress=1880096768, vBaseEnvHwRegionSize=65536, vBaseEnvHwRegionType=RAM
            DSPR1: vBaseEnvHwRegionStartAddress=1610612736, vBaseEnvHwRegionSize=245760, vBaseEnvHwRegionType=RAM
            PSPR1: vBaseEnvHwRegionStartAddress=1611661312, vBaseEnvHwRegionSize=65536, vBaseEnvHwRegionType=RAM
            DSPR2: vBaseEnvHwRegionStartAddress=1342177280, vBaseEnvHwRegionSize=98304, vBaseEnvHwRegionType=RAM
            PSPR2: vBaseEnvHwRegionStartAddress=1343225856, vBaseEnvHwRegionSize=65536, vBaseEnvHwRegionType=RAM
            PFlash0_Cached: vBaseEnvHwRegionStartAddress=2147483648, vBaseEnvHwRegionSize=3145728, vBaseEnvHwRegionType=ROM
            PFlash0_NonCached: vBaseEnvHwRegionStartAddress=2684354560, vBaseEnvHwRegionSize=3145728, vBaseEnvHwRegionType=ROM
            PFlash1_Cached: vBaseEnvHwRegionStartAddress=2150629376, vBaseEnvHwRegionSize=3145728, vBaseEnvHwRegionType=ROM
            PFlash1_NonCached: vBaseEnvHwRegionStartAddress=2687500288, vBaseEnvHwRegionSize=3145728, vBaseEnvHwRegionType=ROM
            BMHD0: vBaseEnvHwRegionStartAddress=2940207104, vBaseEnvHwRegionSize=512, vBaseEnvHwRegionType=ROM
            BMHD1: vBaseEnvHwRegionStartAddress=2940207616, vBaseEnvHwRegionSize=512, vBaseEnvHwRegionType=ROM
            BMHD2: vBaseEnvHwRegionStartAddress=2940208128, vBaseEnvHwRegionSize=512, vBaseEnvHwRegionType=ROM
            BMHD3: vBaseEnvHwRegionStartAddress=2940208640, vBaseEnvHwRegionSize=512, vBaseEnvHwRegionType=ROM
            OLDA_Cached: vBaseEnvHwRegionStartAddress=2413821952, vBaseEnvHwRegionSize=524288, vBaseEnvHwRegionType=RAM
            OLDA_NonCached: vBaseEnvHwRegionStartAddress=2950692864, vBaseEnvHwRegionSize=524288, vBaseEnvHwRegionType=RAM
            DLMU0_Cached: vBaseEnvHwRegionStartAddress=2415919104, vBaseEnvHwRegionSize=65536, vBaseEnvHwRegionType=RAM
            DLMU0_NonCached: vBaseEnvHwRegionStartAddress=2952790016, vBaseEnvHwRegionSize=65536, vBaseEnvHwRegionType=RAM
            DLMU1_Cached: vBaseEnvHwRegionStartAddress=2415984640, vBaseEnvHwRegionSize=65536, vBaseEnvHwRegionType=RAM
            DLMU1_NonCached: vBaseEnvHwRegionStartAddress=2952855552, vBaseEnvHwRegionSize=65536, vBaseEnvHwRegionType=RAM
            DLMU2_Cached: vBaseEnvHwRegionStartAddress=2416050176, vBaseEnvHwRegionSize=65536, vBaseEnvHwRegionType=RAM
            DLMU2_NonCached: vBaseEnvHwRegionStartAddress=2952921088, vBaseEnvHwRegionSize=65536, vBaseEnvHwRegionType=RAM
            DAM0_Cached: vBaseEnvHwRegionStartAddress=2420113408, vBaseEnvHwRegionSize=32768, vBaseEnvHwRegionType=RAM
            DAM0_NonCached: vBaseEnvHwRegionStartAddress=2956984320, vBaseEnvHwRegionSize=32768, vBaseEnvHwRegionType=RAM
            DFlash0: vBaseEnvHwRegionStartAddress=2936012800, vBaseEnvHwRegionSize=131072, vBaseEnvHwRegionType=ROM
            DFlash1: vBaseEnvHwRegionStartAddress=2948595712, vBaseEnvHwRegionSize=131072, vBaseEnvHwRegionType=ROM
        TC374T: vBaseEnvTestedDerivative=TC37x, vBaseEnvTestedDerivativeDescription=Infineon Aurix 2G TC37x Family, vBaseEnvAvailableChannels_Can=12, vBaseEnvAvailableChannels_Ethernet=2, vBaseEnvAvailableChannels_Lin=12
          vBaseEnvAdditionalParameters: vBaseEnvWatchdogGroup=B, vBaseEnvPllGroup=B, vBaseEnvPortGroup=B, vBaseEnvResetGroup=B, vBaseEnvDerivativeGroup=TC3xx
          26 x vBaseEnvMemLayoutHwRegion:
            DSPR0: vBaseEnvHwRegionStartAddress=1879048192, vBaseEnvHwRegionSize=245760, vBaseEnvHwRegionType=RAM
            PSPR0: vBaseEnvHwRegionStartAddress=1880096768, vBaseEnvHwRegionSize=65536, vBaseEnvHwRegionType=RAM
            DSPR1: vBaseEnvHwRegionStartAddress=1610612736, vBaseEnvHwRegionSize=245760, vBaseEnvHwRegionType=RAM
            PSPR1: vBaseEnvHwRegionStartAddress=1611661312, vBaseEnvHwRegionSize=65536, vBaseEnvHwRegionType=RAM
            DSPR2: vBaseEnvHwRegionStartAddress=1342177280, vBaseEnvHwRegionSize=98304, vBaseEnvHwRegionType=RAM
            PSPR2: vBaseEnvHwRegionStartAddress=1343225856, vBaseEnvHwRegionSize=65536, vBaseEnvHwRegionType=RAM
            PFlash0_Cached: vBaseEnvHwRegionStartAddress=2147483648, vBaseEnvHwRegionSize=3145728, vBaseEnvHwRegionType=ROM
            PFlash0_NonCached: vBaseEnvHwRegionStartAddress=2684354560, vBaseEnvHwRegionSize=3145728, vBaseEnvHwRegionType=ROM
            PFlash1_Cached: vBaseEnvHwRegionStartAddress=2150629376, vBaseEnvHwRegionSize=3145728, vBaseEnvHwRegionType=ROM
            PFlash1_NonCached: vBaseEnvHwRegionStartAddress=2687500288, vBaseEnvHwRegionSize=3145728, vBaseEnvHwRegionType=ROM
            BMHD0: vBaseEnvHwRegionStartAddress=2940207104, vBaseEnvHwRegionSize=512, vBaseEnvHwRegionType=ROM
            BMHD1: vBaseEnvHwRegionStartAddress=2940207616, vBaseEnvHwRegionSize=512, vBaseEnvHwRegionType=ROM
            BMHD2: vBaseEnvHwRegionStartAddress=2940208128, vBaseEnvHwRegionSize=512, vBaseEnvHwRegionType=ROM
            BMHD3: vBaseEnvHwRegionStartAddress=2940208640, vBaseEnvHwRegionSize=512, vBaseEnvHwRegionType=ROM
            OLDA_Cached: vBaseEnvHwRegionStartAddress=2413821952, vBaseEnvHwRegionSize=524288, vBaseEnvHwRegionType=RAM
            OLDA_NonCached: vBaseEnvHwRegionStartAddress=2950692864, vBaseEnvHwRegionSize=524288, vBaseEnvHwRegionType=RAM
            DLMU0_Cached: vBaseEnvHwRegionStartAddress=2415919104, vBaseEnvHwRegionSize=65536, vBaseEnvHwRegionType=RAM
            DLMU0_NonCached: vBaseEnvHwRegionStartAddress=2952790016, vBaseEnvHwRegionSize=65536, vBaseEnvHwRegionType=RAM
            DLMU1_Cached: vBaseEnvHwRegionStartAddress=2415984640, vBaseEnvHwRegionSize=65536, vBaseEnvHwRegionType=RAM
            DLMU1_NonCached: vBaseEnvHwRegionStartAddress=2952855552, vBaseEnvHwRegionSize=65536, vBaseEnvHwRegionType=RAM
            DLMU2_Cached: vBaseEnvHwRegionStartAddress=2416050176, vBaseEnvHwRegionSize=65536, vBaseEnvHwRegionType=RAM
            DLMU2_NonCached: vBaseEnvHwRegionStartAddress=2952921088, vBaseEnvHwRegionSize=65536, vBaseEnvHwRegionType=RAM
            DAM0_Cached: vBaseEnvHwRegionStartAddress=2420113408, vBaseEnvHwRegionSize=32768, vBaseEnvHwRegionType=RAM
            DAM0_NonCached: vBaseEnvHwRegionStartAddress=2956984320, vBaseEnvHwRegionSize=32768, vBaseEnvHwRegionType=RAM
            DFlash0: vBaseEnvHwRegionStartAddress=2936012800, vBaseEnvHwRegionSize=131072, vBaseEnvHwRegionType=ROM
            DFlash1: vBaseEnvHwRegionStartAddress=2948595712, vBaseEnvHwRegionSize=131072, vBaseEnvHwRegionType=ROM
        TC357T: vBaseEnvTestedDerivative=TC35x, vBaseEnvTestedDerivativeDescription=Infineon Aurix 2G TC35x Family, vBaseEnvAvailableChannels_Can=8, vBaseEnvAvailableChannels_Ethernet=1, vBaseEnvAvailableChannels_Lin=4
          vBaseEnvAdditionalParameters: vBaseEnvWatchdogGroup=B, vBaseEnvPllGroup=B, vBaseEnvPortGroup=B, vBaseEnvResetGroup=B, vBaseEnvDerivativeGroup=TC3xx
          32 x vBaseEnvMemLayoutHwRegion:
            DSPR0: vBaseEnvHwRegionStartAddress=1879048192, vBaseEnvHwRegionSize=245760, vBaseEnvHwRegionType=RAM
            PSPR0: vBaseEnvHwRegionStartAddress=1880096768, vBaseEnvHwRegionSize=65536, vBaseEnvHwRegionType=RAM
            DSPR1: vBaseEnvHwRegionStartAddress=1610612736, vBaseEnvHwRegionSize=245760, vBaseEnvHwRegionType=RAM
            PSPR1: vBaseEnvHwRegionStartAddress=1611661312, vBaseEnvHwRegionSize=65536, vBaseEnvHwRegionType=RAM
            DSPR2: vBaseEnvHwRegionStartAddress=1342177280, vBaseEnvHwRegionSize=98304, vBaseEnvHwRegionType=RAM
            PSPR2: vBaseEnvHwRegionStartAddress=1343225856, vBaseEnvHwRegionSize=65536, vBaseEnvHwRegionType=RAM
            PFlash0_Cached: vBaseEnvHwRegionStartAddress=2147483648, vBaseEnvHwRegionSize=2097152, vBaseEnvHwRegionType=ROM
            PFlash0_NonCached: vBaseEnvHwRegionStartAddress=2684354560, vBaseEnvHwRegionSize=2097152, vBaseEnvHwRegionType=ROM
            PFlash1_Cached: vBaseEnvHwRegionStartAddress=2150629376, vBaseEnvHwRegionSize=2097152, vBaseEnvHwRegionType=ROM
            PFlash1_NonCached: vBaseEnvHwRegionStartAddress=2687500288, vBaseEnvHwRegionSize=2097152, vBaseEnvHwRegionType=ROM
            LMU0_Cached: vBaseEnvHwRegionStartAddress=2416181248, vBaseEnvHwRegionSize=262144, vBaseEnvHwRegionType=RAM
            LMU0_NonCached: vBaseEnvHwRegionStartAddress=2953052160, vBaseEnvHwRegionSize=262144, vBaseEnvHwRegionType=RAM
            LMU1_Cached: vBaseEnvHwRegionStartAddress=2416443392, vBaseEnvHwRegionSize=262144, vBaseEnvHwRegionType=RAM
            LMU1_NonCached: vBaseEnvHwRegionStartAddress=2953314304, vBaseEnvHwRegionSize=262144, vBaseEnvHwRegionType=RAM
            BMHD0: vBaseEnvHwRegionStartAddress=2940207104, vBaseEnvHwRegionSize=512, vBaseEnvHwRegionType=ROM
            BMHD1: vBaseEnvHwRegionStartAddress=2940207616, vBaseEnvHwRegionSize=512, vBaseEnvHwRegionType=ROM
            BMHD2: vBaseEnvHwRegionStartAddress=2940208128, vBaseEnvHwRegionSize=512, vBaseEnvHwRegionType=ROM
            BMHD3: vBaseEnvHwRegionStartAddress=2940208640, vBaseEnvHwRegionSize=512, vBaseEnvHwRegionType=ROM
            OLDA_Cached: vBaseEnvHwRegionStartAddress=2413821952, vBaseEnvHwRegionSize=524288, vBaseEnvHwRegionType=RAM
            OLDA_NonCached: vBaseEnvHwRegionStartAddress=2950692864, vBaseEnvHwRegionSize=524288, vBaseEnvHwRegionType=RAM
            DLMU0_Cached: vBaseEnvHwRegionStartAddress=2415919104, vBaseEnvHwRegionSize=65536, vBaseEnvHwRegionType=RAM
            DLMU0_NonCached: vBaseEnvHwRegionStartAddress=2952790016, vBaseEnvHwRegionSize=65536, vBaseEnvHwRegionType=RAM
            DLMU1_Cached: vBaseEnvHwRegionStartAddress=2415984640, vBaseEnvHwRegionSize=65536, vBaseEnvHwRegionType=RAM
            DLMU1_NonCached: vBaseEnvHwRegionStartAddress=2952855552, vBaseEnvHwRegionSize=65536, vBaseEnvHwRegionType=RAM
            DLMU2_Cached: vBaseEnvHwRegionStartAddress=2416050176, vBaseEnvHwRegionSize=65536, vBaseEnvHwRegionType=RAM
            DLMU2_NonCached: vBaseEnvHwRegionStartAddress=2952921088, vBaseEnvHwRegionSize=65536, vBaseEnvHwRegionType=RAM
            EMEM0_Cached: vBaseEnvHwRegionStartAddress=2566914048, vBaseEnvHwRegionSize=1048576, vBaseEnvHwRegionType=RAM
            EMEM0_NonCached: vBaseEnvHwRegionStartAddress=3103784960, vBaseEnvHwRegionSize=1048576, vBaseEnvHwRegionType=RAM
            EMEM1_Cached: vBaseEnvHwRegionStartAddress=2567962624, vBaseEnvHwRegionSize=1048576, vBaseEnvHwRegionType=RAM
            EMEM1_NonCached: vBaseEnvHwRegionStartAddress=3104833536, vBaseEnvHwRegionSize=1048576, vBaseEnvHwRegionType=RAM
            DFlash0: vBaseEnvHwRegionStartAddress=2936012800, vBaseEnvHwRegionSize=131072, vBaseEnvHwRegionType=ROM
            DFlash1: vBaseEnvHwRegionStartAddress=2948595712, vBaseEnvHwRegionSize=131072, vBaseEnvHwRegionType=ROM
        TC356T: vBaseEnvTestedDerivative=TC35x, vBaseEnvTestedDerivativeDescription=Infineon Aurix 2G TC35x Family, vBaseEnvAvailableChannels_Can=7, vBaseEnvAvailableChannels_Ethernet=1, vBaseEnvAvailableChannels_Lin=4
          vBaseEnvAdditionalParameters: vBaseEnvWatchdogGroup=B, vBaseEnvPllGroup=B, vBaseEnvPortGroup=B, vBaseEnvResetGroup=B, vBaseEnvDerivativeGroup=TC3xx
          32 x vBaseEnvMemLayoutHwRegion:
            DSPR0: vBaseEnvHwRegionStartAddress=1879048192, vBaseEnvHwRegionSize=245760, vBaseEnvHwRegionType=RAM
            PSPR0: vBaseEnvHwRegionStartAddress=1880096768, vBaseEnvHwRegionSize=65536, vBaseEnvHwRegionType=RAM
            DSPR1: vBaseEnvHwRegionStartAddress=1610612736, vBaseEnvHwRegionSize=245760, vBaseEnvHwRegionType=RAM
            PSPR1: vBaseEnvHwRegionStartAddress=1611661312, vBaseEnvHwRegionSize=65536, vBaseEnvHwRegionType=RAM
            DSPR2: vBaseEnvHwRegionStartAddress=1342177280, vBaseEnvHwRegionSize=98304, vBaseEnvHwRegionType=RAM
            PSPR2: vBaseEnvHwRegionStartAddress=1343225856, vBaseEnvHwRegionSize=65536, vBaseEnvHwRegionType=RAM
            PFlash0_Cached: vBaseEnvHwRegionStartAddress=2147483648, vBaseEnvHwRegionSize=2097152, vBaseEnvHwRegionType=ROM
            PFlash0_NonCached: vBaseEnvHwRegionStartAddress=2684354560, vBaseEnvHwRegionSize=2097152, vBaseEnvHwRegionType=ROM
            PFlash1_Cached: vBaseEnvHwRegionStartAddress=2150629376, vBaseEnvHwRegionSize=2097152, vBaseEnvHwRegionType=ROM
            PFlash1_NonCached: vBaseEnvHwRegionStartAddress=2687500288, vBaseEnvHwRegionSize=2097152, vBaseEnvHwRegionType=ROM
            LMU0_Cached: vBaseEnvHwRegionStartAddress=2416181248, vBaseEnvHwRegionSize=262144, vBaseEnvHwRegionType=RAM
            LMU0_NonCached: vBaseEnvHwRegionStartAddress=2953052160, vBaseEnvHwRegionSize=262144, vBaseEnvHwRegionType=RAM
            LMU1_Cached: vBaseEnvHwRegionStartAddress=2416443392, vBaseEnvHwRegionSize=262144, vBaseEnvHwRegionType=RAM
            LMU1_NonCached: vBaseEnvHwRegionStartAddress=2953314304, vBaseEnvHwRegionSize=262144, vBaseEnvHwRegionType=RAM
            BMHD0: vBaseEnvHwRegionStartAddress=2940207104, vBaseEnvHwRegionSize=512, vBaseEnvHwRegionType=ROM
            BMHD1: vBaseEnvHwRegionStartAddress=2940207616, vBaseEnvHwRegionSize=512, vBaseEnvHwRegionType=ROM
            BMHD2: vBaseEnvHwRegionStartAddress=2940208128, vBaseEnvHwRegionSize=512, vBaseEnvHwRegionType=ROM
            BMHD3: vBaseEnvHwRegionStartAddress=2940208640, vBaseEnvHwRegionSize=512, vBaseEnvHwRegionType=ROM
            OLDA_Cached: vBaseEnvHwRegionStartAddress=2413821952, vBaseEnvHwRegionSize=524288, vBaseEnvHwRegionType=RAM
            OLDA_NonCached: vBaseEnvHwRegionStartAddress=2950692864, vBaseEnvHwRegionSize=524288, vBaseEnvHwRegionType=RAM
            DLMU0_Cached: vBaseEnvHwRegionStartAddress=2415919104, vBaseEnvHwRegionSize=65536, vBaseEnvHwRegionType=RAM
            DLMU0_NonCached: vBaseEnvHwRegionStartAddress=2952790016, vBaseEnvHwRegionSize=65536, vBaseEnvHwRegionType=RAM
            DLMU1_Cached: vBaseEnvHwRegionStartAddress=2415984640, vBaseEnvHwRegionSize=65536, vBaseEnvHwRegionType=RAM
            DLMU1_NonCached: vBaseEnvHwRegionStartAddress=2952855552, vBaseEnvHwRegionSize=65536, vBaseEnvHwRegionType=RAM
            DLMU2_Cached: vBaseEnvHwRegionStartAddress=2416050176, vBaseEnvHwRegionSize=65536, vBaseEnvHwRegionType=RAM
            DLMU2_NonCached: vBaseEnvHwRegionStartAddress=2952921088, vBaseEnvHwRegionSize=65536, vBaseEnvHwRegionType=RAM
            EMEM0_Cached: vBaseEnvHwRegionStartAddress=2566914048, vBaseEnvHwRegionSize=1048576, vBaseEnvHwRegionType=RAM
            EMEM0_NonCached: vBaseEnvHwRegionStartAddress=3103784960, vBaseEnvHwRegionSize=1048576, vBaseEnvHwRegionType=RAM
            EMEM1_Cached: vBaseEnvHwRegionStartAddress=2567962624, vBaseEnvHwRegionSize=1048576, vBaseEnvHwRegionType=RAM
            EMEM1_NonCached: vBaseEnvHwRegionStartAddress=3104833536, vBaseEnvHwRegionSize=1048576, vBaseEnvHwRegionType=RAM
            DFlash0: vBaseEnvHwRegionStartAddress=2936012800, vBaseEnvHwRegionSize=131072, vBaseEnvHwRegionType=ROM
            DFlash1: vBaseEnvHwRegionStartAddress=2948595712, vBaseEnvHwRegionSize=131072, vBaseEnvHwRegionType=ROM
      16 x vBaseEnvMemLayoutHwRegion:
        OLDA_Cached
        OLDA_NonCached
        DLMU0_Cached
        DLMU0_NonCached
        DLMU1_Cached
        DLMU1_NonCached
        DLMU2_Cached
        DLMU2_NonCached
        DAM0_Cached
        DAM0_NonCached
        EMEM0_Cached
        EMEM0_NonCached
        EMEM1_Cached
        EMEM1_NonCached
        DFlash0
        DFlash1
      TC377V (vBaseEnvDerivativeInformation):
        vBaseEnvCpuCoreAmount = 3
        vBaseEnvCpuMaxFrequency = 300000000
        vBaseEnvTestedDerivative = TC37x
        vBaseEnvTestedDerivativeDescription = Infineon Aurix 2G TC37x Family
        vBaseEnvAvailableChannels_Can = 8
        vBaseEnvAvailableChannels_Ethernet = 1
        vBaseEnvAvailableChannels_Flexray = 2
        vBaseEnvAvailableChannels_Lin = 12
        vBaseEnvCpuCore = TC162
        vBaseEnvAvailableChannels_Hyperbus = 0
        vBaseEnvAvailableChannels_I2c = 0
        vBaseEnvAvailableChannels_Spi = 0
        vBaseEnvAdditionalParameters: vBaseEnvWatchdogGroup=B, vBaseEnvPllGroup=B, vBaseEnvPortGroup=B, vBaseEnvResetGroup=B, vBaseEnvDerivativeGroup=TC3xx
        26 x vBaseEnvMemLayoutHwRegion:
          DSPR0: vBaseEnvHwRegionStartAddress=1879048192, vBaseEnvHwRegionSize=245760, vBaseEnvHwRegionType=RAM
          PSPR0: vBaseEnvHwRegionStartAddress=1880096768, vBaseEnvHwRegionSize=65536, vBaseEnvHwRegionType=RAM
          DSPR1: vBaseEnvHwRegionStartAddress=1610612736, vBaseEnvHwRegionSize=245760, vBaseEnvHwRegionType=RAM
          PSPR1: vBaseEnvHwRegionStartAddress=1611661312, vBaseEnvHwRegionSize=65536, vBaseEnvHwRegionType=RAM
          DSPR2: vBaseEnvHwRegionStartAddress=1342177280, vBaseEnvHwRegionSize=98304, vBaseEnvHwRegionType=RAM
          PSPR2: vBaseEnvHwRegionStartAddress=1343225856, vBaseEnvHwRegionSize=65536, vBaseEnvHwRegionType=RAM
          PFlash0_Cached: vBaseEnvHwRegionStartAddress=2147483648, vBaseEnvHwRegionSize=3145728, vBaseEnvHwRegionType=ROM
          PFlash0_NonCached: vBaseEnvHwRegionStartAddress=2684354560, vBaseEnvHwRegionSize=3145728, vBaseEnvHwRegionType=ROM
          PFlash1_Cached: vBaseEnvHwRegionStartAddress=2150629376, vBaseEnvHwRegionSize=3145728, vBaseEnvHwRegionType=ROM
          PFlash1_NonCached: vBaseEnvHwRegionStartAddress=2687500288, vBaseEnvHwRegionSize=3145728, vBaseEnvHwRegionType=ROM
          BMHD0: vBaseEnvHwRegionStartAddress=2940207104, vBaseEnvHwRegionSize=512, vBaseEnvHwRegionType=ROM
          BMHD1: vBaseEnvHwRegionStartAddress=2940207616, vBaseEnvHwRegionSize=512, vBaseEnvHwRegionType=ROM
          BMHD2: vBaseEnvHwRegionStartAddress=2940208128, vBaseEnvHwRegionSize=512, vBaseEnvHwRegionType=ROM
          BMHD3: vBaseEnvHwRegionStartAddress=2940208640, vBaseEnvHwRegionSize=512, vBaseEnvHwRegionType=ROM
          OLDA_Cached: vBaseEnvHwRegionStartAddress=2413821952, vBaseEnvHwRegionSize=524288, vBaseEnvHwRegionType=RAM
          OLDA_NonCached: vBaseEnvHwRegionStartAddress=2950692864, vBaseEnvHwRegionSize=524288, vBaseEnvHwRegionType=RAM
          DLMU0_Cached: vBaseEnvHwRegionStartAddress=2415919104, vBaseEnvHwRegionSize=65536, vBaseEnvHwRegionType=RAM
          DLMU0_NonCached: vBaseEnvHwRegionStartAddress=2952790016, vBaseEnvHwRegionSize=65536, vBaseEnvHwRegionType=RAM
          DLMU1_Cached: vBaseEnvHwRegionStartAddress=2415984640, vBaseEnvHwRegionSize=65536, vBaseEnvHwRegionType=RAM
          DLMU1_NonCached: vBaseEnvHwRegionStartAddress=2952855552, vBaseEnvHwRegionSize=65536, vBaseEnvHwRegionType=RAM
          DLMU2_Cached: vBaseEnvHwRegionStartAddress=2416050176, vBaseEnvHwRegionSize=65536, vBaseEnvHwRegionType=RAM
          DLMU2_NonCached: vBaseEnvHwRegionStartAddress=2952921088, vBaseEnvHwRegionSize=65536, vBaseEnvHwRegionType=RAM
          DAM0_Cached: vBaseEnvHwRegionStartAddress=2420113408, vBaseEnvHwRegionSize=32768, vBaseEnvHwRegionType=RAM
          DAM0_NonCached: vBaseEnvHwRegionStartAddress=2956984320, vBaseEnvHwRegionSize=32768, vBaseEnvHwRegionType=RAM
          DFlash0: vBaseEnvHwRegionStartAddress=2936012800, vBaseEnvHwRegionSize=131072, vBaseEnvHwRegionType=ROM
          DFlash1: vBaseEnvHwRegionStartAddress=2948595712, vBaseEnvHwRegionSize=131072, vBaseEnvHwRegionType=ROM
