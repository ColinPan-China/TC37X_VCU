AUTOSAR XML (schema 00048)
package /InitialEcuC
  ecuc value collection InitialEcuC: ecuc-values=[Can, CanIf, CanNm, CanSM, CanTp, Com, ComM, Dcm, Dem, EcuC, EcuM, Nm, PduR, Xcp]
  module config Can
    CanConfigSet
      CT_TC37X_VCU_CAN00_22cb8fec (CanController):
        CanControllerActivation = true
        CanControllerDefaultBaudrate = CT_TC37X_VCU_CAN00_22cb8fec/CanControllerBaudrateConfig
        CanControllerSystemRef = CT_TC37X_VCU_CAN00
        CanWakeupSourceRef = EcuMCommonConfiguration/CN_TC37X_VCU_CAN00_07b6c9c8
        CanControllerBaudrateConfig: CanControllerBaudRate=500
      CT_TC37X_VCU_CAN01_55ccbf7a (CanController):
        CanControllerActivation = true
        CanControllerDefaultBaudrate = CT_TC37X_VCU_CAN01_55ccbf7a/CanControllerBaudrateConfig
        CanControllerSystemRef = CT_TC37X_VCU_CAN01
        CanWakeupSourceRef = EcuMCommonConfiguration/CN_TC37X_VCU_CAN01_70b1f95e
        CanControllerBaudrateConfig: CanControllerBaudRate=500
      4 x CanHardwareObject, all with CanHandleType=BASIC, CanIdValue=0:
        CN_TC37X_VCU_CAN00_07b6c9c8_Tx: CanObjectType=TRANSMIT, CanControllerRef=CanConfigSet/CT_TC37X_VCU_CAN00_22cb8fec
        CN_TC37X_VCU_CAN00_c052b9c5_Rx: CanIdType=STANDARD, CanObjectType=RECEIVE, CanControllerRef=CanConfigSet/CT_TC37X_VCU_CAN00_22cb8fec
        CN_TC37X_VCU_CAN01_2f90d2fb_Rx: CanIdType=STANDARD, CanObjectType=RECEIVE, CanControllerRef=CanConfigSet/CT_TC37X_VCU_CAN01_55ccbf7a
        CN_TC37X_VCU_CAN01_70b1f95e_Tx: CanObjectType=TRANSMIT, CanControllerRef=CanConfigSet/CT_TC37X_VCU_CAN01_55ccbf7a
    CanGeneral: CanIndex=0
  module config CanIf
    CanIfCtrlDrvCfg_7d254554 (CanIfCtrlDrvCfg): CanIfCtrlDrvInitHohConfigRef=CanIfInitHohCfg, CanIfCtrlDrvNameRef=CanGeneral
      CT_TC37X_VCU_CAN00_22cb8fec (CanIfCtrlCfg): CanIfCtrlCanCtrlRef=CanConfigSet/CT_TC37X_VCU_CAN00_22cb8fec
      CT_TC37X_VCU_CAN01_55ccbf7a (CanIfCtrlCfg): CanIfCtrlCanCtrlRef=CanConfigSet/CT_TC37X_VCU_CAN01_55ccbf7a
    CanIfInitCfg
      CHNL_131d55da (CanIfBufferCfg): CanIfBufferSize=0, CanIfBufferHthRef=CanIfInitHohCfg/CN_TC37X_VCU_CAN01_70b1f95e_Tx
      CHNL_d841867f (CanIfBufferCfg): CanIfBufferSize=0, CanIfBufferHthRef=CanIfInitHohCfg/CN_TC37X_VCU_CAN00_07b6c9c8_Tx
      CanIfInitHohCfg: CanIfInitRefCfgSet=CanConfigSet
        CN_TC37X_VCU_CAN00_c052b9c5_Rx (CanIfHrhCfg): CanIfHrhCanCtrlIdRef=CanIfCtrlDrvCfg_7d254554/CT_TC37X_VCU_CAN00_22cb8fec, CanIfHrhIdSymRef=CanConfigSet/CN_TC37X_VCU_CAN00_c052b9c5_Rx
        CN_TC37X_VCU_CAN01_2f90d2fb_Rx (CanIfHrhCfg): CanIfHrhCanCtrlIdRef=CanIfCtrlDrvCfg_7d254554/CT_TC37X_VCU_CAN01_55ccbf7a, CanIfHrhIdSymRef=CanConfigSet/CN_TC37X_VCU_CAN01_2f90d2fb_Rx
        CN_TC37X_VCU_CAN00_07b6c9c8_Tx (CanIfHthCfg): CanIfHthCanCtrlIdRef=CanIfCtrlDrvCfg_7d254554/CT_TC37X_VCU_CAN00_22cb8fec, CanIfHthIdSymRef=CanConfigSet/CN_TC37X_VCU_CAN00_07b6c9c8_Tx
        CN_TC37X_VCU_CAN01_70b1f95e_Tx (CanIfHthCfg): CanIfHthCanCtrlIdRef=CanIfCtrlDrvCfg_7d254554/CT_TC37X_VCU_CAN01_55ccbf7a, CanIfHthIdSymRef=CanConfigSet/CN_TC37X_VCU_CAN01_70b1f95e_Tx
      9 x CanIfRxPduCfg, all with CanIfRxPduCanIdType=STANDARD_CAN, CanIfRxPduDlc=8:
        VCU_Rx_500h_NM_oTC37X_VCU_CAN00_2f971b6a_Rx: CanIfRxPduCanId=1280, CanIfRxPduUserRxIndicationName=CanNm_RxIndication, CanIfRxPduUserRxIndicationUL=CAN_NM, CanIfRxPduHrhIdRef=CanIfInitHohCfg/CN_TC37X_VCU_CAN00_c052b9c5_Rx, CanIfRxPduRef=VCU_Rx_500h_NM_oTC37X_VCU_CAN00_c4b96e15_Rx
        VCU_Rx_500h_NM_oTC37X_VCU_CAN01_21ea515e_Rx: CanIfRxPduCanId=1280, CanIfRxPduUserRxIndicationName=CanNm_RxIndication, CanIfRxPduUserRxIndicationUL=CAN_NM, CanIfRxPduHrhIdRef=CanIfInitHohCfg/CN_TC37X_VCU_CAN01_2f90d2fb_Rx, CanIfRxPduRef=VCU_Rx_500h_NM_oTC37X_VCU_CAN01_54a3f814_Rx
        VcuRxMsg1_oTC37X_VCU_CAN00_c149044d_Rx: CanIfRxPduCanId=512, CanIfRxPduUserRxIndicationName=PduR_CanIfRxIndication, CanIfRxPduUserRxIndicationUL=PDUR, CanIfRxPduHrhIdRef=CanIfInitHohCfg/CN_TC37X_VCU_CAN00_c052b9c5_Rx, CanIfRxPduRef=EcucPduCollection/VcuRxMsg1_oTC37X_VCU_CAN00_4589bbed_Rx
        VcuRxMsg2_oTC37X_VCU_CAN00_de1782b6_Rx: CanIfRxPduCanId=513, CanIfRxPduUserRxIndicationName=PduR_CanIfRxIndication, CanIfRxPduUserRxIndicationUL=PDUR, CanIfRxPduHrhIdRef=CanIfInitHohCfg/CN_TC37X_VCU_CAN00_c052b9c5_Rx, CanIfRxPduRef=EcucPduCollection/VcuRxMsg2_oTC37X_VCU_CAN00_8cbda0e0_Rx
        VcuRxMsg3_oTC37X_VCU_CAN01_29174725_Rx: CanIfRxPduCanId=514, CanIfRxPduUserRxIndicationName=PduR_CanIfRxIndication, CanIfRxPduUserRxIndicationUL=PDUR, CanIfRxPduHrhIdRef=CanIfInitHohCfg/CN_TC37X_VCU_CAN01_2f90d2fb_Rx, CanIfRxPduRef=EcucPduCollection/VcuRxMsg3_oTC37X_VCU_CAN01_5bb4c01a_Rx
        VcuRxMsg4_oTC37X_VCU_CAN01_1d60377a_Rx: CanIfRxPduCanId=515, CanIfRxPduUserRxIndicationName=PduR_CanIfRxIndication, CanIfRxPduUserRxIndicationUL=PDUR, CanIfRxPduHrhIdRef=CanIfInitHohCfg/CN_TC37X_VCU_CAN01_2f90d2fb_Rx, CanIfRxPduRef=EcucPduCollection/VcuRxMsg4_oTC37X_VCU_CAN01_55be06ba_Rx
        Vcu_Uds_Func_Request_Tp_oTC37X_VCU_CAN00_b229a038_Rx: CanIfRxPduCanId=1792, CanIfRxPduUserRxIndicationName=CanTp_RxIndication, CanIfRxPduUserRxIndicationType=PDUID_PDUINFOPTR, CanIfRxPduUserRxIndicationUL=CAN_TP, CanIfRxPduHrhIdRef=CanIfInitHohCfg/CN_TC37X_VCU_CAN00_c052b9c5_Rx, CanIfRxPduRef=Vcu_Uds_Func_Request_Tp_oTC37X_VCU_CAN00_3dbedef7_Rx
        Vcu_Uds_Phy_Request_Tp_oTC37X_VCU_CAN00_fc9370a6_Rx: CanIfRxPduCanId=1793, CanIfRxPduUserRxIndicationName=CanTp_RxIndication, CanIfRxPduUserRxIndicationType=PDUID_PDUINFOPTR, CanIfRxPduUserRxIndicationUL=CAN_TP, CanIfRxPduHrhIdRef=CanIfInitHohCfg/CN_TC37X_VCU_CAN00_c052b9c5_Rx, CanIfRxPduRef=Vcu_Uds_Phy_Request_Tp_oTC37X_VCU_CAN00_58c52463_Rx
        XCP_Request_oTC37X_VCU_CAN00_e22de59e_Rx: CanIfRxPduCanId=1542, CanIfRxPduUserRxIndicationName=Xcp_CanIfRxIndication, CanIfRxPduUserRxIndicationUL=XCP, CanIfRxPduHrhIdRef=CanIfInitHohCfg/CN_TC37X_VCU_CAN00_c052b9c5_Rx, CanIfRxPduRef=EcucPduCollection/XCP_Request_oTC37X_VCU_CAN00_3c25b45e_Rx
      8 x CanIfTxPduCfg, all with CanIfTxPduCanIdType=STANDARD_CAN, CanIfTxPduDlc=8:
        VCU_Tx_51Ch_NM_oTC37X_VCU_CAN00_560cc988_Tx: CanIfTxPduCanId=1308, CanIfTxPduUserTxConfirmationName=CanNm_TxConfirmation, CanIfTxPduUserTxConfirmationUL=CAN_NM, CanIfTxPduBufferRef=CanIfInitCfg/CHNL_d841867f, CanIfTxPduRef=EcucPduCollection/VCU_Tx_51Ch_NM_oTC37X_VCU_CAN00_0aa0ce62_Tx
        VCU_Tx_51Ch_NM_oTC37X_VCU_CAN01_587183bc_Tx: CanIfTxPduCanId=1308, CanIfTxPduUserTxConfirmationName=CanNm_TxConfirmation, CanIfTxPduUserTxConfirmationUL=CAN_NM, CanIfTxPduBufferRef=CanIfInitCfg/CHNL_131d55da, CanIfTxPduRef=EcucPduCollection/VCU_Tx_51Ch_NM_oTC37X_VCU_CAN01_9aba5863_Tx
        VcuAdcTxMsg1_oTC37X_VCU_CAN01_29adaf4d_Tx: CanIfTxPduCanId=258, CanIfTxPduUserTxConfirmationName=PduR_CanIfTxConfirmation, CanIfTxPduUserTxConfirmationUL=PDUR, CanIfTxPduBufferRef=CanIfInitCfg/CHNL_131d55da, CanIfTxPduRef=EcucPduCollection/VcuAdcTxMsg1_oTC37X_VCU_CAN01_6685c7bf_Tx
        VcuAdcTxMsg2_oTC37X_VCU_CAN01_fa8a8e09_Tx: CanIfTxPduCanId=259, CanIfTxPduUserTxConfirmationName=PduR_CanIfTxConfirmation, CanIfTxPduUserTxConfirmationUL=PDUR, CanIfTxPduBufferRef=CanIfInitCfg/CHNL_131d55da, CanIfTxPduRef=EcucPduCollection/VcuAdcTxMsg2_oTC37X_VCU_CAN01_afb1dcb2_Tx
        VcuTxMsg1_oTC37X_VCU_CAN00_78140f53_Tx: CanIfTxPduCanId=256, CanIfTxPduUserTxConfirmationName=PduR_CanIfTxConfirmation, CanIfTxPduUserTxConfirmationUL=PDUR, CanIfTxPduBufferRef=CanIfInitCfg/CHNL_d841867f, CanIfTxPduRef=EcucPduCollection/VcuTxMsg1_oTC37X_VCU_CAN00_c82dd125_Tx
        VcuTxMsg2_oTC37X_VCU_CAN00_674a89a8_Tx: CanIfTxPduCanId=257, CanIfTxPduUserTxConfirmationName=PduR_CanIfTxConfirmation, CanIfTxPduUserTxConfirmationUL=PDUR, CanIfTxPduBufferRef=CanIfInitCfg/CHNL_d841867f, CanIfTxPduRef=EcucPduCollection/VcuTxMsg2_oTC37X_VCU_CAN00_0119ca28_Tx
        Vcu_Uds_Response_Tp_oTC37X_VCU_CAN00_2ff8982b_Tx: CanIfTxPduCanId=1921, CanIfTxPduUserTxConfirmationName=CanTp_TxConfirmation, CanIfTxPduUserTxConfirmationUL=CAN_TP, CanIfTxPduBufferRef=CanIfInitCfg/CHNL_d841867f, CanIfTxPduRef=Vcu_Uds_Response_Tp_oTC37X_VCU_CAN00_834178f3_Tx
        XCP_Response_oTC37X_VCU_CAN00_933a9e7a_Tx: CanIfTxPduCanId=1543, CanIfTxPduUserTxConfirmationName=Xcp_CanIfTxConfirmation, CanIfTxPduUserTxConfirmationUL=XCP, CanIfTxPduBufferRef=CanIfInitCfg/CHNL_d841867f, CanIfTxPduRef=EcucPduCollection/XCP_Response_oTC37X_VCU_CAN00_34d2da2d_Tx
    CanIfPrivateCfg: CanIfPrivateSoftwareFilterType=LINEAR
    CanIfPublicCfg: CanIfPublicPnSupport=false
  module config CanNm
    CanNmGlobalConfig: CanNmPnEiraCalcEnabled=false, CanNmUserDataEnabled=true
      TC37X_VCU_CAN00_CAN_cc8c31fa (CanNmChannelConfig):
        CanNmMsgCycleOffset = 0
        CanNmMsgCycleTime = 0.5
        CanNmMsgReducedTime = 0.32
        CanNmNodeId = 28
        CanNmRepeatMessageTime = 1.5
        CanNmTimeoutTime = 2
        CanNmUserDataLength = 6
        CanNmWaitBusSleepTime = 2
        CanNmComMNetworkHandleRef = ComMConfigSet/CN_TC37X_VCU_CAN00_07b6c9c8
        VCU_Tx_51Ch_NM_oTC37X_VCU_CAN00_0aa0ce62_Tx (CanNmTxPdu): CanNmTxPduRef=EcucPduCollection/VCU_Tx_51Ch_NM_oTC37X_VCU_CAN00_0aa0ce62_Tx
      TC37X_VCU_CAN01_CAN_f1ec184a (CanNmChannelConfig):
        CanNmMsgCycleOffset = 0
        CanNmMsgCycleTime = 0.5
        CanNmMsgReducedTime = 0.32
        CanNmNodeId = 28
        CanNmRepeatMessageTime = 1.5
        CanNmTimeoutTime = 2
        CanNmUserDataLength = 6
        CanNmWaitBusSleepTime = 2
        CanNmComMNetworkHandleRef = ComMConfigSet/CN_TC37X_VCU_CAN01_70b1f95e
        VCU_Tx_51Ch_NM_oTC37X_VCU_CAN01_9aba5863_Tx (CanNmTxPdu): CanNmTxPduRef=EcucPduCollection/VCU_Tx_51Ch_NM_oTC37X_VCU_CAN01_9aba5863_Tx
  module config CanSM
    CanSMConfiguration
      CHNL_131d55da (CanSMManagerNetwork): CanSMComMNetworkHandleRef=ComMConfigSet/CN_TC37X_VCU_CAN01_70b1f95e
        CT_TC37X_VCU_CAN01_9a653c82 (CanSMController): CanSMControllerId=CanIfCtrlDrvCfg_7d254554/CT_TC37X_VCU_CAN01_55ccbf7a
      CHNL_d841867f (CanSMManagerNetwork): CanSMComMNetworkHandleRef=ComMConfigSet/CN_TC37X_VCU_CAN00_07b6c9c8
        CT_TC37X_VCU_CAN00_5fde07f6 (CanSMController): CanSMControllerId=CanIfCtrlDrvCfg_7d254554/CT_TC37X_VCU_CAN00_22cb8fec
  module config CanTp
    CanTpConfig: CanTpMainFunctionPeriod=0.005
      TPCH_1341a116 (CanTpChannel): CanTpChannelMode=CANTP_MODE_FULL_DUPLEX
        CanTpRxNSdu_fe7a15ff (CanTpRxNSdu):
          CanTpRxAddressingFormat = CANTP_STANDARD
          CanTpRxDl = 8
          CanTpRxTaType = CANTP_PHYSICAL
          CanTpRxNSduRef = EcucPduCollection/Vcu_Uds_Phy_Request_oTC37X_VCU_CAN00_16119f6f_Rx
          CanTpRxNPdu_63ec38a0 (CanTpRxNPdu): CanTpRxNPduRef=Vcu_Uds_Phy_Request_Tp_oTC37X_VCU_CAN00_58c52463_Rx
          CanTpTxFcNPdu_63ec38a0 (CanTpTxFcNPdu): CanTpTxFcNPduRef=Vcu_Uds_Response_Tp_oTC37X_VCU_CAN00_834178f3_Tx
        CanTpTxNSdu_fe7a15ff (CanTpTxNSdu):
          CanTpTxAddressingFormat = CANTP_STANDARD
          CanTpTxDl = 8
          CanTpTxTaType = CANTP_PHYSICAL
          CanTpTxNSduRef = EcucPduCollection/Vcu_Uds_Response_oTC37X_VCU_CAN00_39638a1a_Tx
          CanTpRxFcNPdu_4116ec52 (CanTpRxFcNPdu): CanTpRxFcNPduRef=Vcu_Uds_Phy_Request_Tp_oTC37X_VCU_CAN00_58c52463_Rx
          CanTpTxNPdu_4116ec52 (CanTpTxNPdu): CanTpTxNPduRef=Vcu_Uds_Response_Tp_oTC37X_VCU_CAN00_834178f3_Tx
      TPCH_d230b3ef (CanTpChannel): CanTpChannelMode=CANTP_MODE_FULL_DUPLEX
        CanTpRxNSdu_c12348c5 (CanTpRxNSdu):
          CanTpRxAddressingFormat = CANTP_STANDARD
          CanTpRxDl = 8
          CanTpRxTaType = CANTP_FUNCTIONAL
          CanTpRxNSduRef = EcucPduCollection/Vcu_Uds_Func_Request_oTC37X_VCU_CAN00_455d4346_Rx
          CanTpRxNPdu_257d590c (CanTpRxNPdu): CanTpRxNPduRef=Vcu_Uds_Func_Request_Tp_oTC37X_VCU_CAN00_3dbedef7_Rx
  module config Com
    ComConfig
      8 x ComIPdu, all with ComIPduType=NORMAL:
        VcuAdcTxMsg1_oTC37X_VCU_CAN01_fda515ee_Tx: ComIPduDirection=SEND, ComIPduGroupRef=VCU_oTC37X_VCU_CAN01_Tx_4e6d6cda, ComIPduSignalRef=VcuAdcTxMsg1_Sig0_oVcuAdcTxMsg1_oTC37X_VCU_CAN01_77707e8c_Tx, ComIPduSignalRef=VcuAdcTxMsg1_Sig1_oVcuAdcTxMsg1_oTC37X_VCU_CAN01_86aa7b26_Tx, ComIPduSignalRef=VcuAdcTxMsg1_Sig2_oVcuAdcTxMsg1_oTC37X_VCU_CAN01_4fb57399_Tx, ComIPduSignalRef=VcuAdcTxMsg1_Sig3_oVcuAdcTxMsg1_oTC37X_VCU_CAN01_be6f7633_Tx, ComPduIdRef=EcucPduCollection/VcuAdcTxMsg1_oTC37X_VCU_CAN01_fda515ee_Tx
          ComTxIPdu: ComMinimumDelayTime=0, ComTxIPduUnusedAreasDefault=0
            ComTxModeFalse
              ComTxMode: ComTxModeMode=PERIODIC, ComTxModeTimeOffset=0, ComTxModeTimePeriod=0.5
            ComTxModeTrue
              ComTxMode: ComTxModeMode=PERIODIC, ComTxModeTimeOffset=0, ComTxModeTimePeriod=0.5
        VcuAdcTxMsg2_oTC37X_VCU_CAN01_1723c88c_Tx: ComIPduDirection=SEND, ComIPduGroupRef=VCU_oTC37X_VCU_CAN01_Tx_4e6d6cda, ComIPduSignalRef=VcuAdcTxMsg2_Sig0_oVcuAdcTxMsg2_oTC37X_VCU_CAN01_c7979c8e_Tx, ComIPduSignalRef=VcuAdcTxMsg2_Sig1_oVcuAdcTxMsg2_oTC37X_VCU_CAN01_364d9924_Tx, ComIPduSignalRef=VcuAdcTxMsg2_Sig2_oVcuAdcTxMsg2_oTC37X_VCU_CAN01_ff52919b_Tx, ComIPduSignalRef=VcuAdcTxMsg2_Sig3_oVcuAdcTxMsg2_oTC37X_VCU_CAN01_0e889431_Tx, ComPduIdRef=EcucPduCollection/VcuAdcTxMsg2_oTC37X_VCU_CAN01_1723c88c_Tx
          ComTxIPdu: ComMinimumDelayTime=0, ComTxIPduUnusedAreasDefault=0
            ComTxModeFalse
              ComTxMode: ComTxModeMode=PERIODIC, ComTxModeTimeOffset=0, ComTxModeTimePeriod=0.5
            ComTxModeTrue
              ComTxMode: ComTxModeMode=PERIODIC, ComTxModeTimeOffset=0, ComTxModeTimePeriod=0.5
        VcuRxMsg1_oTC37X_VCU_CAN00_78805594_Rx: ComIPduDirection=RECEIVE, ComIPduGroupRef=VCU_oTC37X_VCU_CAN00_Rx_a08bac39, ComIPduSignalRef=VcuRxMsg1_Sig0_oVcuRxMsg1_oTC37X_VCU_CAN00_13cef464_Rx, ComIPduSignalRef=VcuRxMsg1_Sig1_oVcuRxMsg1_oTC37X_VCU_CAN00_70c92d40_Rx, ComIPduSignalRef=VcuRxMsg1_Sig2_oVcuRxMsg1_oTC37X_VCU_CAN00_d5c1462c_Rx, ComIPduSignalRef=VcuRxMsg1_Sig3_oVcuRxMsg1_oTC37X_VCU_CAN00_b6c69f08_Rx, ComPduIdRef=EcucPduCollection/VcuRxMsg1_oTC37X_VCU_CAN00_78805594_Rx
        VcuRxMsg2_oTC37X_VCU_CAN00_920688f6_Rx: ComIPduDirection=RECEIVE, ComIPduGroupRef=VCU_oTC37X_VCU_CAN00_Rx_a08bac39, ComIPduSignalRef=VcuRxMsg2_Sig0_oVcuRxMsg2_oTC37X_VCU_CAN00_94ceda5c_Rx, ComIPduSignalRef=VcuRxMsg2_Sig1_oVcuRxMsg2_oTC37X_VCU_CAN00_f7c90378_Rx, ComIPduSignalRef=VcuRxMsg2_Sig2_oVcuRxMsg2_oTC37X_VCU_CAN00_52c16814_Rx, ComIPduSignalRef=VcuRxMsg2_Sig3_oVcuRxMsg2_oTC37X_VCU_CAN00_31c6b130_Rx, ComPduIdRef=EcucPduCollection/VcuRxMsg2_oTC37X_VCU_CAN00_920688f6_Rx
        VcuRxMsg3_oTC37X_VCU_CAN01_0a530e81_Rx: ComIPduDirection=RECEIVE, ComIPduGroupRef=VCU_oTC37X_VCU_CAN01_Rx_1837cb5c, ComIPduSignalRef=VcuRxMsg3_Sig0_oVcuRxMsg3_oTC37X_VCU_CAN01_28190d1d_Rx, ComIPduSignalRef=VcuRxMsg3_Sig1_oVcuRxMsg3_oTC37X_VCU_CAN01_4b1ed439_Rx, ComIPduSignalRef=VcuRxMsg3_Sig2_oVcuRxMsg3_oTC37X_VCU_CAN01_ee16bf55_Rx, ComIPduSignalRef=VcuRxMsg3_Sig3_oVcuRxMsg3_oTC37X_VCU_CAN01_8d116671_Rx, ComPduIdRef=EcucPduCollection/VcuRxMsg3_oTC37X_VCU_CAN01_0a530e81_Rx
        VcuRxMsg4_oTC37X_VCU_CAN01_eb7d04e5_Rx: ComIPduDirection=RECEIVE, ComIPduGroupRef=VCU_oTC37X_VCU_CAN01_Rx_1837cb5c, ComIPduSignalRef=VcuRxMsg4_Sig0_oVcuRxMsg4_oTC37X_VCU_CAN01_36b8b0fb_Rx, ComIPduSignalRef=VcuRxMsg4_Sig1_oVcuRxMsg4_oTC37X_VCU_CAN01_55bf69df_Rx, ComIPduSignalRef=VcuRxMsg4_Sig2_oVcuRxMsg4_oTC37X_VCU_CAN01_f0b702b3_Rx, ComIPduSignalRef=VcuRxMsg4_Sig3_oVcuRxMsg4_oTC37X_VCU_CAN01_93b0db97_Rx, ComPduIdRef=EcucPduCollection/VcuRxMsg4_oTC37X_VCU_CAN01_eb7d04e5_Rx
        VcuTxMsg1_oTC37X_VCU_CAN00_954a27ee_Tx: ComIPduDirection=SEND, ComIPduGroupRef=VCU_oTC37X_VCU_CAN00_Tx_f6d10bbf, ComIPduSignalRef=VcuTxMsg1_Sig0_oVcuTxMsg1_oTC37X_VCU_CAN00_8243b9a9_Tx, ComIPduSignalRef=VcuTxMsg1_Sig1_oVcuTxMsg1_oTC37X_VCU_CAN00_e144608d_Tx, ComIPduSignalRef=VcuTxMsg1_Sig2_oVcuTxMsg1_oTC37X_VCU_CAN00_444c0be1_Tx, ComIPduSignalRef=VcuTxMsg1_Sig3_oVcuTxMsg1_oTC37X_VCU_CAN00_274bd2c5_Tx, ComPduIdRef=EcucPduCollection/VcuTxMsg1_oTC37X_VCU_CAN00_954a27ee_Tx
          ComTxIPdu: ComMinimumDelayTime=0, ComTxIPduUnusedAreasDefault=0
            ComTxModeFalse
              ComTxMode: ComTxModeMode=PERIODIC, ComTxModeTimeOffset=0, ComTxModeTimePeriod=0.5
            ComTxModeTrue
              ComTxMode: ComTxModeMode=PERIODIC, ComTxModeTimeOffset=0, ComTxModeTimePeriod=0.5
        VcuTxMsg2_oTC37X_VCU_CAN00_7fccfa8c_Tx: ComIPduDirection=SEND, ComIPduGroupRef=VCU_oTC37X_VCU_CAN00_Tx_f6d10bbf, ComIPduSignalRef=VcuTxMsg2_Sig0_oVcuTxMsg2_oTC37X_VCU_CAN00_05439791_Tx, ComIPduSignalRef=VcuTxMsg2_Sig1_oVcuTxMsg2_oTC37X_VCU_CAN00_66444eb5_Tx, ComIPduSignalRef=VcuTxMsg2_Sig2_oVcuTxMsg2_oTC37X_VCU_CAN00_c34c25d9_Tx, ComIPduSignalRef=VcuTxMsg2_Sig3_oVcuTxMsg2_oTC37X_VCU_CAN00_a04bfcfd_Tx, ComPduIdRef=EcucPduCollection/VcuTxMsg2_oTC37X_VCU_CAN00_7fccfa8c_Tx
          ComTxIPdu: ComMinimumDelayTime=0, ComTxIPduUnusedAreasDefault=0
            ComTxModeFalse
              ComTxMode: ComTxModeMode=PERIODIC, ComTxModeTimeOffset=0, ComTxModeTimePeriod=0.5
            ComTxModeTrue
              ComTxMode: ComTxModeMode=PERIODIC, ComTxModeTimeOffset=0, ComTxModeTimePeriod=0.5
      4 x ComIPduGroup:
        VCU_oTC37X_VCU_CAN00_Rx_a08bac39
        VCU_oTC37X_VCU_CAN00_Tx_f6d10bbf
        VCU_oTC37X_VCU_CAN01_Rx_1837cb5c
        VCU_oTC37X_VCU_CAN01_Tx_4e6d6cda
      32 x ComSignal, all with ComBitSize=16, ComSignalEndianness=LITTLE_ENDIAN, ComSignalInitValue=0, ComSignalType=SINT16, ComTimeout=0:
        VcuAdcTxMsg1_Sig0_oVcuAdcTxMsg1_oTC37X_VCU_CAN01_77707e8c_Tx: ComBitPosition=0, ComTransferProperty=PENDING, ComSystemTemplateSystemSignalRef=VcuAdcTxMsg1_Sig0
        VcuAdcTxMsg1_Sig1_oVcuAdcTxMsg1_oTC37X_VCU_CAN01_86aa7b26_Tx: ComBitPosition=16, ComTransferProperty=PENDING, ComSystemTemplateSystemSignalRef=VcuAdcTxMsg1_Sig1
        VcuAdcTxMsg1_Sig2_oVcuAdcTxMsg1_oTC37X_VCU_CAN01_4fb57399_Tx: ComBitPosition=32, ComTransferProperty=PENDING, ComSystemTemplateSystemSignalRef=VcuAdcTxMsg1_Sig2
        VcuAdcTxMsg1_Sig3_oVcuAdcTxMsg1_oTC37X_VCU_CAN01_be6f7633_Tx: ComBitPosition=48, ComTransferProperty=PENDING, ComSystemTemplateSystemSignalRef=VcuAdcTxMsg1_Sig3
        VcuAdcTxMsg2_Sig0_oVcuAdcTxMsg2_oTC37X_VCU_CAN01_c7979c8e_Tx: ComBitPosition=0, ComTransferProperty=PENDING, ComSystemTemplateSystemSignalRef=VcuAdcTxMsg2_Sig0
        VcuAdcTxMsg2_Sig1_oVcuAdcTxMsg2_oTC37X_VCU_CAN01_364d9924_Tx: ComBitPosition=16, ComTransferProperty=PENDING, ComSystemTemplateSystemSignalRef=VcuAdcTxMsg2_Sig1
        VcuAdcTxMsg2_Sig2_oVcuAdcTxMsg2_oTC37X_VCU_CAN01_ff52919b_Tx: ComBitPosition=32, ComTransferProperty=PENDING, ComSystemTemplateSystemSignalRef=VcuAdcTxMsg2_Sig2
        VcuAdcTxMsg2_Sig3_oVcuAdcTxMsg2_oTC37X_VCU_CAN01_0e889431_Tx: ComBitPosition=48, ComTransferProperty=PENDING, ComSystemTemplateSystemSignalRef=VcuAdcTxMsg2_Sig3
        VcuRxMsg1_Sig0_oVcuRxMsg1_oTC37X_VCU_CAN00_13cef464_Rx: ComBitPosition=0, ComSystemTemplateSystemSignalRef=VcuRxMsg1_Sig0
        VcuRxMsg1_Sig1_oVcuRxMsg1_oTC37X_VCU_CAN00_70c92d40_Rx: ComBitPosition=16, ComSystemTemplateSystemSignalRef=VcuRxMsg1_Sig1
        VcuRxMsg1_Sig2_oVcuRxMsg1_oTC37X_VCU_CAN00_d5c1462c_Rx: ComBitPosition=32, ComSystemTemplateSystemSignalRef=VcuRxMsg1_Sig2
        VcuRxMsg1_Sig3_oVcuRxMsg1_oTC37X_VCU_CAN00_b6c69f08_Rx: ComBitPosition=48, ComSystemTemplateSystemSignalRef=VcuRxMsg1_Sig3
        VcuRxMsg2_Sig0_oVcuRxMsg2_oTC37X_VCU_CAN00_94ceda5c_Rx: ComBitPosition=0, ComSystemTemplateSystemSignalRef=VcuRxMsg2_Sig0
        VcuRxMsg2_Sig1_oVcuRxMsg2_oTC37X_VCU_CAN00_f7c90378_Rx: ComBitPosition=16, ComSystemTemplateSystemSignalRef=VcuRxMsg2_Sig1
        VcuRxMsg2_Sig2_oVcuRxMsg2_oTC37X_VCU_CAN00_52c16814_Rx: ComBitPosition=32, ComSystemTemplateSystemSignalRef=VcuRxMsg2_Sig2
        VcuRxMsg2_Sig3_oVcuRxMsg2_oTC37X_VCU_CAN00_31c6b130_Rx: ComBitPosition=48, ComSystemTemplateSystemSignalRef=VcuRxMsg2_Sig3
        VcuRxMsg3_Sig0_oVcuRxMsg3_oTC37X_VCU_CAN01_28190d1d_Rx: ComBitPosition=0, ComSystemTemplateSystemSignalRef=VcuRxMsg3_Sig0
        VcuRxMsg3_Sig1_oVcuRxMsg3_oTC37X_VCU_CAN01_4b1ed439_Rx: ComBitPosition=16, ComSystemTemplateSystemSignalRef=VcuRxMsg3_Sig1
        VcuRxMsg3_Sig2_oVcuRxMsg3_oTC37X_VCU_CAN01_ee16bf55_Rx: ComBitPosition=32, ComSystemTemplateSystemSignalRef=VcuRxMsg3_Sig2
        VcuRxMsg3_Sig3_oVcuRxMsg3_oTC37X_VCU_CAN01_8d116671_Rx: ComBitPosition=48, ComSystemTemplateSystemSignalRef=VcuRxMsg3_Sig3
        VcuRxMsg4_Sig0_oVcuRxMsg4_oTC37X_VCU_CAN01_36b8b0fb_Rx: ComBitPosition=0, ComSystemTemplateSystemSignalRef=VcuRxMsg4_Sig0
        VcuRxMsg4_Sig1_oVcuRxMsg4_oTC37X_VCU_CAN01_55bf69df_Rx: ComBitPosition=16, ComSystemTemplateSystemSignalRef=VcuRxMsg4_Sig1
        VcuRxMsg4_Sig2_oVcuRxMsg4_oTC37X_VCU_CAN01_f0b702b3_Rx: ComBitPosition=32, ComSystemTemplateSystemSignalRef=VcuRxMsg4_Sig2
        VcuRxMsg4_Sig3_oVcuRxMsg4_oTC37X_VCU_CAN01_93b0db97_Rx: ComBitPosition=48, ComSystemTemplateSystemSignalRef=VcuRxMsg4_Sig3
        VcuTxMsg1_Sig0_oVcuTxMsg1_oTC37X_VCU_CAN00_8243b9a9_Tx: ComBitPosition=0, ComTransferProperty=PENDING, ComSystemTemplateSystemSignalRef=VcuTxMsg1_Sig0
        VcuTxMsg1_Sig1_oVcuTxMsg1_oTC37X_VCU_CAN00_e144608d_Tx: ComBitPosition=16, ComTransferProperty=PENDING, ComSystemTemplateSystemSignalRef=VcuTxMsg1_Sig1
        VcuTxMsg1_Sig2_oVcuTxMsg1_oTC37X_VCU_CAN00_444c0be1_Tx: ComBitPosition=32, ComTransferProperty=PENDING, ComSystemTemplateSystemSignalRef=VcuTxMsg1_Sig2
        VcuTxMsg1_Sig3_oVcuTxMsg1_oTC37X_VCU_CAN00_274bd2c5_Tx: ComBitPosition=48, ComTransferProperty=PENDING, ComSystemTemplateSystemSignalRef=VcuTxMsg1_Sig3
        VcuTxMsg2_Sig0_oVcuTxMsg2_oTC37X_VCU_CAN00_05439791_Tx: ComBitPosition=0, ComTransferProperty=PENDING, ComSystemTemplateSystemSignalRef=VcuTxMsg2_Sig0
        VcuTxMsg2_Sig1_oVcuTxMsg2_oTC37X_VCU_CAN00_66444eb5_Tx: ComBitPosition=16, ComTransferProperty=PENDING, ComSystemTemplateSystemSignalRef=VcuTxMsg2_Sig1
        VcuTxMsg2_Sig2_oVcuTxMsg2_oTC37X_VCU_CAN00_c34c25d9_Tx: ComBitPosition=32, ComTransferProperty=PENDING, ComSystemTemplateSystemSignalRef=VcuTxMsg2_Sig2
        VcuTxMsg2_Sig3_oVcuTxMsg2_oTC37X_VCU_CAN00_a04bfcfd_Tx: ComBitPosition=48, ComTransferProperty=PENDING, ComSystemTemplateSystemSignalRef=VcuTxMsg2_Sig3
    ComGeneral
  module config ComM
    ComMConfigSet: ComMPncEnabled=false
      CN_TC37X_VCU_CAN00_07b6c9c8 (ComMChannel): ComMBusType=COMM_BUS_TYPE_CAN, ComMChannelId=0
        ComMNetworkManagement: ComMNmVariant=FULL
        CN_TC37X_VCU_CAN00_cc35f66d (ComMUserPerChannel): ComMUserChannel=CN_TC37X_VCU_CAN00_b1b4f272
      CN_TC37X_VCU_CAN01_70b1f95e (ComMChannel): ComMBusType=COMM_BUS_TYPE_CAN, ComMChannelId=1
        ComMNetworkManagement: ComMNmVariant=FULL
        CN_TC37X_VCU_CAN01_a952cd2b (ComMUserPerChannel): ComMUserChannel=CN_TC37X_VCU_CAN01_5e76994c
      CN_TC37X_VCU_CAN00_b1b4f272 (ComMUser): ComMUserIdentifier=0
      CN_TC37X_VCU_CAN01_5e76994c (ComMUser): ComMUserIdentifier=1
    ComMGeneral: ComMPncIdCounting=COMM_PNC_ID_COUNT_FROM_NM_MESSAGE, ComMPncSupport=false
  module config Dcm
    DcmConfigSet  # Diagnostics Data Import
      DcmDsl
        DcmDslProtocol
          DcmDslProtocolRow_29812fbf (DcmDslProtocolRow)
            DcmDslConnection_15e709a3 (DcmDslConnection)
              DcmDslMainConnection_f109a58a (DcmDslMainConnection)
                Vcu_Uds_Func_Request_oTC37X_VCU_CAN00_21e26bac_Rx_f99a7a58 (DcmDslProtocolRx):
                  DcmDslProtocolRxAddrType = DCM_FUNCTIONAL_TYPE
                  DcmDslProtocolRxPduId = 1
                  DcmDslProtocolRxComMChannelRef = ComMConfigSet/CN_TC37X_VCU_CAN00_07b6c9c8
                  DcmDslProtocolRxPduRef = Vcu_Uds_Func_Request_oTC37X_VCU_CAN00_21e26bac_Rx
                Vcu_Uds_Phy_Request_oTC37X_VCU_CAN00_d561dcee_Rx_7ba0ca16 (DcmDslProtocolRx):
                  DcmDslProtocolRxAddrType = DCM_PHYSICAL_TYPE
                  DcmDslProtocolRxPduId = 2
                  DcmDslProtocolRxComMChannelRef = ComMConfigSet/CN_TC37X_VCU_CAN00_07b6c9c8
                  DcmDslProtocolRxPduRef = Vcu_Uds_Phy_Request_oTC37X_VCU_CAN00_d561dcee_Rx
                Vcu_Uds_Response_oTC37X_VCU_CAN00_4d111be6_Tx_666acd3e (DcmDslProtocolTx): DcmDslTxConfirmationPduId=0, DcmDslProtocolTxPduRef=EcucPduCollection/Vcu_Uds_Response_oTC37X_VCU_CAN00_4d111be6_Tx
      DcmDsp: DcmDspMaxDidToRead=5  # Diagnostics Data Import
        ComControl (DcmDspComControl)  # Diagnostics Data Import
          DspComContolAllChannel (DcmDspComControlAllChannel)  # Diagnostics Data Import
        DcmDspSession  # Diagnostics Data Import
          3 x DcmDspSessionRow, all with DcmDspSessionP2ServerMax=0.05, DcmDspSessionP2StarServerMax=5:
            Extended: DcmDspSessionLevel=3, DcmDspSessionForBoot=DCM_NO_BOOT  # Diagnostics Data Import
            Programming: DcmDspSessionLevel=2  # Diagnostics Data Import
            Default: DcmDspSessionLevel=1, DcmDspSessionForBoot=DCM_NO_BOOT  # Diagnostics Data Import
        DcmDspSecurity  # Diagnostics Data Import
          Level_3 (DcmDspSecurityRow):  # Diagnostics Data Import
            DcmDspSecurityDelayTime = 10
            DcmDspSecurityDelayTimeOnBoot = 0
            DcmDspSecurityKeySize = 2
            DcmDspSecurityLevel = 2
            DcmDspSecurityNumAttDelay = 3
            DcmDspSecuritySeedSize = 2
          UnlockedL1 (DcmDspSecurityRow):  # Diagnostics Data Import
            DcmDspSecurityDelayTime = 10
            DcmDspSecurityDelayTimeOnBoot = 0
            DcmDspSecurityKeySize = 4
            DcmDspSecurityLevel = 1
            DcmDspSecurityNumAttDelay = 3
            DcmDspSecuritySeedSize = 4
        3 x DcmDspRoutineInfo:
          RoutineInfo_Vcu_Roution_00  # Diagnostics Data Import
            DcmDspRoutineRequestResOut  # Diagnostics Data Import
              Out_New_Data_Object (DcmDspRoutineRequestResOutSignal): DcmDspRoutineSignalLength=16, DcmDspRoutineSignalType=UINT16, DcmDspRoutineSignalEndianness=BIG_ENDIAN, DcmDspRoutineSignalPos=0  # Diagnostics Data Import
            DcmDspRoutineStopOut  # Diagnostics Data Import
              Out_New_Data_Object (DcmDspRoutineStopOutSignal): DcmDspRoutineSignalLength=16, DcmDspRoutineSignalType=UINT16, DcmDspRoutineSignalEndianness=BIG_ENDIAN, DcmDspRoutineSignalPos=0  # Diagnostics Data Import
            DcmDspRoutineStopIn  # Diagnostics Data Import
              In_New_Data_Object (DcmDspRoutineStopInSignal): DcmDspRoutineSignalLength=16, DcmDspRoutineSignalType=UINT16, DcmDspRoutineSignalEndianness=BIG_ENDIAN, DcmDspRoutineSignalPos=0  # Diagnostics Data Import
            DcmDspStartRoutineOut  # Diagnostics Data Import
              Out_New_Data_Object (DcmDspStartRoutineOutSignal): DcmDspRoutineSignalLength=16, DcmDspRoutineSignalType=UINT16, DcmDspRoutineSignalEndianness=BIG_ENDIAN, DcmDspRoutineSignalPos=0  # Diagnostics Data Import
            DcmDspStartRoutineIn  # Diagnostics Data Import
              In_New_Data_Object (DcmDspStartRoutineInSignal): DcmDspRoutineSignalLength=16, DcmDspRoutineSignalType=UINT16, DcmDspRoutineSignalEndianness=BIG_ENDIAN, DcmDspRoutineSignalPos=0  # Diagnostics Data Import
            DcmDspRoutineAuthorization: DcmDspRoutineSessionRef=DcmDspSession/Programming, DcmDspRoutineSessionRef=DcmDspSession/Extended  # Diagnostics Data Import
          RoutineInfo_SampleRoutineControl_StartOnly  # Diagnostics Data Import
            DcmDspRoutineRequestResOut  # Diagnostics Data Import
              Out_Result (DcmDspRoutineRequestResOutSignal): DcmDspRoutineSignalLength=32, DcmDspRoutineSignalType=UINT32, DcmDspRoutineSignalEndianness=BIG_ENDIAN, DcmDspRoutineSignalPos=0  # Diagnostics Data Import
            DcmDspStartRoutineIn  # Diagnostics Data Import
              In_Option1 (DcmDspStartRoutineInSignal): DcmDspRoutineSignalLength=24, DcmDspRoutineSignalType=UINT8_N, DcmDspRoutineSignalEndianness=opaque, DcmDspRoutineSignalPos=0  # Diagnostics Data Import
            DcmDspRoutineAuthorization: DcmDspRoutineSessionRef=DcmDspSession/Programming, DcmDspRoutineSessionRef=DcmDspSession/Extended  # Diagnostics Data Import
          RoutineInfo_SampleRoutineControl  # Diagnostics Data Import
            DcmDspRoutineRequestResOut  # Diagnostics Data Import
              Out_Result (DcmDspRoutineRequestResOutSignal): DcmDspRoutineSignalLength=16, DcmDspRoutineSignalType=UINT16, DcmDspRoutineSignalEndianness=BIG_ENDIAN, DcmDspRoutineSignalPos=0  # Diagnostics Data Import
            DcmDspRoutineStopOut  # Diagnostics Data Import
              Out_StopState (DcmDspRoutineStopOutSignal): DcmDspRoutineSignalLength=32, DcmDspRoutineSignalType=UINT32, DcmDspRoutineSignalEndianness=BIG_ENDIAN, DcmDspRoutineSignalPos=0  # Diagnostics Data Import
            DcmDspStartRoutineOut  # Diagnostics Data Import
              Out_InitState (DcmDspStartRoutineOutSignal): DcmDspRoutineSignalLength=32, DcmDspRoutineSignalType=UINT32, DcmDspRoutineSignalEndianness=BIG_ENDIAN, DcmDspRoutineSignalPos=0  # Diagnostics Data Import
            DcmDspStartRoutineIn  # Diagnostics Data Import
              In_Option0 (DcmDspStartRoutineInSignal): DcmDspRoutineSignalLength=8, DcmDspRoutineSignalType=UINT8, DcmDspRoutineSignalPos=0  # Diagnostics Data Import
            DcmDspRoutineAuthorization: DcmDspRoutineSessionRef=DcmDspSession/Programming, DcmDspRoutineSessionRef=DcmDspSession/Extended  # Diagnostics Data Import
        3 x DcmDspRoutine, all with DcmDspRequestResultsRoutineSupported=true:
          Vcu_Roution_00: DcmDspStopRoutineSupported=true, DcmDspRoutineIdentifier=261, DcmDspRoutineInfoRef=RoutineInfo_Vcu_Roution_00  # Diagnostics Data Import
          SampleRoutineControl_StartOnly: DcmDspStopRoutineSupported=false, DcmDspRoutineIdentifier=260, DcmDspRoutineInfoRef=RoutineInfo_SampleRoutineControl_StartOnly  # Diagnostics Data Import
          SampleRoutineControl: DcmDspStopRoutineSupported=true, DcmDspRoutineIdentifier=256, DcmDspRoutineInfoRef=RoutineInfo_SampleRoutineControl  # Diagnostics Data Import
        10 x DcmDspDidInfo:
          DidInfo_SampleDynamicallyDefinedNonPeriodicDID: DcmDspDidDynamicallyDefined=true  # Diagnostics Data Import
            DcmDspDidAccess  # Diagnostics Data Import
              DcmDspDidDefine: DcmDspDDDidMaxElements=5  # Diagnostics Data Import
              DcmDspDidRead  # Diagnostics Data Import
          DidInfo_Hardware_Version  # Diagnostics Data Import
            DcmDspDidAccess  # Diagnostics Data Import
              DcmDspDidWrite  # Diagnostics Data Import
              DcmDspDidRead  # Diagnostics Data Import
          DidInfo_Vehicle_Identification  # Diagnostics Data Import
            DcmDspDidAccess  # Diagnostics Data Import
              DcmDspDidWrite  # Diagnostics Data Import
              DcmDspDidRead  # Diagnostics Data Import
          DidInfo_SerialNumber  # Diagnostics Data Import
            DcmDspDidAccess  # Diagnostics Data Import
              DcmDspDidWrite  # Diagnostics Data Import
              DcmDspDidRead  # Diagnostics Data Import
          DidInfo_EcuIdentification  # Diagnostics Data Import
            DcmDspDidAccess  # Diagnostics Data Import
              DcmDspDidWrite  # Diagnostics Data Import
              DcmDspDidRead  # Diagnostics Data Import
          DidInfo_Spare_Part_Number  # Diagnostics Data Import
            DcmDspDidAccess  # Diagnostics Data Import
              DcmDspDidWrite  # Diagnostics Data Import
              DcmDspDidRead  # Diagnostics Data Import
          DidInfo_Boot_Software  # Diagnostics Data Import
            DcmDspDidAccess  # Diagnostics Data Import
              DcmDspDidWrite  # Diagnostics Data Import
              DcmDspDidRead  # Diagnostics Data Import
          DidInfo_VCU_DID_00  # Diagnostics Data Import
            DcmDspDidAccess  # Diagnostics Data Import
              DcmDspDidWrite  # Diagnostics Data Import
              DcmDspDidRead  # Diagnostics Data Import
          DidInfo_DataDiagnosticIdentifier_DID  # Diagnostics Data Import
            DcmDspDidAccess  # Diagnostics Data Import
              DcmDspDidWrite  # Diagnostics Data Import
              DcmDspDidRead  # Diagnostics Data Import
          DidInfo_DevelopmentData  # Diagnostics Data Import
            DcmDspDidAccess  # Diagnostics Data Import
              DcmDspDidWrite  # Diagnostics Data Import
              DcmDspDidRead  # Diagnostics Data Import
        10 x DcmDspDid:
          SampleDynamicallyDefinedNonPeriodicDID: DcmDspDidIdentifier=62208, DcmDspDidInfoRef=DidInfo_SampleDynamicallyDefinedNonPeriodicDID  # Diagnostics Data Import
          Hardware_Version: DcmDspDidIdentifier=61843, DcmDspDidInfoRef=DidInfo_Hardware_Version  # Diagnostics Data Import
            Hardware_Version_Number (DcmDspDidSignal): DcmDspDidDataPos=0, DcmDspDidDataRef=Hardware_Version_Hardware_Version_Number  # Diagnostics Data Import
          Vehicle_Identification: DcmDspDidIdentifier=61840, DcmDspDidInfoRef=DidInfo_Vehicle_Identification  # Diagnostics Data Import
            VIN (DcmDspDidSignal): DcmDspDidDataPos=0, DcmDspDidDataRef=Vehicle_Identification_VIN  # Diagnostics Data Import
          SerialNumber: DcmDspDidIdentifier=61836, DcmDspDidInfoRef=DidInfo_SerialNumber  # Diagnostics Data Import
            SerialNumber (DcmDspDidSignal): DcmDspDidDataPos=0, DcmDspDidDataRef=SerialNumber_SerialNumber  # Diagnostics Data Import
          EcuIdentification: DcmDspDidIdentifier=61833, DcmDspDidInfoRef=DidInfo_EcuIdentification  # Diagnostics Data Import
            Part_Number (DcmDspDidSignal): DcmDspDidDataPos=0, DcmDspDidDataRef=EcuIdentification_Part_Number  # Diagnostics Data Import
          Spare_Part_Number: DcmDspDidIdentifier=61831, DcmDspDidInfoRef=DidInfo_Spare_Part_Number  # Diagnostics Data Import
            Spare_Part_Number (DcmDspDidSignal): DcmDspDidDataPos=0, DcmDspDidDataRef=Spare_Part_Number_Spare_Part_Number  # Diagnostics Data Import
          Boot_Software: DcmDspDidIdentifier=61824, DcmDspDidInfoRef=DidInfo_Boot_Software  # Diagnostics Data Import
            Boot_Software_Identification (DcmDspDidSignal): DcmDspDidDataPos=8, DcmDspDidDataRef=Boot_Software_Boot_Software_Identification  # Diagnostics Data Import
            NumberOfModules (DcmDspDidSignal): DcmDspDidDataPos=0, DcmDspDidDataRef=Boot_Software_NumberOfModules  # Diagnostics Data Import
          VCU_DID_00: DcmDspDidIdentifier=4132, DcmDspDidInfoRef=DidInfo_VCU_DID_00  # Diagnostics Data Import
            DataRecord (DcmDspDidSignal): DcmDspDidDataPos=0, DcmDspDidDataRef=VCU_DID_00_DataRecord  # Diagnostics Data Import
          DataDiagnosticIdentifier_DID: DcmDspDidIdentifier=257, DcmDspDidInfoRef=DidInfo_DataDiagnosticIdentifier_DID  # Diagnostics Data Import
            DataDiagnosticIdentifier (DcmDspDidSignal): DcmDspDidDataPos=0, DcmDspDidDataRef=DataDiagnosticIdentifier_DID_DataDiagnosticIdentifier  # Diagnostics Data Import
          DevelopmentData: DcmDspDidIdentifier=256, DcmDspDidInfoRef=DidInfo_DevelopmentData  # Diagnostics Data Import
            5 x DcmDspDidSignal:
              TransportLayerVersion: DcmDspDidDataPos=64, DcmDspDidDataRef=DevelopmentData_TransportLayerVersion  # Diagnostics Data Import
              DiagnosticModuleVersion: DcmDspDidDataPos=48, DcmDspDidDataRef=DevelopmentData_DiagnosticModuleVersion  # Diagnostics Data Import
              NmVersion: DcmDspDidDataPos=32, DcmDspDidDataRef=DevelopmentData_NmVersion  # Diagnostics Data Import
              CanDriverVersion: DcmDspDidDataPos=16, DcmDspDidDataRef=DevelopmentData_CanDriverVersion  # Diagnostics Data Import
              OperatingSystemVersion: DcmDspDidDataPos=0, DcmDspDidDataRef=DevelopmentData_OperatingSystemVersion  # Diagnostics Data Import
        DataInfo_Hardware_Version_Hardware_Version_Number (DcmDspDataInfo): DcmDspDataFixedLength=true  # Diagnostics Data Import
        Hardware_Version_Hardware_Version_Number (DcmDspData): DcmDspDataSize=32, DcmDspDataType=UINT32, DcmDspDataInfoRef=DataInfo_Hardware_Version_Hardware_Version_Number  # Diagnostics Data Import
        DataInfo_Vehicle_Identification_VIN (DcmDspDataInfo): DcmDspDataFixedLength=true  # Diagnostics Data Import
        Vehicle_Identification_VIN (DcmDspData): DcmDspDataSize=136, DcmDspDataType=UINT8_N, DcmDspDataInfoRef=DataInfo_Vehicle_Identification_VIN  # Diagnostics Data Import
        DataInfo_SerialNumber_SerialNumber (DcmDspDataInfo): DcmDspDataFixedLength=true  # Diagnostics Data Import
        SerialNumber_SerialNumber (DcmDspData): DcmDspDataSize=32, DcmDspDataType=UINT32, DcmDspDataInfoRef=DataInfo_SerialNumber_SerialNumber  # Diagnostics Data Import
        DataInfo_EcuIdentification_Part_Number (DcmDspDataInfo): DcmDspDataFixedLength=true  # Diagnostics Data Import
        EcuIdentification_Part_Number (DcmDspData): DcmDspDataSize=104, DcmDspDataType=UINT8_N, DcmDspDataInfoRef=DataInfo_EcuIdentification_Part_Number  # Diagnostics Data Import
        DataInfo_Spare_Part_Number_Spare_Part_Number (DcmDspDataInfo): DcmDspDataFixedLength=true  # Diagnostics Data Import
        Spare_Part_Number_Spare_Part_Number (DcmDspData): DcmDspDataSize=32, DcmDspDataType=UINT32, DcmDspDataInfoRef=DataInfo_Spare_Part_Number_Spare_Part_Number  # Diagnostics Data Import
        DataInfo_Boot_Software_Boot_Software_Identification (DcmDspDataInfo): DcmDspDataFixedLength=true  # Diagnostics Data Import
        Boot_Software_Boot_Software_Identification (DcmDspData): DcmDspDataSize=32, DcmDspDataType=UINT32, DcmDspDataInfoRef=DataInfo_Boot_Software_Boot_Software_Identification  # Diagnostics Data Import
        DataInfo_Boot_Software_NumberOfModules (DcmDspDataInfo): DcmDspDataFixedLength=true  # Diagnostics Data Import
        Boot_Software_NumberOfModules (DcmDspData): DcmDspDataSize=8, DcmDspDataType=UINT8, DcmDspDataInfoRef=DataInfo_Boot_Software_NumberOfModules  # Diagnostics Data Import
        DataInfo_VCU_DID_00_DataRecord (DcmDspDataInfo): DcmDspDataFixedLength=true  # Diagnostics Data Import
        VCU_DID_00_DataRecord (DcmDspData): DcmDspDataSize=32, DcmDspDataType=UINT32, DcmDspDataInfoRef=DataInfo_VCU_DID_00_DataRecord  # Diagnostics Data Import
        DataInfo_DataDiagnosticIdentifier_DID_DataDiagnosticIdentifier (DcmDspDataInfo): DcmDspDataFixedLength=true  # Diagnostics Data Import
        DataDiagnosticIdentifier_DID_DataDiagnosticIdentifier (DcmDspData): DcmDspDataSize=16, DcmDspDataType=UINT16, DcmDspDataInfoRef=DataInfo_DataDiagnosticIdentifier_DID_DataDiagnosticIdentifier  # Diagnostics Data Import
        DataInfo_DevelopmentData_TransportLayerVersion (DcmDspDataInfo): DcmDspDataFixedLength=true  # Diagnostics Data Import
        DevelopmentData_TransportLayerVersion (DcmDspData): DcmDspDataSize=16, DcmDspDataType=UINT16, DcmDspDataInfoRef=DataInfo_DevelopmentData_TransportLayerVersion  # Diagnostics Data Import
        DataInfo_DevelopmentData_DiagnosticModuleVersion (DcmDspDataInfo): DcmDspDataFixedLength=true  # Diagnostics Data Import
        DevelopmentData_DiagnosticModuleVersion (DcmDspData): DcmDspDataSize=16, DcmDspDataType=UINT16, DcmDspDataInfoRef=DataInfo_DevelopmentData_DiagnosticModuleVersion  # Diagnostics Data Import
        DataInfo_DevelopmentData_NmVersion (DcmDspDataInfo): DcmDspDataFixedLength=true  # Diagnostics Data Import
        DevelopmentData_NmVersion (DcmDspData): DcmDspDataSize=16, DcmDspDataType=UINT16, DcmDspDataInfoRef=DataInfo_DevelopmentData_NmVersion  # Diagnostics Data Import
        DataInfo_DevelopmentData_CanDriverVersion (DcmDspDataInfo): DcmDspDataFixedLength=true  # Diagnostics Data Import
        DevelopmentData_CanDriverVersion (DcmDspData): DcmDspDataSize=16, DcmDspDataType=UINT16, DcmDspDataInfoRef=DataInfo_DevelopmentData_CanDriverVersion  # Diagnostics Data Import
        DataInfo_DevelopmentData_OperatingSystemVersion (DcmDspDataInfo): DcmDspDataFixedLength=true  # Diagnostics Data Import
        DevelopmentData_OperatingSystemVersion (DcmDspData): DcmDspDataSize=16, DcmDspDataType=UINT16, DcmDspDataInfoRef=DataInfo_DevelopmentData_OperatingSystemVersion  # Diagnostics Data Import
      DcmDsd  # Diagnostics Data Import
        DcmDsdServiceTable  # Diagnostics Data Import
          14 x DcmDsdService:
            ControlDtcSetting: DcmDsdSidTabServiceId=133, DcmDsdSidTabSubfuncAvail=true  # Diagnostics Data Import
              Disable (DcmDsdSubService): DcmDsdSubServiceId=2  # Diagnostics Data Import
              Enable (DcmDsdSubService): DcmDsdSubServiceId=1  # Diagnostics Data Import
            TesterPresent: DcmDsdSidTabServiceId=62, DcmDsdSidTabSubfuncAvail=true  # Diagnostics Data Import
              TesterPresent (DcmDsdSubService): DcmDsdSubServiceId=0  # Diagnostics Data Import
            WriteMemoryByAddress: DcmDsdSidTabServiceId=61, DcmDsdSidTabSubfuncAvail=false  # Diagnostics Data Import
            RoutineControl: DcmDsdSidTabServiceId=49, DcmDsdSidTabSubfuncAvail=true, DcmDsdSidTabSessionLevelRef=DcmDspSession/Programming, DcmDsdSidTabSessionLevelRef=DcmDspSession/Extended  # Diagnostics Data Import
            WriteDataById: DcmDsdSidTabServiceId=46, DcmDsdSidTabSubfuncAvail=false  # Diagnostics Data Import
            DynamicallyDefineDataId: DcmDsdSidTabServiceId=44, DcmDsdSidTabSubfuncAvail=true  # Diagnostics Data Import
              3 x DcmDsdSubService:
                DynDefClr: DcmDsdSubServiceId=3  # Diagnostics Data Import
                DynDefByAddr: DcmDsdSubServiceId=2  # Diagnostics Data Import
                DynDefById: DcmDsdSubServiceId=1  # Diagnostics Data Import
            CommunicationControl: DcmDsdSidTabServiceId=40, DcmDsdSidTabSubfuncAvail=true, DcmDsdSidTabSessionLevelRef=DcmDspSession/Programming, DcmDsdSidTabSessionLevelRef=DcmDspSession/Extended  # Diagnostics Data Import
              4 x DcmDsdSubService, all with DcmDsdSubServiceSessionLevelRef=DcmDspSession/Programming, DcmDsdSubServiceSessionLevelRef=DcmDspSession/Extended:
                DisableRxAndTx: DcmDsdSubServiceId=3  # Diagnostics Data Import
                DisableRxAndEnableTx: DcmDsdSubServiceId=2  # Diagnostics Data Import
                EnableRxAndDisableTx: DcmDsdSubServiceId=1  # Diagnostics Data Import
                EnableRxAndTx: DcmDsdSubServiceId=0  # Diagnostics Data Import
            SecurityAccess: DcmDsdSidTabServiceId=39, DcmDsdSidTabSubfuncAvail=true, DcmDsdSidTabSessionLevelRef=DcmDspSession/Programming, DcmDsdSidTabSessionLevelRef=DcmDspSession/Extended  # Diagnostics Data Import
              4 x DcmDsdSubService, all with DcmDsdSubServiceSessionLevelRef=DcmDspSession/Programming, DcmDsdSubServiceSessionLevelRef=DcmDspSession/Extended:
                sendKey_Send: DcmDsdSubServiceId=4  # Diagnostics Data Import
                requestSeed_Request: DcmDsdSubServiceId=3  # Diagnostics Data Import
                KeyLevel1_Send: DcmDsdSubServiceId=2  # Diagnostics Data Import
                SeedLevel1_Request: DcmDsdSubServiceId=1  # Diagnostics Data Import
            ReadMemoryByAddress: DcmDsdSidTabServiceId=35, DcmDsdSidTabSubfuncAvail=false  # Diagnostics Data Import
            ReadDataById: DcmDsdSidTabServiceId=34, DcmDsdSidTabSubfuncAvail=false  # Diagnostics Data Import
            ReadDtcInfo: DcmDsdSidTabServiceId=25, DcmDsdSidTabSubfuncAvail=true  # Diagnostics Data Import
              12 x DcmDsdSubService:
                RDTCFDC: DcmDsdSubServiceId=20  # Diagnostics Data Import
                RMRTFDTC: DcmDsdSubServiceId=13  # Diagnostics Data Import
                RFCDTC: DcmDsdSubServiceId=12  # Diagnostics Data Import
                RSUPDTC: DcmDsdSubServiceId=10  # Diagnostics Data Import
                RSIODTC: DcmDsdSubServiceId=9  # Diagnostics Data Import
                RDTCBSMR: DcmDsdSubServiceId=8  # Diagnostics Data Import
                RNODTCBSMR: DcmDsdSubServiceId=7  # Diagnostics Data Import
                RDTCEDRBDN: DcmDsdSubServiceId=6  # Diagnostics Data Import
                RDTCSSBDTC: DcmDsdSubServiceId=4  # Diagnostics Data Import
                RDTCSSI: DcmDsdSubServiceId=3  # Diagnostics Data Import
                RDTCBSM: DcmDsdSubServiceId=2  # Diagnostics Data Import
                RNODTCBSM: DcmDsdSubServiceId=1  # Diagnostics Data Import
            ClearDiagInfo: DcmDsdSidTabServiceId=20, DcmDsdSidTabSubfuncAvail=false  # Diagnostics Data Import
            EcuReset: DcmDsdSidTabServiceId=17, DcmDsdSidTabSubfuncAvail=true  # Diagnostics Data Import
              Hard (DcmDsdSubService): DcmDsdSubServiceId=1  # Diagnostics Data Import
            DiagSessionControl: DcmDsdSidTabServiceId=16, DcmDsdSidTabSubfuncAvail=true  # Diagnostics Data Import
              3 x DcmDsdSubService:
                Extended: DcmDsdSubServiceId=3  # Diagnostics Data Import
                Programming: DcmDsdSubServiceId=2  # Diagnostics Data Import
                Default: DcmDsdSubServiceId=1  # Diagnostics Data Import
      DcmGeneral: DcmResetToFblAfterSessionFinalResponseEnabled=false  # Diagnostics Data Import
  module config Dem
    DemGeneral:  # Diagnostics Data Import
      DemAgingCycleCounterProcessing = DEM_PROCESS_AGINGCTR_INTERN
      DemDebounceCounterBasedSupport = true
      DemPTOSupport = false
      DemDtcStatusAvailabilityMask = 255
      DemTypeOfFreezeFrameRecordNumeration = DEM_FF_RECNUM_CALCULATED
      OccurrenceCounter_Occurrence_Counter (DemDataClass): DemDataElementDataSize=1, DemDataElementInternalData=DEM_OCCCTR, DemDataElementUsePort=USE_DATA_INTERNAL  # Diagnostics Data Import
      4 x DemOperationCycle:
        WarmUpCycle: DemOperationCycleType=DEM_OPCYC_WARMUP  # Diagnostics Data Import
        PowerCycle: DemOperationCycleType=DEM_OPCYC_POWER  # Diagnostics Data Import
        OBDDrivingCycle: DemOperationCycleType=DEM_OPCYC_OBD_DCY  # Diagnostics Data Import
        IgnitionCycle: DemOperationCycleType=DEM_OPCYC_IGNITION  # Diagnostics Data Import
      WarningIndicator (DemIndicator)  # Diagnostics Data Import
      OccurrenceCounter (DemExtendedDataRecordClass): DemExtendedDataRecordNumber=1, DemDataClassRef=OccurrenceCounter_Occurrence_Counter  # Diagnostics Data Import
      ExtendedDataClass_83dcefb7 (DemExtendedDataClass): DemExtendedDataRecordClassRef=OccurrenceCounter  # Diagnostics Data Import
    DemConfigSet  # Diagnostics Data Import
      DTC_0x000003 (DemEventParameter): DemEventKind=DEM_EVENT_KIND_SWC, DemDTCClassRef=DTCClass_DTC_0x000003, DemExtendedDataClassRef=ExtendedDataClass_83dcefb7  # Diagnostics Data Import
        DemEventClass:  # Diagnostics Data Import
          DemAgingAllowed = true
          DemAgingCycleCounterThreshold = 40
          DemEventDestination = DEM_DTC_ORIGIN_PRIMARY_MEMORY
          DemEventPriority = 1
          DemEventSignificance = DEM_EVENT_SIGNIFICANCE_FAULT
          DemEventFailureCycleCounterThreshold = 2
          DemAgingCycleRef = WarmUpCycle
          DemOperationCycleRef = OBDDrivingCycle
          IndicatorAttribute_WarningIndicator (DemIndicatorAttribute): DemIndicatorFailureCycleSource=DEM_FAILURE_CYCLE_EVENT, DemIndicatorHealingCycleRef=OBDDrivingCycle, DemIndicatorRef=WarningIndicator  # Diagnostics Data Import
          DemDebounceAlgorithmClass  # Diagnostics Data Import
            DemDebounceCounterBased: DemDebounceCounterDecrementStepSize=1, DemDebounceCounterIncrementStepSize=1, DemDebounceCounterJumpDown=false, DemDebounceCounterJumpUp=true  # Diagnostics Data Import
      DTCClass_DTC_0x000003 (DemDTCClass): DemDTCSeverity=DEM_DTC_SEV_NO_SEVERITY, DemUdsDTC=3  # Diagnostics Data Import
      DTC_0x000002 (DemEventParameter): DemEventKind=DEM_EVENT_KIND_SWC, DemDTCClassRef=DTCClass_DTC_0x000002, DemExtendedDataClassRef=ExtendedDataClass_83dcefb7  # Diagnostics Data Import
        DemEventClass:  # Diagnostics Data Import
          DemAgingAllowed = false
          DemAgingCycleCounterThreshold = 100
          DemEventDestination = DEM_DTC_ORIGIN_PRIMARY_MEMORY
          DemEventPriority = 2
          DemEventSignificance = DEM_EVENT_SIGNIFICANCE_FAULT
          DemEventFailureCycleCounterThreshold = 0
          DemAgingCycleRef = IgnitionCycle
          DemOperationCycleRef = PowerCycle
          IndicatorAttribute_WarningIndicator (DemIndicatorAttribute): DemIndicatorFailureCycleSource=DEM_FAILURE_CYCLE_EVENT, DemIndicatorHealingCycleRef=PowerCycle, DemIndicatorRef=WarningIndicator  # Diagnostics Data Import
          DemDebounceAlgorithmClass  # Diagnostics Data Import
            DemDebounceCounterBased: DemDebounceCounterDecrementStepSize=1, DemDebounceCounterIncrementStepSize=1, DemDebounceCounterJumpDown=false, DemDebounceCounterJumpUp=true  # Diagnostics Data Import
        DemCallbackInitMForE  # Diagnostics Data Import
      DTCClass_DTC_0x000002 (DemDTCClass): DemDTCSeverity=DEM_DTC_SEV_NO_SEVERITY, DemUdsDTC=2  # Diagnostics Data Import
  module config EcuC
    EcucPduCollection: PduIdTypeEnum=UINT8, PduLengthTypeEnum=UINT8
      31 x Pdu:
        VCU_Rx_500h_NM_oTC37X_VCU_CAN00_c4b96e15_Rx: DynamicLength=false, PduLength=8, SysTPduToFrameMappingRef=VCU_Rx_500h_NM
        VCU_Rx_500h_NM_oTC37X_VCU_CAN01_54a3f814_Rx: DynamicLength=false, PduLength=8, SysTPduToFrameMappingRef=VCU_Rx_500h_NM
        VCU_Tx_51Ch_NM_oTC37X_VCU_CAN00_0aa0ce62_Tx: DynamicLength=false, PduLength=8, SysTPduToFrameMappingRef=VCU_Tx_51Ch_NM
        VCU_Tx_51Ch_NM_oTC37X_VCU_CAN01_9aba5863_Tx: DynamicLength=false, PduLength=8, SysTPduToFrameMappingRef=VCU_Tx_51Ch_NM
        VcuAdcTxMsg1_oTC37X_VCU_CAN01_6685c7bf_Tx: DynamicLength=false, PduLength=8, SysTPduToFrameMappingRef=VcuAdcTxMsg1
        VcuAdcTxMsg1_oTC37X_VCU_CAN01_fda515ee_Tx: DynamicLength=false, PduLength=8
        VcuAdcTxMsg2_oTC37X_VCU_CAN01_1723c88c_Tx: DynamicLength=false, PduLength=8
        VcuAdcTxMsg2_oTC37X_VCU_CAN01_afb1dcb2_Tx: DynamicLength=false, PduLength=8, SysTPduToFrameMappingRef=VcuAdcTxMsg2
        VcuRxMsg1_oTC37X_VCU_CAN00_4589bbed_Rx: DynamicLength=false, PduLength=8, SysTPduToFrameMappingRef=VcuRxMsg1
        VcuRxMsg1_oTC37X_VCU_CAN00_78805594_Rx: DynamicLength=false, PduLength=8
        VcuRxMsg2_oTC37X_VCU_CAN00_8cbda0e0_Rx: DynamicLength=false, PduLength=8, SysTPduToFrameMappingRef=VcuRxMsg2
        VcuRxMsg2_oTC37X_VCU_CAN00_920688f6_Rx: DynamicLength=false, PduLength=8
        VcuRxMsg3_oTC37X_VCU_CAN01_0a530e81_Rx: DynamicLength=false, PduLength=8
        VcuRxMsg3_oTC37X_VCU_CAN01_5bb4c01a_Rx: DynamicLength=false, PduLength=8, SysTPduToFrameMappingRef=VcuRxMsg3
        VcuRxMsg4_oTC37X_VCU_CAN01_55be06ba_Rx: DynamicLength=false, PduLength=8, SysTPduToFrameMappingRef=VcuRxMsg4
        VcuRxMsg4_oTC37X_VCU_CAN01_eb7d04e5_Rx: DynamicLength=false, PduLength=8
        VcuTxMsg1_oTC37X_VCU_CAN00_954a27ee_Tx: DynamicLength=false, PduLength=8
        VcuTxMsg1_oTC37X_VCU_CAN00_c82dd125_Tx: DynamicLength=false, PduLength=8, SysTPduToFrameMappingRef=VcuTxMsg1
        VcuTxMsg2_oTC37X_VCU_CAN00_0119ca28_Tx: DynamicLength=false, PduLength=8, SysTPduToFrameMappingRef=VcuTxMsg2
        VcuTxMsg2_oTC37X_VCU_CAN00_7fccfa8c_Tx: DynamicLength=false, PduLength=8
        Vcu_Uds_Func_Request_Tp_oTC37X_VCU_CAN00_3dbedef7_Rx: DynamicLength=false, PduLength=8, SysTPduToFrameMappingRef=Vcu_Uds_Func_Request_Tp
        Vcu_Uds_Func_Request_oTC37X_VCU_CAN00_21e26bac_Rx: DynamicLength=true, PduLength=7
        Vcu_Uds_Func_Request_oTC37X_VCU_CAN00_455d4346_Rx: DynamicLength=true, PduLength=7
        Vcu_Uds_Phy_Request_Tp_oTC37X_VCU_CAN00_58c52463_Rx: DynamicLength=false, PduLength=8, SysTPduToFrameMappingRef=Vcu_Uds_Phy_Request_Tp
        Vcu_Uds_Phy_Request_oTC37X_VCU_CAN00_16119f6f_Rx: DynamicLength=true, PduLength=8
        Vcu_Uds_Phy_Request_oTC37X_VCU_CAN00_d561dcee_Rx: DynamicLength=true, PduLength=8
        Vcu_Uds_Response_Tp_oTC37X_VCU_CAN00_834178f3_Tx: DynamicLength=false, PduLength=8, SysTPduToFrameMappingRef=Vcu_Uds_Response_Tp
        Vcu_Uds_Response_oTC37X_VCU_CAN00_39638a1a_Tx: DynamicLength=true, PduLength=8
        Vcu_Uds_Response_oTC37X_VCU_CAN00_4d111be6_Tx: DynamicLength=true, PduLength=8
        XCP_Request_oTC37X_VCU_CAN00_3c25b45e_Rx: DynamicLength=false, PduLength=8, SysTPduToFrameMappingRef=XCP_Request
        XCP_Response_oTC37X_VCU_CAN00_34d2da2d_Tx: DynamicLength=false, PduLength=8, SysTPduToFrameMappingRef=XCP_Response
  module config EcuM
    EcuMConfiguration
      EcuMCommonConfiguration
        EcuMDriverInitListOne
        EcuMDriverRestartList
        CN_TC37X_VCU_CAN00_07b6c9c8 (EcuMWakeupSource): EcuMWakeupSourceId=5, EcuMComMChannelRef=ComMConfigSet/CN_TC37X_VCU_CAN00_07b6c9c8
        CN_TC37X_VCU_CAN01_70b1f95e (EcuMWakeupSource): EcuMWakeupSourceId=6, EcuMComMChannelRef=ComMConfigSet/CN_TC37X_VCU_CAN01_70b1f95e
      EcuMFlexConfiguration: EcuMFlexModuleConfigurationRef=CanConfigSet
  module config Nm
    CN_TC37X_VCU_CAN00_07b6c9c8 (NmChannelConfig): NmComMChannelRef=ComMConfigSet/CN_TC37X_VCU_CAN00_07b6c9c8
      TC37X_VCU_CAN00_CAN_cc8c31fa (NmBusType)
        NmStandardBusNmConfig: NmStandardBusType=NM_BUSNM_CANNM  # TC37X_VCU_CAN00_CAN
    CN_TC37X_VCU_CAN01_70b1f95e (NmChannelConfig): NmComMChannelRef=ComMConfigSet/CN_TC37X_VCU_CAN01_70b1f95e
      TC37X_VCU_CAN01_CAN_f1ec184a (NmBusType)
        NmStandardBusNmConfig: NmStandardBusType=NM_BUSNM_CANNM  # TC37X_VCU_CAN01_CAN
    NmGlobalConfig
      NmGlobalFeatures: NmNodeIdEnabled=true, NmUserDataEnabled=true
      NmGlobalProperties
  module config PduR
    PduRGeneral
    PduRRoutingTables
      PduRRoutingTable
        11 x PduRRoutingPath:
          VcuAdcTxMsg1_oTC37X_VCU_CAN01_fda515ee_Tx
            VcuAdcTxMsg1_oTC37X_VCU_CAN01_6685c7bf_Tx (PduRDestPdu): PduRDestPduRef=EcucPduCollection/VcuAdcTxMsg1_oTC37X_VCU_CAN01_6685c7bf_Tx
            PduRSrcPdu_f8c9b934 (PduRSrcPdu): PduRSrcPduRef=EcucPduCollection/VcuAdcTxMsg1_oTC37X_VCU_CAN01_fda515ee_Tx
          VcuAdcTxMsg2_oTC37X_VCU_CAN01_1723c88c_Tx
            VcuAdcTxMsg2_oTC37X_VCU_CAN01_afb1dcb2_Tx (PduRDestPdu): PduRDestPduRef=EcucPduCollection/VcuAdcTxMsg2_oTC37X_VCU_CAN01_afb1dcb2_Tx
            PduRSrcPdu_df42a212 (PduRSrcPdu): PduRSrcPduRef=EcucPduCollection/VcuAdcTxMsg2_oTC37X_VCU_CAN01_1723c88c_Tx
          VcuRxMsg1_oTC37X_VCU_CAN00_4589bbed_Rx
            VcuRxMsg1_oTC37X_VCU_CAN00_4589bbed_Rx_6711bd67_Rx (PduRDestPdu): PduRDestPduRef=EcucPduCollection/VcuRxMsg1_oTC37X_VCU_CAN00_78805594_Rx
            PduRSrcPdu_6711bd67 (PduRSrcPdu): PduRSrcPduRef=EcucPduCollection/VcuRxMsg1_oTC37X_VCU_CAN00_4589bbed_Rx
          VcuRxMsg2_oTC37X_VCU_CAN00_8cbda0e0_Rx
            VcuRxMsg2_oTC37X_VCU_CAN00_8cbda0e0_Rx_803efadc_Rx (PduRDestPdu): PduRDestPduRef=EcucPduCollection/VcuRxMsg2_oTC37X_VCU_CAN00_920688f6_Rx
            PduRSrcPdu_803efadc (PduRSrcPdu): PduRSrcPduRef=EcucPduCollection/VcuRxMsg2_oTC37X_VCU_CAN00_8cbda0e0_Rx
          VcuRxMsg3_oTC37X_VCU_CAN01_5bb4c01a_Rx
            VcuRxMsg3_oTC37X_VCU_CAN01_5bb4c01a_Rx_3905054b_Rx (PduRDestPdu): PduRDestPduRef=EcucPduCollection/VcuRxMsg3_oTC37X_VCU_CAN01_0a530e81_Rx
            PduRSrcPdu_3905054b (PduRSrcPdu): PduRSrcPduRef=EcucPduCollection/VcuRxMsg3_oTC37X_VCU_CAN01_5bb4c01a_Rx
          VcuRxMsg4_oTC37X_VCU_CAN01_55be06ba_Rx
            VcuRxMsg4_oTC37X_VCU_CAN01_55be06ba_Rx_f5b46736_Rx (PduRDestPdu): PduRDestPduRef=EcucPduCollection/VcuRxMsg4_oTC37X_VCU_CAN01_eb7d04e5_Rx
            PduRSrcPdu_f5b46736 (PduRSrcPdu): PduRSrcPduRef=EcucPduCollection/VcuRxMsg4_oTC37X_VCU_CAN01_55be06ba_Rx
          VcuTxMsg1_oTC37X_VCU_CAN00_954a27ee_Tx
            VcuTxMsg1_oTC37X_VCU_CAN00_c82dd125_Tx (PduRDestPdu): PduRDestPduRef=EcucPduCollection/VcuTxMsg1_oTC37X_VCU_CAN00_c82dd125_Tx
            PduRSrcPdu_91d52164 (PduRSrcPdu): PduRSrcPduRef=EcucPduCollection/VcuTxMsg1_oTC37X_VCU_CAN00_954a27ee_Tx
          VcuTxMsg2_oTC37X_VCU_CAN00_7fccfa8c_Tx
            VcuTxMsg2_oTC37X_VCU_CAN00_0119ca28_Tx (PduRDestPdu): PduRDestPduRef=EcucPduCollection/VcuTxMsg2_oTC37X_VCU_CAN00_0119ca28_Tx
            PduRSrcPdu_69924b1b (PduRSrcPdu): PduRSrcPduRef=EcucPduCollection/VcuTxMsg2_oTC37X_VCU_CAN00_7fccfa8c_Tx
          Vcu_Uds_Func_Request_oTC37X_VCU_CAN00_455d4346_Rx
            Vcu_Uds_Func_Request_oTC37X_VCU_CAN00_455d4346_Rx_4bac36fb_Rx (PduRDestPdu): PduRDestPduRef=Vcu_Uds_Func_Request_oTC37X_VCU_CAN00_21e26bac_Rx
            PduRSrcPdu_4bac36fb (PduRSrcPdu): PduRSrcPduRef=EcucPduCollection/Vcu_Uds_Func_Request_oTC37X_VCU_CAN00_455d4346_Rx
          Vcu_Uds_Phy_Request_oTC37X_VCU_CAN00_16119f6f_Rx
            Vcu_Uds_Phy_Request_oTC37X_VCU_CAN00_16119f6f_Rx_925fbf89_Rx (PduRDestPdu): PduRDestPduRef=Vcu_Uds_Phy_Request_oTC37X_VCU_CAN00_d561dcee_Rx
            PduRSrcPdu_925fbf89 (PduRSrcPdu): PduRSrcPduRef=EcucPduCollection/Vcu_Uds_Phy_Request_oTC37X_VCU_CAN00_16119f6f_Rx
          Vcu_Uds_Response_oTC37X_VCU_CAN00_4d111be6_Tx
            Vcu_Uds_Response_oTC37X_VCU_CAN00_39638a1a_Tx (PduRDestPdu): PduRDestPduRef=EcucPduCollection/Vcu_Uds_Response_oTC37X_VCU_CAN00_39638a1a_Tx
            PduRSrcPdu_1a8748e9 (PduRSrcPdu): PduRSrcPduRef=EcucPduCollection/Vcu_Uds_Response_oTC37X_VCU_CAN00_4d111be6_Tx
  module config Xcp
    XcpConfig
      XCP_Request_oTC37X_VCU_CAN00_3c25b45e_Rx (XcpPdu)
        XCP_Request_oTC37X_VCU_CAN00_3c25b45e_Rx (XcpRxPdu): XcpRxPduRef=EcucPduCollection/XCP_Request_oTC37X_VCU_CAN00_3c25b45e_Rx
      XCP_Response_oTC37X_VCU_CAN00_34d2da2d_Tx (XcpPdu)
        XCP_Response_oTC37X_VCU_CAN00_34d2da2d_Tx (XcpTxPdu): XcpTxPduRef=EcucPduCollection/XCP_Response_oTC37X_VCU_CAN00_34d2da2d_Tx
    XcpGeneral
