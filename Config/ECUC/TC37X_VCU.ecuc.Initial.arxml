[part 1 of 3: package /InitialEcuC]
AUTOSAR XML (schema 00048)
package /InitialEcuC
  ecuc value collection InitialEcuC: ecuc-values=[Can, CanIf, CanNm, CanSM, CanTp, Com, ComM, Dcm, Dem, EcuC, EcuM, Lin, LinIf, LinSM, LinTp, Nm, PduR, Xcp]
  module config Can
    CanConfigSet
      5 x CanController, all with CanControllerActivation=true:
        CT_ATOM_CANFD_Matrix_CH_V600_202502_37050292: CanControllerDefaultBaudrate=CT_ATOM_CANFD_Matrix_CH_V600_202502_37050292/CanControllerBaudrateConfig, CanControllerSystemRef=CT_ATOM_CANFD_Matrix_CH_V600_202502, CanWakeupSourceRef=EcuMCommonConfiguration/CN_ATOM_CANFD_Matrix_CH_V600_202502_a4d436ac
          CanControllerBaudrateConfig
        CT_TC37X_VCU_CAN00_22cb8fec: CanControllerDefaultBaudrate=CT_TC37X_VCU_CAN00_22cb8fec/CanControllerBaudrateConfig, CanControllerSystemRef=CT_TC37X_VCU_CAN00, CanWakeupSourceRef=EcuMCommonConfiguration/CN_TC37X_VCU_CAN00_07b6c9c8
          CanControllerBaudrateConfig: CanControllerBaudRate=500
        CT_TC37X_VCU_CAN01_55ccbf7a: CanControllerDefaultBaudrate=CT_TC37X_VCU_CAN01_55ccbf7a/CanControllerBaudrateConfig, CanControllerSystemRef=CT_TC37X_VCU_CAN01, CanWakeupSourceRef=EcuMCommonConfiguration/CN_TC37X_VCU_CAN01_70b1f95e
          CanControllerBaudrateConfig: CanControllerBaudRate=500
        CT_TC37X_VCU_CAN03_bbc2de56: CanControllerDefaultBaudrate=CT_TC37X_VCU_CAN03_bbc2de56/CanControllerBaudrateConfig, CanControllerSystemRef=CT_TC37X_VCU_CAN03, CanWakeupSourceRef=EcuMCommonConfiguration/CN_TC37X_VCU_CAN03_9ebf9872
          CanControllerBaudrateConfig: CanControllerBaudRate=500
        CT_TC37X_VCU_CAN12_d5dedf81: CanControllerDefaultBaudrate=CT_TC37X_VCU_CAN12_d5dedf81/CanControllerBaudrateConfig, CanControllerSystemRef=CT_TC37X_VCU_CAN12, CanWakeupSourceRef=EcuMCommonConfiguration/CN_TC37X_VCU_CAN12_f0a399a5
          CanControllerBaudrateConfig: CanControllerBaudRate=500
      10 x CanHardwareObject, all with CanHandleType=BASIC, CanIdValue=0:
        CN_ATOM_CANFD_Matrix_CH_V600_202502_64375107_Rx: CanIdType=STANDARD, CanObjectType=RECEIVE, CanControllerRef=CanConfigSet/CT_ATOM_CANFD_Matrix_CH_V600_202502_37050292
        CN_ATOM_CANFD_Matrix_CH_V600_202502_a4d436ac_Tx: CanObjectType=TRANSMIT, CanControllerRef=CanConfigSet/CT_ATOM_CANFD_Matrix_CH_V600_202502_37050292
        CN_TC37X_VCU_CAN00_07b6c9c8_Tx: CanObjectType=TRANSMIT, CanControllerRef=CanConfigSet/CT_TC37X_VCU_CAN00_22cb8fec
        CN_TC37X_VCU_CAN00_c052b9c5_Rx: CanIdType=STANDARD, CanObjectType=RECEIVE, CanControllerRef=CanConfigSet/CT_TC37X_VCU_CAN00_22cb8fec
        CN_TC37X_VCU_CAN01_2f90d2fb_Rx: CanIdType=STANDARD, CanObjectType=RECEIVE, CanControllerRef=CanConfigSet/CT_TC37X_VCU_CAN01_55ccbf7a
        CN_TC37X_VCU_CAN01_70b1f95e_Tx: CanObjectType=TRANSMIT, CanControllerRef=CanConfigSet/CT_TC37X_VCU_CAN01_55ccbf7a
        CN_TC37X_VCU_CAN03_2b6502c6_Rx: CanIdType=STANDARD, CanObjectType=RECEIVE, CanControllerRef=CanConfigSet/CT_TC37X_VCU_CAN03_bbc2de56
        CN_TC37X_VCU_CAN03_9ebf9872_Tx: CanObjectType=TRANSMIT, CanControllerRef=CanConfigSet/CT_TC37X_VCU_CAN03_bbc2de56
        CN_TC37X_VCU_CAN12_0529b638_Rx: CanIdType=STANDARD, CanObjectType=RECEIVE, CanControllerRef=CanConfigSet/CT_TC37X_VCU_CAN12_d5dedf81
        CN_TC37X_VCU_CAN12_f0a399a5_Tx: CanObjectType=TRANSMIT, CanControllerRef=CanConfigSet/CT_TC37X_VCU_CAN12_d5dedf81
    CanGeneral: CanIndex=0
  module config CanIf
    CanIfCtrlDrvCfg_7d254554 (CanIfCtrlDrvCfg): CanIfCtrlDrvInitHohConfigRef=CanIfInitHohCfg, CanIfCtrlDrvNameRef=CanGeneral
      5 x CanIfCtrlCfg:
        CT_ATOM_CANFD_Matrix_CH_V600_202502_37050292: CanIfCtrlCanCtrlRef=CanConfigSet/CT_ATOM_CANFD_Matrix_CH_V600_202502_37050292
        CT_TC37X_VCU_CAN00_22cb8fec: CanIfCtrlCanCtrlRef=CanConfigSet/CT_TC37X_VCU_CAN00_22cb8fec
        CT_TC37X_VCU_CAN01_55ccbf7a: CanIfCtrlCanCtrlRef=CanConfigSet/CT_TC37X_VCU_CAN01_55ccbf7a
        CT_TC37X_VCU_CAN03_bbc2de56: CanIfCtrlCanCtrlRef=CanConfigSet/CT_TC37X_VCU_CAN03_bbc2de56
        CT_TC37X_VCU_CAN12_d5dedf81: CanIfCtrlCanCtrlRef=CanConfigSet/CT_TC37X_VCU_CAN12_d5dedf81
    CanIfInitCfg
      5 x CanIfBufferCfg, all with CanIfBufferSize=0:
        CHNL_131d55da: CanIfBufferHthRef=CanIfInitHohCfg/CN_TC37X_VCU_CAN01_70b1f95e_Tx
        CHNL_33fe2cc0: CanIfBufferHthRef=CanIfInitHohCfg/CN_TC37X_VCU_CAN12_f0a399a5_Tx
        CHNL_5ed5f4d1: CanIfBufferHthRef=CanIfInitHohCfg/CN_TC37X_VCU_CAN03_9ebf9872_Tx
        CHNL_785eea40: CanIfBufferHthRef=CanIfInitHohCfg/CN_ATOM_CANFD_Matrix_CH_V600_202502_a4d436ac_Tx
        CHNL_d841867f: CanIfBufferHthRef=CanIfInitHohCfg/CN_TC37X_VCU_CAN00_07b6c9c8_Tx
      CanIfInitHohCfg: CanIfInitRefCfgSet=CanConfigSet
        5 x CanIfHrhCfg:
          CN_ATOM_CANFD_Matrix_CH_V600_202502_64375107_Rx: CanIfHrhCanCtrlIdRef=CanIfCtrlDrvCfg_7d254554/CT_ATOM_CANFD_Matrix_CH_V600_202502_37050292, CanIfHrhIdSymRef=CanConfigSet/CN_ATOM_CANFD_Matrix_CH_V600_202502_64375107_Rx
          CN_TC37X_VCU_CAN00_c052b9c5_Rx: CanIfHrhCanCtrlIdRef=CanIfCtrlDrvCfg_7d254554/CT_TC37X_VCU_CAN00_22cb8fec, CanIfHrhIdSymRef=CanConfigSet/CN_TC37X_VCU_CAN00_c052b9c5_Rx
          CN_TC37X_VCU_CAN01_2f90d2fb_Rx: CanIfHrhCanCtrlIdRef=CanIfCtrlDrvCfg_7d254554/CT_TC37X_VCU_CAN01_55ccbf7a, CanIfHrhIdSymRef=CanConfigSet/CN_TC37X_VCU_CAN01_2f90d2fb_Rx
          CN_TC37X_VCU_CAN03_2b6502c6_Rx: CanIfHrhCanCtrlIdRef=CanIfCtrlDrvCfg_7d254554/CT_TC37X_VCU_CAN03_bbc2de56, CanIfHrhIdSymRef=CanConfigSet/CN_TC37X_VCU_CAN03_2b6502c6_Rx
          CN_TC37X_VCU_CAN12_0529b638_Rx: CanIfHrhCanCtrlIdRef=CanIfCtrlDrvCfg_7d254554/CT_TC37X_VCU_CAN12_d5dedf81, CanIfHrhIdSymRef=CanConfigSet/CN_TC37X_VCU_CAN12_0529b638_Rx
        5 x CanIfHthCfg:
          CN_ATOM_CANFD_Matrix_CH_V600_202502_a4d436ac_Tx: CanIfHthCanCtrlIdRef=CanIfCtrlDrvCfg_7d254554/CT_ATOM_CANFD_Matrix_CH_V600_202502_37050292, CanIfHthIdSymRef=CanConfigSet/CN_ATOM_CANFD_Matrix_CH_V600_202502_a4d436ac_Tx
          CN_TC37X_VCU_CAN00_07b6c9c8_Tx: CanIfHthCanCtrlIdRef=CanIfCtrlDrvCfg_7d254554/CT_TC37X_VCU_CAN00_22cb8fec, CanIfHthIdSymRef=CanConfigSet/CN_TC37X_VCU_CAN00_07b6c9c8_Tx
          CN_TC37X_VCU_CAN01_70b1f95e_Tx: CanIfHthCanCtrlIdRef=CanIfCtrlDrvCfg_7d254554/CT_TC37X_VCU_CAN01_55ccbf7a, CanIfHthIdSymRef=CanConfigSet/CN_TC37X_VCU_CAN01_70b1f95e_Tx
          CN_TC37X_VCU_CAN03_9ebf9872_Tx: CanIfHthCanCtrlIdRef=CanIfCtrlDrvCfg_7d254554/CT_TC37X_VCU_CAN03_bbc2de56, CanIfHthIdSymRef=CanConfigSet/CN_TC37X_VCU_CAN03_9ebf9872_Tx
          CN_TC37X_VCU_CAN12_f0a399a5_Tx: CanIfHthCanCtrlIdRef=CanIfCtrlDrvCfg_7d254554/CT_TC37X_VCU_CAN12_d5dedf81, CanIfHthIdSymRef=CanConfigSet/CN_TC37X_VCU_CAN12_f0a399a5_Tx
      39 x CanIfRxPduCfg, all with CanIfRxPduCanIdType=STANDARD_CAN, CanIfRxPduDlc=8:
        ACU_01_oATOM_CANFD_Matrix_CH_V600_202502_a8187c42_Rx: CanIfRxPduCanId=245, CanIfRxPduUserRxIndicationName=PduR_CanIfRxIndication, CanIfRxPduUserRxIndicationUL=PDUR, CanIfRxPduHrhIdRef=CanIfInitHohCfg/CN_ATOM_CANFD_Matrix_CH_V600_202502_64375107_Rx, CanIfRxPduRef=EcucPduCollection/ACU_01_oATOM_CANFD_Matrix_CH_V600_202502_1343b9ef_Rx
        ACU_02_oATOM_CANFD_Matrix_CH_V600_202502_013f48ab_Rx: CanIfRxPduCanId=246, CanIfRxPduUserRxIndicationName=PduR_CanIfRxIndication, CanIfRxPduUserRxIndicationUL=PDUR, CanIfRxPduHrhIdRef=CanIfInitHohCfg/CN_ATOM_CANFD_Matrix_CH_V600_202502_64375107_Rx, CanIfRxPduRef=EcucPduCollection/ACU_02_oATOM_CANFD_Matrix_CH_V600_202502_8a035e80_Rx
        ACU_info_oATOM_CANFD_Matrix_CH_V600_202502_3a26f0a5_Rx: CanIfRxPduCanId=151, CanIfRxPduUserRxIndicationName=PduR_CanIfRxIndication, CanIfRxPduUserRxIndicationUL=PDUR, CanIfRxPduHrhIdRef=CanIfInitHohCfg/CN_ATOM_CANFD_Matrix_CH_V600_202502_64375107_Rx, CanIfRxPduRef=EcucPduCollection/ACU_info_oATOM_CANFD_Matrix_CH_V600_202502_83006605_Rx
        ADCU_ACC_02_oATOM_CANFD_Matrix_CH_V600_202502_c4c0c3b8_Rx: CanIfRxPduCanId=224, CanIfRxPduUserRxIndicationName=PduR_CanIfRxIndication, CanIfRxPduUserRxIndicationUL=PDUR, CanIfRxPduHrhIdRef=CanIfInitHohCfg/CN_ATOM_CANFD_Matrix_CH_V600_202502_64375107_Rx, CanIfRxPduRef=EcucPduCollection/ADCU_ACC_02_oATOM_CANFD_Matrix_CH_V600_202502_9c78bb9f_Rx
        ADCU_AEB_01_oATOM_CANFD_Matrix_CH_V600_202502_112d0569_Rx: CanIfRxPduCanId=226, CanIfRxPduUserRxIndicationName=PduR_CanIfRxIndication, CanIfRxPduUserRxIndicationUL=PDUR, CanIfRxPduHrhIdRef=CanIfInitHohCfg/CN_ATOM_CANFD_Matrix_CH_V600_202502_64375107_Rx, CanIfRxPduRef=EcucPduCollection/ADCU_AEB_01_oATOM_CANFD_Matrix_CH_V600_202502_aeea498e_Rx
        ADCU_APS_01_oATOM_CANFD_Matrix_CH_V600_202502_49d00f95_Rx: CanIfRxPduCanId=228, CanIfRxPduUserRxIndicationName=PduR_CanIfRxIndication, CanIfRxPduUserRxIndicationUL=PDUR, CanIfRxPduHrhIdRef=CanIfInitHohCfg/CN_ATOM_CANFD_Matrix_CH_V600_202502_64375107_Rx, CanIfRxPduRef=EcucPduCollection/ADCU_APS_01_oATOM_CANFD_Matrix_CH_V600_202502_c0dbb601_Rx
        ADCU_APS_02_oATOM_CANFD_Matrix_CH_V600_202502_4e07b11c_Rx: CanIfRxPduCanId=525, CanIfRxPduUserRxIndicationName=PduR_CanIfRxIndication, CanIfRxPduUserRxIndicationUL=PDUR, CanIfRxPduHrhIdRef=CanIfInitHohCfg/CN_ATOM_CANFD_Matrix_CH_V600_202502_64375107_Rx, CanIfRxPduRef=EcucPduCollection/ADCU_APS_02_oATOM_CANFD_Matrix_CH_V600_202502_599b516e_Rx
        ADCU_DA_oATOM_CANFD_Matrix_CH_V600_202502_006b7786_Rx: CanIfRxPduCanId=230, CanIfRxPduUserRxIndicationName=PduR_CanIfRxIndication, CanIfRxPduUserRxIndicationUL=PDUR, CanIfRxPduHrhIdRef=CanIfInitHohCfg/CN_ATOM_CANFD_Matrix_CH_V600_202502_64375107_Rx, CanIfRxPduRef=EcucPduCollection/ADCU_DA_oATOM_CANFD_Matrix_CH_V600_202502_8a75132b_Rx
        IBS_ACC_oATOM_CANFD_Matrix_CH_V600_202502_bc049b13_Rx: CanIfRxPduCanId=184, CanIfRxPduUserRxIndicationName=PduR_CanIfRxIndication, CanIfRxPduUserRxIndicationUL=PDUR, CanIfRxPduHrhIdRef=CanIfInitHohCfg/CN_ATOM_CANFD_Matrix_CH_V600_202502_64375107_Rx, CanIfRxPduRef=EcucPduCollection/IBS_ACC_oATOM_CANFD_Matrix_CH_V600_202502_205c1446_Rx
        IBS_APS_oATOM_CANFD_Matrix_CH_V600_202502_85b7a139_Rx: CanIfRxPduCanId=183, CanIfRxPduUserRxIndicationName=PduR_CanIfRxIndication, CanIfRxPduUserRxIndicationUL=PDUR, CanIfRxPduHrhIdRef=CanIfInitHohCfg/CN_ATOM_CANFD_Matrix_CH_V600_202502_64375107_Rx, CanIfRxPduRef=EcucPduCollection/IBS_APS_oATOM_CANFD_Matrix_CH_V600_202502_8feeb71a_Rx
        IBS_Status_01_oATOM_CANFD_Matrix_CH_V600_202502_efd7d15c_Rx: CanIfRxPduCanId=178, CanIfRxPduUserRxIndicationName=PduR_CanIfRxIndication, CanIfRxPduUserRxIndicationUL=PDUR, CanIfRxPduHrhIdRef=CanIfInitHohCfg/CN_ATOM_CANFD_Matrix_CH_V600_202502_64375107_Rx, CanIfRxPduRef=EcucPduCollection/IBS_Status_01_oATOM_CANFD_Matrix_CH_V600_202502_acfe14e2_Rx
        IBS_Status_02_oATOM_CANFD_Matrix_CH_V600_202502_b20084e1_Rx: CanIfRxPduCanId=179, CanIfRxPduUserRxIndicationName=PduR_CanIfRxIndication, CanIfRxPduUserRxIndicationUL=PDUR, CanIfRxPduHrhIdRef=CanIfInitHohCfg/CN_ATOM_CANFD_Matrix_CH_V600_202502_64375107_Rx, CanIfRxPduRef=EcucPduCollection/IBS_Status_02_oATOM_CANFD_Matrix_CH_V600_202502_35bef38d_Rx
        IBS_Status_03_oATOM_CANFD_Matrix_CH_V600_202502_3062b5b5_Rx: CanIfRxPduCanId=180, CanIfRxPduUserRxIndicationName=PduR_CanIfRxIndication, CanIfRxPduUserRxIndicationUL=PDUR, CanIfRxPduHrhIdRef=CanIfInitHohCfg/CN_ATOM_CANFD_Matrix_CH_V600_202502_64375107_Rx, CanIfRxPduRef=EcucPduCollection/IBS_Status_03_oATOM_CANFD_Matrix_CH_V600_202502_f451ac97_Rx
        IBS_Status_04_oATOM_CANFD_Matrix_CH_V600_202502_09ae2f9b_Rx: CanIfRxPduCanId=186, CanIfRxPduUserRxIndicationName=PduR_CanIfRxIndication, CanIfRxPduUserRxIndicationUL=PDUR, CanIfRxPduHrhIdRef=CanIfInitHohCfg/CN_ATOM_CANFD_Matrix_CH_V600_202502_64375107_Rx, CanIfRxPduRef=EcucPduCollection/IBS_Status_04_oATOM_CANFD_Matrix_CH_V600_202502_dc4e3b12_Rx
        IBS_Status_06_oATOM_CANFD_Matrix_CH_V600_202502_d61b4b72_Rx: CanIfRxPduCanId=188, CanIfRxPduUserRxIndicationName=PduR_CanIfRxIndication, CanIfRxPduUserRxIndicationUL=PDUR, CanIfRxPduHrhIdRef=CanIfInitHohCfg/CN_ATOM_CANFD_Matrix_CH_V600_202502_64375107_Rx, CanIfRxPduRef=EcucPduCollection/IBS_Status_06_oATOM_CANFD_Matrix_CH_V600_202502_84e18367_Rx
        IBS_Torque_oATOM_CANFD_Matrix_CH_V600_202502_859bc039_Rx: CanIfRxPduCanId=185, CanIfRxPduUserRxIndicationName=PduR_CanIfRxIndication, CanIfRxPduUserRxIndicationUL=PDUR, CanIfRxPduHrhIdRef=CanIfInitHohCfg/CN_ATOM_CANFD_Matrix_CH_V600_202502_64375107_Rx, CanIfRxPduRef=EcucPduCollection/IBS_Torque_oATOM_CANFD_Matrix_CH_V600_202502_94259583_Rx
        IBS_VCU_MotorControl_oATOM_CANFD_Matrix_CH_V600_202502_0ce6310f_Rx: CanIfRxPduCanId=144, CanIfRxPduUserRxIndicationName=PduR_CanIfRxIndication, CanIfRxPduUserRxIndicationUL=PDUR, CanIfRxPduHrhIdRef=CanIfInitHohCfg/CN_ATOM_CANFD_Matrix_CH_V600_202502_64375107_Rx, CanIfRxPduRef=EcucPduCollection/IBS_VCU_MotorControl_oATOM_CANFD_Matrix_CH_V600_202502_df4c437b_Rx
        IBS_WheelSpeed_01_oATOM_CANFD_Matrix_CH_V600_202502_1af19e81_Rx: CanIfRxPduCanId=176, CanIfRxPduUserRxIndicationName=PduR_CanIfRxIndication, CanIfRxPduUserRxIndicationUL=PDUR, CanIfRxPduHrhIdRef=CanIfInitHohCfg/CN_ATOM_CANFD_Matrix_CH_V600_202502_64375107_Rx, CanIfRxPduRef=EcucPduCollection/IBS_WheelSpeed_01_oATOM_CANFD_Matrix_CH_V600_202502_cdf72100_Rx
        IBS_WheelSpeed_02_oATOM_CANFD_Matrix_CH_V600_202502_9a94b166_Rx: CanIfRxPduCanId=177, CanIfRxPduUserRxIndicationName=PduR_CanIfRxIndication, CanIfRxPduUserRxIndicationUL=PDUR, CanIfRxPduHrhIdRef=CanIfInitHohCfg/CN_ATOM_CANFD_Matrix_CH_V600_202502_64375107_Rx, CanIfRxPduRef=EcucPduCollection/IBS_WheelSpeed_02_oATOM_CANFD_Matrix_CH_V600_202502_54b7c66f_Rx
        SGW_17_oATOM_CANFD_Matrix_CH_V600_202502_a3accfb6_Rx: CanIfRxPduCanId=850, CanIfRxPduUserRxIndicationName=PduR_CanIfRxIndication, CanIfRxPduUserRxIndicationUL=PDUR, CanIfRxPduHrhIdRef=CanIfInitHohCfg/CN_ATOM_CANFD_Matrix_CH_V600_202502_64375107_Rx, CanIfRxPduRef=EcucPduCollection/SGW_17_oATOM_CANFD_Matrix_CH_V600_202502_3a9eb4a2_Rx
        VCU_42a243c5_Rx: CanIfRxPduUserRxIndicationName=CanNm_RxIndication, CanIfRxPduUserRxIndicationUL=CAN_NM, CanIfRxPduHrhIdRef=CanIfInitHohCfg/CN_ATOM_CANFD_Matrix_CH_V600_202502_64375107_Rx, CanIfRxPduRef=VCU_3966faea_Rx
          CHNL_9f084fc6 (CanIfRxPduCanIdRange): CanIfRxPduCanIdRangeLowerCanId=1280, CanIfRxPduCanIdRangeUpperCanId=1407
        VCU_Rx_500h_NM_oTC37X_VCU_CAN00_2f971b6a_Rx: CanIfRxPduCanId=1280, CanIfRxPduUserRxIndicationName=CanNm_RxIndication, CanIfRxPduUserRxIndicationUL=CAN_NM, CanIfRxPduHrhIdRef=CanIfInitHohCfg/CN_TC37X_VCU_CAN00_c052b9c5_Rx, CanIfRxPduRef=VCU_Rx_500h_NM_oTC37X_VCU_CAN00_c4b96e15_Rx
        VCU_Rx_500h_NM_oTC37X_VCU_CAN01_21ea515e_Rx: CanIfRxPduCanId=1280, CanIfRxPduUserRxIndicationName=CanNm_RxIndication, CanIfRxPduUserRxIndicationUL=CAN_NM, CanIfRxPduHrhIdRef=CanIfInitHohCfg/CN_TC37X_VCU_CAN01_2f90d2fb_Rx, CanIfRxPduRef=VCU_Rx_500h_NM_oTC37X_VCU_CAN01_54a3f814_Rx
        VCU_Rx_500h_NM_oTC37X_VCU_CAN03_3d10c536_Rx: CanIfRxPduCanId=1280, CanIfRxPduUserRxIndicationName=CanNm_RxIndication, CanIfRxPduUserRxIndicationUL=CAN_NM, CanIfRxPduHrhIdRef=CanIfInitHohCfg/CN_TC37X_VCU_CAN03_2b6502c6_Rx, CanIfRxPduRef=VCU_Rx_500h_NM_oTC37X_VCU_CAN03_afe7d257_Rx
        VCU_Rx_500h_NM_oTC37X_VCU_CAN12_12d706fd_Rx: CanIfRxPduCanId=1280, CanIfRxPduUserRxIndicationName=CanNm_RxIndication, CanIfRxPduUserRxIndicationUL=CAN_NM, CanIfRxPduHrhIdRef=CanIfInitHohCfg/CN_TC37X_VCU_CAN12_0529b638_Rx, CanIfRxPduRef=VCU_Rx_500h_NM_oTC37X_VCU_CAN12_486a6e56_Rx
        VcuCan03RxMsg1_oTC37X_VCU_CAN03_d3a6cc6e_Rx: CanIfRxPduCanId=530, CanIfRxPduUserRxIndicationName=PduR_CanIfRxIndication, CanIfRxPduUserRxIndicationUL=PDUR, CanIfRxPduHrhIdRef=CanIfInitHohCfg/CN_TC37X_VCU_CAN03_2b6502c6_Rx, CanIfRxPduRef=EcucPduCollection/VcuCan03RxMsg1_oTC37X_VCU_CAN03_4dd213bb_Rx
        VcuCan03RxMsg2_oTC37X_VCU_CAN03_90956af5_Rx: CanIfRxPduCanId=531, CanIfRxPduUserRxIndicationName=PduR_CanIfRxIndication, CanIfRxPduUserRxIndicationUL=PDUR, CanIfRxPduHrhIdRef=CanIfInitHohCfg/CN_TC37X_VCU_CAN03_2b6502c6_Rx, CanIfRxPduRef=EcucPduCollection/VcuCan03RxMsg2_oTC37X_VCU_CAN03_84e608b6_Rx
        VcuCan12RxMsg3_oTC37X_VCU_CAN12_b2a63007_Rx: CanIfRxPduCanId=51, CanIfRxPduUserRxIndicationName=PduR_CanIfRxIndication, CanIfRxPduUserRxIndicationUL=PDUR, CanIfRxPduHrhIdRef=CanIfInitHohCfg/CN_TC37X_VCU_CAN12_0529b638_Rx, CanIfRxPduRef=EcucPduCollection/VcuCan12RxMsg3_oTC37X_VCU_CAN12_2f1174ae_Rx
        VcuCan12RxMsg4_oTC37X_VCU_CAN12_0a2fe0b8_Rx: CanIfRxPduCanId=50, CanIfRxPduUserRxIndicationName=PduR_CanIfRxIndication, CanIfRxPduUserRxIndicationUL=PDUR, CanIfRxPduHrhIdRef=CanIfInitHohCfg/CN_TC37X_VCU_CAN12_0529b638_Rx, CanIfRxPduRef=EcucPduCollection/VcuCan12RxMsg4_oTC37X_VCU_CAN12_211bb20e_Rx
        VcuRxCtrlMsg0_oTC37X_VCU_CAN01_6f777a62_Rx: CanIfRxPduCanId=270, CanIfRxPduUserRxIndicationName=PduR_CanIfRxIndication, CanIfRxPduUserRxIndicationUL=PDUR, CanIfRxPduHrhIdRef=CanIfInitHohCfg/CN_TC37X_VCU_CAN01_2f90d2fb_Rx, CanIfRxPduRef=EcucPduCollection/VcuRxCtrlMsg0_oTC37X_VCU_CAN01_3715838b_Rx
        VcuRxCtrlMsg1_oTC37X_VCU_CAN01_989a1812_Rx: CanIfRxPduCanId=271, CanIfRxPduUserRxIndicationName=PduR_CanIfRxIndication, CanIfRxPduUserRxIndicationUL=PDUR, CanIfRxPduHrhIdRef=CanIfInitHohCfg/CN_TC37X_VCU_CAN01_2f90d2fb_Rx, CanIfRxPduRef=EcucPduCollection/VcuRxCtrlMsg1_oTC37X_VCU_CAN01_70067570_Rx
        VcuRxCtrlMsg2_oTC37X_VCU_CAN01_5bdcb8c3_Rx: CanIfRxPduCanId=272, CanIfRxPduUserRxIndicationName=PduR_CanIfRxIndication, CanIfRxPduUserRxIndicationUL=PDUR, CanIfRxPduHrhIdRef=CanIfInitHohCfg/CN_TC37X_VCU_CAN01_2f90d2fb_Rx, CanIfRxPduRef=EcucPduCollection/VcuRxCtrlMsg2_oTC37X_VCU_CAN01_b9326e7d_Rx
        VcuRxMsg1_oTC37X_VCU_CAN00_c149044d_Rx: CanIfRxPduCanId=512, CanIfRxPduUserRxIndicationName=PduR_CanIfRxIndication, CanIfRxPduUserRxIndicationUL=PDUR, CanIfRxPduHrhIdRef=CanIfInitHohCfg/CN_TC37X_VCU_CAN00_c052b9c5_Rx, CanIfRxPduRef=EcucPduCollection/VcuRxMsg1_oTC37X_VCU_CAN00_4589bbed_Rx
        VcuRxMsg2_oTC37X_VCU_CAN00_de1782b6_Rx: CanIfRxPduCanId=513, CanIfRxPduUserRxIndicationName=PduR_CanIfRxIndication, CanIfRxPduUserRxIndicationUL=PDUR, CanIfRxPduHrhIdRef=CanIfInitHohCfg/CN_TC37X_VCU_CAN00_c052b9c5_Rx, CanIfRxPduRef=EcucPduCollection/VcuRxMsg2_oTC37X_VCU_CAN00_8cbda0e0_Rx
        VcuRxMsg3_oTC37X_VCU_CAN01_29174725_Rx: CanIfRxPduCanId=514, CanIfRxPduUserRxIndicationName=PduR_CanIfRxIndication, CanIfRxPduUserRxIndicationUL=PDUR, CanIfRxPduHrhIdRef=CanIfInitHohCfg/CN_TC37X_VCU_CAN01_2f90d2fb_Rx, CanIfRxPduRef=EcucPduCollection/VcuRxMsg3_oTC37X_VCU_CAN01_5bb4c01a_Rx
        VcuRxMsg4_oTC37X_VCU_CAN01_1d60377a_Rx: CanIfRxPduCanId=515, CanIfRxPduUserRxIndicationName=PduR_CanIfRxIndication, CanIfRxPduUserRxIndicationUL=PDUR, CanIfRxPduHrhIdRef=CanIfInitHohCfg/CN_TC37X_VCU_CAN01_2f90d2fb_Rx, CanIfRxPduRef=EcucPduCollection/VcuRxMsg4_oTC37X_VCU_CAN01_55be06ba_Rx
        Vcu_Uds_Func_Request_Tp_oTC37X_VCU_CAN00_b229a038_Rx: CanIfRxPduCanId=1792, CanIfRxPduUserRxIndicationName=CanTp_RxIndication, CanIfRxPduUserRxIndicationType=PDUID_PDUINFOPTR, CanIfRxPduUserRxIndicationUL=CAN_TP, CanIfRxPduHrhIdRef=CanIfInitHohCfg/CN_TC37X_VCU_CAN00_c052b9c5_Rx, CanIfRxPduRef=Vcu_Uds_Func_Request_Tp_oTC37X_VCU_CAN00_3dbedef7_Rx
        Vcu_Uds_Phy_Request_Tp_oTC37X_VCU_CAN00_fc9370a6_Rx: CanIfRxPduCanId=1793, CanIfRxPduUserRxIndicationName=CanTp_RxIndication, CanIfRxPduUserRxIndicationType=PDUID_PDUINFOPTR, CanIfRxPduUserRxIndicationUL=CAN_TP, CanIfRxPduHrhIdRef=CanIfInitHohCfg/CN_TC37X_VCU_CAN00_c052b9c5_Rx, CanIfRxPduRef=Vcu_Uds_Phy_Request_Tp_oTC37X_VCU_CAN00_58c52463_Rx
        XCP_Request_oTC37X_VCU_CAN00_e22de59e_Rx: CanIfRxPduCanId=1542, CanIfRxPduUserRxIndicationName=Xcp_CanIfRxIndication, CanIfRxPduUserRxIndicationUL=XCP, CanIfRxPduHrhIdRef=CanIfInitHohCfg/CN_TC37X_VCU_CAN00_c052b9c5_Rx, CanIfRxPduRef=EcucPduCollection/XCP_Request_oTC37X_VCU_CAN00_3c25b45e_Rx
      45 x CanIfTxPduCfg, all with CanIfTxPduDlc=8:
        NM_VCU_oATOM_CANFD_Matrix_CH_V600_202502_4d937c12_Tx: CanIfTxPduCanId=1324, CanIfTxPduCanIdType=STANDARD_CAN, CanIfTxPduUserTxConfirmationName=CanNm_TxConfirmation, CanIfTxPduUserTxConfirmationUL=CAN_NM, CanIfTxPduBufferRef=CanIfInitCfg/CHNL_785eea40, CanIfTxPduRef=EcucPduCollection/NM_VCU_oATOM_CANFD_Matrix_CH_V600_202502_7321f2c3_Tx
        VCU_02_oATOM_CANFD_Matrix_CH_V600_202502_ba0b4faa_Tx: CanIfTxPduCanId=793, CanIfTxPduCanIdType=STANDARD_FD_CAN, CanIfTxPduUserTxConfirmationName=PduR_CanIfTxConfirmation, CanIfTxPduUserTxConfirmationUL=PDUR, CanIfTxPduBufferRef=CanIfInitCfg/CHNL_785eea40, CanIfTxPduRef=EcucPduCollection/VCU_02_oATOM_CANFD_Matrix_CH_V600_202502_b9b0de03_Tx
        VCU_03_oATOM_CANFD_Matrix_CH_V600_202502_dd165c0d_Tx: CanIfTxPduCanId=546, CanIfTxPduCanIdType=STANDARD_FD_CAN, CanIfTxPduUserTxConfirmationName=PduR_CanIfTxConfirmation, CanIfTxPduUserTxConfirmationUL=PDUR, CanIfTxPduBufferRef=CanIfInitCfg/CHNL_785eea40, CanIfTxPduRef=EcucPduCollection/VCU_03_oATOM_CANFD_Matrix_CH_V600_202502_785f8119_Tx
        VCU_04_oATOM_CANFD_Matrix_CH_V600_202502_33342039_Tx: CanIfTxPduCanId=547, CanIfTxPduCanIdType=STANDARD_FD_CAN, CanIfTxPduUserTxConfirmationName=PduR_CanIfTxConfirmation, CanIfTxPduUserTxConfirmationUL=PDUR, CanIfTxPduBufferRef=CanIfInitCfg/CHNL_785eea40, CanIfTxPduRef=EcucPduCollection/VCU_04_oATOM_CANFD_Matrix_CH_V600_202502_5040169c_Tx
        VCU_AccPedal_oATOM_CANFD_Matrix_CH_V600_202502_6e926372_Tx: CanIfTxPduCanId=210, CanIfTxPduCanIdType=STANDARD_FD_CAN, CanIfTxPduUserTxConfirmationName=PduR_CanIfTxConfirmation, CanIfTxPduUserTxConfirmationUL=PDUR, CanIfTxPduBufferRef=CanIfInitCfg/CHNL_785eea40, CanIfTxPduRef=EcucPduCollection/VCU_AccPedal_oATOM_CANFD_Matrix_CH_V600_202502_3cf928f4_Tx
        VCU_BMS_oATOM_CANFD_Matrix_CH_V600_202502_f1d5756e_Tx: CanIfTxPduCanId=209, CanIfTxPduCanIdType=STANDARD_FD_CAN, CanIfTxPduUserTxConfirmationName=PduR_CanIfTxConfirmation, CanIfTxPduUserTxConfirmationUL=PDUR, CanIfTxPduBufferRef=CanIfInitCfg/CHNL_785eea40, CanIfTxPduRef=EcucPduCollection/VCU_BMS_oATOM_CANFD_Matrix_CH_V600_202502_8dd4382b_Tx
        VCU_Chassis_01_oATOM_CANFD_Matrix_CH_V600_202502_d9a729e3_Tx: CanIfTxPduCanId=211, CanIfTxPduCanIdType=STANDARD_FD_CAN, CanIfTxPduUserTxConfirmationName=PduR_CanIfTxConfirmation, CanIfTxPduUserTxConfirmationUL=PDUR, CanIfTxPduBufferRef=CanIfInitCfg/CHNL_785eea40, CanIfTxPduRef=EcucPduCollection/VCU_Chassis_01_oATOM_CANFD_Matrix_CH_V600_202502_e79830d3_Tx
        VCU_HMIsignals_01_oATOM_CANFD_Matrix_CH_V600_202502_d2142187_Tx: CanIfTxPduCanId=791, CanIfTxPduCanIdType=STANDARD_FD_CAN, CanIfTxPduUserTxConfirmationName=PduR_CanIfTxConfirmation, CanIfTxPduUserTxConfirmationUL=PDUR, CanIfTxPduBufferRef=CanIfInitCfg/CHNL_785eea40, CanIfTxPduRef=EcucPduCollection/VCU_HMIsignals_01_oATOM_CANFD_Matrix_CH_V600_202502_ad7bde1a_Tx
        VCU_HMIsignals_02_oATOM_CANFD_Matrix_CH_V600_202502_52710e60_Tx: CanIfTxPduCanId=792, CanIfTxPduCanIdType=STANDARD_FD_CAN, CanIfTxPduUserTxConfirmationName=PduR_CanIfTxConfirmation, CanIfTxPduUserTxConfirmationUL=PDUR, CanIfTxPduBufferRef=CanIfInitCfg/CHNL_785eea40, CanIfTxPduRef=EcucPduCollection/VCU_HMIsignals_02_oATOM_CANFD_Matrix_CH_V600_202502_343b3975_Tx
        VCU_IBS_01_oATOM_CANFD_Matrix_CH_V600_202502_7a39d019_Tx: CanIfTxPduCanId=148, CanIfTxPduCanIdType=STANDARD_FD_CAN, CanIfTxPduUserTxConfirmationName=PduR_CanIfTxConfirmation, CanIfTxPduUserTxConfirmationUL=PDUR, CanIfTxPduBufferRef=CanIfInitCfg/CHNL_785eea40, CanIfTxPduRef=EcucPduCollection/VCU_IBS_01_oATOM_CANFD_Matrix_CH_V600_202502_72f519e8_Tx
        VCU_MCU_03_oATOM_CANFD_Matrix_CH_V600_202502_033d9a67_Tx: CanIfTxPduCanId=149, CanIfTxPduCanIdType=STANDARD_FD_CAN, CanIfTxPduUserTxConfirmationName=PduR_CanIfTxConfirmation, CanIfTxPduUserTxConfirmationUL=PDUR, CanIfTxPduBufferRef=CanIfInitCfg/CHNL_785eea40, CanIfTxPduRef=EcucPduCollection/VCU_MCU_03_oATOM_CANFD_Matrix_CH_V600_202502_9c2fbb06_Tx
        VCU_PlugInChrgInfo_oATOM_CANFD_Matrix_CH_V600_202502_bd173cc2_Tx: CanIfTxPduCanId=913, CanIfTxPduCanIdType=STANDARD_FD_CAN, CanIfTxPduUserTxConfirmationName=PduR_CanIfTxConfirmation, CanIfTxPduUserTxConfirmationUL=PDUR, CanIfTxPduBufferRef=CanIfInitCfg/CHNL_785eea40, CanIfTxPduRef=EcucPduCollection/VCU_PlugInChrgInfo_oATOM_CANFD_Matrix_CH_V600_202502_f8a23add_Tx
        VCU_Tx_51Ch_NM_oTC37X_VCU_CAN00_560cc988_Tx: CanIfTxPduCanId=1308, CanIfTxPduCanIdType=STANDARD_CAN, CanIfTxPduUserTxConfirmationName=CanNm_TxConfirmation, CanIfTxPduUserTxConfirmationUL=CAN_NM, CanIfTxPduBufferRef=CanIfInitCfg/CHNL_d841867f, CanIfTxPduRef=EcucPduCollection/VCU_Tx_51Ch_NM_oTC37X_VCU_CAN00_0aa0ce62_Tx
        VCU_Tx_51Ch_NM_oTC37X_VCU_CAN01_587183bc_Tx: CanIfTxPduCanId=1308, CanIfTxPduCanIdType=STANDARD_CAN, CanIfTxPduUserTxConfirmationName=CanNm_TxConfirmation, CanIfTxPduUserTxConfirmationUL=CAN_NM, CanIfTxPduBufferRef=CanIfInitCfg/CHNL_131d55da, CanIfTxPduRef=EcucPduCollection/VCU_Tx_51Ch_NM_oTC37X_VCU_CAN01_9aba5863_Tx
        VCU_Tx_51Ch_NM_oTC37X_VCU_CAN03_448b17d4_Tx: CanIfTxPduCanId=1308, CanIfTxPduCanIdType=STANDARD_CAN, CanIfTxPduUserTxConfirmationName=CanNm_TxConfirmation, CanIfTxPduUserTxConfirmationUL=CAN_NM, CanIfTxPduBufferRef=CanIfInitCfg/CHNL_5ed5f4d1, CanIfTxPduRef=EcucPduCollection/VCU_Tx_51Ch_NM_oTC37X_VCU_CAN03_61fe7220_Tx
        VCU_Tx_51Ch_NM_oTC37X_VCU_CAN12_6b4cd41f_Tx: CanIfTxPduCanId=1308, CanIfTxPduCanIdType=STANDARD_CAN, CanIfTxPduUserTxConfirmationName=CanNm_TxConfirmation, CanIfTxPduUserTxConfirmationUL=CAN_NM, CanIfTxPduBufferRef=CanIfInitCfg/CHNL_33fe2cc0, CanIfTxPduRef=EcucPduCollection/VCU_Tx_51Ch_NM_oTC37X_VCU_CAN12_8673ce21_Tx
        VcuAdcTxG0Msg0_oTC37X_VCU_CAN01_fc783169_Tx: CanIfTxPduCanId=258, CanIfTxPduCanIdType=STANDARD_CAN, CanIfTxPduUserTxConfirmationName=PduR_CanIfTxConfirmation, CanIfTxPduUserTxConfirmationUL=PDUR, CanIfTxPduBufferRef=CanIfInitCfg/CHNL_131d55da, CanIfTxPduRef=EcucPduCollection/VcuAdcTxG0Msg0_oTC37X_VCU_CAN01_0847dbfd_Tx
        VcuAdcTxG0Msg1_oTC37X_VCU_CAN01_c296ace0_Tx: CanIfTxPduCanId=259, CanIfTxPduCanIdType=STANDARD_CAN, CanIfTxPduUserTxConfirmationName=PduR_CanIfTxConfirmation, CanIfTxPduUserTxConfirmationUL=PDUR, CanIfTxPduBufferRef=CanIfInitCfg/CHNL_131d55da, CanIfTxPduRef=EcucPduCollection/VcuAdcTxG0Msg1_oTC37X_VCU_CAN01_4f542d06_Tx
        VcuAdcTxG1Msg0_oTC37X_VCU_CAN01_987e20b2_Tx: CanIfTxPduCanId=260, CanIfTxPduCanIdType=STANDARD_CAN, CanIfTxPduUserTxConfirmationName=PduR_CanIfTxConfirmation, CanIfTxPduUserTxConfirmationUL=PDUR, CanIfTxPduBufferRef=CanIfInitCfg/CHNL_131d55da, CanIfTxPduRef=EcucPduCollection/VcuAdcTxG1Msg0_oTC37X_VCU_CAN01_613ed098_Tx
        VcuAdcTxG1Msg1_oTC37X_VCU_CAN01_a690bd3b_Tx: CanIfTxPduCanId=261, CanIfTxPduCanIdType=STANDARD_CAN, CanIfTxPduUserTxConfirmationName=PduR_CanIfTxConfirmation, CanIfTxPduUserTxConfirmationUL=PDUR, CanIfTxPduBufferRef=CanIfInitCfg/CHNL_131d55da, CanIfTxPduRef=EcucPduCollection/VcuAdcTxG1Msg1_oTC37X_VCU_CAN01_262d2663_Tx
        VcuAdcTxG2Msg0_oTC37X_VCU_CAN01_347412df_Tx: CanIfTxPduCanId=262, CanIfTxPduCanIdType=STANDARD_CAN, CanIfTxPduUserTxConfirmationName=PduR_CanIfTxConfirmation, CanIfTxPduUserTxConfirmationUL=PDUR, CanIfTxPduBufferRef=CanIfInitCfg/CHNL_131d55da, CanIfTxPduRef=EcucPduCollection/VcuAdcTxG2Msg0_oTC37X_VCU_CAN01_dab5cd37_Tx
        VcuAdcTxG2Msg1_oTC37X_VCU_CAN01_0a9a8f56_Tx: CanIfTxPduCanId=263, CanIfTxPduCanIdType=STANDARD_CAN, CanIfTxPduUserTxConfirmationName=PduR_CanIfTxConfirmation, CanIfTxPduUserTxConfirmationUL=PDUR, CanIfTxPduBufferRef=CanIfInitCfg/CHNL_131d55da, CanIfTxPduRef=EcucPduCollection/VcuAdcTxG2Msg1_oTC37X_VCU_CAN01_9da63bcc_Tx
        VcuAdcTxG3Msg0_oTC37X_VCU_CAN01_50720304_Tx: CanIfTxPduCanId=264, CanIfTxPduCanIdType=STANDARD_CAN, CanIfTxPduUserTxConfirmationName=PduR_CanIfTxConfirmation, CanIfTxPduUserTxConfirmationUL=PDUR, CanIfTxPduBufferRef=CanIfInitCfg/CHNL_131d55da, CanIfTxPduRef=EcucPduCollection/VcuAdcTxG3Msg0_oTC37X_VCU_CAN01_b3ccc652_Tx
        VcuAdcTxG3Msg1_oTC37X_VCU_CAN01_6e9c9e8d_Tx: CanIfTxPduCanId=265, CanIfTxPduCanIdType=STANDARD_CAN, CanIfTxPduUserTxConfirmationName=PduR_CanIfTxConfirmation, CanIfTxPduUserTxConfirmationUL=PDUR, CanIfTxPduBufferRef=CanIfInitCfg/CHNL_131d55da, CanIfTxPduRef=EcucPduCollection/VcuAdcTxG3Msg1_oTC37X_VCU_CAN01_f4df30a9_Tx
        VcuAdcTxG8Msg0_oTC37X_VCU_CAN01_6aaab333_Tx: CanIfTxPduCanId=266, CanIfTxPduCanIdType=STANDARD_CAN, CanIfTxPduUserTxConfirmationName=PduR_CanIfTxConfirmation, CanIfTxPduUserTxConfirmationUL=PDUR, CanIfTxPduBufferRef=CanIfInitCfg/CHNL_131d55da, CanIfTxPduRef=EcucPduCollection/VcuAdcTxG8Msg0_oTC37X_VCU_CAN01_f56d8c57_Tx
        VcuAdcTxG8Msg1_oTC37X_VCU_CAN01_54442eba_Tx: CanIfTxPduCanId=267, CanIfTxPduCanIdType=STANDARD_CAN, CanIfTxPduUserTxConfirmationName=PduR_CanIfTxConfirmation, CanIfTxPduUserTxConfirmationUL=PDUR, CanIfTxPduBufferRef=CanIfInitCfg/CHNL_131d55da, CanIfTxPduRef=EcucPduCollection/VcuAdcTxG8Msg1_oTC37X_VCU_CAN01_b27e7aac_Tx
        VcuAdcTxG8Msg2_oTC37X_VCU_CAN01_17778821_Tx: CanIfTxPduCanId=268, CanIfTxPduCanIdType=STANDARD_CAN, CanIfTxPduUserTxConfirmationName=PduR_CanIfTxConfirmation, CanIfTxPduUserTxConfirmationUL=PDUR, CanIfTxPduBufferRef=CanIfInitCfg/CHNL_131d55da, CanIfTxPduRef=EcucPduCollection/VcuAdcTxG8Msg2_oTC37X_VCU_CAN01_7b4a61a1_Tx
        VcuAdcTxG8Msg3_oTC37X_VCU_CAN01_299915a8_Tx: CanIfTxPduCanId=269, CanIfTxPduCanIdType=STANDARD_CAN, CanIfTxPduUserTxConfirmationName=PduR_CanIfTxConfirmation, CanIfTxPduUserTxConfirmationUL=PDUR, CanIfTxPduBufferRef=CanIfInitCfg/CHNL_131d55da, CanIfTxPduRef=EcucPduCollection/VcuAdcTxG8Msg3_oTC37X_VCU_CAN01_3c59975a_Tx
        VcuCan03TxMsg1_oTC37X_VCU_CAN03_b4f8e3c0_Tx: CanIfTxPduCanId=274, CanIfTxPduCanIdType=STANDARD_CAN, CanIfTxPduUserTxConfirmationName=PduR_CanIfTxConfirmation, CanIfTxPduUserTxConfirmationUL=PDUR, CanIfTxPduBufferRef=CanIfInitCfg/CHNL_5ed5f4d1, CanIfTxPduRef=EcucPduCollection/VcuCan03TxMsg1_oTC37X_VCU_CAN03_c0767973_Tx
        VcuCan03TxMsg2_oTC37X_VCU_CAN03_f7cb455b_Tx: CanIfTxPduCanId=275, CanIfTxPduCanIdType=STANDARD_CAN, CanIfTxPduUserTxConfirmationName=PduR_CanIfTxConfirmation, CanIfTxPduUserTxConfirmationUL=PDUR, CanIfTxPduBufferRef=CanIfInitCfg/CHNL_5ed5f4d1, CanIfTxPduRef=EcucPduCollection/VcuCan03TxMsg2_oTC37X_VCU_CAN03_0942627e_Tx
        VcuCan12TxMsg1_oTC37X_VCU_CAN12_a82524bb_Tx: CanIfTxPduCanId=53, CanIfTxPduCanIdType=STANDARD_CAN, CanIfTxPduUserTxConfirmationName=PduR_CanIfTxConfirmation, CanIfTxPduUserTxConfirmationUL=PDUR, CanIfTxPduBufferRef=CanIfInitCfg/CHNL_33fe2cc0, CanIfTxPduRef=EcucPduCollection/VcuCan12TxMsg1_oTC37X_VCU_CAN12_2c92f390_Tx
        VcuCan12TxMsg2_oTC37X_VCU_CAN12_eb168220_Tx: CanIfTxPduCanId=52, CanIfTxPduCanIdType=STANDARD_CAN, CanIfTxPduUserTxConfirmationName=PduR_CanIfTxConfirmation, CanIfTxPduUserTxConfirmationUL=PDUR, CanIfTxPduBufferRef=CanIfInitCfg/CHNL_33fe2cc0, CanIfTxPduRef=EcucPduCollection/VcuCan12TxMsg2_oTC37X_VCU_CAN12_e5a6e89d_Tx
        VcuMeasurementMsg0_oTC37X_VCU_CAN01_b3a7d237_Tx: CanIfTxPduCanId=273, CanIfTxPduCanIdType=STANDARD_CAN, CanIfTxPduUserTxConfirmationName=PduR_CanIfTxConfirmation, CanIfTxPduUserTxConfirmationUL=PDUR, CanIfTxPduBufferRef=CanIfInitCfg/CHNL_131d55da, CanIfTxPduRef=EcucPduCollection/VcuMeasurementMsg0_oTC37X_VCU_CAN01_d96481d0_Tx
        VcuTxIoMsg1_oTC37X_VCU_CAN00_644aaa1f_Tx: CanIfTxPduCanId=260, CanIfTxPduCanIdType=STANDARD_CAN, CanIfTxPduUserTxConfirmationName=PduR_CanIfTxConfirmation, CanIfTxPduUserTxConfirmationUL=PDUR, CanIfTxPduBufferRef=CanIfInitCfg/CHNL_d841867f, CanIfTxPduRef=EcucPduCollection/VcuTxIoMsg1_oTC37X_VCU_CAN00_869e33bc_Tx
        VcuTxIoMsg2_oTC37X_VCU_CAN00_0c9644c1_Tx: CanIfTxPduCanId=261, CanIfTxPduCanIdType=STANDARD_CAN, CanIfTxPduUserTxConfirmationName=PduR_CanIfTxConfirmation, CanIfTxPduUserTxConfirmationUL=PDUR, CanIfTxPduBufferRef=CanIfInitCfg/CHNL_d841867f, CanIfTxPduRef=EcucPduCollection/VcuTxIoMsg2_oTC37X_VCU_CAN00_4faa28b1_Tx
        VcuTxIoMsg3_oTC37X_VCU_CAN00_2b221e8b_Tx: CanIfTxPduCanId=262, CanIfTxPduCanIdType=STANDARD_CAN, CanIfTxPduUserTxConfirmationName=PduR_CanIfTxConfirmation, CanIfTxPduUserTxConfirmationUL=PDUR, CanIfTxPduBufferRef=CanIfInitCfg/CHNL_d841867f, CanIfTxPduRef=EcucPduCollection/VcuTxIoMsg3_oTC37X_VCU_CAN00_08b9de4a_Tx
        VcuTxIoMsg4_oTC37X_VCU_CAN00_dd2f997d_Tx: CanIfTxPduCanId=263, CanIfTxPduCanIdType=STANDARD_CAN, CanIfTxPduUserTxConfirmationName=PduR_CanIfTxConfirmation, CanIfTxPduUserTxConfirmationUL=PDUR, CanIfTxPduBufferRef=CanIfInitCfg/CHNL_d841867f, CanIfTxPduRef=EcucPduCollection/VcuTxIoMsg4_oTC37X_VCU_CAN00_06b318ea_Tx
        VcuTxIoMsg5_oTC37X_VCU_CAN00_fa9bc337_Tx: CanIfTxPduCanId=264, CanIfTxPduCanIdType=STANDARD_CAN, CanIfTxPduUserTxConfirmationName=PduR_CanIfTxConfirmation, CanIfTxPduUserTxConfirmationUL=PDUR, CanIfTxPduBufferRef=CanIfInitCfg/CHNL_d841867f, CanIfTxPduRef=EcucPduCollection/VcuTxIoMsg5_oTC37X_VCU_CAN00_41a0ee11_Tx
        VcuTxIoMsg6_oTC37X_VCU_CAN00_92472de9_Tx: CanIfTxPduCanId=265, CanIfTxPduCanIdType=STANDARD_CAN, CanIfTxPduUserTxConfirmationName=PduR_CanIfTxConfirmation, CanIfTxPduUserTxConfirmationUL=PDUR, CanIfTxPduBufferRef=CanIfInitCfg/CHNL_d841867f, CanIfTxPduRef=EcucPduCollection/VcuTxIoMsg6_oTC37X_VCU_CAN00_8894f51c_Tx
        VcuTxIoMsg7_oTC37X_VCU_CAN00_b5f377a3_Tx: CanIfTxPduCanId=266, CanIfTxPduCanIdType=STANDARD_CAN, CanIfTxPduUserTxConfirmationName=PduR_CanIfTxConfirmation, CanIfTxPduUserTxConfirmationUL=PDUR, CanIfTxPduBufferRef=CanIfInitCfg/CHNL_d841867f, CanIfTxPduRef=EcucPduCollection/VcuTxIoMsg7_oTC37X_VCU_CAN00_cf8703e7_Tx
        VcuTxIoMsg8_oTC37X_VCU_CAN00_a52d2444_Tx: CanIfTxPduCanId=267, CanIfTxPduCanIdType=STANDARD_CAN, CanIfTxPduUserTxConfirmationName=PduR_CanIfTxConfirmation, CanIfTxPduUserTxConfirmationUL=PDUR, CanIfTxPduBufferRef=CanIfInitCfg/CHNL_d841867f, CanIfTxPduRef=EcucPduCollection/VcuTxIoMsg8_oTC37X_VCU_CAN00_9481785c_Tx
        VcuTxMsg1_oTC37X_VCU_CAN00_78140f53_Tx: CanIfTxPduCanId=256, CanIfTxPduCanIdType=STANDARD_CAN, CanIfTxPduUserTxConfirmationName=PduR_CanIfTxConfirmation, CanIfTxPduUserTxConfirmationUL=PDUR, CanIfTxPduBufferRef=CanIfInitCfg/CHNL_d841867f, CanIfTxPduRef=EcucPduCollection/VcuTxMsg1_oTC37X_VCU_CAN00_c82dd125_Tx
        VcuTxMsg2_oTC37X_VCU_CAN00_674a89a8_Tx: CanIfTxPduCanId=257, CanIfTxPduCanIdType=STANDARD_CAN, CanIfTxPduUserTxConfirmationName=PduR_CanIfTxConfirmation, CanIfTxPduUserTxConfirmationUL=PDUR, CanIfTxPduBufferRef=CanIfInitCfg/CHNL_d841867f, CanIfTxPduRef=EcucPduCollection/VcuTxMsg2_oTC37X_VCU_CAN00_0119ca28_Tx
        Vcu_Uds_Response_Tp_oTC37X_VCU_CAN00_2ff8982b_Tx: CanIfTxPduCanId=1921, CanIfTxPduCanIdType=STANDARD_CAN, CanIfTxPduUserTxConfirmationName=CanTp_TxConfirmation, CanIfTxPduUserTxConfirmationUL=CAN_TP, CanIfTxPduBufferRef=CanIfInitCfg/CHNL_d841867f, CanIfTxPduRef=Vcu_Uds_Response_Tp_oTC37X_VCU_CAN00_834178f3_Tx
        XCP_Response_oTC37X_VCU_CAN00_933a9e7a_Tx: CanIfTxPduCanId=1543, CanIfTxPduCanIdType=STANDARD_CAN, CanIfTxPduUserTxConfirmationName=Xcp_CanIfTxConfirmation, CanIfTxPduUserTxConfirmationUL=XCP, CanIfTxPduBufferRef=CanIfInitCfg/CHNL_d841867f, CanIfTxPduRef=EcucPduCollection/XCP_Response_oTC37X_VCU_CAN00_34d2da2d_Tx
    CanIfPrivateCfg: CanIfPrivateSoftwareFilterType=LINEAR
    CanIfPublicCfg: CanIfPublicPnSupport=false
  module config CanNm
    CanNmGlobalConfig: CanNmPnEiraCalcEnabled=false, CanNmUserDataEnabled=true
      5 x CanNmChannelConfig, all with CanNmMsgCycleOffset=0, CanNmMsgCycleTime=0.5, CanNmMsgReducedTime=0.32, CanNmNodeId=28, CanNmRepeatMessageTime=1.5, CanNmTimeoutTime=2, CanNmUserDataLength=6, CanNmWaitBusSleepTime=2:
        ATOM_CANFD_Matrix_CH_V600_202502_CAN_b5bd2095: CanNmComMNetworkHandleRef=ComMConfigSet/CN_ATOM_CANFD_Matrix_CH_V600_202502_a4d436ac
          ATOM_CANFD_Matrix_CH_V600_202502_CAN_b5bd2095_Rx (CanNmRxPdu): CanNmRxPduRef=VCU_3966faea_Rx
          NM_VCU_oATOM_CANFD_Matrix_CH_V600_202502_7321f2c3_Tx (CanNmTxPdu): CanNmTxPduRef=EcucPduCollection/NM_VCU_oATOM_CANFD_Matrix_CH_V600_202502_7321f2c3_Tx
        TC37X_VCU_CAN00_CAN_cc8c31fa: CanNmComMNetworkHandleRef=ComMConfigSet/CN_TC37X_VCU_CAN00_07b6c9c8
          VCU_Tx_51Ch_NM_oTC37X_VCU_CAN00_0aa0ce62_Tx (CanNmTxPdu): CanNmTxPduRef=EcucPduCollection/VCU_Tx_51Ch_NM_oTC37X_VCU_CAN00_0aa0ce62_Tx
        TC37X_VCU_CAN01_CAN_f1ec184a: CanNmComMNetworkHandleRef=ComMConfigSet/CN_TC37X_VCU_CAN01_70b1f95e
          VCU_Tx_51Ch_NM_oTC37X_VCU_CAN01_9aba5863_Tx (CanNmTxPdu): CanNmTxPduRef=EcucPduCollection/VCU_Tx_51Ch_NM_oTC37X_VCU_CAN01_9aba5863_Tx
        TC37X_VCU_CAN03_CAN_8b2c4b2a: CanNmComMNetworkHandleRef=ComMConfigSet/CN_TC37X_VCU_CAN03_9ebf9872
          VCU_Tx_51Ch_NM_oTC37X_VCU_CAN03_61fe7220_Tx (CanNmTxPdu): CanNmTxPduRef=EcucPduCollection/VCU_Tx_51Ch_NM_oTC37X_VCU_CAN03_61fe7220_Tx
        TC37X_VCU_CAN12_CAN_7d10b13f: CanNmComMNetworkHandleRef=ComMConfigSet/CN_TC37X_VCU_CAN12_f0a399a5
          VCU_Tx_51Ch_NM_oTC37X_VCU_CAN12_8673ce21_Tx (CanNmTxPdu): CanNmTxPduRef=EcucPduCollection/VCU_Tx_51Ch_NM_oTC37X_VCU_CAN12_8673ce21_Tx
  module config CanSM
    CanSMConfiguration
      5 x CanSMManagerNetwork:
        CHNL_131d55da: CanSMComMNetworkHandleRef=ComMConfigSet/CN_TC37X_VCU_CAN01_70b1f95e
          CT_TC37X_VCU_CAN01_9a653c82 (CanSMController): CanSMControllerId=CanIfCtrlDrvCfg_7d254554/CT_TC37X_VCU_CAN01_55ccbf7a
        CHNL_33fe2cc0: CanSMComMNetworkHandleRef=ComMConfigSet/CN_TC37X_VCU_CAN12_f0a399a5
          CT_TC37X_VCU_CAN12_58747941 (CanSMController): CanSMControllerId=CanIfCtrlDrvCfg_7d254554/CT_TC37X_VCU_CAN12_d5dedf81
        CHNL_5ed5f4d1: CanSMComMNetworkHandleRef=ComMConfigSet/CN_TC37X_VCU_CAN03_9ebf9872
          CT_TC37X_VCU_CAN03_ca624c2b (CanSMController): CanSMControllerId=CanIfCtrlDrvCfg_7d254554/CT_TC37X_VCU_CAN03_bbc2de56
        CHNL_785eea40: CanSMComMNetworkHandleRef=ComMConfigSet/CN_ATOM_CANFD_Matrix_CH_V600_202502_a4d436ac
          CT_ATOM_CANFD_Matrix_CH_V600_202502_c1a25aaa (CanSMController): CanSMControllerId=CanIfCtrlDrvCfg_7d254554/CT_ATOM_CANFD_Matrix_CH_V600_202502_37050292
        CHNL_d841867f: CanSMComMNetworkHandleRef=ComMConfigSet/CN_TC37X_VCU_CAN00_07b6c9c8
          CT_TC37X_VCU_CAN00_5fde07f6 (CanSMController): CanSMControllerId=CanIfCtrlDrvCfg_7d254554/CT_TC37X_VCU_CAN00_22cb8fec
  module config CanTp
    CanTpConfig: CanTpMainFunctionPeriod=0.005
      TPCH_1341a116 (CanTpChannel): CanTpChannelMode=CANTP_MODE_FULL_DUPLEX
        CanTpRxNSdu_fe7a15ff (CanTpRxNSdu):
          CanTpRxAddressingFormat = CANTP_STANDARD
          CanTpRxDl = 8
          CanTpRxTaType = CANTP_PHYSICAL
          CanTpRxNSduRef = EcucPduCollection/Vcu_Uds_Phy_Request_oTC37X_VCU_CAN00_16119f6f_Rx
          CanTpRxNPdu_63ec38a0 (CanTpRxNPdu): CanTpRxNPduRef=Vcu_Uds_Phy_Request_Tp_oTC37X_VCU_CAN00_58c52463_Rx
          CanTpTxFcNPdu_63ec38a0 (CanTpTxFcNPdu): CanTpTxFcNPduRef=Vcu_Uds_Response_Tp_oTC37X_VCU_CAN00_834178f3_Tx
        CanTpTxNSdu_fe7a15ff (CanTpTxNSdu):
          CanTpTxAddressingFormat = CANTP_STANDARD
          CanTpTxDl = 8
          CanTpTxTaType = CANTP_PHYSICAL
          CanTpTxNSduRef = EcucPduCollection/Vcu_Uds_Response_oTC37X_VCU_CAN00_39638a1a_Tx
          CanTpRxFcNPdu_4116ec52 (CanTpRxFcNPdu): CanTpRxFcNPduRef=Vcu_Uds_Phy_Request_Tp_oTC37X_VCU_CAN00_58c52463_Rx
          CanTpTxNPdu_4116ec52 (CanTpTxNPdu): CanTpTxNPduRef=Vcu_Uds_Response_Tp_oTC37X_VCU_CAN00_834178f3_Tx
      TPCH_d230b3ef (CanTpChannel): CanTpChannelMode=CANTP_MODE_FULL_DUPLEX
        CanTpRxNSdu_c12348c5 (CanTpRxNSdu):
          CanTpRxAddressingFormat = CANTP_STANDARD
          CanTpRxDl = 8
          CanTpRxTaType = CANTP_FUNCTIONAL
          CanTpRxNSduRef = EcucPduCollection/Vcu_Uds_Func_Request_oTC37X_VCU_CAN00_455d4346_Rx
          CanTpRxNPdu_257d590c (CanTpRxNPdu): CanTpRxNPduRef=Vcu_Uds_Func_Request_Tp_oTC37X_VCU_CAN00_3dbedef7_Rx
