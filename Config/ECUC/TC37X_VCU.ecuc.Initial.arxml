[part 3 of 3: package /InitialEcuC]
AUTOSAR XML (schema 00048)
package /InitialEcuC  (continued)
  module config ComM
    ComMConfigSet: ComMPncEnabled=false
      7 x ComMChannel:
        CN_ATOM_CANFD_Matrix_CH_V600_202502_a4d436ac: ComMBusType=COMM_BUS_TYPE_CAN, ComMChannelId=0
          ComMNetworkManagement: ComMNmVariant=FULL
          CN_ATOM_CANFD_Matrix_CH_V600_202502_1a7e52a0 (ComMUserPerChannel): ComMUserChannel=CN_ATOM_CANFD_Matrix_CH_V600_202502_15d11ab0
        CN_LIN00_b12a0454: ComMBusType=COMM_BUS_TYPE_LIN, ComMChannelId=5
          ComMNetworkManagement: ComMNmVariant=NONE
          CN_LIN00_8453a76d (ComMUserPerChannel): ComMUserChannel=CN_LIN00_984dfd9e
        CN_LIN01_c62d34c2: ComMBusType=COMM_BUS_TYPE_LIN, ComMChannelId=6
          ComMNetworkManagement: ComMNmVariant=NONE
          CN_LIN01_e1349c2b (ComMUserPerChannel): ComMUserChannel=CN_LIN01_778f96a0
        CN_TC37X_VCU_CAN00_07b6c9c8: ComMBusType=COMM_BUS_TYPE_CAN, ComMChannelId=1
          ComMNetworkManagement: ComMNmVariant=FULL
          CN_TC37X_VCU_CAN00_cc35f66d (ComMUserPerChannel): ComMUserChannel=CN_TC37X_VCU_CAN00_b1b4f272
        CN_TC37X_VCU_CAN01_70b1f95e: ComMBusType=COMM_BUS_TYPE_CAN, ComMChannelId=2
          ComMNetworkManagement: ComMNmVariant=FULL
          CN_TC37X_VCU_CAN01_a952cd2b (ComMUserPerChannel): ComMUserChannel=CN_TC37X_VCU_CAN01_5e76994c
        CN_TC37X_VCU_CAN03_9ebf9872: ComMBusType=COMM_BUS_TYPE_CAN, ComMChannelId=3
          ComMNetworkManagement: ComMNmVariant=FULL
          CN_TC37X_VCU_CAN03_639cbba7 (ComMUserPerChannel): ComMUserChannel=CN_TC37X_VCU_CAN03_5a834971
        CN_TC37X_VCU_CAN12_f0a399a5: ComMBusType=COMM_BUS_TYPE_CAN, ComMChannelId=4
          ComMNetworkManagement: ComMNmVariant=FULL
          CN_TC37X_VCU_CAN12_9921037f (ComMUserPerChannel): ComMUserChannel=CN_TC37X_VCU_CAN12_74cffd8f
      7 x ComMUser:
        CN_ATOM_CANFD_Matrix_CH_V600_202502_15d11ab0: ComMUserIdentifier=0
        CN_LIN00_984dfd9e: ComMUserIdentifier=5
        CN_LIN01_778f96a0: ComMUserIdentifier=6
        CN_TC37X_VCU_CAN00_b1b4f272: ComMUserIdentifier=1
        CN_TC37X_VCU_CAN01_5e76994c: ComMUserIdentifier=2
        CN_TC37X_VCU_CAN03_5a834971: ComMUserIdentifier=3
        CN_TC37X_VCU_CAN12_74cffd8f: ComMUserIdentifier=4
    ComMGeneral: ComMPncIdCounting=COMM_PNC_ID_COUNT_FROM_NM_MESSAGE, ComMPncSupport=false
  module config Dcm
    DcmConfigSet  # Diagnostics Data Import
      DcmDsl
        DcmDslProtocol
          DcmDslProtocolRow_29812fbf (DcmDslProtocolRow)
            DcmDslConnection_15e709a3 (DcmDslConnection)
              DcmDslMainConnection_f109a58a (DcmDslMainConnection)
                Vcu_Uds_Func_Request_oTC37X_VCU_CAN00_21e26bac_Rx_f99a7a58 (DcmDslProtocolRx):
                  DcmDslProtocolRxAddrType = DCM_FUNCTIONAL_TYPE
                  DcmDslProtocolRxPduId = 1
                  DcmDslProtocolRxComMChannelRef = ComMConfigSet/CN_TC37X_VCU_CAN00_07b6c9c8
                  DcmDslProtocolRxPduRef = Vcu_Uds_Func_Request_oTC37X_VCU_CAN00_21e26bac_Rx
                Vcu_Uds_Phy_Request_oTC37X_VCU_CAN00_d561dcee_Rx_7ba0ca16 (DcmDslProtocolRx):
                  DcmDslProtocolRxAddrType = DCM_PHYSICAL_TYPE
                  DcmDslProtocolRxPduId = 2
                  DcmDslProtocolRxComMChannelRef = ComMConfigSet/CN_TC37X_VCU_CAN00_07b6c9c8
                  DcmDslProtocolRxPduRef = Vcu_Uds_Phy_Request_oTC37X_VCU_CAN00_d561dcee_Rx
                Vcu_Uds_Response_oTC37X_VCU_CAN00_4d111be6_Tx_666acd3e (DcmDslProtocolTx): DcmDslTxConfirmationPduId=0, DcmDslProtocolTxPduRef=EcucPduCollection/Vcu_Uds_Response_oTC37X_VCU_CAN00_4d111be6_Tx
      DcmDsp: DcmDspMaxDidToRead=5  # Diagnostics Data Import
        ComControl (DcmDspComControl)  # Diagnostics Data Import
          DspComContolAllChannel (DcmDspComControlAllChannel)  # Diagnostics Data Import
        DcmDspSession  # Diagnostics Data Import
          3 x DcmDspSessionRow, all with DcmDspSessionP2ServerMax=0.05, DcmDspSessionP2StarServerMax=5:
            Extended: DcmDspSessionLevel=3, DcmDspSessionForBoot=DCM_NO_BOOT  # Diagnostics Data Import
            Programming: DcmDspSessionLevel=2  # Diagnostics Data Import
            Default: DcmDspSessionLevel=1, DcmDspSessionForBoot=DCM_NO_BOOT  # Diagnostics Data Import
        DcmDspSecurity  # Diagnostics Data Import
          Level_3 (DcmDspSecurityRow):  # Diagnostics Data Import
            DcmDspSecurityADRSize = 2
            DcmDspSecurityDelayTime = 10
            DcmDspSecurityDelayTimeOnBoot = 0
            DcmDspSecurityKeySize = 2
            DcmDspSecurityLevel = 2
            DcmDspSecurityNumAttDelay = 3
            DcmDspSecuritySeedSize = 2
          UnlockedL1 (DcmDspSecurityRow):  # Diagnostics Data Import
            DcmDspSecurityDelayTime = 10
            DcmDspSecurityDelayTimeOnBoot = 0
            DcmDspSecurityKeySize = 4
            DcmDspSecurityLevel = 1
            DcmDspSecurityNumAttDelay = 3
            DcmDspSecuritySeedSize = 4
        RoutineInfo_Vcu_Roution_00 (DcmDspRoutineInfo)  # Diagnostics Data Import
          DcmDspRoutineRequestResOut  # Diagnostics Data Import
            Out_New_Data_Object (DcmDspRoutineRequestResOutSignal): DcmDspRoutineSignalLength=16, DcmDspRoutineSignalType=UINT16, DcmDspRoutineSignalEndianness=BIG_ENDIAN, DcmDspRoutineSignalPos=0  # Diagnostics Data Import
          DcmDspRoutineStopOut  # Diagnostics Data Import
            Out_New_Data_Object (DcmDspRoutineStopOutSignal): DcmDspRoutineSignalLength=16, DcmDspRoutineSignalType=UINT16, DcmDspRoutineSignalEndianness=BIG_ENDIAN, DcmDspRoutineSignalPos=0  # Diagnostics Data Import
          DcmDspRoutineStopIn  # Diagnostics Data Import
            In_New_Data_Object (DcmDspRoutineStopInSignal): DcmDspRoutineSignalLength=16, DcmDspRoutineSignalType=UINT16, DcmDspRoutineSignalEndianness=BIG_ENDIAN, DcmDspRoutineSignalPos=0  # Diagnostics Data Import
          DcmDspStartRoutineOut  # Diagnostics Data Import
            Out_New_Data_Object (DcmDspStartRoutineOutSignal): DcmDspRoutineSignalLength=16, DcmDspRoutineSignalType=UINT16, DcmDspRoutineSignalEndianness=BIG_ENDIAN, DcmDspRoutineSignalPos=0  # Diagnostics Data Import
          DcmDspStartRoutineIn  # Diagnostics Data Import
            In_New_Data_Object (DcmDspStartRoutineInSignal): DcmDspRoutineSignalLength=16, DcmDspRoutineSignalType=UINT16, DcmDspRoutineSignalEndianness=BIG_ENDIAN, DcmDspRoutineSignalPos=0  # Diagnostics Data Import
          DcmDspRoutineAuthorization: DcmDspRoutineSessionRef=DcmDspSession/Programming, DcmDspRoutineSessionRef=DcmDspSession/Extended  # Diagnostics Data Import
        RoutineInfo_New_Routine_Control (DcmDspRoutineInfo)  # Diagnostics Data Import
          DcmDspRoutineAuthorization: DcmDspRoutineSessionRef=DcmDspSession/Programming, DcmDspRoutineSessionRef=DcmDspSession/Extended  # Diagnostics Data Import
        Vcu_Roution_00 (DcmDspRoutine):  # Diagnostics Data Import
          DcmDspRequestResultsRoutineSupported = true
          DcmDspStopRoutineSupported = true
          DcmDspRoutineIdentifier = 261
          DcmDspRoutineInfoRef = RoutineInfo_Vcu_Roution_00
        New_Routine_Control (DcmDspRoutine):  # Diagnostics Data Import
          DcmDspRequestResultsRoutineSupported = false
          DcmDspStopRoutineSupported = false
          DcmDspRoutineIdentifier = 256
          DcmDspRoutineInfoRef = RoutineInfo_New_Routine_Control
        18 x DcmDspDidInfo:
          DidInfo_New_Dynamically_Define_Non_Periodic_Data: DcmDspDidDynamicallyDefined=true  # Diagnostics Data Import
            DcmDspDidAccess  # Diagnostics Data Import
              DcmDspDidDefine: DcmDspDDDidMaxElements=5  # Diagnostics Data Import
              DcmDspDidRead  # Diagnostics Data Import
          DidInfo_DID_0xF1A3  # Diagnostics Data Import
            DcmDspDidAccess  # Diagnostics Data Import
              DcmDspDidWrite  # Diagnostics Data Import
              DcmDspDidRead  # Diagnostics Data Import
          DidInfo_DID_0xF1A2  # Diagnostics Data Import
            DcmDspDidAccess  # Diagnostics Data Import
              DcmDspDidWrite  # Diagnostics Data Import
              DcmDspDidRead  # Diagnostics Data Import
          DidInfo_DID_0xF1A1  # Diagnostics Data Import
            DcmDspDidAccess  # Diagnostics Data Import
              DcmDspDidWrite  # Diagnostics Data Import
              DcmDspDidRead  # Diagnostics Data Import
          DidInfo_DID_0xF1A0  # Diagnostics Data Import
            DcmDspDidAccess  # Diagnostics Data Import
              DcmDspDidWrite  # Diagnostics Data Import
              DcmDspDidRead  # Diagnostics Data Import
          DidInfo_DID_0xF194_1  # Diagnostics Data Import
            DcmDspDidAccess  # Diagnostics Data Import
              DcmDspDidWrite  # Diagnostics Data Import
              DcmDspDidRead  # Diagnostics Data Import
          DidInfo_Hardware_Version  # Diagnostics Data Import
            DcmDspDidAccess  # Diagnostics Data Import
              DcmDspDidWrite  # Diagnostics Data Import
              DcmDspDidRead  # Diagnostics Data Import
          DidInfo_Vehicle_Identification  # Diagnostics Data Import
            DcmDspDidAccess  # Diagnostics Data Import
              DcmDspDidWrite  # Diagnostics Data Import
              DcmDspDidRead  # Diagnostics Data Import
          DidInfo_SerialNumber  # Diagnostics Data Import
            DcmDspDidAccess  # Diagnostics Data Import
              DcmDspDidWrite  # Diagnostics Data Import
              DcmDspDidRead  # Diagnostics Data Import
          DidInfo_EcuIdentification  # Diagnostics Data Import
            DcmDspDidAccess  # Diagnostics Data Import
              DcmDspDidWrite  # Diagnostics Data Import
              DcmDspDidRead  # Diagnostics Data Import
          DidInfo_Spare_Part_Number  # Diagnostics Data Import
            DcmDspDidAccess  # Diagnostics Data Import
              DcmDspDidWrite  # Diagnostics Data Import
              DcmDspDidRead  # Diagnostics Data Import
          DidInfo_Boot_Software  # Diagnostics Data Import
            DcmDspDidAccess  # Diagnostics Data Import
              DcmDspDidWrite  # Diagnostics Data Import
              DcmDspDidRead  # Diagnostics Data Import
          DidInfo_VCU_DID_00  # Diagnostics Data Import
            DcmDspDidAccess  # Diagnostics Data Import
              DcmDspDidWrite  # Diagnostics Data Import
              DcmDspDidRead  # Diagnostics Data Import
          DidInfo_DID_0x0400  # Diagnostics Data Import
            DcmDspDidAccess  # Diagnostics Data Import
              DcmDspDidRead  # Diagnostics Data Import
          DidInfo_DID_0x0300  # Diagnostics Data Import
            DcmDspDidAccess  # Diagnostics Data Import
              DcmDspDidRead  # Diagnostics Data Import
              DcmDspDidControl:  # Diagnostics Data Import
                DcmDspDidFreezeCurrentState = true
                DcmDspDidResetToDefault = true
                DcmDspDidReturnControlToEcu = true
                DcmDspDidShortTermAdjustment = true
                DcmDspDidControlSessionRef = DcmDspSession/Extended
          DidInfo_DID_0x0200  # Diagnostics Data Import
            DcmDspDidAccess  # Diagnostics Data Import
              DcmDspDidWrite  # Diagnostics Data Import
              DcmDspDidRead  # Diagnostics Data Import
          DidInfo_DataDiagnosticIdentifier_DDI  # Diagnostics Data Import
            DcmDspDidAccess  # Diagnostics Data Import
              DcmDspDidWrite  # Diagnostics Data Import
              DcmDspDidRead  # Diagnostics Data Import
          DidInfo_DevelopmentData  # Diagnostics Data Import
            DcmDspDidAccess  # Diagnostics Data Import
              DcmDspDidWrite  # Diagnostics Data Import
              DcmDspDidRead  # Diagnostics Data Import
        18 x DcmDspDid:
          New_Dynamically_Define_Non_Periodic_Data: DcmDspDidIdentifier=62208, DcmDspDidInfoRef=DidInfo_New_Dynamically_Define_Non_Periodic_Data  # Diagnostics Data Import
          DID_0xF1A3: DcmDspDidIdentifier=61859, DcmDspDidInfoRef=DidInfo_DID_0xF1A3  # Diagnostics Data Import
            F1A3_Data (DcmDspDidSignal): DcmDspDidDataPos=0, DcmDspDidDataRef=DID_0xF1A3_F1A3_Data  # Diagnostics Data Import
          DID_0xF1A2: DcmDspDidIdentifier=61858, DcmDspDidInfoRef=DidInfo_DID_0xF1A2  # Diagnostics Data Import
            F1A2_Data (DcmDspDidSignal): DcmDspDidDataPos=0, DcmDspDidDataRef=DID_0xF1A2_F1A2_Data  # Diagnostics Data Import
          DID_0xF1A1: DcmDspDidIdentifier=61857, DcmDspDidInfoRef=DidInfo_DID_0xF1A1  # Diagnostics Data Import
            F1A1_Data (DcmDspDidSignal): DcmDspDidDataPos=0, DcmDspDidDataRef=DID_0xF1A1_F1A1_Data  # Diagnostics Data Import
          DID_0xF1A0: DcmDspDidIdentifier=61856, DcmDspDidInfoRef=DidInfo_DID_0xF1A0  # Diagnostics Data Import
            F1A0_Data (DcmDspDidSignal): DcmDspDidDataPos=0, DcmDspDidDataRef=DID_0xF1A0_F1A0_Data  # Diagnostics Data Import
          DID_0xF194_1: DcmDspDidIdentifier=61844, DcmDspDidInfoRef=DidInfo_DID_0xF194_1  # Diagnostics Data Import
            New_Data_Object (DcmDspDidSignal): DcmDspDidDataPos=0, DcmDspDidDataRef=DID_0xF194_1_New_Data_Object  # Diagnostics Data Import
          Hardware_Version: DcmDspDidIdentifier=61843, DcmDspDidInfoRef=DidInfo_Hardware_Version  # Diagnostics Data Import
            Hardware_Version_Number (DcmDspDidSignal): DcmDspDidDataPos=0, DcmDspDidDataRef=Hardware_Version_Hardware_Version_Number  # Diagnostics Data Import
          Vehicle_Identification: DcmDspDidIdentifier=61840, DcmDspDidInfoRef=DidInfo_Vehicle_Identification  # Diagnostics Data Import
            VIN (DcmDspDidSignal): DcmDspDidDataPos=0, DcmDspDidDataRef=Vehicle_Identification_VIN  # Diagnostics Data Import
          SerialNumber: DcmDspDidIdentifier=61836, DcmDspDidInfoRef=DidInfo_SerialNumber  # Diagnostics Data Import
            SerialNumber (DcmDspDidSignal): DcmDspDidDataPos=0, DcmDspDidDataRef=SerialNumber_SerialNumber  # Diagnostics Data Import
          EcuIdentification: DcmDspDidIdentifier=61833, DcmDspDidInfoRef=DidInfo_EcuIdentification  # Diagnostics Data Import
            Part_Number (DcmDspDidSignal): DcmDspDidDataPos=0, DcmDspDidDataRef=EcuIdentification_Part_Number  # Diagnostics Data Import
          Spare_Part_Number: DcmDspDidIdentifier=61831, DcmDspDidInfoRef=DidInfo_Spare_Part_Number  # Diagnostics Data Import
            Spare_Part_Number (DcmDspDidSignal): DcmDspDidDataPos=0, DcmDspDidDataRef=Spare_Part_Number_Spare_Part_Number  # Diagnostics Data Import
          Boot_Software: DcmDspDidIdentifier=61824, DcmDspDidInfoRef=DidInfo_Boot_Software  # Diagnostics Data Import
            Boot_Software_Identification (DcmDspDidSignal): DcmDspDidDataPos=8, DcmDspDidDataRef=Boot_Software_Boot_Software_Identification  # Diagnostics Data Import
            NumberOfModules (DcmDspDidSignal): DcmDspDidDataPos=0, DcmDspDidDataRef=Boot_Software_NumberOfModules  # Diagnostics Data Import
          VCU_DID_00: DcmDspDidIdentifier=4132, DcmDspDidInfoRef=DidInfo_VCU_DID_00  # Diagnostics Data Import
            DataRecord (DcmDspDidSignal): DcmDspDidDataPos=0, DcmDspDidDataRef=VCU_DID_00_DataRecord  # Diagnostics Data Import
          DID_0x0400: DcmDspDidIdentifier=1024, DcmDspDidInfoRef=DidInfo_DID_0x0400  # Diagnostics Data Import
            DID_Data (DcmDspDidSignal): DcmDspDidDataPos=0, DcmDspDidDataRef=DID_0x0400_DID_Data  # Diagnostics Data Import
          DID_0x0300: DcmDspDidIdentifier=768, DcmDspDidInfoRef=DidInfo_DID_0x0300  # Diagnostics Data Import
            DID_Data (DcmDspDidSignal): DcmDspDidDataPos=0, DcmDspDidDataRef=DID_0x0300_DID_Data  # Diagnostics Data Import
          DID_0x0200: DcmDspDidIdentifier=512, DcmDspDidInfoRef=DidInfo_DID_0x0200  # Diagnostics Data Import
            Data (DcmDspDidSignal): DcmDspDidDataPos=0, DcmDspDidDataRef=DID_0x0200_Data  # Diagnostics Data Import
          DataDiagnosticIdentifier_DDI: DcmDspDidIdentifier=257, DcmDspDidInfoRef=DidInfo_DataDiagnosticIdentifier_DDI  # Diagnostics Data Import
            DataDiagnosticIdentifier (DcmDspDidSignal): DcmDspDidDataPos=0, DcmDspDidDataRef=DataDiagnosticIdentifier_DDI_DataDiagnosticIdentifier  # Diagnostics Data Import
          DevelopmentData: DcmDspDidIdentifier=256, DcmDspDidInfoRef=DidInfo_DevelopmentData  # Diagnostics Data Import
            5 x DcmDspDidSignal:
              TransportLayerVersion: DcmDspDidDataPos=64, DcmDspDidDataRef=DevelopmentData_TransportLayerVersion  # Diagnostics Data Import
              DiagnosticModuleVersion: DcmDspDidDataPos=48, DcmDspDidDataRef=DevelopmentData_DiagnosticModuleVersion  # Diagnostics Data Import
              NmVersion: DcmDspDidDataPos=32, DcmDspDidDataRef=DevelopmentData_NmVersion  # Diagnostics Data Import
              CanDriverVersion: DcmDspDidDataPos=16, DcmDspDidDataRef=DevelopmentData_CanDriverVersion  # Diagnostics Data Import
              OperatingSystemVersion: DcmDspDidDataPos=0, DcmDspDidDataRef=DevelopmentData_OperatingSystemVersion  # Diagnostics Data Import
        DataInfo_DID_0xF1A3_F1A3_Data (DcmDspDataInfo): DcmDspDataFixedLength=true  # Diagnostics Data Import
        DID_0xF1A3_F1A3_Data (DcmDspData): DcmDspDataSize=16, DcmDspDataType=UINT16, DcmDspDataInfoRef=DataInfo_DID_0xF1A3_F1A3_Data  # Diagnostics Data Import
        DataInfo_DID_0xF1A2_F1A2_Data (DcmDspDataInfo): DcmDspDataFixedLength=true  # Diagnostics Data Import
        DID_0xF1A2_F1A2_Data (DcmDspData): DcmDspDataSize=16, DcmDspDataType=UINT16, DcmDspDataInfoRef=DataInfo_DID_0xF1A2_F1A2_Data  # Diagnostics Data Import
        DataInfo_DID_0xF1A1_F1A1_Data (DcmDspDataInfo): DcmDspDataFixedLength=true  # Diagnostics Data Import
        DID_0xF1A1_F1A1_Data (DcmDspData): DcmDspDataSize=16, DcmDspDataType=UINT16, DcmDspDataInfoRef=DataInfo_DID_0xF1A1_F1A1_Data  # Diagnostics Data Import
        DataInfo_DID_0xF1A0_F1A0_Data (DcmDspDataInfo): DcmDspDataFixedLength=true  # Diagnostics Data Import
        DID_0xF1A0_F1A0_Data (DcmDspData): DcmDspDataSize=16, DcmDspDataType=UINT16, DcmDspDataInfoRef=DataInfo_DID_0xF1A0_F1A0_Data  # Diagnostics Data Import
        DataInfo_DID_0xF194_1_New_Data_Object (DcmDspDataInfo): DcmDspDataFixedLength=true  # Diagnostics Data Import
        DID_0xF194_1_New_Data_Object (DcmDspData): DcmDspDataSize=8, DcmDspDataType=UINT8, DcmDspDataInfoRef=DataInfo_DID_0xF194_1_New_Data_Object  # Diagnostics Data Import
        DataInfo_Hardware_Version_Hardware_Version_Number (DcmDspDataInfo): DcmDspDataFixedLength=true  # Diagnostics Data Import
        Hardware_Version_Hardware_Version_Number (DcmDspData): DcmDspDataSize=32, DcmDspDataType=UINT32, DcmDspDataInfoRef=DataInfo_Hardware_Version_Hardware_Version_Number  # Diagnostics Data Import
        DataInfo_Vehicle_Identification_VIN (DcmDspDataInfo): DcmDspDataFixedLength=true  # Diagnostics Data Import
        Vehicle_Identification_VIN (DcmDspData): DcmDspDataSize=136, DcmDspDataType=UINT8_N, DcmDspDataInfoRef=DataInfo_Vehicle_Identification_VIN  # Diagnostics Data Import
        DataInfo_SerialNumber_SerialNumber (DcmDspDataInfo): DcmDspDataFixedLength=true  # Diagnostics Data Import
        SerialNumber_SerialNumber (DcmDspData): DcmDspDataSize=32, DcmDspDataType=UINT32, DcmDspDataInfoRef=DataInfo_SerialNumber_SerialNumber  # Diagnostics Data Import
        DataInfo_EcuIdentification_Part_Number (DcmDspDataInfo): DcmDspDataFixedLength=true  # Diagnostics Data Import
        EcuIdentification_Part_Number (DcmDspData): DcmDspDataSize=104, DcmDspDataType=UINT8_N, DcmDspDataInfoRef=DataInfo_EcuIdentification_Part_Number  # Diagnostics Data Import
        DataInfo_Spare_Part_Number_Spare_Part_Number (DcmDspDataInfo): DcmDspDataFixedLength=true  # Diagnostics Data Import
        Spare_Part_Number_Spare_Part_Number (DcmDspData): DcmDspDataSize=32, DcmDspDataType=UINT32, DcmDspDataInfoRef=DataInfo_Spare_Part_Number_Spare_Part_Number  # Diagnostics Data Import
        DataInfo_Boot_Software_Boot_Software_Identification (DcmDspDataInfo): DcmDspDataFixedLength=true  # Diagnostics Data Import
        Boot_Software_Boot_Software_Identification (DcmDspData): DcmDspDataSize=32, DcmDspDataType=UINT32, DcmDspDataInfoRef=DataInfo_Boot_Software_Boot_Software_Identification  # Diagnostics Data Import
        DataInfo_Boot_Software_NumberOfModules (DcmDspDataInfo): DcmDspDataFixedLength=true  # Diagnostics Data Import
        Boot_Software_NumberOfModules (DcmDspData): DcmDspDataSize=8, DcmDspDataType=UINT8, DcmDspDataInfoRef=DataInfo_Boot_Software_NumberOfModules  # Diagnostics Data Import
        DataInfo_VCU_DID_00_DataRecord (DcmDspDataInfo): DcmDspDataFixedLength=true  # Diagnostics Data Import
        VCU_DID_00_DataRecord (DcmDspData): DcmDspDataSize=32, DcmDspDataType=UINT32, DcmDspDataInfoRef=DataInfo_VCU_DID_00_DataRecord  # Diagnostics Data Import
        DataInfo_DID_0x0400_DID_Data (DcmDspDataInfo): DcmDspDataFixedLength=true  # Diagnostics Data Import
        DID_0x0400_DID_Data (DcmDspData): DcmDspDataSize=16, DcmDspDataType=UINT16, DcmDspDataInfoRef=DataInfo_DID_0x0400_DID_Data  # Diagnostics Data Import
        DataInfo_DID_0x0300_DID_Data (DcmDspDataInfo): DcmDspDataFixedLength=true  # Diagnostics Data Import
        DID_0x0300_DID_Data (DcmDspData): DcmDspDataConditionCheckReadFncUsed=false, DcmDspDataSize=32, DcmDspDataType=UINT32, DcmDspDataInfoRef=DataInfo_DID_0x0300_DID_Data  # Diagnostics Data Import
        DataInfo_DID_0x0200_Data (DcmDspDataInfo): DcmDspDataFixedLength=true  # Diagnostics Data Import
        DID_0x0200_Data (DcmDspData): DcmDspDataSize=8, DcmDspDataType=UINT8, DcmDspDataInfoRef=DataInfo_DID_0x0200_Data  # Diagnostics Data Import
        DataInfo_DataDiagnosticIdentifier_DDI_DataDiagnosticIdentifier (DcmDspDataInfo): DcmDspDataFixedLength=true  # Diagnostics Data Import
        DataDiagnosticIdentifier_DDI_DataDiagnosticIdentifier (DcmDspData): DcmDspDataSize=16, DcmDspDataType=UINT16, DcmDspDataInfoRef=DataInfo_DataDiagnosticIdentifier_DDI_DataDiagnosticIdentifier  # Diagnostics Data Import
        DataInfo_DevelopmentData_TransportLayerVersion (DcmDspDataInfo): DcmDspDataFixedLength=true  # Diagnostics Data Import
        DevelopmentData_TransportLayerVersion (DcmDspData): DcmDspDataSize=16, DcmDspDataType=UINT16, DcmDspDataInfoRef=DataInfo_DevelopmentData_TransportLayerVersion  # Diagnostics Data Import
        DataInfo_DevelopmentData_DiagnosticModuleVersion (DcmDspDataInfo): DcmDspDataFixedLength=true  # Diagnostics Data Import
        DevelopmentData_DiagnosticModuleVersion (DcmDspData): DcmDspDataSize=16, DcmDspDataType=UINT16, DcmDspDataInfoRef=DataInfo_DevelopmentData_DiagnosticModuleVersion  # Diagnostics Data Import
        DataInfo_DevelopmentData_NmVersion (DcmDspDataInfo): DcmDspDataFixedLength=true  # Diagnostics Data Import
        DevelopmentData_NmVersion (DcmDspData): DcmDspDataSize=16, DcmDspDataType=UINT16, DcmDspDataInfoRef=DataInfo_DevelopmentData_NmVersion  # Diagnostics Data Import
        DataInfo_DevelopmentData_CanDriverVersion (DcmDspDataInfo): DcmDspDataFixedLength=true  # Diagnostics Data Import
        DevelopmentData_CanDriverVersion (DcmDspData): DcmDspDataSize=16, DcmDspDataType=UINT16, DcmDspDataInfoRef=DataInfo_DevelopmentData_CanDriverVersion  # Diagnostics Data Import
        DataInfo_DevelopmentData_OperatingSystemVersion (DcmDspDataInfo): DcmDspDataFixedLength=true  # Diagnostics Data Import
        DevelopmentData_OperatingSystemVersion (DcmDspData): DcmDspDataSize=16, DcmDspDataType=UINT16, DcmDspDataInfoRef=DataInfo_DevelopmentData_OperatingSystemVersion  # Diagnostics Data Import
      DcmDsd  # Diagnostics Data Import
        DcmDsdServiceTable  # Diagnostics Data Import
          15 x DcmDsdService:
            ControlDtcSetting: DcmDsdSidTabServiceId=133, DcmDsdSidTabSubfuncAvail=true  # Diagnostics Data Import
              Disable (DcmDsdSubService): DcmDsdSubServiceId=2  # Diagnostics Data Import
              Enable (DcmDsdSubService): DcmDsdSubServiceId=1  # Diagnostics Data Import
            TesterPresent: DcmDsdSidTabServiceId=62, DcmDsdSidTabSubfuncAvail=true  # Diagnostics Data Import
              TesterPresent (DcmDsdSubService): DcmDsdSubServiceId=0  # Diagnostics Data Import
            WriteMemoryByAddress: DcmDsdSidTabServiceId=61, DcmDsdSidTabSubfuncAvail=false  # Diagnostics Data Import
            RoutineControl: DcmDsdSidTabServiceId=49, DcmDsdSidTabSubfuncAvail=true, DcmDsdSidTabSessionLevelRef=DcmDspSession/Programming, DcmDsdSidTabSessionLevelRef=DcmDspSession/Extended  # Diagnostics Data Import
            IoControlById: DcmDsdSidTabServiceId=47, DcmDsdSidTabSubfuncAvail=false, DcmDsdSidTabSessionLevelRef=DcmDspSession/Extended  # Diagnostics Data Import
            WriteDataById: DcmDsdSidTabServiceId=46, DcmDsdSidTabSubfuncAvail=false  # Diagnostics Data Import
            DynamicallyDefineDataId: DcmDsdSidTabServiceId=44, DcmDsdSidTabSubfuncAvail=true  # Diagnostics Data Import
              3 x DcmDsdSubService:
                DynDefClr: DcmDsdSubServiceId=3  # Diagnostics Data Import
                DynDefByAddr: DcmDsdSubServiceId=2  # Diagnostics Data Import
                DynDefById: DcmDsdSubServiceId=1  # Diagnostics Data Import
            CommunicationControl: DcmDsdSidTabServiceId=40, DcmDsdSidTabSubfuncAvail=true, DcmDsdSidTabSessionLevelRef=DcmDspSession/Programming, DcmDsdSidTabSessionLevelRef=DcmDspSession/Extended  # Diagnostics Data Import
              4 x DcmDsdSubService, all with DcmDsdSubServiceSessionLevelRef=DcmDspSession/Programming, DcmDsdSubServiceSessionLevelRef=DcmDspSession/Extended:
                DisableRxAndTx: DcmDsdSubServiceId=3  # Diagnostics Data Import
                DisableRxAndEnableTx: DcmDsdSubServiceId=2  # Diagnostics Data Import
                EnableRxAndDisableTx: DcmDsdSubServiceId=1  # Diagnostics Data Import
                EnableRxAndTx: DcmDsdSubServiceId=0  # Diagnostics Data Import
            SecurityAccess: DcmDsdSidTabServiceId=39, DcmDsdSidTabSubfuncAvail=true, DcmDsdSidTabSessionLevelRef=DcmDspSession/Programming, DcmDsdSidTabSessionLevelRef=DcmDspSession/Extended  # Diagnostics Data Import
              4 x DcmDsdSubService, all with DcmDsdSubServiceSessionLevelRef=DcmDspSession/Programming, DcmDsdSubServiceSessionLevelRef=DcmDspSession/Extended:
                sendKey_Send: DcmDsdSubServiceId=4  # Diagnostics Data Import
                requestSeed_Request: DcmDsdSubServiceId=3  # Diagnostics Data Import
                KeyLevel1_Send: DcmDsdSubServiceId=2  # Diagnostics Data Import
                SeedLevel1_Request: DcmDsdSubServiceId=1  # Diagnostics Data Import
            ReadMemoryByAddress: DcmDsdSidTabServiceId=35, DcmDsdSidTabSubfuncAvail=false  # Diagnostics Data Import
            ReadDataById: DcmDsdSidTabServiceId=34, DcmDsdSidTabSubfuncAvail=false  # Diagnostics Data Import
            ReadDtcInfo: DcmDsdSidTabServiceId=25, DcmDsdSidTabSubfuncAvail=true  # Diagnostics Data Import
              14 x DcmDsdSubService:
                RDTCFDC: DcmDsdSubServiceId=20  # Diagnostics Data Import
                RMRCDTC: DcmDsdSubServiceId=14  # Diagnostics Data Import
                RMRTFDTC: DcmDsdSubServiceId=13  # Diagnostics Data Import
                RFCDTC: DcmDsdSubServiceId=12  # Diagnostics Data Import
                RFTFDTC: DcmDsdSubServiceId=11  # Diagnostics Data Import
                RSUPDTC: DcmDsdSubServiceId=10  # Diagnostics Data Import
                RSIODTC: DcmDsdSubServiceId=9  # Diagnostics Data Import
                RDTCBSMR: DcmDsdSubServiceId=8  # Diagnostics Data Import
                RNODTCBSMR: DcmDsdSubServiceId=7  # Diagnostics Data Import
                RDTCEDRBDN: DcmDsdSubServiceId=6  # Diagnostics Data Import
                RDTCSSBDTC: DcmDsdSubServiceId=4  # Diagnostics Data Import
                RDTCSSI: DcmDsdSubServiceId=3  # Diagnostics Data Import
                RDTCBSM: DcmDsdSubServiceId=2  # Diagnostics Data Import
                RNODTCBSM: DcmDsdSubServiceId=1  # Diagnostics Data Import
            ClearDiagInfo: DcmDsdSidTabServiceId=20, DcmDsdSidTabSubfuncAvail=false  # Diagnostics Data Import
            EcuReset: DcmDsdSidTabServiceId=17, DcmDsdSidTabSubfuncAvail=true  # Diagnostics Data Import
              Soft (DcmDsdSubService): DcmDsdSubServiceId=3  # Diagnostics Data Import
              Hard (DcmDsdSubService): DcmDsdSubServiceId=1  # Diagnostics Data Import
            DiagSessionControl: DcmDsdSidTabServiceId=16, DcmDsdSidTabSubfuncAvail=true  # Diagnostics Data Import
              3 x DcmDsdSubService:
                Extended: DcmDsdSubServiceId=3  # Diagnostics Data Import
                Programming: DcmDsdSubServiceId=2  # Diagnostics Data Import
                Default: DcmDsdSubServiceId=1  # Diagnostics Data Import
      DcmGeneral: DcmResetToFblAfterSessionFinalResponseEnabled=false  # Diagnostics Data Import
  module config Dem
    DemGeneral:  # Diagnostics Data Import
      DemAgingCycleCounterProcessing = DEM_PROCESS_AGINGCTR_INTERN
      DemDebounceCounterBasedSupport = true
      DemEnableConditionSupport = true
      DemPTOSupport = false
      DemDtcStatusAvailabilityMask = 255
      DemTypeOfFreezeFrameRecordNumeration = DEM_FF_RECNUM_CALCULATED
      7 x DemDataClass:
        ExtendedDataRecord0x01_Fault_Aging_Counter: DemDataElementDataSize=1, DemDataElementInternalData=DEM_AGINGCTR_DOWNCNT, DemDataElementUsePort=USE_DATA_INTERNAL  # Diagnostics Data Import
        ExtendedDataRecord0x02_Fault_Aging_Counte_Up: DemDataElementDataSize=1, DemDataElementInternalData=DEM_AGINGCTR_UPCNT, DemDataElementUsePort=USE_DATA_INTERNAL  # Diagnostics Data Import
        ExtendedDataRecord0x01_Occurence_Counter: DemDataElementDataSize=1, DemDataElementInternalData=DEM_OCCCTR, DemDataElementUsePort=USE_DATA_INTERNAL  # Diagnostics Data Import
        DID_0xf1a3_F1A3_Data: DemDataElementDataSize=2, DemDataElementDataType=UINT16, DemDataElementEndianness=BIG_ENDIAN, DemDataElementUsePort=USE_DATA_CLIENT_SERVER_PORT, DemDataElementStoreNonVolatile=true  # Diagnostics Data Import
        DID_0xf1a2_F1A2_Data: DemDataElementDataSize=2, DemDataElementDataType=UINT16, DemDataElementEndianness=BIG_ENDIAN, DemDataElementUsePort=USE_DATA_CLIENT_SERVER_PORT, DemDataElementStoreNonVolatile=true  # Diagnostics Data Import
        DID_0xf1a1_F1A1_Data: DemDataElementDataSize=2, DemDataElementDataType=UINT16, DemDataElementEndianness=BIG_ENDIAN, DemDataElementUsePort=USE_DATA_CLIENT_SERVER_PORT, DemDataElementStoreNonVolatile=true  # Diagnostics Data Import
        DID_0xf1a0_F1A0_Data: DemDataElementDataSize=2, DemDataElementDataType=UINT16, DemDataElementEndianness=BIG_ENDIAN, DemDataElementUsePort=USE_DATA_CLIENT_SERVER_PORT, DemDataElementStoreNonVolatile=true  # Diagnostics Data Import
      PowerCycle (DemOperationCycle): DemOperationCycleType=DEM_OPCYC_POWER  # Diagnostics Data Import
      WarningIndicator (DemIndicator)  # Diagnostics Data Import
      FreezeFrameClass_8de652ca (DemFreezeFrameClass): DemDidClassRef=DemGeneral/DID_0xF1A0, DemDidClassRef=DemGeneral/DID_0xF1A1, DemDidClassRef=DemGeneral/DID_0xF1A2  # Diagnostics Data Import
      FreezeFrameClass_34739cdf (DemFreezeFrameClass):  # Diagnostics Data Import
        DemDidClassRef = DemGeneral/DID_0xF1A{0..3}
      ExtendedDataRecord0x02 (DemExtendedDataRecordClass): DemExtendedDataRecordNumber=2, DemDataClassRef=ExtendedDataRecord0x02_Fault_Aging_Counte_Up  # Diagnostics Data Import
      ExtendedDataRecord0x01 (DemExtendedDataRecordClass):  # Diagnostics Data Import
        DemExtendedDataRecordNumber = 1
        DemDataClassRef = ExtendedDataRecord0x01_Occurence_Counter
        DemDataClassRef = ExtendedDataRecord0x01_Fault_Aging_Counter
      EnableConditionGroup_Example_EnableCondition1 (DemEnableConditionGroup): DemEnableConditionRef=Example_EnableCondition1  # Diagnostics Data Import
      EnableConditionGroup_2f9cc720 (DemEnableConditionGroup): DemEnableConditionRef=Example_EnableCondition1, DemEnableConditionRef=Example_EnableCondition2  # Diagnostics Data Import
      ExtendedDataClass_4f5344cd (DemExtendedDataClass): DemExtendedDataRecordClassRef=ExtendedDataRecord0x01, DemExtendedDataRecordClassRef=ExtendedDataRecord0x02  # Diagnostics Data Import
      Example_EnableCondition2 (DemEnableCondition)  # Diagnostics Data Import
      Example_EnableCondition1 (DemEnableCondition)  # Diagnostics Data Import
      4 x DemDidClass:
        DID_0xF1A3: DemDidIdentifier=61859, DemDidDataClassRef=DID_0xf1a3_F1A3_Data  # Diagnostics Data Import
        DID_0xF1A2: DemDidIdentifier=61858, DemDidDataClassRef=DID_0xf1a2_F1A2_Data  # Diagnostics Data Import
        DID_0xF1A1: DemDidIdentifier=61857, DemDidDataClassRef=DID_0xf1a1_F1A1_Data  # Diagnostics Data Import
        DID_0xF1A0: DemDidIdentifier=61856, DemDidDataClassRef=DID_0xf1a0_F1A0_Data  # Diagnostics Data Import
    DemConfigSet  # Diagnostics Data Import
      CAN00_BUSOFF (DemEventParameter):  # Diagnostics Data Import
        DemEventKind = DEM_EVENT_KIND_SWC
        DemMaxNumberFreezeFrameRecords = 2
        DemDTCClassRef = DTCClass_CAN00_BUSOFF
        DemExtendedDataClassRef = ExtendedDataClass_4f5344cd
        DemFreezeFrameClassRef = FreezeFrameClass_8de652ca
        DemEventClass:  # Diagnostics Data Import
          DemAgingAllowed = true
          DemAgingCycleCounterThreshold = 40
          DemEventDestination = DEM_DTC_ORIGIN_PRIMARY_MEMORY
          DemEventPriority = 3
          DemEventSignificance = DEM_EVENT_SIGNIFICANCE_FAULT
          DemEventFailureCycleCounterThreshold = 3
          DemAgingCycleRef = PowerCycle
          DemOperationCycleRef = PowerCycle
          IndicatorAttribute_WarningIndicator (DemIndicatorAttribute): DemIndicatorFailureCycleSource=DEM_FAILURE_CYCLE_EVENT, DemIndicatorHealingCycleRef=PowerCycle, DemIndicatorRef=WarningIndicator  # Diagnostics Data Import
          DemDebounceAlgorithmClass  # Diagnostics Data Import
            DemDebounceCounterBased:  # Diagnostics Data Import
              DemDebounceCounterDecrementStepSize = 1
              DemDebounceCounterIncrementStepSize = 1
              DemDebounceCounterJumpDown = false
              DemDebounceCounterJumpUp = true
              DemDebounceCounterFailedThreshold = 40
              DemDebounceCounterPassedThreshold = -40
      DTCClass_CAN00_BUSOFF (DemDTCClass): DemDTCSeverity=DEM_DTC_SEV_NO_SEVERITY, DemUdsDTC=13631748  # Diagnostics Data Import
      DTC_0X000003 (DemEventParameter):  # Diagnostics Data Import
        DemEventKind = DEM_EVENT_KIND_SWC
        DemMaxNumberFreezeFrameRecords = 2
        DemDTCClassRef = DTCClass_DTC_0X000003
        DemExtendedDataClassRef = ExtendedDataClass_4f5344cd
        DemFreezeFrameClassRef = FreezeFrameClass_8de652ca
        DemEventClass:  # Diagnostics Data Import
          DemAgingAllowed = true
          DemAgingCycleCounterThreshold = 40
          DemEventDestination = DEM_DTC_ORIGIN_PRIMARY_MEMORY
          DemEventPriority = 2
          DemEventSignificance = DEM_EVENT_SIGNIFICANCE_FAULT
          DemEventFailureCycleCounterThreshold = 3
          DemAgingCycleRef = PowerCycle
          DemEnableConditionGroupRef = EnableConditionGroup_Example_EnableCondition1
          DemOperationCycleRef = PowerCycle
          IndicatorAttribute_WarningIndicator (DemIndicatorAttribute): DemIndicatorFailureCycleSource=DEM_FAILURE_CYCLE_EVENT, DemIndicatorHealingCycleRef=PowerCycle, DemIndicatorRef=WarningIndicator  # Diagnostics Data Import
          DemDebounceAlgorithmClass  # Diagnostics Data Import
            DemDebounceCounterBased:  # Diagnostics Data Import
              DemDebounceCounterDecrementStepSize = 32
              DemDebounceCounterIncrementStepSize = 32
              DemDebounceCounterJumpDown = false
              DemDebounceCounterJumpUp = false
              DemDebounceCounterFailedThreshold = 40
              DemDebounceCounterPassedThreshold = -40
      DTCClass_DTC_0X000003 (DemDTCClass): DemDTCSeverity=DEM_DTC_SEV_NO_SEVERITY, DemUdsDTC=771  # Diagnostics Data Import
      DTC_0X000002 (DemEventParameter):  # Diagnostics Data Import
        DemEventKind = DEM_EVENT_KIND_SWC
        DemMaxNumberFreezeFrameRecords = 2
        DemDTCClassRef = DTCClass_DTC_0X000002
        DemExtendedDataClassRef = ExtendedDataClass_4f5344cd
        DemFreezeFrameClassRef = FreezeFrameClass_34739cdf
        DemEventClass:  # Diagnostics Data Import
          DemAgingAllowed = true
          DemAgingCycleCounterThreshold = 40
          DemEventDestination = DEM_DTC_ORIGIN_PRIMARY_MEMORY
          DemEventPriority = 1
          DemEventSignificance = DEM_EVENT_SIGNIFICANCE_FAULT
          DemEventFailureCycleCounterThreshold = 3
          DemAgingCycleRef = PowerCycle
          DemEnableConditionGroupRef = EnableConditionGroup_2f9cc720
          DemOperationCycleRef = PowerCycle
          IndicatorAttribute_WarningIndicator (DemIndicatorAttribute): DemIndicatorFailureCycleSource=DEM_FAILURE_CYCLE_EVENT, DemIndicatorHealingCycleRef=PowerCycle, DemIndicatorRef=WarningIndicator  # Diagnostics Data Import
          DemDebounceAlgorithmClass  # Diagnostics Data Import
            DemDebounceCounterBased:  # Diagnostics Data Import
              DemDebounceCounterDecrementStepSize = 1
              DemDebounceCounterIncrementStepSize = 1
              DemDebounceCounterJumpDown = false
              DemDebounceCounterJumpUp = true
              DemDebounceCounterFailedThreshold = 40
              DemDebounceCounterPassedThreshold = -40
      DTCClass_DTC_0X000002 (DemDTCClass): DemDTCSeverity=DEM_DTC_SEV_NO_SEVERITY, DemUdsDTC=514  # Diagnostics Data Import
      DTC_0X000004 (DemEventParameter):  # Diagnostics Data Import
        DemEventKind = DEM_EVENT_KIND_SWC
        DemMaxNumberFreezeFrameRecords = 2
        DemDTCClassRef = DTCClass_DTC_0X000004
        DemExtendedDataClassRef = ExtendedDataClass_4f5344cd
        DemFreezeFrameClassRef = FreezeFrameClass_8de652ca
        DemEventClass:  # Diagnostics Data Import
          DemAgingAllowed = true
          DemAgingCycleCounterThreshold = 40
          DemEventDestination = DEM_DTC_ORIGIN_PRIMARY_MEMORY
          DemEventPriority = 4
          DemEventSignificance = DEM_EVENT_SIGNIFICANCE_FAULT
          DemEventFailureCycleCounterThreshold = 3
          DemAgingCycleRef = PowerCycle
          DemOperationCycleRef = PowerCycle
          IndicatorAttribute_WarningIndicator (DemIndicatorAttribute): DemIndicatorFailureCycleSource=DEM_FAILURE_CYCLE_EVENT, DemIndicatorHealingCycleRef=PowerCycle, DemIndicatorRef=WarningIndicator  # Diagnostics Data Import
          DemDebounceAlgorithmClass  # Diagnostics Data Import
            DemDebounceCounterBased:  # Diagnostics Data Import
              DemDebounceCounterDecrementStepSize = 1
              DemDebounceCounterIncrementStepSize = 1
              DemDebounceCounterJumpDown = false
              DemDebounceCounterJumpUp = true
              DemDebounceCounterFailedThreshold = 40
              DemDebounceCounterPassedThreshold = -40
      DTCClass_DTC_0X000004 (DemDTCClass): DemDTCSeverity=DEM_DTC_SEV_NO_SEVERITY, DemUdsDTC=4  # Diagnostics Data Import
  module config EcuC
    EcucPduCollection: PduIdTypeEnum=UINT8, PduLengthTypeEnum=UINT8
      235 x Pdu:
        ACU_01_oATOM_CANFD_Matrix_CH_V600_202502_1343b9ef_Rx: DynamicLength=false, PduLength=8, SysTPduToFrameMappingRef=ACU_01
        ACU_01_oATOM_CANFD_Matrix_CH_V600_202502_92b30981_Rx: DynamicLength=false, PduLength=8
        ACU_02_oATOM_CANFD_Matrix_CH_V600_202502_19603798_Rx: DynamicLength=false, PduLength=8
        ACU_02_oATOM_CANFD_Matrix_CH_V600_202502_8a035e80_Rx: DynamicLength=false, PduLength=8, SysTPduToFrameMappingRef=ACU_02
        ACU_info_oATOM_CANFD_Matrix_CH_V600_202502_83006605_Rx: DynamicLength=false, PduLength=8, SysTPduToFrameMappingRef=ACU_info
        ACU_info_oATOM_CANFD_Matrix_CH_V600_202502_c3757d77_Rx: DynamicLength=false, PduLength=8
        ADCU_ACC_02_oATOM_CANFD_Matrix_CH_V600_202502_09e0da82_Rx: DynamicLength=false, PduLength=8
        ADCU_ACC_02_oATOM_CANFD_Matrix_CH_V600_202502_9c78bb9f_Rx: DynamicLength=false, PduLength=8, SysTPduToFrameMappingRef=ADCU_ACC_02
        ADCU_AEB_01_oATOM_CANFD_Matrix_CH_V600_202502_73fc26ce_Rx: DynamicLength=false, PduLength=8
        ADCU_AEB_01_oATOM_CANFD_Matrix_CH_V600_202502_aeea498e_Rx: DynamicLength=false, PduLength=8, SysTPduToFrameMappingRef=ADCU_AEB_01
        ADCU_APS_01_oATOM_CANFD_Matrix_CH_V600_202502_c0dbb601_Rx: DynamicLength=false, PduLength=8, SysTPduToFrameMappingRef=ADCU_APS_01
        ADCU_APS_01_oATOM_CANFD_Matrix_CH_V600_202502_d7aca41b_Rx: DynamicLength=false, PduLength=8
        ADCU_APS_02_oATOM_CANFD_Matrix_CH_V600_202502_599b516e_Rx: DynamicLength=false, PduLength=8, SysTPduToFrameMappingRef=ADCU_APS_02
        ADCU_APS_02_oATOM_CANFD_Matrix_CH_V600_202502_5c7f9a02_Rx: DynamicLength=false, PduLength=8
        ADCU_DA_oATOM_CANFD_Matrix_CH_V600_202502_8a75132b_Rx: DynamicLength=false, PduLength=8, SysTPduToFrameMappingRef=ADCU_DA
        ADCU_DA_oATOM_CANFD_Matrix_CH_V600_202502_c19ff818_Rx: DynamicLength=false, PduLength=8
        EDCU_EXV2_oLIN00_18b050dc_Tx: DynamicLength=false, PduLength=8, SysTPduToFrameMappingRef=EDCU_EXV2
        EDCU_EXV2_oLIN00_1f8750a5_Tx: DynamicLength=false, PduLength=8
        EXV2_Status_oLIN00_7fcf9f75_Rx: DynamicLength=false, PduLength=8, SysTPduToFrameMappingRef=EXV2_Status
        EXV2_Status_oLIN00_d5e93929_Rx: DynamicLength=false, PduLength=8
        EXV_1_VCU_oLIN00_366267d6_Rx: DynamicLength=false, PduLength=8, SysTPduToFrameMappingRef=EXV_1_VCU
        EXV_1_VCU_oLIN00_69d4ef5f_Rx: DynamicLength=false, PduLength=8
        EXV_2_VCU_oLIN00_1e4a3daf_Rx: DynamicLength=false, PduLength=8
        EXV_2_VCU_oLIN00_85f64a15_Rx: DynamicLength=false, PduLength=8, SysTPduToFrameMappingRef=EXV_2_VCU
        HVCH_Rsp01_oLIN00_a6e33eef_Rx: DynamicLength=false, PduLength=8
        HVCH_Rsp01_oLIN00_d50f5fa3_Rx: DynamicLength=false, PduLength=8, SysTPduToFrameMappingRef=HVCH_Rsp01
        HVCH_Rsp02_oLIN00_286c390c_Rx: DynamicLength=false, PduLength=8
        HVCH_Rsp02_oLIN00_a3ea669e_Rx: DynamicLength=false, PduLength=8, SysTPduToFrameMappingRef=HVCH_Rsp02
        IBS_ACC_oATOM_CANFD_Matrix_CH_V600_202502_205c1446_Rx: DynamicLength=false, PduLength=8, SysTPduToFrameMappingRef=IBS_ACC
        IBS_ACC_oATOM_CANFD_Matrix_CH_V600_202502_ef8c28ba_Rx: DynamicLength=false, PduLength=8
        IBS_APS_oATOM_CANFD_Matrix_CH_V600_202502_25d77553_Rx: DynamicLength=false, PduLength=8
        IBS_APS_oATOM_CANFD_Matrix_CH_V600_202502_8feeb71a_Rx: DynamicLength=false, PduLength=8, SysTPduToFrameMappingRef=IBS_APS
        IBS_Status_01_oATOM_CANFD_Matrix_CH_V600_202502_acfe14e2_Rx: DynamicLength=false, PduLength=8, SysTPduToFrameMappingRef=IBS_Status_01
        IBS_Status_01_oATOM_CANFD_Matrix_CH_V600_202502_b0697754_Rx: DynamicLength=false, PduLength=8
        IBS_Status_02_oATOM_CANFD_Matrix_CH_V600_202502_35bef38d_Rx: DynamicLength=false, PduLength=8, SysTPduToFrameMappingRef=IBS_Status_02
        IBS_Status_02_oATOM_CANFD_Matrix_CH_V600_202502_3bba494d_Rx: DynamicLength=false, PduLength=8
        IBS_Status_03_oATOM_CANFD_Matrix_CH_V600_202502_f4245e85_Rx: DynamicLength=false, PduLength=8
        IBS_Status_03_oATOM_CANFD_Matrix_CH_V600_202502_f451ac97_Rx: DynamicLength=false, PduLength=8, SysTPduToFrameMappingRef=IBS_Status_03
        IBS_Status_04_oATOM_CANFD_Matrix_CH_V600_202502_dc4e3b12_Rx: DynamicLength=false, PduLength=8, SysTPduToFrameMappingRef=IBS_Status_04
        IBS_Status_04_oATOM_CANFD_Matrix_CH_V600_202502_f76d333e_Rx: DynamicLength=false, PduLength=8
        IBS_Status_06_oATOM_CANFD_Matrix_CH_V600_202502_84e18367_Rx: DynamicLength=false, PduLength=8, SysTPduToFrameMappingRef=IBS_Status_06
        IBS_Status_06_oATOM_CANFD_Matrix_CH_V600_202502_b3201aef_Rx: DynamicLength=false, PduLength=8
        IBS_Torque_oATOM_CANFD_Matrix_CH_V600_202502_94259583_Rx: DynamicLength=false, PduLength=8, SysTPduToFrameMappingRef=IBS_Torque
        IBS_Torque_oATOM_CANFD_Matrix_CH_V600_202502_e4106cfa_Rx: DynamicLength=false, PduLength=8
        IBS_VCU_MotorControl_oATOM_CANFD_Matrix_CH_V600_202502_d229d0d9_Rx: DynamicLength=false, PduLength=8
        IBS_VCU_MotorControl_oATOM_CANFD_Matrix_CH_V600_202502_df4c437b_Rx: DynamicLength=false, PduLength=8, SysTPduToFrameMappingRef=IBS_VCU_MotorControl
        IBS_WheelSpeed_01_oATOM_CANFD_Matrix_CH_V600_202502_1c45b3ee_Rx: DynamicLength=false, PduLength=8
        IBS_WheelSpeed_01_oATOM_CANFD_Matrix_CH_V600_202502_cdf72100_Rx: DynamicLength=false, PduLength=8, SysTPduToFrameMappingRef=IBS_WheelSpeed_01
        IBS_WheelSpeed_02_oATOM_CANFD_Matrix_CH_V600_202502_54b7c66f_Rx: DynamicLength=false, PduLength=8, SysTPduToFrameMappingRef=IBS_WheelSpeed_02
        IBS_WheelSpeed_02_oATOM_CANFD_Matrix_CH_V600_202502_97968df7_Rx: DynamicLength=false, PduLength=8
        MasterReq_ERV_oLIN00_10f4fcd8_Tx: DynamicLength=true, PduLength=8
        MasterReq_ERV_oLIN00_f3aa7150_Tx: DynamicLength=true, PduLength=8
        MasterReq_EXV_1_oLIN00_52f4d550_Tx: DynamicLength=true, PduLength=8
        MasterReq_EXV_1_oLIN00_cdcee39b_Tx: DynamicLength=true, PduLength=8
        MasterReq_EXV_2_oLIN00_bb2bdaa6_Tx: DynamicLength=true, PduLength=8
        MasterReq_EXV_2_oLIN00_dc7bd2b3_Tx: DynamicLength=true, PduLength=8
        MasterReq_GWM_oLIN01_08407441_Tx: DynamicLength=true, PduLength=8
        MasterReq_GWM_oLIN01_25aef125_Tx: DynamicLength=true, PduLength=8
        MasterReq_HVCH_oLIN00_0c968313_Tx: DynamicLength=true, PduLength=8
        MasterReq_HVCH_oLIN00_726494b3_Tx: DynamicLength=true, PduLength=8
        MasterReq_PMP_1_oLIN00_14f05772_Tx: DynamicLength=true, PduLength=8
        MasterReq_PMP_1_oLIN00_90773f5d_Tx: DynamicLength=true, PduLength=8
        MasterReq_PMP_2_oLIN00_9a7f5091_Tx: DynamicLength=true, PduLength=8
        MasterReq_PMP_2_oLIN00_e6920660_Tx: DynamicLength=true, PduLength=8
        MasterReq_SVA_oLIN00_11d66449_Tx: DynamicLength=true, PduLength=8
        MasterReq_SVA_oLIN00_deabba25_Tx: DynamicLength=true, PduLength=8
        MasterReq_Tp_oLIN00_7147b638_Tx: DynamicLength=false, PduLength=8, SysTPduToFrameMappingRef=MasterReq_Tp
        MasterReq_Tp_oLIN01_a828173f_Tx: DynamicLength=false, PduLength=8, SysTPduToFrameMappingRef=MasterReq_Tp
        MasterReq_oLIN00_3234fe1b_Tx: DynamicLength=true, PduLength=8
        MasterReq_oLIN00_4a2bb011_Tx: DynamicLength=true, PduLength=8
        MasterReq_oLIN01_3d2c8087_Tx: DynamicLength=true, PduLength=8
        MasterReq_oLIN01_eb5b5f1c_Tx: DynamicLength=true, PduLength=8
        NM_VCU_oATOM_CANFD_Matrix_CH_V600_202502_7321f2c3_Tx: DynamicLength=false, PduLength=8, SysTPduToFrameMappingRef=NM_VCU
        PMP2_Sts_oLIN00_200c907c_Rx: DynamicLength=false, PduLength=8, SysTPduToFrameMappingRef=PMP2_Sts
        PMP2_Sts_oLIN00_cab90b6b_Rx: DynamicLength=false, PduLength=8
        PMP3_Sts_oLIN00_4e808b3d_Rx: DynamicLength=false, PduLength=8, SysTPduToFrameMappingRef=PMP3_Sts
        PMP3_Sts_oLIN00_511c4704_Rx: DynamicLength=false, PduLength=8
        PMP_Cmd_oLIN00_3912b28b_Tx: DynamicLength=false, PduLength=8
        PMP_Cmd_oLIN00_6d889c97_Tx: DynamicLength=false, PduLength=8, SysTPduToFrameMappingRef=PMP_Cmd
        SGW_17_oATOM_CANFD_Matrix_CH_V600_202502_3a9eb4a2_Rx: DynamicLength=false, PduLength=8, SysTPduToFrameMappingRef=SGW_17
        SGW_17_oATOM_CANFD_Matrix_CH_V600_202502_9b3e5336_Rx: DynamicLength=false, PduLength=8
        SVA_VCU_STD_oLIN00_4526aa1c_Rx: DynamicLength=false, PduLength=8
        SVA_VCU_STD_oLIN00_4f0795ef_Rx: DynamicLength=false, PduLength=8, SysTPduToFrameMappingRef=SVA_VCU_STD
        SlaveResp_ERV_oLIN00_4c387f1b_Rx: DynamicLength=true, PduLength=8
        SlaveResp_ERV_oLIN00_e833ce7b_Rx: DynamicLength=true, PduLength=8
        SlaveResp_EXV_1_oLIN00_1f09933d_Rx: DynamicLength=true, PduLength=8
        SlaveResp_EXV_1_oLIN00_39fbe7c0_Rx: DynamicLength=true, PduLength=8
        SlaveResp_EXV_2_oLIN00_4f1edefd_Rx: DynamicLength=true, PduLength=8
        SlaveResp_EXV_2_oLIN00_918694de_Rx: DynamicLength=true, PduLength=8
        SlaveResp_GWM_oLIN01_9a3cff6e_Rx: DynamicLength=true, PduLength=8
        SlaveResp_GWM_oLIN01_f08746e2_Rx: DynamicLength=true, PduLength=8
        SlaveResp_HVCH_oLIN00_43b1b673_Rx: DynamicLength=true, PduLength=8
        SlaveResp_HVCH_oLIN00_93d59ea5_Rx: DynamicLength=true, PduLength=8
        SlaveResp_PMP_1_oLIN00_590d111f_Rx: DynamicLength=true, PduLength=8
        SlaveResp_PMP_1_oLIN00_64423b06_Rx: DynamicLength=true, PduLength=8
        SlaveResp_PMP_2_oLIN00_12a7023b_Rx: DynamicLength=true, PduLength=8
        SlaveResp_PMP_2_oLIN00_d78216fc_Rx: DynamicLength=true, PduLength=8
        SlaveResp_SVA_oLIN00_6139b46e_Rx: DynamicLength=true, PduLength=8
        SlaveResp_SVA_oLIN00_e91156ea_Rx: DynamicLength=true, PduLength=8
        SlaveResp_Tp_oLIN00_3328eb0b_Rx: DynamicLength=false, PduLength=8, SysTPduToFrameMappingRef=SlaveResp_Tp
        SlaveResp_Tp_oLIN01_ea474a0c_Rx: DynamicLength=false, PduLength=8, SysTPduToFrameMappingRef=SlaveResp_Tp
        TCU_HVCH_Cmd_oLIN00_385d5651_Tx: DynamicLength=false, PduLength=4
        TCU_HVCH_Cmd_oLIN00_ddc31229_Tx: DynamicLength=false, PduLength=4, SysTPduToFrameMappingRef=TCU_HVCH_Cmd
        VCU_02_oATOM_CANFD_Matrix_CH_V600_202502_17bac731_Tx: DynamicLength=false, PduLength=8
        VCU_02_oATOM_CANFD_Matrix_CH_V600_202502_b9b0de03_Tx: DynamicLength=false, PduLength=8, SysTPduToFrameMappingRef=VCU_02
        VCU_03_oATOM_CANFD_Matrix_CH_V600_202502_785f8119_Tx: DynamicLength=false, PduLength=8, SysTPduToFrameMappingRef=VCU_03
        VCU_03_oATOM_CANFD_Matrix_CH_V600_202502_d824d0f9_Tx: DynamicLength=false, PduLength=8
        VCU_04_oATOM_CANFD_Matrix_CH_V600_202502_5040169c_Tx: DynamicLength=false, PduLength=8, SysTPduToFrameMappingRef=VCU_04
        VCU_04_oATOM_CANFD_Matrix_CH_V600_202502_db6dbd42_Tx: DynamicLength=false, PduLength=8
        VCU_3966faea_Rx: PduLength=8, SysTPduToFrameMappingRef=NM_CGW
        VCU_AccPedal_oATOM_CANFD_Matrix_CH_V600_202502_0d0df7a0_Tx: DynamicLength=false, PduLength=8
        VCU_AccPedal_oATOM_CANFD_Matrix_CH_V600_202502_3cf928f4_Tx: DynamicLength=false, PduLength=8, SysTPduToFrameMappingRef=VCU_AccPedal
        VCU_BMS_oATOM_CANFD_Matrix_CH_V600_202502_1208e503_Tx: DynamicLength=false, PduLength=8
        VCU_BMS_oATOM_CANFD_Matrix_CH_V600_202502_8dd4382b_Tx: DynamicLength=false, PduLength=8, SysTPduToFrameMappingRef=VCU_BMS
        VCU_Chassis_01_oATOM_CANFD_Matrix_CH_V600_202502_d7fdb34f_Tx: DynamicLength=false, PduLength=8
        VCU_Chassis_01_oATOM_CANFD_Matrix_CH_V600_202502_e79830d3_Tx: DynamicLength=false, PduLength=8, SysTPduToFrameMappingRef=VCU_Chassis_01
        VCU_EXV_1_oLIN00_50eec975_Tx: DynamicLength=false, PduLength=8
        VCU_EXV_1_oLIN00_58a890ac_Tx: DynamicLength=false, PduLength=8, SysTPduToFrameMappingRef=VCU_EXV_1
        VCU_EXV_2_oLIN00_2e4da991_Tx: DynamicLength=false, PduLength=8, SysTPduToFrameMappingRef=VCU_EXV_2
        VCU_EXV_2_oLIN00_de61ce96_Tx: DynamicLength=false, PduLength=8
        VCU_HMIsignals_01_oATOM_CANFD_Matrix_CH_V600_202502_ad7bde1a_Tx: DynamicLength=false, PduLength=8, SysTPduToFrameMappingRef=VCU_HMIsignals_01
        VCU_HMIsignals_01_oATOM_CANFD_Matrix_CH_V600_202502_f29a9fcc_Tx: DynamicLength=false, PduLength=8
        VCU_HMIsignals_02_oATOM_CANFD_Matrix_CH_V600_202502_343b3975_Tx: DynamicLength=false, PduLength=8, SysTPduToFrameMappingRef=VCU_HMIsignals_02
        VCU_HMIsignals_02_oATOM_CANFD_Matrix_CH_V600_202502_7949a1d5_Tx: DynamicLength=false, PduLength=8
        VCU_IBS_01_oATOM_CANFD_Matrix_CH_V600_202502_4c086bc0_Tx: DynamicLength=false, PduLength=8
        VCU_IBS_01_oATOM_CANFD_Matrix_CH_V600_202502_72f519e8_Tx: DynamicLength=false, PduLength=8, SysTPduToFrameMappingRef=VCU_IBS_01
        VCU_MCU_03_oATOM_CANFD_Matrix_CH_V600_202502_0d9d0aa9_Tx: DynamicLength=false, PduLength=8
        VCU_MCU_03_oATOM_CANFD_Matrix_CH_V600_202502_9c2fbb06_Tx: DynamicLength=false, PduLength=8, SysTPduToFrameMappingRef=VCU_MCU_03
        VCU_PlugInChrgInfo_oATOM_CANFD_Matrix_CH_V600_202502_20405e82_Tx: DynamicLength=false, PduLength=8
        VCU_PlugInChrgInfo_oATOM_CANFD_Matrix_CH_V600_202502_f8a23add_Tx: DynamicLength=false, PduLength=8, SysTPduToFrameMappingRef=VCU_PlugInChrgInfo
        VCU_Rx_500h_NM_oTC37X_VCU_CAN00_c4b96e15_Rx: DynamicLength=false, PduLength=8, SysTPduToFrameMappingRef=VCU_Rx_500h_NM
        VCU_Rx_500h_NM_oTC37X_VCU_CAN01_54a3f814_Rx: DynamicLength=false, PduLength=8, SysTPduToFrameMappingRef=VCU_Rx_500h_NM
        VCU_Rx_500h_NM_oTC37X_VCU_CAN03_afe7d257_Rx: DynamicLength=false, PduLength=8, SysTPduToFrameMappingRef=VCU_Rx_500h_NM
        VCU_Rx_500h_NM_oTC37X_VCU_CAN12_486a6e56_Rx: DynamicLength=false, PduLength=8, SysTPduToFrameMappingRef=VCU_Rx_500h_NM
        VCU_SVA_CMD_oLIN00_756d14f6_Tx: DynamicLength=false, PduLength=8
        VCU_SVA_CMD_oLIN00_89e2bb7b_Tx: DynamicLength=false, PduLength=8, SysTPduToFrameMappingRef=VCU_SVA_CMD
        VCU_Tx_51Ch_NM_oTC37X_VCU_CAN00_0aa0ce62_Tx: DynamicLength=false, PduLength=8, SysTPduToFrameMappingRef=VCU_Tx_51Ch_NM
        VCU_Tx_51Ch_NM_oTC37X_VCU_CAN01_9aba5863_Tx: DynamicLength=false, PduLength=8, SysTPduToFrameMappingRef=VCU_Tx_51Ch_NM
        VCU_Tx_51Ch_NM_oTC37X_VCU_CAN03_61fe7220_Tx: DynamicLength=false, PduLength=8, SysTPduToFrameMappingRef=VCU_Tx_51Ch_NM
        VCU_Tx_51Ch_NM_oTC37X_VCU_CAN12_8673ce21_Tx: DynamicLength=false, PduLength=8, SysTPduToFrameMappingRef=VCU_Tx_51Ch_NM
        VcuAdcTxG0Msg0_oTC37X_VCU_CAN01_0847dbfd_Tx: DynamicLength=false, PduLength=8, SysTPduToFrameMappingRef=VcuAdcTxG0Msg0
        VcuAdcTxG0Msg0_oTC37X_VCU_CAN01_5798df68_Tx: DynamicLength=false, PduLength=8
        VcuAdcTxG0Msg1_oTC37X_VCU_CAN01_4f542d06_Tx: DynamicLength=false, PduLength=8, SysTPduToFrameMappingRef=VcuAdcTxG0Msg1
        VcuAdcTxG0Msg1_oTC37X_VCU_CAN01_b8ca6989_Tx: DynamicLength=false, PduLength=8
        VcuAdcTxG1Msg0_oTC37X_VCU_CAN01_40b0bba8_Tx: DynamicLength=false, PduLength=8
        VcuAdcTxG1Msg0_oTC37X_VCU_CAN01_613ed098_Tx: DynamicLength=false, PduLength=8, SysTPduToFrameMappingRef=VcuAdcTxG1Msg0
        VcuAdcTxG1Msg1_oTC37X_VCU_CAN01_262d2663_Tx: DynamicLength=false, PduLength=8, SysTPduToFrameMappingRef=VcuAdcTxG1Msg1
        VcuAdcTxG1Msg1_oTC37X_VCU_CAN01_afe20d49_Tx: DynamicLength=false, PduLength=8
        VcuAdcTxG2Msg0_oTC37X_VCU_CAN01_79c816e8_Tx: DynamicLength=false, PduLength=8
        VcuAdcTxG2Msg0_oTC37X_VCU_CAN01_dab5cd37_Tx: DynamicLength=false, PduLength=8, SysTPduToFrameMappingRef=VcuAdcTxG2Msg0
        VcuAdcTxG2Msg1_oTC37X_VCU_CAN01_969aa009_Tx: DynamicLength=false, PduLength=8
        VcuAdcTxG2Msg1_oTC37X_VCU_CAN01_9da63bcc_Tx: DynamicLength=false, PduLength=8, SysTPduToFrameMappingRef=VcuAdcTxG2Msg1
        VcuAdcTxG3Msg0_oTC37X_VCU_CAN01_6ee07228_Tx: DynamicLength=false, PduLength=8
        VcuAdcTxG3Msg0_oTC37X_VCU_CAN01_b3ccc652_Tx: DynamicLength=false, PduLength=8, SysTPduToFrameMappingRef=VcuAdcTxG3Msg0
        VcuAdcTxG3Msg1_oTC37X_VCU_CAN01_81b2c4c9_Tx: DynamicLength=false, PduLength=8
        VcuAdcTxG3Msg1_oTC37X_VCU_CAN01_f4df30a9_Tx: DynamicLength=false, PduLength=8, SysTPduToFrameMappingRef=VcuAdcTxG3Msg1
        VcuAdcTxG8Msg0_oTC37X_VCU_CAN01_eedbf968_Tx: DynamicLength=false, PduLength=8
        VcuAdcTxG8Msg0_oTC37X_VCU_CAN01_f56d8c57_Tx: DynamicLength=false, PduLength=8, SysTPduToFrameMappingRef=VcuAdcTxG8Msg0
        VcuAdcTxG8Msg1_oTC37X_VCU_CAN01_01894f89_Tx: DynamicLength=false, PduLength=8
        VcuAdcTxG8Msg1_oTC37X_VCU_CAN01_b27e7aac_Tx: DynamicLength=false, PduLength=8, SysTPduToFrameMappingRef=VcuAdcTxG8Msg1
        VcuAdcTxG8Msg2_oTC37X_VCU_CAN01_7b4a61a1_Tx: DynamicLength=false, PduLength=8, SysTPduToFrameMappingRef=VcuAdcTxG8Msg2
        VcuAdcTxG8Msg2_oTC37X_VCU_CAN01_eb0f92eb_Tx: DynamicLength=false, PduLength=8
        VcuAdcTxG8Msg3_oTC37X_VCU_CAN01_045d240a_Tx: DynamicLength=false, PduLength=8
        VcuAdcTxG8Msg3_oTC37X_VCU_CAN01_3c59975a_Tx: DynamicLength=false, PduLength=8, SysTPduToFrameMappingRef=VcuAdcTxG8Msg3
        VcuCan03RxMsg1_oTC37X_VCU_CAN03_4dd213bb_Rx: DynamicLength=false, PduLength=8, SysTPduToFrameMappingRef=VcuCan03RxMsg1
        VcuCan03RxMsg1_oTC37X_VCU_CAN03_77e3a75f_Rx: DynamicLength=false, PduLength=8
        VcuCan03RxMsg2_oTC37X_VCU_CAN03_84e608b6_Rx: DynamicLength=false, PduLength=8, SysTPduToFrameMappingRef=VcuCan03RxMsg2
        VcuCan03RxMsg2_oTC37X_VCU_CAN03_9d657a3d_Rx: DynamicLength=false, PduLength=8
        VcuCan03TxMsg1_oTC37X_VCU_CAN03_9a29d525_Tx: DynamicLength=false, PduLength=8
        VcuCan03TxMsg1_oTC37X_VCU_CAN03_c0767973_Tx: DynamicLength=false, PduLength=8, SysTPduToFrameMappingRef=VcuCan03TxMsg1
        VcuCan03TxMsg2_oTC37X_VCU_CAN03_0942627e_Tx: DynamicLength=false, PduLength=8, SysTPduToFrameMappingRef=VcuCan03TxMsg2
        VcuCan03TxMsg2_oTC37X_VCU_CAN03_70af0847_Tx: DynamicLength=false, PduLength=8
        VcuCan12RxMsg3_oTC37X_VCU_CAN12_2f1174ae_Rx: DynamicLength=false, PduLength=8, SysTPduToFrameMappingRef=VcuCan12RxMsg3
        VcuCan12RxMsg3_oTC37X_VCU_CAN12_38853822_Rx: DynamicLength=false, PduLength=8
        VcuCan12RxMsg4_oTC37X_VCU_CAN12_211bb20e_Rx: DynamicLength=false, PduLength=8, SysTPduToFrameMappingRef=VcuCan12RxMsg4
        VcuCan12RxMsg4_oTC37X_VCU_CAN12_d9ab3246_Rx: DynamicLength=false, PduLength=8
        VcuCan12TxMsg1_oTC37X_VCU_CAN12_2c92f390_Tx: DynamicLength=false, PduLength=8, SysTPduToFrameMappingRef=VcuCan12TxMsg1
        VcuCan12TxMsg1_oTC37X_VCU_CAN12_d09b21db_Tx: DynamicLength=false, PduLength=8
        VcuCan12TxMsg2_oTC37X_VCU_CAN12_3a1dfcb9_Tx: DynamicLength=false, PduLength=8
        VcuCan12TxMsg2_oTC37X_VCU_CAN12_e5a6e89d_Tx: DynamicLength=false, PduLength=8, SysTPduToFrameMappingRef=VcuCan12TxMsg2
        VcuMeasurementMsg0_oTC37X_VCU_CAN01_0deb23c3_Tx: DynamicLength=false, PduLength=8
        VcuMeasurementMsg0_oTC37X_VCU_CAN01_d96481d0_Tx: DynamicLength=false, PduLength=8, SysTPduToFrameMappingRef=VcuMeasurementMsg0
        VcuRxCtrlMsg0_oTC37X_VCU_CAN01_3715838b_Rx: DynamicLength=false, PduLength=8, SysTPduToFrameMappingRef=VcuRxCtrlMsg0
        VcuRxCtrlMsg0_oTC37X_VCU_CAN01_b24a2ab4_Rx: DynamicLength=false, PduLength=8
        VcuRxCtrlMsg1_oTC37X_VCU_CAN01_5d189c55_Rx: DynamicLength=false, PduLength=8
        VcuRxCtrlMsg1_oTC37X_VCU_CAN01_70067570_Rx: DynamicLength=false, PduLength=8, SysTPduToFrameMappingRef=VcuRxCtrlMsg1
        VcuRxCtrlMsg2_oTC37X_VCU_CAN01_b79e4137_Rx: DynamicLength=false, PduLength=8
        VcuRxCtrlMsg2_oTC37X_VCU_CAN01_b9326e7d_Rx: DynamicLength=false, PduLength=8, SysTPduToFrameMappingRef=VcuRxCtrlMsg2
        VcuRxMsg1_oTC37X_VCU_CAN00_4589bbed_Rx: DynamicLength=false, PduLength=8, SysTPduToFrameMappingRef=VcuRxMsg1
        VcuRxMsg1_oTC37X_VCU_CAN00_78805594_Rx: DynamicLength=false, PduLength=8
        VcuRxMsg2_oTC37X_VCU_CAN00_8cbda0e0_Rx: DynamicLength=false, PduLength=8, SysTPduToFrameMappingRef=VcuRxMsg2
        VcuRxMsg2_oTC37X_VCU_CAN00_920688f6_Rx: DynamicLength=false, PduLength=8
        VcuRxMsg3_oTC37X_VCU_CAN01_0a530e81_Rx: DynamicLength=false, PduLength=8
        VcuRxMsg3_oTC37X_VCU_CAN01_5bb4c01a_Rx: DynamicLength=false, PduLength=8, SysTPduToFrameMappingRef=VcuRxMsg3
        VcuRxMsg4_oTC37X_VCU_CAN01_55be06ba_Rx: DynamicLength=false, PduLength=8, SysTPduToFrameMappingRef=VcuRxMsg4
        VcuRxMsg4_oTC37X_VCU_CAN01_eb7d04e5_Rx: DynamicLength=false, PduLength=8
        VcuTxIoMsg1_oTC37X_VCU_CAN00_54884add_Tx: DynamicLength=false, PduLength=8
        VcuTxIoMsg1_oTC37X_VCU_CAN00_869e33bc_Tx: DynamicLength=false, PduLength=8, SysTPduToFrameMappingRef=VcuTxIoMsg1
        VcuTxIoMsg2_oTC37X_VCU_CAN00_4faa28b1_Tx: DynamicLength=false, PduLength=8, SysTPduToFrameMappingRef=VcuTxIoMsg2
        VcuTxIoMsg2_oTC37X_VCU_CAN00_be0e97bf_Tx: DynamicLength=false, PduLength=8
        VcuTxIoMsg3_oTC37X_VCU_CAN00_08b9de4a_Tx: DynamicLength=false, PduLength=8, SysTPduToFrameMappingRef=VcuTxIoMsg3
        VcuTxIoMsg3_oTC37X_VCU_CAN00_515c215e_Tx: DynamicLength=false, PduLength=8
        VcuTxIoMsg4_oTC37X_VCU_CAN00_06b318ea_Tx: DynamicLength=false, PduLength=8, SysTPduToFrameMappingRef=VcuTxIoMsg4
        VcuTxIoMsg4_oTC37X_VCU_CAN00_b0722b3a_Tx: DynamicLength=false, PduLength=8
        VcuTxIoMsg5_oTC37X_VCU_CAN00_41a0ee11_Tx: DynamicLength=false, PduLength=8, SysTPduToFrameMappingRef=VcuTxIoMsg5
        VcuTxIoMsg5_oTC37X_VCU_CAN00_5f209ddb_Tx: DynamicLength=false, PduLength=8
        VcuTxIoMsg6_oTC37X_VCU_CAN00_8894f51c_Tx: DynamicLength=false, PduLength=8, SysTPduToFrameMappingRef=VcuTxIoMsg6
        VcuTxIoMsg6_oTC37X_VCU_CAN00_b5a640b9_Tx: DynamicLength=false, PduLength=8
        VcuTxIoMsg7_oTC37X_VCU_CAN00_5af4f658_Tx: DynamicLength=false, PduLength=8
        VcuTxIoMsg7_oTC37X_VCU_CAN00_cf8703e7_Tx: DynamicLength=false, PduLength=8, SysTPduToFrameMappingRef=VcuTxIoMsg7
        VcuTxIoMsg8_oTC37X_VCU_CAN00_9481785c_Tx: DynamicLength=false, PduLength=8, SysTPduToFrameMappingRef=VcuTxIoMsg8
        VcuTxIoMsg8_oTC37X_VCU_CAN00_ac8b5230_Tx: DynamicLength=false, PduLength=8
        VcuTxMsg1_oTC37X_VCU_CAN00_954a27ee_Tx: DynamicLength=false, PduLength=8
        VcuTxMsg1_oTC37X_VCU_CAN00_c82dd125_Tx: DynamicLength=false, PduLength=8, SysTPduToFrameMappingRef=VcuTxMsg1
        VcuTxMsg2_oTC37X_VCU_CAN00_0119ca28_Tx: DynamicLength=false, PduLength=8, SysTPduToFrameMappingRef=VcuTxMsg2
        VcuTxMsg2_oTC37X_VCU_CAN00_7fccfa8c_Tx: DynamicLength=false, PduLength=8
        Vcu_Lin0_RxMsg1_oLIN01_079b7478_Rx: DynamicLength=false, PduLength=8, SysTPduToFrameMappingRef=Vcu_Lin0_RxMsg1
        Vcu_Lin0_RxMsg1_oLIN01_24780c64_Rx: DynamicLength=false, PduLength=8
        Vcu_Lin0_RxMsg2_oLIN01_717e4d45_Rx: DynamicLength=false, PduLength=8, SysTPduToFrameMappingRef=Vcu_Lin0_RxMsg2
        Vcu_Lin0_RxMsg2_oLIN01_aaf70b87_Rx: DynamicLength=false, PduLength=8
        Vcu_Lin0_TxMsg1_oLIN01_02277a36_Tx: DynamicLength=false, PduLength=8, SysTPduToFrameMappingRef=Vcu_Lin0_TxMsg1
        Vcu_Lin0_TxMsg1_oLIN01_849dd3b9_Tx: DynamicLength=false, PduLength=8
        Vcu_Lin0_TxMsg2_oLIN01_0a12d45a_Tx: DynamicLength=false, PduLength=8
        Vcu_Lin0_TxMsg2_oLIN01_74c2430b_Tx: DynamicLength=false, PduLength=8, SysTPduToFrameMappingRef=Vcu_Lin0_TxMsg2
        Vcu_Uds_Func_Request_Tp_oTC37X_VCU_CAN00_3dbedef7_Rx: DynamicLength=false, PduLength=8, SysTPduToFrameMappingRef=Vcu_Uds_Func_Request_Tp
        Vcu_Uds_Func_Request_oTC37X_VCU_CAN00_21e26bac_Rx: DynamicLength=true, PduLength=7
        Vcu_Uds_Func_Request_oTC37X_VCU_CAN00_455d4346_Rx: DynamicLength=true, PduLength=7
        Vcu_Uds_Phy_Request_Tp_oTC37X_VCU_CAN00_58c52463_Rx: DynamicLength=false, PduLength=8, SysTPduToFrameMappingRef=Vcu_Uds_Phy_Request_Tp
        Vcu_Uds_Phy_Request_oTC37X_VCU_CAN00_16119f6f_Rx: DynamicLength=true, PduLength=8
        Vcu_Uds_Phy_Request_oTC37X_VCU_CAN00_d561dcee_Rx: DynamicLength=true, PduLength=8
        Vcu_Uds_Response_Tp_oTC37X_VCU_CAN00_834178f3_Tx: DynamicLength=false, PduLength=8, SysTPduToFrameMappingRef=Vcu_Uds_Response_Tp
        Vcu_Uds_Response_oTC37X_VCU_CAN00_39638a1a_Tx: DynamicLength=true, PduLength=8
        Vcu_Uds_Response_oTC37X_VCU_CAN00_4d111be6_Tx: DynamicLength=true, PduLength=8
        XCP_Request_oTC37X_VCU_CAN00_3c25b45e_Rx: DynamicLength=false, PduLength=8, SysTPduToFrameMappingRef=XCP_Request
        XCP_Response_oTC37X_VCU_CAN00_34d2da2d_Tx: DynamicLength=false, PduLength=8, SysTPduToFrameMappingRef=XCP_Response
  module config EcuM
    EcuMConfiguration
      EcuMCommonConfiguration
        EcuMDriverInitListOne
        EcuMDriverRestartList
        7 x EcuMWakeupSource:
          CN_ATOM_CANFD_Matrix_CH_V600_202502_a4d436ac: EcuMWakeupSourceId=5, EcuMComMChannelRef=ComMConfigSet/CN_ATOM_CANFD_Matrix_CH_V600_202502_a4d436ac
          CN_LIN00_b12a0454: EcuMWakeupSourceId=10, EcuMComMChannelRef=ComMConfigSet/CN_LIN00_b12a0454
          CN_LIN01_c62d34c2: EcuMWakeupSourceId=11, EcuMComMChannelRef=ComMConfigSet/CN_LIN01_c62d34c2
          CN_TC37X_VCU_CAN00_07b6c9c8: EcuMWakeupSourceId=6, EcuMComMChannelRef=ComMConfigSet/CN_TC37X_VCU_CAN00_07b6c9c8
          CN_TC37X_VCU_CAN01_70b1f95e: EcuMWakeupSourceId=7, EcuMComMChannelRef=ComMConfigSet/CN_TC37X_VCU_CAN01_70b1f95e
          CN_TC37X_VCU_CAN03_9ebf9872: EcuMWakeupSourceId=8, EcuMComMChannelRef=ComMConfigSet/CN_TC37X_VCU_CAN03_9ebf9872
          CN_TC37X_VCU_CAN12_f0a399a5: EcuMWakeupSourceId=9, EcuMComMChannelRef=ComMConfigSet/CN_TC37X_VCU_CAN12_f0a399a5
      EcuMFlexConfiguration: EcuMFlexModuleConfigurationRef=CanConfigSet, EcuMFlexModuleConfigurationRef=LinGlobalConfig
  module config Lin
    LinGlobalConfig
      CN_LIN00_b12a0454 (LinChannel): LinChannelBaudRate=19200, LinChannelId=0, LinChannelEcuMWakeupSource=EcuMCommonConfiguration/CN_LIN00_b12a0454  # LIN00
      CN_LIN01_c62d34c2 (LinChannel): LinChannelBaudRate=19200, LinChannelId=1, LinChannelEcuMWakeupSource=EcuMCommonConfiguration/CN_LIN01_c62d34c2  # LIN01
  module config LinIf
    LinIfGeneral: LinIfJ2602ResponseToleranceSupport=false
    LinIfGlobalConfig
      CHNL_45618847 (LinIfChannel): LinIfClusterTimeBase=0.005, LinIfChannelRef=LinGlobalConfig/CN_LIN00_b12a0454, LinIfComMNetworkHandleRef=ComMConfigSet/CN_LIN00_b12a0454
        16 x LinIfFrame:
          FT_EDCU_EXV2_cbc2ea70_Tx: LinIfChecksumType=ENHANCED, LinIfLength=8, LinIfPid=226
            LinIfPduDirection
              LinIfTxPdu_51fe7a72 (LinIfTxPdu): LinIfTxPduRef=EcucPduCollection/EDCU_EXV2_oLIN00_18b050dc_Tx
          FT_EXV2_Status_7cc3db8b_Rx: LinIfChecksumType=ENHANCED, LinIfLength=8, LinIfPid=146
            LinIfPduDirection
              LinIfRxPdu: LinIfRxPduRef=EcucPduCollection/EXV2_Status_oLIN00_7fcf9f75_Rx
          FT_EXV_1_VCU_83f01f29_Rx: LinIfChecksumType=ENHANCED, LinIfLength=8, LinIfPid=173
            LinIfPduDirection
              LinIfRxPdu: LinIfRxPduRef=EcucPduCollection/EXV_1_VCU_oLIN00_366267d6_Rx
          FT_EXV_2_VCU_c45065f9_Rx: LinIfChecksumType=ENHANCED, LinIfLength=8, LinIfPid=245
            LinIfPduDirection
              LinIfRxPdu: LinIfRxPduRef=EcucPduCollection/EXV_2_VCU_oLIN00_85f64a15_Rx
          FT_HVCH_Rsp01_09d67b55_Rx: LinIfChecksumType=ENHANCED, LinIfLength=8, LinIfPid=214
            LinIfPduDirection
              LinIfRxPdu: LinIfRxPduRef=EcucPduCollection/HVCH_Rsp01_oLIN00_d50f5fa3_Rx
          FT_HVCH_Rsp02_90df2aef_Rx: LinIfChecksumType=ENHANCED, LinIfLength=8, LinIfPid=151
            LinIfPduDirection
              LinIfRxPdu: LinIfRxPduRef=EcucPduCollection/HVCH_Rsp02_oLIN00_a3ea669e_Rx
          FT_MasterReq_355bc768_Tx: LinIfChecksumType=CLASSIC, LinIfFrameType=MRF, LinIfLength=8, LinIfPid=60
            LinIfPduDirection
              LinIfInternalPdu
          FT_PMP2_Sts_c93e4d7b_Rx: LinIfChecksumType=ENHANCED, LinIfLength=8, LinIfPid=166
            LinIfPduDirection
              LinIfRxPdu: LinIfRxPduRef=EcucPduCollection/PMP2_Sts_oLIN00_200c907c_Rx
          FT_PMP3_Sts_f45e64cb_Rx: LinIfChecksumType=ENHANCED, LinIfLength=8, LinIfPid=231
            LinIfPduDirection
              LinIfRxPdu: LinIfRxPduRef=EcucPduCollection/PMP3_Sts_oLIN00_4e808b3d_Rx
          FT_PMP_Cmd_bd05f3f5_Tx: LinIfChecksumType=ENHANCED, LinIfLength=8, LinIfPid=100
            LinIfPduDirection
              LinIfTxPdu_c5fc6a36 (LinIfTxPdu): LinIfTxPduRef=EcucPduCollection/PMP_Cmd_oLIN00_6d889c97_Tx
          FT_SVA_VCU_STD_d43d5185_Rx: LinIfChecksumType=ENHANCED, LinIfLength=8, LinIfPid=17
            LinIfPduDirection
              LinIfRxPdu: LinIfRxPduRef=EcucPduCollection/SVA_VCU_STD_oLIN00_4f0795ef_Rx
          FT_SlaveResp_9d5cbedc_Rx: LinIfChecksumType=CLASSIC, LinIfFrameType=SRF, LinIfLength=8, LinIfPid=125
            LinIfPduDirection
              LinIfInternalPdu
          FT_TCU_HVCH_Cmd_ccc60f64_Tx: LinIfChecksumType=ENHANCED, LinIfLength=4, LinIfPid=85
            LinIfPduDirection
              LinIfTxPdu_d8f856fb (LinIfTxPdu): LinIfTxPduRef=EcucPduCollection/TCU_HVCH_Cmd_oLIN00_ddc31229_Tx
          FT_VCU_EXV_1_3ba9d0d7_Tx: LinIfChecksumType=ENHANCED, LinIfLength=8, LinIfPid=31
            LinIfPduDirection
              LinIfTxPdu_66470162 (LinIfTxPdu): LinIfTxPduRef=EcucPduCollection/VCU_EXV_1_oLIN00_58a890ac_Tx
          FT_VCU_EXV_2_a2a0816d_Tx: LinIfChecksumType=ENHANCED, LinIfLength=8, LinIfPid=180
            LinIfPduDirection
              LinIfTxPdu_814bac9f (LinIfTxPdu): LinIfTxPduRef=EcucPduCollection/VCU_EXV_2_oLIN00_2e4da991_Tx
          FT_VCU_SVA_CMD_86a423b3_Tx: LinIfChecksumType=ENHANCED, LinIfLength=8, LinIfPid=80
            LinIfPduDirection
              LinIfTxPdu_d60e946c (LinIfTxPdu): LinIfTxPduRef=EcucPduCollection/VCU_SVA_CMD_oLIN00_89e2bb7b_Tx
        LinIfNodeType  # CT_LIN00
          CT_LIN00_7284c7d4 (LinIfMaster): LinIfJitter=0.0001
        NULLSchedule_CHNL_45618847 (LinIfScheduleTable): LinIfResumePosition=CONTINUE_AT_IT_POINT, LinIfRunMode=RUN_CONTINUOUS, LinIfScheduleMode=LINTP_APPLICATIVE_SCHEDULE, LinIfScheduleTableIndex=0
        TCU_LIN_Schedule_740f8639 (LinIfScheduleTable): LinIfRunMode=RUN_CONTINUOUS, LinIfScheduleTableIndex=1, LinIfScheduleTableName=
          14 x LinIfEntry:
            TCU_LIN_Schedule_00931437: LinIfDelay=0.1, LinIfEntryIndex=2, LinIfFrameRef=FT_VCU_EXV_1_3ba9d0d7_Tx
            TCU_LIN_Schedule_05477fb4: LinIfDelay=0.01, LinIfEntryIndex=0, LinIfFrameRef=FT_EDCU_EXV2_cbc2ea70_Tx
            TCU_LIN_Schedule_0b3bc331: LinIfDelay=0.01, LinIfEntryIndex=6, LinIfFrameRef=FT_PMP_Cmd_bd05f3f5_Tx
            TCU_LIN_Schedule_0b57a2ce: LinIfDelay=0.02, LinIfEntryIndex=11, LinIfFrameRef=FT_TCU_HVCH_Cmd_ccc60f64_Tx
            TCU_LIN_Schedule_0e83c94d: LinIfDelay=0.02, LinIfEntryIndex=13, LinIfFrameRef=FT_HVCH_Rsp02_90df2aef_Rx
            TCU_LIN_Schedule_0eefa8b2: LinIfDelay=0.1, LinIfEntryIndex=4, LinIfFrameRef=FT_VCU_EXV_2_a2a0816d_Tx
            TCU_LIN_Schedule_1216d1b8: LinIfDelay=0.01, LinIfEntryIndex=8, LinIfFrameRef=FT_PMP3_Sts_f45e64cb_Rx
            TCU_LIN_Schedule_e1bd1e53: LinIfDelay=0.1, LinIfEntryIndex=5, LinIfFrameRef=FT_EXV_2_VCU_c45065f9_Rx
            TCU_LIN_Schedule_e1d17fac: LinIfDelay=0.02, LinIfEntryIndex=12, LinIfFrameRef=FT_HVCH_Rsp01_09d67b55_Rx
            TCU_LIN_Schedule_e405142f: LinIfDelay=0.015, LinIfEntryIndex=10, LinIfFrameRef=FT_SVA_VCU_STD_d43d5185_Rx
            TCU_LIN_Schedule_e46975d0: LinIfDelay=0.01, LinIfEntryIndex=7, LinIfFrameRef=FT_PMP2_Sts_c93e4d7b_Rx
            TCU_LIN_Schedule_ea15c955: LinIfDelay=0.01, LinIfEntryIndex=1, LinIfFrameRef=FT_EXV2_Status_7cc3db8b_Rx
            TCU_LIN_Schedule_efc1a2d6: LinIfDelay=0.1, LinIfEntryIndex=3, LinIfFrameRef=FT_EXV_1_VCU_83f01f29_Rx
            TCU_LIN_Schedule_fd446759: LinIfDelay=0.015, LinIfEntryIndex=9, LinIfFrameRef=FT_VCU_SVA_CMD_86a423b3_Tx
      CHNL_8e3d5be2 (LinIfChannel): LinIfClusterTimeBase=0.005, LinIfChannelRef=LinGlobalConfig/CN_LIN01_c62d34c2, LinIfComMNetworkHandleRef=ComMConfigSet/CN_LIN01_c62d34c2
        6 x LinIfFrame, all with LinIfLength=8:
          FT_MasterReq_e2b94730_Tx: LinIfChecksumType=CLASSIC, LinIfFrameType=MRF, LinIfPid=60
            LinIfPduDirection
              LinIfInternalPdu
          FT_SlaveResp_4abe3e84_Rx: LinIfChecksumType=CLASSIC, LinIfFrameType=SRF, LinIfPid=125
            LinIfPduDirection
              LinIfInternalPdu
          FT_Vcu_Lin0_RxMsg1_83589417_Rx: LinIfChecksumType=ENHANCED, LinIfPid=32
            LinIfPduDirection
              LinIfRxPdu: LinIfRxPduRef=EcucPduCollection/Vcu_Lin0_RxMsg1_oLIN01_079b7478_Rx
          FT_Vcu_Lin0_RxMsg2_1a51c5ad_Rx: LinIfChecksumType=ENHANCED, LinIfPid=97
            LinIfPduDirection
              LinIfRxPdu: LinIfRxPduRef=EcucPduCollection/Vcu_Lin0_RxMsg2_oLIN01_717e4d45_Rx
          FT_Vcu_Lin0_TxMsg1_5501770a_Tx: LinIfChecksumType=ENHANCED, LinIfPid=94
            LinIfPduDirection
              LinIfTxPdu_76dd5725 (LinIfTxPdu): LinIfTxPduRef=EcucPduCollection/Vcu_Lin0_TxMsg1_oLIN01_02277a36_Tx
          FT_Vcu_Lin0_TxMsg2_cc0826b0_Tx: LinIfChecksumType=ENHANCED, LinIfPid=31
            LinIfPduDirection
              LinIfTxPdu_87e9e0e9 (LinIfTxPdu): LinIfTxPduRef=EcucPduCollection/Vcu_Lin0_TxMsg2_oLIN01_74c2430b_Tx
        LinIfNodeType  # CT_LIN01
          CT_LIN01_0583f742 (LinIfMaster): LinIfJitter=0.0001
        NULLSchedule (LinIfScheduleTable): LinIfResumePosition=CONTINUE_AT_IT_POINT, LinIfRunMode=RUN_CONTINUOUS, LinIfScheduleMode=LINTP_APPLICATIVE_SCHEDULE, LinIfScheduleTableIndex=0
        Vcu_Lin0_Schedule_0e999bb4 (LinIfScheduleTable): LinIfRunMode=RUN_CONTINUOUS, LinIfScheduleTableIndex=1, LinIfScheduleTableName=
          4 x LinIfEntry, all with LinIfDelay=0.02:
            Vcu_Lin0_Schedule_519d2303: LinIfEntryIndex=2, LinIfFrameRef=FT_Vcu_Lin0_RxMsg1_83589417_Rx
            Vcu_Lin0_Schedule_54494880: LinIfEntryIndex=0, LinIfFrameRef=FT_Vcu_Lin0_TxMsg1_5501770a_Tx
            Vcu_Lin0_Schedule_bb1bfe61: LinIfEntryIndex=1, LinIfFrameRef=FT_Vcu_Lin0_TxMsg2_cc0826b0_Tx
            Vcu_Lin0_Schedule_becf95e2: LinIfEntryIndex=3, LinIfFrameRef=FT_Vcu_Lin0_RxMsg2_1a51c5ad_Rx
  module config LinSM
    LinSMConfigSet
      CHNL_45618847 (LinSMChannel): LinSMNodeType=MASTER, LinSMComMNetworkHandleRef=ComMConfigSet/CN_LIN00_b12a0454
        CHNL_45618847_32a17f26 (LinSMSchedule): LinSMScheduleIndex=0, LinSMScheduleIndexRef=NULLSchedule_CHNL_45618847
        TCU_LIN_Schedule_740f8639 (LinSMSchedule): LinSMScheduleIndex=1, LinSMScheduleIndexRef=CHNL_45618847/TCU_LIN_Schedule_740f8639
      CHNL_8e3d5be2 (LinSMChannel): LinSMNodeType=MASTER, LinSMComMNetworkHandleRef=ComMConfigSet/CN_LIN01_c62d34c2
        CHNL_8e3d5be2_a66eb9f7 (LinSMSchedule): LinSMScheduleIndex=0, LinSMScheduleIndexRef=NULLSchedule
        Vcu_Lin0_Schedule_0e999bb4 (LinSMSchedule): LinSMScheduleIndex=1, LinSMScheduleIndexRef=CHNL_8e3d5be2/Vcu_Lin0_Schedule_0e999bb4
  module config LinTp
    LinTpGeneral: LinTpFunctionalRequestsSupported=true
    LinTpGlobalConfig
      CHNL_45618847 (LinTpChannelConfig): LinTpChannelRef=LinIfGlobalConfig/CHNL_45618847
      CHNL_8e3d5be2 (LinTpChannelConfig): LinTpChannelRef=LinIfGlobalConfig/CHNL_8e3d5be2
      8 x LinTpRxNSdu, all with LinTpDl=8:
        SlaveResp_ERV_oLIN00_e833ce7b_Rx: LinTpRxNSduNad=98, LinTpRxNSduChannelRef=LinIfGlobalConfig/CHNL_45618847, LinTpRxNSduPduRef=EcucPduCollection/SlaveResp_ERV_oLIN00_4c387f1b_Rx
        SlaveResp_EXV_1_oLIN00_1f09933d_Rx: LinTpRxNSduNad=99, LinTpRxNSduChannelRef=LinIfGlobalConfig/CHNL_45618847, LinTpRxNSduPduRef=EcucPduCollection/SlaveResp_EXV_1_oLIN00_39fbe7c0_Rx
        SlaveResp_EXV_2_oLIN00_918694de_Rx: LinTpRxNSduNad=100, LinTpRxNSduChannelRef=LinIfGlobalConfig/CHNL_45618847, LinTpRxNSduPduRef=EcucPduCollection/SlaveResp_EXV_2_oLIN00_4f1edefd_Rx
        SlaveResp_GWM_oLIN01_f08746e2_Rx: LinTpRxNSduNad=82, LinTpRxNSduChannelRef=LinIfGlobalConfig/CHNL_8e3d5be2, LinTpRxNSduPduRef=EcucPduCollection/SlaveResp_GWM_oLIN01_9a3cff6e_Rx
        SlaveResp_HVCH_oLIN00_43b1b673_Rx: LinTpRxNSduNad=91, LinTpRxNSduChannelRef=LinIfGlobalConfig/CHNL_45618847, LinTpRxNSduPduRef=EcucPduCollection/SlaveResp_HVCH_oLIN00_93d59ea5_Rx
        SlaveResp_PMP_1_oLIN00_590d111f_Rx: LinTpRxNSduNad=116, LinTpRxNSduChannelRef=LinIfGlobalConfig/CHNL_45618847, LinTpRxNSduPduRef=EcucPduCollection/SlaveResp_PMP_1_oLIN00_64423b06_Rx
        SlaveResp_PMP_2_oLIN00_d78216fc_Rx: LinTpRxNSduNad=117, LinTpRxNSduChannelRef=LinIfGlobalConfig/CHNL_45618847, LinTpRxNSduPduRef=EcucPduCollection/SlaveResp_PMP_2_oLIN00_12a7023b_Rx
        SlaveResp_SVA_oLIN00_e91156ea_Rx: LinTpRxNSduNad=101, LinTpRxNSduChannelRef=LinIfGlobalConfig/CHNL_45618847, LinTpRxNSduPduRef=EcucPduCollection/SlaveResp_SVA_oLIN00_6139b46e_Rx
      10 x LinTpTxNSdu:
        MasterReq_ERV_oLIN00_10f4fcd8_Tx: LinTpTxNSduNad=98, LinTpTxNSduChannelRef=LinIfGlobalConfig/CHNL_45618847, LinTpTxNSduPduRef=EcucPduCollection/MasterReq_ERV_oLIN00_f3aa7150_Tx
        MasterReq_EXV_1_oLIN00_52f4d550_Tx: LinTpTxNSduNad=99, LinTpTxNSduChannelRef=LinIfGlobalConfig/CHNL_45618847, LinTpTxNSduPduRef=EcucPduCollection/MasterReq_EXV_1_oLIN00_cdcee39b_Tx
        MasterReq_EXV_2_oLIN00_dc7bd2b3_Tx: LinTpTxNSduNad=100, LinTpTxNSduChannelRef=LinIfGlobalConfig/CHNL_45618847, LinTpTxNSduPduRef=EcucPduCollection/MasterReq_EXV_2_oLIN00_bb2bdaa6_Tx
        MasterReq_GWM_oLIN01_08407441_Tx: LinTpTxNSduNad=82, LinTpTxNSduChannelRef=LinIfGlobalConfig/CHNL_8e3d5be2, LinTpTxNSduPduRef=EcucPduCollection/MasterReq_GWM_oLIN01_25aef125_Tx
        MasterReq_HVCH_oLIN00_0c968313_Tx: LinTpTxNSduNad=91, LinTpTxNSduChannelRef=LinIfGlobalConfig/CHNL_45618847, LinTpTxNSduPduRef=EcucPduCollection/MasterReq_HVCH_oLIN00_726494b3_Tx
        MasterReq_PMP_1_oLIN00_14f05772_Tx: LinTpTxNSduNad=116, LinTpTxNSduChannelRef=LinIfGlobalConfig/CHNL_45618847, LinTpTxNSduPduRef=EcucPduCollection/MasterReq_PMP_1_oLIN00_90773f5d_Tx
        MasterReq_PMP_2_oLIN00_9a7f5091_Tx: LinTpTxNSduNad=117, LinTpTxNSduChannelRef=LinIfGlobalConfig/CHNL_45618847, LinTpTxNSduPduRef=EcucPduCollection/MasterReq_PMP_2_oLIN00_e6920660_Tx
        MasterReq_SVA_oLIN00_11d66449_Tx: LinTpTxNSduNad=101, LinTpTxNSduChannelRef=LinIfGlobalConfig/CHNL_45618847, LinTpTxNSduPduRef=EcucPduCollection/MasterReq_SVA_oLIN00_deabba25_Tx
        MasterReq_oLIN00_4a2bb011_Tx: LinTpTxNSduNad=126, LinTpTxNSduChannelRef=LinIfGlobalConfig/CHNL_45618847, LinTpTxNSduPduRef=EcucPduCollection/MasterReq_oLIN00_3234fe1b_Tx
        MasterReq_oLIN01_3d2c8087_Tx: LinTpTxNSduNad=126, LinTpTxNSduChannelRef=LinIfGlobalConfig/CHNL_8e3d5be2, LinTpTxNSduPduRef=EcucPduCollection/MasterReq_oLIN01_eb5b5f1c_Tx
  module config Nm
    5 x NmChannelConfig:
      CN_ATOM_CANFD_Matrix_CH_V600_202502_a4d436ac: NmComMChannelRef=ComMConfigSet/CN_ATOM_CANFD_Matrix_CH_V600_202502_a4d436ac
        ATOM_CANFD_Matrix_CH_V600_202502_CAN_b5bd2095 (NmBusType)
          NmStandardBusNmConfig: NmStandardBusType=NM_BUSNM_CANNM  # ATOM_CANFD_Matrix_CH_V600_202502_CAN
      CN_TC37X_VCU_CAN00_07b6c9c8: NmComMChannelRef=ComMConfigSet/CN_TC37X_VCU_CAN00_07b6c9c8
        TC37X_VCU_CAN00_CAN_cc8c31fa (NmBusType)
          NmStandardBusNmConfig: NmStandardBusType=NM_BUSNM_CANNM  # TC37X_VCU_CAN00_CAN
      CN_TC37X_VCU_CAN01_70b1f95e: NmComMChannelRef=ComMConfigSet/CN_TC37X_VCU_CAN01_70b1f95e
        TC37X_VCU_CAN01_CAN_f1ec184a (NmBusType)
          NmStandardBusNmConfig: NmStandardBusType=NM_BUSNM_CANNM  # TC37X_VCU_CAN01_CAN
      CN_TC37X_VCU_CAN03_9ebf9872: NmComMChannelRef=ComMConfigSet/CN_TC37X_VCU_CAN03_9ebf9872
        TC37X_VCU_CAN03_CAN_8b2c4b2a (NmBusType)
          NmStandardBusNmConfig: NmStandardBusType=NM_BUSNM_CANNM  # TC37X_VCU_CAN03_CAN
      CN_TC37X_VCU_CAN12_f0a399a5: NmComMChannelRef=ComMConfigSet/CN_TC37X_VCU_CAN12_f0a399a5
        TC37X_VCU_CAN12_CAN_7d10b13f (NmBusType)
          NmStandardBusNmConfig: NmStandardBusType=NM_BUSNM_CANNM  # TC37X_VCU_CAN12_CAN
    NmGlobalConfig
      NmGlobalFeatures: NmNodeIdEnabled=true, NmUserDataEnabled=true
      NmGlobalProperties
  module config PduR
    PduRGeneral
    PduRRoutingTables
      PduRRoutingTable
        108 x PduRRoutingPath:
          ACU_01_oATOM_CANFD_Matrix_CH_V600_202502_1343b9ef_Rx
            ACU_01_oATOM_CANFD_Matrix_CH_V600_202502_1343b9ef_Rx_9eae4558_Rx (PduRDestPdu): PduRDestPduRef=EcucPduCollection/ACU_01_oATOM_CANFD_Matrix_CH_V600_202502_92b30981_Rx
            PduRSrcPdu_9eae4558 (PduRSrcPdu): PduRSrcPduRef=EcucPduCollection/ACU_01_oATOM_CANFD_Matrix_CH_V600_202502_1343b9ef_Rx
          ACU_02_oATOM_CANFD_Matrix_CH_V600_202502_8a035e80_Rx
            ACU_02_oATOM_CANFD_Matrix_CH_V600_202502_8a035e80_Rx_0dbe25ba_Rx (PduRDestPdu): PduRDestPduRef=EcucPduCollection/ACU_02_oATOM_CANFD_Matrix_CH_V600_202502_19603798_Rx
            PduRSrcPdu_0dbe25ba (PduRSrcPdu): PduRSrcPduRef=EcucPduCollection/ACU_02_oATOM_CANFD_Matrix_CH_V600_202502_8a035e80_Rx
          ACU_info_oATOM_CANFD_Matrix_CH_V600_202502_83006605_Rx
            ACU_info_oATOM_CANFD_Matrix_CH_V600_202502_83006605_Rx_f767588b_Rx (PduRDestPdu): PduRDestPduRef=EcucPduCollection/ACU_info_oATOM_CANFD_Matrix_CH_V600_202502_c3757d77_Rx
            PduRSrcPdu_f767588b (PduRSrcPdu): PduRSrcPduRef=EcucPduCollection/ACU_info_oATOM_CANFD_Matrix_CH_V600_202502_83006605_Rx
          ADCU_ACC_02_oATOM_CANFD_Matrix_CH_V600_202502_9c78bb9f_Rx
            ADCU_ACC_02_oATOM_CANFD_Matrix_CH_V600_202502_9c78bb9f_Rx_56f39b3b_Rx (PduRDestPdu): PduRDestPduRef=EcucPduCollection/ADCU_ACC_02_oATOM_CANFD_Matrix_CH_V600_202502_09e0da82_Rx
            PduRSrcPdu_56f39b3b (PduRSrcPdu): PduRSrcPduRef=EcucPduCollection/ADCU_ACC_02_oATOM_CANFD_Matrix_CH_V600_202502_9c78bb9f_Rx
          ADCU_AEB_01_oATOM_CANFD_Matrix_CH_V600_202502_aeea498e_Rx
            ADCU_AEB_01_oATOM_CANFD_Matrix_CH_V600_202502_aeea498e_Rx_686bd310_Rx (PduRDestPdu): PduRDestPduRef=EcucPduCollection/ADCU_AEB_01_oATOM_CANFD_Matrix_CH_V600_202502_73fc26ce_Rx
            PduRSrcPdu_686bd310 (PduRSrcPdu): PduRSrcPduRef=EcucPduCollection/ADCU_AEB_01_oATOM_CANFD_Matrix_CH_V600_202502_aeea498e_Rx
          ADCU_APS_01_oATOM_CANFD_Matrix_CH_V600_202502_c0dbb601_Rx
            ADCU_APS_01_oATOM_CANFD_Matrix_CH_V600_202502_c0dbb601_Rx_d84c121b_Rx (PduRDestPdu): PduRDestPduRef=EcucPduCollection/ADCU_APS_01_oATOM_CANFD_Matrix_CH_V600_202502_d7aca41b_Rx
            PduRSrcPdu_d84c121b (PduRSrcPdu): PduRSrcPduRef=EcucPduCollection/ADCU_APS_01_oATOM_CANFD_Matrix_CH_V600_202502_c0dbb601_Rx
          ADCU_APS_02_oATOM_CANFD_Matrix_CH_V600_202502_599b516e_Rx
            ADCU_APS_02_oATOM_CANFD_Matrix_CH_V600_202502_599b516e_Rx_bc9c1fec_Rx (PduRDestPdu): PduRDestPduRef=EcucPduCollection/ADCU_APS_02_oATOM_CANFD_Matrix_CH_V600_202502_5c7f9a02_Rx
            PduRSrcPdu_bc9c1fec (PduRSrcPdu): PduRSrcPduRef=EcucPduCollection/ADCU_APS_02_oATOM_CANFD_Matrix_CH_V600_202502_599b516e_Rx
          ADCU_DA_oATOM_CANFD_Matrix_CH_V600_202502_8a75132b_Rx
            ADCU_DA_oATOM_CANFD_Matrix_CH_V600_202502_8a75132b_Rx_08ea31b4_Rx (PduRDestPdu): PduRDestPduRef=EcucPduCollection/ADCU_DA_oATOM_CANFD_Matrix_CH_V600_202502_c19ff818_Rx
            PduRSrcPdu_08ea31b4 (PduRSrcPdu): PduRSrcPduRef=EcucPduCollection/ADCU_DA_oATOM_CANFD_Matrix_CH_V600_202502_8a75132b_Rx
          EDCU_EXV2_oLIN00_1f8750a5_Tx
            EDCU_EXV2_oLIN00_18b050dc_Tx (PduRDestPdu): PduRDestPduRef=EcucPduCollection/EDCU_EXV2_oLIN00_18b050dc_Tx
            PduRSrcPdu_0361509d (PduRSrcPdu): PduRSrcPduRef=EcucPduCollection/EDCU_EXV2_oLIN00_1f8750a5_Tx
          EXV2_Status_oLIN00_7fcf9f75_Rx
            EXV2_Status_oLIN00_7fcf9f75_Rx_c3f2be6b_Rx (PduRDestPdu): PduRDestPduRef=EcucPduCollection/EXV2_Status_oLIN00_d5e93929_Rx
            PduRSrcPdu_c3f2be6b (PduRSrcPdu): PduRSrcPduRef=EcucPduCollection/EXV2_Status_oLIN00_7fcf9f75_Rx
          EXV_1_VCU_oLIN00_366267d6_Rx
            EXV_1_VCU_oLIN00_366267d6_Rx_718a1cfb_Rx (PduRDestPdu): PduRDestPduRef=EcucPduCollection/EXV_1_VCU_oLIN00_69d4ef5f_Rx
            PduRSrcPdu_718a1cfb (PduRSrcPdu): PduRSrcPduRef=EcucPduCollection/EXV_1_VCU_oLIN00_366267d6_Rx
          EXV_2_VCU_oLIN00_85f64a15_Rx
            EXV_2_VCU_oLIN00_85f64a15_Rx_b894d38e_Rx (PduRDestPdu): PduRDestPduRef=EcucPduCollection/EXV_2_VCU_oLIN00_1e4a3daf_Rx
            PduRSrcPdu_b894d38e (PduRSrcPdu): PduRSrcPduRef=EcucPduCollection/EXV_2_VCU_oLIN00_85f64a15_Rx
          HVCH_Rsp01_oLIN00_d50f5fa3_Rx
            HVCH_Rsp01_oLIN00_d50f5fa3_Rx_aa2a3f7d_Rx (PduRDestPdu): PduRDestPduRef=EcucPduCollection/HVCH_Rsp01_oLIN00_a6e33eef_Rx
            PduRSrcPdu_aa2a3f7d (PduRSrcPdu): PduRSrcPduRef=EcucPduCollection/HVCH_Rsp01_oLIN00_d50f5fa3_Rx
          HVCH_Rsp02_oLIN00_a3ea669e_Rx
            HVCH_Rsp02_oLIN00_a3ea669e_Rx_90a9658c_Rx (PduRDestPdu): PduRDestPduRef=EcucPduCollection/HVCH_Rsp02_oLIN00_286c390c_Rx
            PduRSrcPdu_90a9658c (PduRSrcPdu): PduRSrcPduRef=EcucPduCollection/HVCH_Rsp02_oLIN00_a3ea669e_Rx
          IBS_ACC_oATOM_CANFD_Matrix_CH_V600_202502_205c1446_Rx
            IBS_ACC_oATOM_CANFD_Matrix_CH_V600_202502_205c1446_Rx_ca3eaa8a_Rx (PduRDestPdu): PduRDestPduRef=EcucPduCollection/IBS_ACC_oATOM_CANFD_Matrix_CH_V600_202502_ef8c28ba_Rx
            PduRSrcPdu_ca3eaa8a (PduRSrcPdu): PduRSrcPduRef=EcucPduCollection/IBS_ACC_oATOM_CANFD_Matrix_CH_V600_202502_205c1446_Rx
          IBS_APS_oATOM_CANFD_Matrix_CH_V600_202502_8feeb71a_Rx
            IBS_APS_oATOM_CANFD_Matrix_CH_V600_202502_8feeb71a_Rx_283e282c_Rx (PduRDestPdu): PduRDestPduRef=EcucPduCollection/IBS_APS_oATOM_CANFD_Matrix_CH_V600_202502_25d77553_Rx
            PduRSrcPdu_283e282c (PduRSrcPdu): PduRSrcPduRef=EcucPduCollection/IBS_APS_oATOM_CANFD_Matrix_CH_V600_202502_8feeb71a_Rx
          IBS_Status_01_oATOM_CANFD_Matrix_CH_V600_202502_acfe14e2_Rx
            IBS_Status_01_oATOM_CANFD_Matrix_CH_V600_202502_acfe14e2_Rx_d09902f0_Rx (PduRDestPdu): PduRDestPduRef=EcucPduCollection/IBS_Status_01_oATOM_CANFD_Matrix_CH_V600_202502_b0697754_Rx
            PduRSrcPdu_d09902f0 (PduRSrcPdu): PduRSrcPduRef=EcucPduCollection/IBS_Status_01_oATOM_CANFD_Matrix_CH_V600_202502_acfe14e2_Rx
          IBS_Status_02_oATOM_CANFD_Matrix_CH_V600_202502_35bef38d_Rx
            IBS_Status_02_oATOM_CANFD_Matrix_CH_V600_202502_35bef38d_Rx_77b4603c_Rx (PduRDestPdu): PduRDestPduRef=EcucPduCollection/IBS_Status_02_oATOM_CANFD_Matrix_CH_V600_202502_3bba494d_Rx
            PduRSrcPdu_77b4603c (PduRSrcPdu): PduRSrcPduRef=EcucPduCollection/IBS_Status_02_oATOM_CANFD_Matrix_CH_V600_202502_35bef38d_Rx
          IBS_Status_03_oATOM_CANFD_Matrix_CH_V600_202502_f451ac97_Rx
            IBS_Status_03_oATOM_CANFD_Matrix_CH_V600_202502_f451ac97_Rx_12481f07_Rx (PduRDestPdu): PduRDestPduRef=EcucPduCollection/IBS_Status_03_oATOM_CANFD_Matrix_CH_V600_202502_f4245e85_Rx
            PduRSrcPdu_12481f07 (PduRSrcPdu): PduRSrcPduRef=EcucPduCollection/IBS_Status_03_oATOM_CANFD_Matrix_CH_V600_202502_f451ac97_Rx
          IBS_Status_04_oATOM_CANFD_Matrix_CH_V600_202502_dc4e3b12_Rx
            IBS_Status_04_oATOM_CANFD_Matrix_CH_V600_202502_dc4e3b12_Rx_6a5d743a_Rx (PduRDestPdu): PduRDestPduRef=EcucPduCollection/IBS_Status_04_oATOM_CANFD_Matrix_CH_V600_202502_f76d333e_Rx
            PduRSrcPdu_6a5d743a (PduRSrcPdu): PduRSrcPduRef=EcucPduCollection/IBS_Status_04_oATOM_CANFD_Matrix_CH_V600_202502_dc4e3b12_Rx
          IBS_Status_06_oATOM_CANFD_Matrix_CH_V600_202502_84e18367_Rx
            IBS_Status_06_oATOM_CANFD_Matrix_CH_V600_202502_84e18367_Rx_65adbba1_Rx (PduRDestPdu): PduRDestPduRef=EcucPduCollection/IBS_Status_06_oATOM_CANFD_Matrix_CH_V600_202502_b3201aef_Rx
            PduRSrcPdu_65adbba1 (PduRSrcPdu): PduRSrcPduRef=EcucPduCollection/IBS_Status_06_oATOM_CANFD_Matrix_CH_V600_202502_84e18367_Rx
          IBS_Torque_oATOM_CANFD_Matrix_CH_V600_202502_94259583_Rx
            IBS_Torque_oATOM_CANFD_Matrix_CH_V600_202502_94259583_Rx_629168fc_Rx (PduRDestPdu): PduRDestPduRef=EcucPduCollection/IBS_Torque_oATOM_CANFD_Matrix_CH_V600_202502_e4106cfa_Rx
            PduRSrcPdu_629168fc (PduRSrcPdu): PduRSrcPduRef=EcucPduCollection/IBS_Torque_oATOM_CANFD_Matrix_CH_V600_202502_94259583_Rx
          IBS_VCU_MotorControl_oATOM_CANFD_Matrix_CH_V600_202502_df4c437b_Rx
            IBS_VCU_MotorControl_oATOM_CANFD_Matrix_CH_V600_202502_df4c437b_Rx_4e239512_Rx (PduRDestPdu): PduRDestPduRef=EcucPduCollection/IBS_VCU_MotorControl_oATOM_CANFD_Matrix_CH_V600_202502_d229d0d9_Rx
            PduRSrcPdu_4e239512 (PduRSrcPdu): PduRSrcPduRef=EcucPduCollection/IBS_VCU_MotorControl_oATOM_CANFD_Matrix_CH_V600_202502_df4c437b_Rx
          IBS_WheelSpeed_01_oATOM_CANFD_Matrix_CH_V600_202502_cdf72100_Rx
            IBS_WheelSpeed_01_oATOM_CANFD_Matrix_CH_V600_202502_cdf72100_Rx_fcecab79_Rx (PduRDestPdu): PduRDestPduRef=EcucPduCollection/IBS_WheelSpeed_01_oATOM_CANFD_Matrix_CH_V600_202502_1c45b3ee_Rx
            PduRSrcPdu_fcecab79 (PduRSrcPdu): PduRSrcPduRef=EcucPduCollection/IBS_WheelSpeed_01_oATOM_CANFD_Matrix_CH_V600_202502_cdf72100_Rx
          IBS_WheelSpeed_02_oATOM_CANFD_Matrix_CH_V600_202502_54b7c66f_Rx
            IBS_WheelSpeed_02_oATOM_CANFD_Matrix_CH_V600_202502_54b7c66f_Rx_ca150190_Rx (PduRDestPdu): PduRDestPduRef=EcucPduCollection/IBS_WheelSpeed_02_oATOM_CANFD_Matrix_CH_V600_202502_97968df7_Rx
            PduRSrcPdu_ca150190 (PduRSrcPdu): PduRSrcPduRef=EcucPduCollection/IBS_WheelSpeed_02_oATOM_CANFD_Matrix_CH_V600_202502_54b7c66f_Rx
          MasterReq_ERV_oLIN00_10f4fcd8_Tx
            MasterReq_ERV_oLIN00_f3aa7150_Tx (PduRDestPdu): PduRDestPduRef=EcucPduCollection/MasterReq_ERV_oLIN00_f3aa7150_Tx
            PduRSrcPdu_a9b251eb (PduRSrcPdu): PduRSrcPduRef=EcucPduCollection/MasterReq_ERV_oLIN00_10f4fcd8_Tx
          MasterReq_EXV_1_oLIN00_52f4d550_Tx
            MasterReq_EXV_1_oLIN00_cdcee39b_Tx (PduRDestPdu): PduRDestPduRef=EcucPduCollection/MasterReq_EXV_1_oLIN00_cdcee39b_Tx
            PduRSrcPdu_971d7b9f (PduRSrcPdu): PduRSrcPduRef=EcucPduCollection/MasterReq_EXV_1_oLIN00_52f4d550_Tx
          MasterReq_EXV_2_oLIN00_dc7bd2b3_Tx
            MasterReq_EXV_2_oLIN00_bb2bdaa6_Tx (PduRDestPdu): PduRDestPduRef=EcucPduCollection/MasterReq_EXV_2_oLIN00_bb2bdaa6_Tx
            PduRSrcPdu_a4b1fa3e (PduRSrcPdu): PduRSrcPduRef=EcucPduCollection/MasterReq_EXV_2_oLIN00_dc7bd2b3_Tx
          MasterReq_GWM_oLIN01_08407441_Tx
            MasterReq_GWM_oLIN01_25aef125_Tx (PduRDestPdu): PduRDestPduRef=EcucPduCollection/MasterReq_GWM_oLIN01_25aef125_Tx
            PduRSrcPdu_de6654a5 (PduRSrcPdu): PduRSrcPduRef=EcucPduCollection/MasterReq_GWM_oLIN01_08407441_Tx
          MasterReq_HVCH_oLIN00_0c968313_Tx
            MasterReq_HVCH_oLIN00_726494b3_Tx (PduRDestPdu): PduRDestPduRef=EcucPduCollection/MasterReq_HVCH_oLIN00_726494b3_Tx
            PduRSrcPdu_08dc267f (PduRSrcPdu): PduRSrcPduRef=EcucPduCollection/MasterReq_HVCH_oLIN00_0c968313_Tx
          MasterReq_PMP_1_oLIN00_14f05772_Tx
            MasterReq_PMP_1_oLIN00_90773f5d_Tx (PduRDestPdu): PduRDestPduRef=EcucPduCollection/MasterReq_PMP_1_oLIN00_90773f5d_Tx
            PduRSrcPdu_c9d7bd8d (PduRSrcPdu): PduRSrcPduRef=EcucPduCollection/MasterReq_PMP_1_oLIN00_14f05772_Tx
          MasterReq_PMP_2_oLIN00_9a7f5091_Tx
            MasterReq_PMP_2_oLIN00_e6920660_Tx (PduRDestPdu): PduRDestPduRef=EcucPduCollection/MasterReq_PMP_2_oLIN00_e6920660_Tx
            PduRSrcPdu_c560d24d (PduRSrcPdu): PduRSrcPduRef=EcucPduCollection/MasterReq_PMP_2_oLIN00_9a7f5091_Tx
          MasterReq_SVA_oLIN00_11d66449_Tx
            MasterReq_SVA_oLIN00_deabba25_Tx (PduRDestPdu): PduRDestPduRef=EcucPduCollection/MasterReq_SVA_oLIN00_deabba25_Tx
            PduRSrcPdu_502f75b4 (PduRSrcPdu): PduRSrcPduRef=EcucPduCollection/MasterReq_SVA_oLIN00_11d66449_Tx
          MasterReq_oLIN00_4a2bb011_Tx
            MasterReq_oLIN00_3234fe1b_Tx (PduRDestPdu): PduRDestPduRef=EcucPduCollection/MasterReq_oLIN00_3234fe1b_Tx
            PduRSrcPdu_927d3065 (PduRSrcPdu): PduRSrcPduRef=EcucPduCollection/MasterReq_oLIN00_4a2bb011_Tx
          MasterReq_oLIN01_3d2c8087_Tx
            MasterReq_oLIN01_eb5b5f1c_Tx (PduRDestPdu): PduRDestPduRef=EcucPduCollection/MasterReq_oLIN01_eb5b5f1c_Tx
            PduRSrcPdu_e38dbced (PduRSrcPdu): PduRSrcPduRef=EcucPduCollection/MasterReq_oLIN01_3d2c8087_Tx
          PMP2_Sts_oLIN00_200c907c_Rx
            PMP2_Sts_oLIN00_200c907c_Rx_9a742e46_Rx (PduRDestPdu): PduRDestPduRef=EcucPduCollection/PMP2_Sts_oLIN00_cab90b6b_Rx
            PduRSrcPdu_9a742e46 (PduRSrcPdu): PduRSrcPduRef=EcucPduCollection/PMP2_Sts_oLIN00_200c907c_Rx
          PMP3_Sts_oLIN00_4e808b3d_Rx
            PMP3_Sts_oLIN00_4e808b3d_Rx_43cea622_Rx (PduRDestPdu): PduRDestPduRef=EcucPduCollection/PMP3_Sts_oLIN00_511c4704_Rx
            PduRSrcPdu_43cea622 (PduRSrcPdu): PduRSrcPduRef=EcucPduCollection/PMP3_Sts_oLIN00_4e808b3d_Rx
          PMP_Cmd_oLIN00_3912b28b_Tx
            PMP_Cmd_oLIN00_6d889c97_Tx (PduRDestPdu): PduRDestPduRef=EcucPduCollection/PMP_Cmd_oLIN00_6d889c97_Tx
            PduRSrcPdu_4bd8719a (PduRSrcPdu): PduRSrcPduRef=EcucPduCollection/PMP_Cmd_oLIN00_3912b28b_Tx
          SGW_17_oATOM_CANFD_Matrix_CH_V600_202502_3a9eb4a2_Rx
            SGW_17_oATOM_CANFD_Matrix_CH_V600_202502_3a9eb4a2_Rx_316b9b30_Rx (PduRDestPdu): PduRDestPduRef=EcucPduCollection/SGW_17_oATOM_CANFD_Matrix_CH_V600_202502_9b3e5336_Rx
            PduRSrcPdu_316b9b30 (PduRSrcPdu): PduRSrcPduRef=EcucPduCollection/SGW_17_oATOM_CANFD_Matrix_CH_V600_202502_3a9eb4a2_Rx
          SVA_VCU_STD_oLIN00_4f0795ef_Rx
            SVA_VCU_STD_oLIN00_4f0795ef_Rx_166cd16c_Rx (PduRDestPdu): PduRDestPduRef=EcucPduCollection/SVA_VCU_STD_oLIN00_4526aa1c_Rx
            PduRSrcPdu_166cd16c (PduRSrcPdu): PduRSrcPduRef=EcucPduCollection/SVA_VCU_STD_oLIN00_4f0795ef_Rx
          SlaveResp_ERV_oLIN00_4c387f1b_Rx
            SlaveResp_ERV_oLIN00_4c387f1b_Rx_faf94ab0_Rx (PduRDestPdu): PduRDestPduRef=EcucPduCollection/SlaveResp_ERV_oLIN00_e833ce7b_Rx
            PduRSrcPdu_faf94ab0 (PduRSrcPdu): PduRSrcPduRef=EcucPduCollection/SlaveResp_ERV_oLIN00_4c387f1b_Rx
          SlaveResp_EXV_1_oLIN00_39fbe7c0_Rx
            SlaveResp_EXV_1_oLIN00_39fbe7c0_Rx_5cd8da0b_Rx (PduRDestPdu): PduRDestPduRef=EcucPduCollection/SlaveResp_EXV_1_oLIN00_1f09933d_Rx
            PduRSrcPdu_5cd8da0b (PduRSrcPdu): PduRSrcPduRef=EcucPduCollection/SlaveResp_EXV_1_oLIN00_39fbe7c0_Rx
          SlaveResp_EXV_2_oLIN00_4f1edefd_Rx
            SlaveResp_EXV_2_oLIN00_4f1edefd_Rx_e51dcfec_Rx (PduRDestPdu): PduRDestPduRef=EcucPduCollection/SlaveResp_EXV_2_oLIN00_918694de_Rx
            PduRSrcPdu_e51dcfec (PduRSrcPdu): PduRSrcPduRef=EcucPduCollection/SlaveResp_EXV_2_oLIN00_4f1edefd_Rx
          SlaveResp_GWM_oLIN01_9a3cff6e_Rx
            SlaveResp_GWM_oLIN01_9a3cff6e_Rx_3bd099cd_Rx (PduRDestPdu): PduRDestPduRef=EcucPduCollection/SlaveResp_GWM_oLIN01_f08746e2_Rx
            PduRSrcPdu_3bd099cd (PduRSrcPdu): PduRSrcPduRef=EcucPduCollection/SlaveResp_GWM_oLIN01_9a3cff6e_Rx
          SlaveResp_HVCH_oLIN00_93d59ea5_Rx
            SlaveResp_HVCH_oLIN00_93d59ea5_Rx_2d50b796_Rx (PduRDestPdu): PduRDestPduRef=EcucPduCollection/SlaveResp_HVCH_oLIN00_43b1b673_Rx
            PduRSrcPdu_2d50b796 (PduRSrcPdu): PduRSrcPduRef=EcucPduCollection/SlaveResp_HVCH_oLIN00_93d59ea5_Rx
          SlaveResp_PMP_1_oLIN00_64423b06_Rx
            SlaveResp_PMP_1_oLIN00_64423b06_Rx_e889db0f_Rx (PduRDestPdu): PduRDestPduRef=EcucPduCollection/SlaveResp_PMP_1_oLIN00_590d111f_Rx
            PduRSrcPdu_e889db0f (PduRSrcPdu): PduRSrcPduRef=EcucPduCollection/SlaveResp_PMP_1_oLIN00_64423b06_Rx
          SlaveResp_PMP_2_oLIN00_12a7023b_Rx
            SlaveResp_PMP_2_oLIN00_12a7023b_Rx_2d890913_Rx (PduRDestPdu): PduRDestPduRef=EcucPduCollection/SlaveResp_PMP_2_oLIN00_d78216fc_Rx
            PduRSrcPdu_2d890913 (PduRSrcPdu): PduRSrcPduRef=EcucPduCollection/SlaveResp_PMP_2_oLIN00_12a7023b_Rx
          SlaveResp_SVA_oLIN00_6139b46e_Rx
            SlaveResp_SVA_oLIN00_6139b46e_Rx_04ff3713_Rx (PduRDestPdu): PduRDestPduRef=EcucPduCollection/SlaveResp_SVA_oLIN00_e91156ea_Rx
            PduRSrcPdu_04ff3713 (PduRSrcPdu): PduRSrcPduRef=EcucPduCollection/SlaveResp_SVA_oLIN00_6139b46e_Rx
          TCU_HVCH_Cmd_oLIN00_385d5651_Tx
            TCU_HVCH_Cmd_oLIN00_ddc31229_Tx (PduRDestPdu): PduRDestPduRef=EcucPduCollection/TCU_HVCH_Cmd_oLIN00_ddc31229_Tx
            PduRSrcPdu_6a17111c (PduRSrcPdu): PduRSrcPduRef=EcucPduCollection/TCU_HVCH_Cmd_oLIN00_385d5651_Tx
          VCU_02_oATOM_CANFD_Matrix_CH_V600_202502_17bac731_Tx
            VCU_02_oATOM_CANFD_Matrix_CH_V600_202502_b9b0de03_Tx (PduRDestPdu): PduRDestPduRef=EcucPduCollection/VCU_02_oATOM_CANFD_Matrix_CH_V600_202502_b9b0de03_Tx
            PduRSrcPdu_fd46d90f (PduRSrcPdu): PduRSrcPduRef=EcucPduCollection/VCU_02_oATOM_CANFD_Matrix_CH_V600_202502_17bac731_Tx
          VCU_03_oATOM_CANFD_Matrix_CH_V600_202502_d824d0f9_Tx
            VCU_03_oATOM_CANFD_Matrix_CH_V600_202502_785f8119_Tx (PduRDestPdu): PduRDestPduRef=EcucPduCollection/VCU_03_oATOM_CANFD_Matrix_CH_V600_202502_785f8119_Tx
            PduRSrcPdu_eeac2237 (PduRSrcPdu): PduRSrcPduRef=EcucPduCollection/VCU_03_oATOM_CANFD_Matrix_CH_V600_202502_d824d0f9_Tx
          VCU_04_oATOM_CANFD_Matrix_CH_V600_202502_db6dbd42_Tx
            VCU_04_oATOM_CANFD_Matrix_CH_V600_202502_5040169c_Tx (PduRDestPdu): PduRDestPduRef=EcucPduCollection/VCU_04_oATOM_CANFD_Matrix_CH_V600_202502_5040169c_Tx
            PduRSrcPdu_ec53c477 (PduRSrcPdu): PduRSrcPduRef=EcucPduCollection/VCU_04_oATOM_CANFD_Matrix_CH_V600_202502_db6dbd42_Tx
          VCU_AccPedal_oATOM_CANFD_Matrix_CH_V600_202502_0d0df7a0_Tx
            VCU_AccPedal_oATOM_CANFD_Matrix_CH_V600_202502_3cf928f4_Tx (PduRDestPdu): PduRDestPduRef=EcucPduCollection/VCU_AccPedal_oATOM_CANFD_Matrix_CH_V600_202502_3cf928f4_Tx
            PduRSrcPdu_319663fb (PduRSrcPdu): PduRSrcPduRef=EcucPduCollection/VCU_AccPedal_oATOM_CANFD_Matrix_CH_V600_202502_0d0df7a0_Tx
          VCU_BMS_oATOM_CANFD_Matrix_CH_V600_202502_1208e503_Tx
            VCU_BMS_oATOM_CANFD_Matrix_CH_V600_202502_8dd4382b_Tx (PduRDestPdu): PduRDestPduRef=EcucPduCollection/VCU_BMS_oATOM_CANFD_Matrix_CH_V600_202502_8dd4382b_Tx
            PduRSrcPdu_961dd6a8 (PduRSrcPdu): PduRSrcPduRef=EcucPduCollection/VCU_BMS_oATOM_CANFD_Matrix_CH_V600_202502_1208e503_Tx
          VCU_Chassis_01_oATOM_CANFD_Matrix_CH_V600_202502_d7fdb34f_Tx
            VCU_Chassis_01_oATOM_CANFD_Matrix_CH_V600_202502_e79830d3_Tx (PduRDestPdu): PduRDestPduRef=EcucPduCollection/VCU_Chassis_01_oATOM_CANFD_Matrix_CH_V600_202502_e79830d3_Tx
            PduRSrcPdu_49c8436f (PduRSrcPdu): PduRSrcPduRef=EcucPduCollection/VCU_Chassis_01_oATOM_CANFD_Matrix_CH_V600_202502_d7fdb34f_Tx
          VCU_EXV_1_oLIN00_50eec975_Tx
            VCU_EXV_1_oLIN00_58a890ac_Tx (PduRDestPdu): PduRDestPduRef=EcucPduCollection/VCU_EXV_1_oLIN00_58a890ac_Tx
            PduRSrcPdu_91ca29f5 (PduRSrcPdu): PduRSrcPduRef=EcucPduCollection/VCU_EXV_1_oLIN00_50eec975_Tx
          VCU_EXV_2_oLIN00_de61ce96_Tx
            VCU_EXV_2_oLIN00_2e4da991_Tx (PduRDestPdu): PduRDestPduRef=EcucPduCollection/VCU_EXV_2_oLIN00_2e4da991_Tx
            PduRSrcPdu_9414725b (PduRSrcPdu): PduRSrcPduRef=EcucPduCollection/VCU_EXV_2_oLIN00_de61ce96_Tx
          VCU_HMIsignals_01_oATOM_CANFD_Matrix_CH_V600_202502_f29a9fcc_Tx
            VCU_HMIsignals_01_oATOM_CANFD_Matrix_CH_V600_202502_ad7bde1a_Tx (PduRDestPdu): PduRDestPduRef=EcucPduCollection/VCU_HMIsignals_01_oATOM_CANFD_Matrix_CH_V600_202502_ad7bde1a_Tx
            PduRSrcPdu_c0ac8d7c (PduRSrcPdu): PduRSrcPduRef=EcucPduCollection/VCU_HMIsignals_01_oATOM_CANFD_Matrix_CH_V600_202502_f29a9fcc_Tx
          VCU_HMIsignals_02_oATOM_CANFD_Matrix_CH_V600_202502_7949a1d5_Tx
            VCU_HMIsignals_02_oATOM_CANFD_Matrix_CH_V600_202502_343b3975_Tx (PduRDestPdu): PduRDestPduRef=EcucPduCollection/VCU_HMIsignals_02_oATOM_CANFD_Matrix_CH_V600_202502_343b3975_Tx
            PduRSrcPdu_108c7515 (PduRSrcPdu): PduRSrcPduRef=EcucPduCollection/VCU_HMIsignals_02_oATOM_CANFD_Matrix_CH_V600_202502_7949a1d5_Tx
          VCU_IBS_01_oATOM_CANFD_Matrix_CH_V600_202502_4c086bc0_Tx
            VCU_IBS_01_oATOM_CANFD_Matrix_CH_V600_202502_72f519e8_Tx (PduRDestPdu): PduRDestPduRef=EcucPduCollection/VCU_IBS_01_oATOM_CANFD_Matrix_CH_V600_202502_72f519e8_Tx
            PduRSrcPdu_17f11187 (PduRSrcPdu): PduRSrcPduRef=EcucPduCollection/VCU_IBS_01_oATOM_CANFD_Matrix_CH_V600_202502_4c086bc0_Tx
          VCU_MCU_03_oATOM_CANFD_Matrix_CH_V600_202502_0d9d0aa9_Tx
            VCU_MCU_03_oATOM_CANFD_Matrix_CH_V600_202502_9c2fbb06_Tx (PduRDestPdu): PduRDestPduRef=EcucPduCollection/VCU_MCU_03_oATOM_CANFD_Matrix_CH_V600_202502_9c2fbb06_Tx
            PduRSrcPdu_c3983958 (PduRSrcPdu): PduRSrcPduRef=EcucPduCollection/VCU_MCU_03_oATOM_CANFD_Matrix_CH_V600_202502_0d9d0aa9_Tx
          VCU_PlugInChrgInfo_oATOM_CANFD_Matrix_CH_V600_202502_20405e82_Tx
            VCU_PlugInChrgInfo_oATOM_CANFD_Matrix_CH_V600_202502_f8a23add_Tx (PduRDestPdu): PduRDestPduRef=EcucPduCollection/VCU_PlugInChrgInfo_oATOM_CANFD_Matrix_CH_V600_202502_f8a23add_Tx
            PduRSrcPdu_a60cff81 (PduRSrcPdu): PduRSrcPduRef=EcucPduCollection/VCU_PlugInChrgInfo_oATOM_CANFD_Matrix_CH_V600_202502_20405e82_Tx
          VCU_SVA_CMD_oLIN00_756d14f6_Tx
            VCU_SVA_CMD_oLIN00_89e2bb7b_Tx (PduRDestPdu): PduRDestPduRef=EcucPduCollection/VCU_SVA_CMD_oLIN00_89e2bb7b_Tx
            PduRSrcPdu_b06eca36 (PduRSrcPdu): PduRSrcPduRef=EcucPduCollection/VCU_SVA_CMD_oLIN00_756d14f6_Tx
          VcuAdcTxG0Msg0_oTC37X_VCU_CAN01_5798df68_Tx
            VcuAdcTxG0Msg0_oTC37X_VCU_CAN01_0847dbfd_Tx (PduRDestPdu): PduRDestPduRef=EcucPduCollection/VcuAdcTxG0Msg0_oTC37X_VCU_CAN01_0847dbfd_Tx
            PduRSrcPdu_75ceb29f (PduRSrcPdu): PduRSrcPduRef=EcucPduCollection/VcuAdcTxG0Msg0_oTC37X_VCU_CAN01_5798df68_Tx
          VcuAdcTxG0Msg1_oTC37X_VCU_CAN01_b8ca6989_Tx
            VcuAdcTxG0Msg1_oTC37X_VCU_CAN01_4f542d06_Tx (PduRDestPdu): PduRDestPduRef=EcucPduCollection/VcuAdcTxG0Msg1_oTC37X_VCU_CAN01_4f542d06_Tx
            PduRSrcPdu_0a2b7a00 (PduRSrcPdu): PduRSrcPduRef=EcucPduCollection/VcuAdcTxG0Msg1_oTC37X_VCU_CAN01_b8ca6989_Tx
          VcuAdcTxG1Msg0_oTC37X_VCU_CAN01_40b0bba8_Tx
            VcuAdcTxG1Msg0_oTC37X_VCU_CAN01_613ed098_Tx (PduRDestPdu): PduRDestPduRef=EcucPduCollection/VcuAdcTxG1Msg0_oTC37X_VCU_CAN01_613ed098_Tx
            PduRSrcPdu_238e87f9 (PduRSrcPdu): PduRSrcPduRef=EcucPduCollection/VcuAdcTxG1Msg0_oTC37X_VCU_CAN01_40b0bba8_Tx
          VcuAdcTxG1Msg1_oTC37X_VCU_CAN01_afe20d49_Tx
            VcuAdcTxG1Msg1_oTC37X_VCU_CAN01_262d2663_Tx (PduRDestPdu): PduRDestPduRef=EcucPduCollection/VcuAdcTxG1Msg1_oTC37X_VCU_CAN01_262d2663_Tx
            PduRSrcPdu_ae15b571 (PduRSrcPdu): PduRSrcPduRef=EcucPduCollection/VcuAdcTxG1Msg1_oTC37X_VCU_CAN01_afe20d49_Tx
          VcuAdcTxG2Msg0_oTC37X_VCU_CAN01_79c816e8_Tx
            VcuAdcTxG2Msg0_oTC37X_VCU_CAN01_dab5cd37_Tx (PduRDestPdu): PduRDestPduRef=EcucPduCollection/VcuAdcTxG2Msg0_oTC37X_VCU_CAN01_dab5cd37_Tx
            PduRSrcPdu_9fc32995 (PduRSrcPdu): PduRSrcPduRef=EcucPduCollection/VcuAdcTxG2Msg0_oTC37X_VCU_CAN01_79c816e8_Tx
          VcuAdcTxG2Msg1_oTC37X_VCU_CAN01_969aa009_Tx
            VcuAdcTxG2Msg1_oTC37X_VCU_CAN01_9da63bcc_Tx (PduRDestPdu): PduRDestPduRef=EcucPduCollection/VcuAdcTxG2Msg1_oTC37X_VCU_CAN01_9da63bcc_Tx
            PduRSrcPdu_1008b467 (PduRSrcPdu): PduRSrcPduRef=EcucPduCollection/VcuAdcTxG2Msg1_oTC37X_VCU_CAN01_969aa009_Tx
          VcuAdcTxG3Msg0_oTC37X_VCU_CAN01_6ee07228_Tx
            VcuAdcTxG3Msg0_oTC37X_VCU_CAN01_b3ccc652_Tx (PduRDestPdu): PduRDestPduRef=EcucPduCollection/VcuAdcTxG3Msg0_oTC37X_VCU_CAN01_b3ccc652_Tx
            PduRSrcPdu_0b6ac76d (PduRSrcPdu): PduRSrcPduRef=EcucPduCollection/VcuAdcTxG3Msg0_oTC37X_VCU_CAN01_6ee07228_Tx
          VcuAdcTxG3Msg1_oTC37X_VCU_CAN01_81b2c4c9_Tx
            VcuAdcTxG3Msg1_oTC37X_VCU_CAN01_f4df30a9_Tx (PduRDestPdu): PduRDestPduRef=EcucPduCollection/VcuAdcTxG3Msg1_oTC37X_VCU_CAN01_f4df30a9_Tx
            PduRSrcPdu_4fcbec42 (PduRSrcPdu): PduRSrcPduRef=EcucPduCollection/VcuAdcTxG3Msg1_oTC37X_VCU_CAN01_81b2c4c9_Tx
          VcuAdcTxG8Msg0_oTC37X_VCU_CAN01_eedbf968_Tx
            VcuAdcTxG8Msg0_oTC37X_VCU_CAN01_f56d8c57_Tx (PduRDestPdu): PduRDestPduRef=EcucPduCollection/VcuAdcTxG8Msg0_oTC37X_VCU_CAN01_f56d8c57_Tx
            PduRSrcPdu_624e541b (PduRSrcPdu): PduRSrcPduRef=EcucPduCollection/VcuAdcTxG8Msg0_oTC37X_VCU_CAN01_eedbf968_Tx
          VcuAdcTxG8Msg1_oTC37X_VCU_CAN01_01894f89_Tx
            VcuAdcTxG8Msg1_oTC37X_VCU_CAN01_b27e7aac_Tx (PduRDestPdu): PduRDestPduRef=EcucPduCollection/VcuAdcTxG8Msg1_oTC37X_VCU_CAN01_b27e7aac_Tx
            PduRSrcPdu_350c260d (PduRSrcPdu): PduRSrcPduRef=EcucPduCollection/VcuAdcTxG8Msg1_oTC37X_VCU_CAN01_01894f89_Tx
          VcuAdcTxG8Msg2_oTC37X_VCU_CAN01_eb0f92eb_Tx
            VcuAdcTxG8Msg2_oTC37X_VCU_CAN01_7b4a61a1_Tx (PduRDestPdu): PduRDestPduRef=EcucPduCollection/VcuAdcTxG8Msg2_oTC37X_VCU_CAN01_7b4a61a1_Tx
            PduRSrcPdu_37fea4b2 (PduRSrcPdu): PduRSrcPduRef=EcucPduCollection/VcuAdcTxG8Msg2_oTC37X_VCU_CAN01_eb0f92eb_Tx
          VcuAdcTxG8Msg3_oTC37X_VCU_CAN01_045d240a_Tx
            VcuAdcTxG8Msg3_oTC37X_VCU_CAN01_3c59975a_Tx (PduRDestPdu): PduRDestPduRef=EcucPduCollection/VcuAdcTxG8Msg3_oTC37X_VCU_CAN01_3c59975a_Tx
            PduRSrcPdu_88d7da53 (PduRSrcPdu): PduRSrcPduRef=EcucPduCollection/VcuAdcTxG8Msg3_oTC37X_VCU_CAN01_045d240a_Tx
          VcuCan03RxMsg1_oTC37X_VCU_CAN03_4dd213bb_Rx
            VcuCan03RxMsg1_oTC37X_VCU_CAN03_4dd213bb_Rx_4e610413_Rx (PduRDestPdu): PduRDestPduRef=EcucPduCollection/VcuCan03RxMsg1_oTC37X_VCU_CAN03_77e3a75f_Rx
            PduRSrcPdu_4e610413 (PduRSrcPdu): PduRSrcPduRef=EcucPduCollection/VcuCan03RxMsg1_oTC37X_VCU_CAN03_4dd213bb_Rx
          VcuCan03RxMsg2_oTC37X_VCU_CAN03_84e608b6_Rx
            VcuCan03RxMsg2_oTC37X_VCU_CAN03_84e608b6_Rx_a2204cbf_Rx (PduRDestPdu): PduRDestPduRef=EcucPduCollection/VcuCan03RxMsg2_oTC37X_VCU_CAN03_9d657a3d_Rx
            PduRSrcPdu_a2204cbf (PduRSrcPdu): PduRSrcPduRef=EcucPduCollection/VcuCan03RxMsg2_oTC37X_VCU_CAN03_84e608b6_Rx
          VcuCan03TxMsg1_oTC37X_VCU_CAN03_9a29d525_Tx
            VcuCan03TxMsg1_oTC37X_VCU_CAN03_c0767973_Tx (PduRDestPdu): PduRDestPduRef=EcucPduCollection/VcuCan03TxMsg1_oTC37X_VCU_CAN03_c0767973_Tx
            PduRSrcPdu_6c0ea6d2 (PduRSrcPdu): PduRSrcPduRef=EcucPduCollection/VcuCan03TxMsg1_oTC37X_VCU_CAN03_9a29d525_Tx
          VcuCan03TxMsg2_oTC37X_VCU_CAN03_70af0847_Tx
            VcuCan03TxMsg2_oTC37X_VCU_CAN03_0942627e_Tx (PduRDestPdu): PduRDestPduRef=EcucPduCollection/VcuCan03TxMsg2_oTC37X_VCU_CAN03_0942627e_Tx
            PduRSrcPdu_a59b3a32 (PduRSrcPdu): PduRSrcPduRef=EcucPduCollection/VcuCan03TxMsg2_oTC37X_VCU_CAN03_70af0847_Tx
          VcuCan12RxMsg3_oTC37X_VCU_CAN12_2f1174ae_Rx
            VcuCan12RxMsg3_oTC37X_VCU_CAN12_2f1174ae_Rx_9d116735_Rx (PduRDestPdu): PduRDestPduRef=EcucPduCollection/VcuCan12RxMsg3_oTC37X_VCU_CAN12_38853822_Rx
            PduRSrcPdu_9d116735 (PduRSrcPdu): PduRSrcPduRef=EcucPduCollection/VcuCan12RxMsg3_oTC37X_VCU_CAN12_2f1174ae_Rx
          VcuCan12RxMsg4_oTC37X_VCU_CAN12_211bb20e_Rx
            VcuCan12RxMsg4_oTC37X_VCU_CAN12_211bb20e_Rx_0a95646f_Rx (PduRDestPdu): PduRDestPduRef=EcucPduCollection/VcuCan12RxMsg4_oTC37X_VCU_CAN12_d9ab3246_Rx
            PduRSrcPdu_0a95646f (PduRSrcPdu): PduRSrcPduRef=EcucPduCollection/VcuCan12RxMsg4_oTC37X_VCU_CAN12_211bb20e_Rx
          VcuCan12TxMsg1_oTC37X_VCU_CAN12_d09b21db_Tx
            VcuCan12TxMsg1_oTC37X_VCU_CAN12_2c92f390_Tx (PduRDestPdu): PduRDestPduRef=EcucPduCollection/VcuCan12TxMsg1_oTC37X_VCU_CAN12_2c92f390_Tx
            PduRSrcPdu_6cefc258 (PduRSrcPdu): PduRSrcPduRef=EcucPduCollection/VcuCan12TxMsg1_oTC37X_VCU_CAN12_d09b21db_Tx
          VcuCan12TxMsg2_oTC37X_VCU_CAN12_3a1dfcb9_Tx
            VcuCan12TxMsg2_oTC37X_VCU_CAN12_e5a6e89d_Tx (PduRDestPdu): PduRDestPduRef=EcucPduCollection/VcuCan12TxMsg2_oTC37X_VCU_CAN12_e5a6e89d_Tx
            PduRSrcPdu_573a7055 (PduRSrcPdu): PduRSrcPduRef=EcucPduCollection/VcuCan12TxMsg2_oTC37X_VCU_CAN12_3a1dfcb9_Tx
          VcuMeasurementMsg0_oTC37X_VCU_CAN01_0deb23c3_Tx
            VcuMeasurementMsg0_oTC37X_VCU_CAN01_d96481d0_Tx (PduRDestPdu): PduRDestPduRef=EcucPduCollection/VcuMeasurementMsg0_oTC37X_VCU_CAN01_d96481d0_Tx
            PduRSrcPdu_9fbb06ad (PduRSrcPdu): PduRSrcPduRef=EcucPduCollection/VcuMeasurementMsg0_oTC37X_VCU_CAN01_0deb23c3_Tx
          VcuRxCtrlMsg0_oTC37X_VCU_CAN01_3715838b_Rx
            VcuRxCtrlMsg0_oTC37X_VCU_CAN01_3715838b_Rx_01131484_Rx (PduRDestPdu): PduRDestPduRef=EcucPduCollection/VcuRxCtrlMsg0_oTC37X_VCU_CAN01_b24a2ab4_Rx
            PduRSrcPdu_01131484 (PduRSrcPdu): PduRSrcPduRef=EcucPduCollection/VcuRxCtrlMsg0_oTC37X_VCU_CAN01_3715838b_Rx
          VcuRxCtrlMsg1_oTC37X_VCU_CAN01_70067570_Rx
            VcuRxCtrlMsg1_oTC37X_VCU_CAN01_70067570_Rx_35c74fdb_Rx (PduRDestPdu): PduRDestPduRef=EcucPduCollection/VcuRxCtrlMsg1_oTC37X_VCU_CAN01_5d189c55_Rx
            PduRSrcPdu_35c74fdb (PduRSrcPdu): PduRSrcPduRef=EcucPduCollection/VcuRxCtrlMsg1_oTC37X_VCU_CAN01_70067570_Rx
          VcuRxCtrlMsg2_oTC37X_VCU_CAN01_b9326e7d_Rx
            VcuRxCtrlMsg2_oTC37X_VCU_CAN01_b9326e7d_Rx_d7cb99e6_Rx (PduRDestPdu): PduRDestPduRef=EcucPduCollection/VcuRxCtrlMsg2_oTC37X_VCU_CAN01_b79e4137_Rx
            PduRSrcPdu_d7cb99e6 (PduRSrcPdu): PduRSrcPduRef=EcucPduCollection/VcuRxCtrlMsg2_oTC37X_VCU_CAN01_b9326e7d_Rx
          VcuRxMsg1_oTC37X_VCU_CAN00_4589bbed_Rx
            VcuRxMsg1_oTC37X_VCU_CAN00_4589bbed_Rx_6711bd67_Rx (PduRDestPdu): PduRDestPduRef=EcucPduCollection/VcuRxMsg1_oTC37X_VCU_CAN00_78805594_Rx
            PduRSrcPdu_6711bd67 (PduRSrcPdu): PduRSrcPduRef=EcucPduCollection/VcuRxMsg1_oTC37X_VCU_CAN00_4589bbed_Rx
          VcuRxMsg2_oTC37X_VCU_CAN00_8cbda0e0_Rx
            VcuRxMsg2_oTC37X_VCU_CAN00_8cbda0e0_Rx_803efadc_Rx (PduRDestPdu): PduRDestPduRef=EcucPduCollection/VcuRxMsg2_oTC37X_VCU_CAN00_920688f6_Rx
            PduRSrcPdu_803efadc (PduRSrcPdu): PduRSrcPduRef=EcucPduCollection/VcuRxMsg2_oTC37X_VCU_CAN00_8cbda0e0_Rx
          VcuRxMsg3_oTC37X_VCU_CAN01_5bb4c01a_Rx
            VcuRxMsg3_oTC37X_VCU_CAN01_5bb4c01a_Rx_3905054b_Rx (PduRDestPdu): PduRDestPduRef=EcucPduCollection/VcuRxMsg3_oTC37X_VCU_CAN01_0a530e81_Rx
            PduRSrcPdu_3905054b (PduRSrcPdu): PduRSrcPduRef=EcucPduCollection/VcuRxMsg3_oTC37X_VCU_CAN01_5bb4c01a_Rx
          VcuRxMsg4_oTC37X_VCU_CAN01_55be06ba_Rx
            VcuRxMsg4_oTC37X_VCU_CAN01_55be06ba_Rx_f5b46736_Rx (PduRDestPdu): PduRDestPduRef=EcucPduCollection/VcuRxMsg4_oTC37X_VCU_CAN01_eb7d04e5_Rx
            PduRSrcPdu_f5b46736 (PduRSrcPdu): PduRSrcPduRef=EcucPduCollection/VcuRxMsg4_oTC37X_VCU_CAN01_55be06ba_Rx
          VcuTxIoMsg1_oTC37X_VCU_CAN00_54884add_Tx
            VcuTxIoMsg1_oTC37X_VCU_CAN00_869e33bc_Tx (PduRDestPdu): PduRDestPduRef=EcucPduCollection/VcuTxIoMsg1_oTC37X_VCU_CAN00_869e33bc_Tx
            PduRSrcPdu_96b222db (PduRSrcPdu): PduRSrcPduRef=EcucPduCollection/VcuTxIoMsg1_oTC37X_VCU_CAN00_54884add_Tx
          VcuTxIoMsg2_oTC37X_VCU_CAN00_be0e97bf_Tx
            VcuTxIoMsg2_oTC37X_VCU_CAN00_4faa28b1_Tx (PduRDestPdu): PduRDestPduRef=EcucPduCollection/VcuTxIoMsg2_oTC37X_VCU_CAN00_4faa28b1_Tx
            PduRSrcPdu_3ef2d11c (PduRSrcPdu): PduRSrcPduRef=EcucPduCollection/VcuTxIoMsg2_oTC37X_VCU_CAN00_be0e97bf_Tx
          VcuTxIoMsg3_oTC37X_VCU_CAN00_515c215e_Tx
            VcuTxIoMsg3_oTC37X_VCU_CAN00_08b9de4a_Tx (PduRDestPdu): PduRDestPduRef=EcucPduCollection/VcuTxIoMsg3_oTC37X_VCU_CAN00_08b9de4a_Tx
            PduRSrcPdu_23c89b9b (PduRSrcPdu): PduRSrcPduRef=EcucPduCollection/VcuTxIoMsg3_oTC37X_VCU_CAN00_515c215e_Tx
          VcuTxIoMsg4_oTC37X_VCU_CAN00_b0722b3a_Tx
            VcuTxIoMsg4_oTC37X_VCU_CAN00_06b318ea_Tx (PduRDestPdu): PduRDestPduRef=EcucPduCollection/VcuTxIoMsg4_oTC37X_VCU_CAN00_06b318ea_Tx
            PduRSrcPdu_15ef524a (PduRSrcPdu): PduRSrcPduRef=EcucPduCollection/VcuTxIoMsg4_oTC37X_VCU_CAN00_b0722b3a_Tx
          VcuTxIoMsg5_oTC37X_VCU_CAN00_5f209ddb_Tx
            VcuTxIoMsg5_oTC37X_VCU_CAN00_41a0ee11_Tx (PduRDestPdu): PduRDestPduRef=EcucPduCollection/VcuTxIoMsg5_oTC37X_VCU_CAN00_41a0ee11_Tx
            PduRSrcPdu_886ac60a (PduRSrcPdu): PduRSrcPduRef=EcucPduCollection/VcuTxIoMsg5_oTC37X_VCU_CAN00_5f209ddb_Tx
          VcuTxIoMsg6_oTC37X_VCU_CAN00_b5a640b9_Tx
            VcuTxIoMsg6_oTC37X_VCU_CAN00_8894f51c_Tx (PduRDestPdu): PduRDestPduRef=EcucPduCollection/VcuTxIoMsg6_oTC37X_VCU_CAN00_8894f51c_Tx
            PduRSrcPdu_275934e8 (PduRSrcPdu): PduRSrcPduRef=EcucPduCollection/VcuTxIoMsg6_oTC37X_VCU_CAN00_b5a640b9_Tx
          VcuTxIoMsg7_oTC37X_VCU_CAN00_5af4f658_Tx
            VcuTxIoMsg7_oTC37X_VCU_CAN00_cf8703e7_Tx (PduRDestPdu): PduRDestPduRef=EcucPduCollection/VcuTxIoMsg7_oTC37X_VCU_CAN00_cf8703e7_Tx
            PduRSrcPdu_8c9b3cfc (PduRSrcPdu): PduRSrcPduRef=EcucPduCollection/VcuTxIoMsg7_oTC37X_VCU_CAN00_5af4f658_Tx
          VcuTxIoMsg8_oTC37X_VCU_CAN00_ac8b5230_Tx
            VcuTxIoMsg8_oTC37X_VCU_CAN00_9481785c_Tx (PduRDestPdu): PduRDestPduRef=EcucPduCollection/VcuTxIoMsg8_oTC37X_VCU_CAN00_9481785c_Tx
            PduRSrcPdu_27dcf988 (PduRSrcPdu): PduRSrcPduRef=EcucPduCollection/VcuTxIoMsg8_oTC37X_VCU_CAN00_ac8b5230_Tx
          VcuTxMsg1_oTC37X_VCU_CAN00_954a27ee_Tx
            VcuTxMsg1_oTC37X_VCU_CAN00_c82dd125_Tx (PduRDestPdu): PduRDestPduRef=EcucPduCollection/VcuTxMsg1_oTC37X_VCU_CAN00_c82dd125_Tx
            PduRSrcPdu_91d52164 (PduRSrcPdu): PduRSrcPduRef=EcucPduCollection/VcuTxMsg1_oTC37X_VCU_CAN00_954a27ee_Tx
          VcuTxMsg2_oTC37X_VCU_CAN00_7fccfa8c_Tx
            VcuTxMsg2_oTC37X_VCU_CAN00_0119ca28_Tx (PduRDestPdu): PduRDestPduRef=EcucPduCollection/VcuTxMsg2_oTC37X_VCU_CAN00_0119ca28_Tx
            PduRSrcPdu_69924b1b (PduRSrcPdu): PduRSrcPduRef=EcucPduCollection/VcuTxMsg2_oTC37X_VCU_CAN00_7fccfa8c_Tx
          Vcu_Lin0_RxMsg1_oLIN01_079b7478_Rx
            Vcu_Lin0_RxMsg1_oLIN01_079b7478_Rx_12331c6c_Rx (PduRDestPdu): PduRDestPduRef=EcucPduCollection/Vcu_Lin0_RxMsg1_oLIN01_24780c64_Rx
            PduRSrcPdu_12331c6c (PduRSrcPdu): PduRSrcPduRef=EcucPduCollection/Vcu_Lin0_RxMsg1_oLIN01_079b7478_Rx
          Vcu_Lin0_RxMsg2_oLIN01_717e4d45_Rx
            Vcu_Lin0_RxMsg2_oLIN01_717e4d45_Rx_d314568e_Rx (PduRDestPdu): PduRDestPduRef=EcucPduCollection/Vcu_Lin0_RxMsg2_oLIN01_aaf70b87_Rx
            PduRSrcPdu_d314568e (PduRSrcPdu): PduRSrcPduRef=EcucPduCollection/Vcu_Lin0_RxMsg2_oLIN01_717e4d45_Rx
          Vcu_Lin0_TxMsg1_oLIN01_849dd3b9_Tx
            Vcu_Lin0_TxMsg1_oLIN01_02277a36_Tx (PduRDestPdu): PduRDestPduRef=EcucPduCollection/Vcu_Lin0_TxMsg1_oLIN01_02277a36_Tx
            PduRSrcPdu_ff5e60c1 (PduRSrcPdu): PduRSrcPduRef=EcucPduCollection/Vcu_Lin0_TxMsg1_oLIN01_849dd3b9_Tx
          Vcu_Lin0_TxMsg2_oLIN01_0a12d45a_Tx
            Vcu_Lin0_TxMsg2_oLIN01_74c2430b_Tx (PduRDestPdu): PduRDestPduRef=EcucPduCollection/Vcu_Lin0_TxMsg2_oLIN01_74c2430b_Tx
            PduRSrcPdu_0417dd35 (PduRSrcPdu): PduRSrcPduRef=EcucPduCollection/Vcu_Lin0_TxMsg2_oLIN01_0a12d45a_Tx
          Vcu_Uds_Func_Request_oTC37X_VCU_CAN00_455d4346_Rx
            Vcu_Uds_Func_Request_oTC37X_VCU_CAN00_455d4346_Rx_4bac36fb_Rx (PduRDestPdu): PduRDestPduRef=Vcu_Uds_Func_Request_oTC37X_VCU_CAN00_21e26bac_Rx
            PduRSrcPdu_4bac36fb (PduRSrcPdu): PduRSrcPduRef=EcucPduCollection/Vcu_Uds_Func_Request_oTC37X_VCU_CAN00_455d4346_Rx
          Vcu_Uds_Phy_Request_oTC37X_VCU_CAN00_16119f6f_Rx
            Vcu_Uds_Phy_Request_oTC37X_VCU_CAN00_16119f6f_Rx_925fbf89_Rx (PduRDestPdu): PduRDestPduRef=Vcu_Uds_Phy_Request_oTC37X_VCU_CAN00_d561dcee_Rx
            PduRSrcPdu_925fbf89 (PduRSrcPdu): PduRSrcPduRef=EcucPduCollection/Vcu_Uds_Phy_Request_oTC37X_VCU_CAN00_16119f6f_Rx
          Vcu_Uds_Response_oTC37X_VCU_CAN00_4d111be6_Tx
            Vcu_Uds_Response_oTC37X_VCU_CAN00_39638a1a_Tx (PduRDestPdu): PduRDestPduRef=EcucPduCollection/Vcu_Uds_Response_oTC37X_VCU_CAN00_39638a1a_Tx
            PduRSrcPdu_1a8748e9 (PduRSrcPdu): PduRSrcPduRef=EcucPduCollection/Vcu_Uds_Response_oTC37X_VCU_CAN00_4d111be6_Tx
  module config Xcp
    XcpConfig
      XCP_Request_oTC37X_VCU_CAN00_3c25b45e_Rx (XcpPdu)
        XCP_Request_oTC37X_VCU_CAN00_3c25b45e_Rx (XcpRxPdu): XcpRxPduRef=EcucPduCollection/XCP_Request_oTC37X_VCU_CAN00_3c25b45e_Rx
      XCP_Response_oTC37X_VCU_CAN00_34d2da2d_Tx (XcpPdu)
        XCP_Response_oTC37X_VCU_CAN00_34d2da2d_Tx (XcpTxPdu): XcpTxPduRef=EcucPduCollection/XCP_Response_oTC37X_VCU_CAN00_34d2da2d_Tx
    XcpGeneral
