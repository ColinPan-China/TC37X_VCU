AUTOSAR XML (schema 00048)
package /InitialEcuC
  ecuc value collection InitialEcuC: ecuc-values=[Can, CanIf, CanNm, CanSM, CanTp, Com, ComM, Dcm, Dem, EcuC, EcuM, Lin, LinIf, LinSM, LinTp, Nm, PduR, Xcp]
  module config Can
    CanConfigSet
      5 x CanController, all with CanControllerActivation=true:
        CT_KAMA_FP_EPT_0303_1b7da7f9: CanControllerDefaultBaudrate=CT_KAMA_FP_EPT_0303_1b7da7f9/CanControllerBaudrateConfig, CanControllerSystemRef=CT_KAMA_FP_EPT_0303, CanWakeupSourceRef=EcuMCommonConfiguration/CN_KAMA_FP_EPT_0303_275b3e6e
          CanControllerBaudrateConfig: CanControllerBaudRate=500
        CT_TC37X_VCU_CAN00_22cb8fec: CanControllerDefaultBaudrate=CT_TC37X_VCU_CAN00_22cb8fec/CanControllerBaudrateConfig, CanControllerSystemRef=CT_TC37X_VCU_CAN00, CanWakeupSourceRef=EcuMCommonConfiguration/CN_TC37X_VCU_CAN00_07b6c9c8
          CanControllerBaudrateConfig: CanControllerBaudRate=500
        CT_TC37X_VCU_CAN01_55ccbf7a: CanControllerDefaultBaudrate=CT_TC37X_VCU_CAN01_55ccbf7a/CanControllerBaudrateConfig, CanControllerSystemRef=CT_TC37X_VCU_CAN01, CanWakeupSourceRef=EcuMCommonConfiguration/CN_TC37X_VCU_CAN01_70b1f95e
          CanControllerBaudrateConfig: CanControllerBaudRate=500
        CT_TC37X_VCU_CAN03_bbc2de56: CanControllerDefaultBaudrate=CT_TC37X_VCU_CAN03_bbc2de56/CanControllerBaudrateConfig, CanControllerSystemRef=CT_TC37X_VCU_CAN03, CanWakeupSourceRef=EcuMCommonConfiguration/CN_TC37X_VCU_CAN03_9ebf9872
          CanControllerBaudrateConfig: CanControllerBaudRate=500
        CT_TC37X_VCU_CAN12_d5dedf81: CanControllerDefaultBaudrate=CT_TC37X_VCU_CAN12_d5dedf81/CanControllerBaudrateConfig, CanControllerSystemRef=CT_TC37X_VCU_CAN12, CanWakeupSourceRef=EcuMCommonConfiguration/CN_TC37X_VCU_CAN12_f0a399a5
          CanControllerBaudrateConfig: CanControllerBaudRate=500
      10 x CanHardwareObject, all with CanHandleType=BASIC, CanIdValue=0:
        CN_KAMA_FP_EPT_0303_275b3e6e_Tx: CanObjectType=TRANSMIT, CanControllerRef=CanConfigSet/CT_KAMA_FP_EPT_0303_1b7da7f9
        CN_KAMA_FP_EPT_0303_c7999d11_Rx: CanIdType=STANDARD, CanObjectType=RECEIVE, CanControllerRef=CanConfigSet/CT_KAMA_FP_EPT_0303_1b7da7f9
        CN_TC37X_VCU_CAN00_07b6c9c8_Tx: CanObjectType=TRANSMIT, CanControllerRef=CanConfigSet/CT_TC37X_VCU_CAN00_22cb8fec
        CN_TC37X_VCU_CAN00_c052b9c5_Rx: CanIdType=STANDARD, CanObjectType=RECEIVE, CanControllerRef=CanConfigSet/CT_TC37X_VCU_CAN00_22cb8fec
        CN_TC37X_VCU_CAN01_2f90d2fb_Rx: CanIdType=STANDARD, CanObjectType=RECEIVE, CanControllerRef=CanConfigSet/CT_TC37X_VCU_CAN01_55ccbf7a
        CN_TC37X_VCU_CAN01_70b1f95e_Tx: CanObjectType=TRANSMIT, CanControllerRef=CanConfigSet/CT_TC37X_VCU_CAN01_55ccbf7a
        CN_TC37X_VCU_CAN03_2b6502c6_Rx: CanIdType=STANDARD, CanObjectType=RECEIVE, CanControllerRef=CanConfigSet/CT_TC37X_VCU_CAN03_bbc2de56
        CN_TC37X_VCU_CAN03_9ebf9872_Tx: CanObjectType=TRANSMIT, CanControllerRef=CanConfigSet/CT_TC37X_VCU_CAN03_bbc2de56
        CN_TC37X_VCU_CAN12_0529b638_Rx: CanIdType=STANDARD, CanObjectType=RECEIVE, CanControllerRef=CanConfigSet/CT_TC37X_VCU_CAN12_d5dedf81
        CN_TC37X_VCU_CAN12_f0a399a5_Tx: CanObjectType=TRANSMIT, CanControllerRef=CanConfigSet/CT_TC37X_VCU_CAN12_d5dedf81
    CanGeneral: CanIndex=0
  module config CanIf
    CanIfCtrlDrvCfg_7d254554 (CanIfCtrlDrvCfg): CanIfCtrlDrvInitHohConfigRef=CanIfInitHohCfg, CanIfCtrlDrvNameRef=CanGeneral
      5 x CanIfCtrlCfg:
        CT_KAMA_FP_EPT_0303_1b7da7f9: CanIfCtrlCanCtrlRef=CanConfigSet/CT_KAMA_FP_EPT_0303_1b7da7f9
        CT_TC37X_VCU_CAN00_22cb8fec: CanIfCtrlCanCtrlRef=CanConfigSet/CT_TC37X_VCU_CAN00_22cb8fec
        CT_TC37X_VCU_CAN01_55ccbf7a: CanIfCtrlCanCtrlRef=CanConfigSet/CT_TC37X_VCU_CAN01_55ccbf7a
        CT_TC37X_VCU_CAN03_bbc2de56: CanIfCtrlCanCtrlRef=CanConfigSet/CT_TC37X_VCU_CAN03_bbc2de56
        CT_TC37X_VCU_CAN12_d5dedf81: CanIfCtrlCanCtrlRef=CanConfigSet/CT_TC37X_VCU_CAN12_d5dedf81
    CanIfInitCfg
      5 x CanIfBufferCfg, all with CanIfBufferSize=0:
        CHNL_131d55da: CanIfBufferHthRef=CanIfInitHohCfg/CN_TC37X_VCU_CAN01_70b1f95e_Tx
        CHNL_33fe2cc0: CanIfBufferHthRef=CanIfInitHohCfg/CN_TC37X_VCU_CAN12_f0a399a5_Tx
        CHNL_5ed5f4d1: CanIfBufferHthRef=CanIfInitHohCfg/CN_TC37X_VCU_CAN03_9ebf9872_Tx
        CHNL_d841867f: CanIfBufferHthRef=CanIfInitHohCfg/CN_TC37X_VCU_CAN00_07b6c9c8_Tx
        CHNL_f95a0907: CanIfBufferHthRef=CanIfInitHohCfg/CN_KAMA_FP_EPT_0303_275b3e6e_Tx
      CanIfInitHohCfg: CanIfInitRefCfgSet=CanConfigSet
        5 x CanIfHrhCfg:
          CN_KAMA_FP_EPT_0303_c7999d11_Rx: CanIfHrhCanCtrlIdRef=CanIfCtrlDrvCfg_7d254554/CT_KAMA_FP_EPT_0303_1b7da7f9, CanIfHrhIdSymRef=CanConfigSet/CN_KAMA_FP_EPT_0303_c7999d11_Rx
          CN_TC37X_VCU_CAN00_c052b9c5_Rx: CanIfHrhCanCtrlIdRef=CanIfCtrlDrvCfg_7d254554/CT_TC37X_VCU_CAN00_22cb8fec, CanIfHrhIdSymRef=CanConfigSet/CN_TC37X_VCU_CAN00_c052b9c5_Rx
          CN_TC37X_VCU_CAN01_2f90d2fb_Rx: CanIfHrhCanCtrlIdRef=CanIfCtrlDrvCfg_7d254554/CT_TC37X_VCU_CAN01_55ccbf7a, CanIfHrhIdSymRef=CanConfigSet/CN_TC37X_VCU_CAN01_2f90d2fb_Rx
          CN_TC37X_VCU_CAN03_2b6502c6_Rx: CanIfHrhCanCtrlIdRef=CanIfCtrlDrvCfg_7d254554/CT_TC37X_VCU_CAN03_bbc2de56, CanIfHrhIdSymRef=CanConfigSet/CN_TC37X_VCU_CAN03_2b6502c6_Rx
          CN_TC37X_VCU_CAN12_0529b638_Rx: CanIfHrhCanCtrlIdRef=CanIfCtrlDrvCfg_7d254554/CT_TC37X_VCU_CAN12_d5dedf81, CanIfHrhIdSymRef=CanConfigSet/CN_TC37X_VCU_CAN12_0529b638_Rx
        5 x CanIfHthCfg:
          CN_KAMA_FP_EPT_0303_275b3e6e_Tx: CanIfHthCanCtrlIdRef=CanIfCtrlDrvCfg_7d254554/CT_KAMA_FP_EPT_0303_1b7da7f9, CanIfHthIdSymRef=CanConfigSet/CN_KAMA_FP_EPT_0303_275b3e6e_Tx
          CN_TC37X_VCU_CAN00_07b6c9c8_Tx: CanIfHthCanCtrlIdRef=CanIfCtrlDrvCfg_7d254554/CT_TC37X_VCU_CAN00_22cb8fec, CanIfHthIdSymRef=CanConfigSet/CN_TC37X_VCU_CAN00_07b6c9c8_Tx
          CN_TC37X_VCU_CAN01_70b1f95e_Tx: CanIfHthCanCtrlIdRef=CanIfCtrlDrvCfg_7d254554/CT_TC37X_VCU_CAN01_55ccbf7a, CanIfHthIdSymRef=CanConfigSet/CN_TC37X_VCU_CAN01_70b1f95e_Tx
          CN_TC37X_VCU_CAN03_9ebf9872_Tx: CanIfHthCanCtrlIdRef=CanIfCtrlDrvCfg_7d254554/CT_TC37X_VCU_CAN03_bbc2de56, CanIfHthIdSymRef=CanConfigSet/CN_TC37X_VCU_CAN03_9ebf9872_Tx
          CN_TC37X_VCU_CAN12_f0a399a5_Tx: CanIfHthCanCtrlIdRef=CanIfCtrlDrvCfg_7d254554/CT_TC37X_VCU_CAN12_d5dedf81, CanIfHthIdSymRef=CanConfigSet/CN_TC37X_VCU_CAN12_f0a399a5_Tx
      16 x CanIfRxPduCfg, all with CanIfRxPduCanIdType=STANDARD_CAN, CanIfRxPduDlc=8:
        VCU_Minor_03_oKAMA_FP_EPT_0303_610c6b36_Rx: CanIfRxPduCanId=127, CanIfRxPduUserRxIndicationName=PduR_CanIfRxIndication, CanIfRxPduUserRxIndicationUL=PDUR, CanIfRxPduHrhIdRef=CanIfInitHohCfg/CN_KAMA_FP_EPT_0303_c7999d11_Rx, CanIfRxPduRef=EcucPduCollection/VCU_Minor_03_oKAMA_FP_EPT_0303_d9755fba_Rx
        VCU_Rx_500h_NM_oTC37X_VCU_CAN00_2f971b6a_Rx: CanIfRxPduCanId=1280, CanIfRxPduUserRxIndicationName=CanNm_RxIndication, CanIfRxPduUserRxIndicationUL=CAN_NM, CanIfRxPduHrhIdRef=CanIfInitHohCfg/CN_TC37X_VCU_CAN00_c052b9c5_Rx, CanIfRxPduRef=VCU_Rx_500h_NM_oTC37X_VCU_CAN00_c4b96e15_Rx
        VCU_Rx_500h_NM_oTC37X_VCU_CAN01_21ea515e_Rx: CanIfRxPduCanId=1280, CanIfRxPduUserRxIndicationName=CanNm_RxIndication, CanIfRxPduUserRxIndicationUL=CAN_NM, CanIfRxPduHrhIdRef=CanIfInitHohCfg/CN_TC37X_VCU_CAN01_2f90d2fb_Rx, CanIfRxPduRef=VCU_Rx_500h_NM_oTC37X_VCU_CAN01_54a3f814_Rx
        VCU_Rx_500h_NM_oTC37X_VCU_CAN03_3d10c536_Rx: CanIfRxPduCanId=1280, CanIfRxPduUserRxIndicationName=CanNm_RxIndication, CanIfRxPduUserRxIndicationUL=CAN_NM, CanIfRxPduHrhIdRef=CanIfInitHohCfg/CN_TC37X_VCU_CAN03_2b6502c6_Rx, CanIfRxPduRef=VCU_Rx_500h_NM_oTC37X_VCU_CAN03_afe7d257_Rx
        VCU_Rx_500h_NM_oTC37X_VCU_CAN12_12d706fd_Rx: CanIfRxPduCanId=1280, CanIfRxPduUserRxIndicationName=CanNm_RxIndication, CanIfRxPduUserRxIndicationUL=CAN_NM, CanIfRxPduHrhIdRef=CanIfInitHohCfg/CN_TC37X_VCU_CAN12_0529b638_Rx, CanIfRxPduRef=VCU_Rx_500h_NM_oTC37X_VCU_CAN12_486a6e56_Rx
        VcuCan03RxMsg1_oTC37X_VCU_CAN03_d3a6cc6e_Rx: CanIfRxPduCanId=530, CanIfRxPduUserRxIndicationName=PduR_CanIfRxIndication, CanIfRxPduUserRxIndicationUL=PDUR, CanIfRxPduHrhIdRef=CanIfInitHohCfg/CN_TC37X_VCU_CAN03_2b6502c6_Rx, CanIfRxPduRef=EcucPduCollection/VcuCan03RxMsg1_oTC37X_VCU_CAN03_4dd213bb_Rx
        VcuCan03RxMsg2_oTC37X_VCU_CAN03_90956af5_Rx: CanIfRxPduCanId=531, CanIfRxPduUserRxIndicationName=PduR_CanIfRxIndication, CanIfRxPduUserRxIndicationUL=PDUR, CanIfRxPduHrhIdRef=CanIfInitHohCfg/CN_TC37X_VCU_CAN03_2b6502c6_Rx, CanIfRxPduRef=EcucPduCollection/VcuCan03RxMsg2_oTC37X_VCU_CAN03_84e608b6_Rx
        VcuCan12RxMsg3_oTC37X_VCU_CAN12_b2a63007_Rx: CanIfRxPduCanId=51, CanIfRxPduUserRxIndicationName=PduR_CanIfRxIndication, CanIfRxPduUserRxIndicationUL=PDUR, CanIfRxPduHrhIdRef=CanIfInitHohCfg/CN_TC37X_VCU_CAN12_0529b638_Rx, CanIfRxPduRef=EcucPduCollection/VcuCan12RxMsg3_oTC37X_VCU_CAN12_2f1174ae_Rx
        VcuCan12RxMsg4_oTC37X_VCU_CAN12_0a2fe0b8_Rx: CanIfRxPduCanId=50, CanIfRxPduUserRxIndicationName=PduR_CanIfRxIndication, CanIfRxPduUserRxIndicationUL=PDUR, CanIfRxPduHrhIdRef=CanIfInitHohCfg/CN_TC37X_VCU_CAN12_0529b638_Rx, CanIfRxPduRef=EcucPduCollection/VcuCan12RxMsg4_oTC37X_VCU_CAN12_211bb20e_Rx
        VcuRxMsg1_oTC37X_VCU_CAN00_c149044d_Rx: CanIfRxPduCanId=512, CanIfRxPduUserRxIndicationName=PduR_CanIfRxIndication, CanIfRxPduUserRxIndicationUL=PDUR, CanIfRxPduHrhIdRef=CanIfInitHohCfg/CN_TC37X_VCU_CAN00_c052b9c5_Rx, CanIfRxPduRef=EcucPduCollection/VcuRxMsg1_oTC37X_VCU_CAN00_4589bbed_Rx
        VcuRxMsg2_oTC37X_VCU_CAN00_de1782b6_Rx: CanIfRxPduCanId=513, CanIfRxPduUserRxIndicationName=PduR_CanIfRxIndication, CanIfRxPduUserRxIndicationUL=PDUR, CanIfRxPduHrhIdRef=CanIfInitHohCfg/CN_TC37X_VCU_CAN00_c052b9c5_Rx, CanIfRxPduRef=EcucPduCollection/VcuRxMsg2_oTC37X_VCU_CAN00_8cbda0e0_Rx
        VcuRxMsg3_oTC37X_VCU_CAN01_29174725_Rx: CanIfRxPduCanId=514, CanIfRxPduUserRxIndicationName=PduR_CanIfRxIndication, CanIfRxPduUserRxIndicationUL=PDUR, CanIfRxPduHrhIdRef=CanIfInitHohCfg/CN_TC37X_VCU_CAN01_2f90d2fb_Rx, CanIfRxPduRef=EcucPduCollection/VcuRxMsg3_oTC37X_VCU_CAN01_5bb4c01a_Rx
        VcuRxMsg4_oTC37X_VCU_CAN01_1d60377a_Rx: CanIfRxPduCanId=515, CanIfRxPduUserRxIndicationName=PduR_CanIfRxIndication, CanIfRxPduUserRxIndicationUL=PDUR, CanIfRxPduHrhIdRef=CanIfInitHohCfg/CN_TC37X_VCU_CAN01_2f90d2fb_Rx, CanIfRxPduRef=EcucPduCollection/VcuRxMsg4_oTC37X_VCU_CAN01_55be06ba_Rx
        Vcu_Uds_Func_Request_Tp_oTC37X_VCU_CAN00_b229a038_Rx: CanIfRxPduCanId=1792, CanIfRxPduUserRxIndicationName=CanTp_RxIndication, CanIfRxPduUserRxIndicationType=PDUID_PDUINFOPTR, CanIfRxPduUserRxIndicationUL=CAN_TP, CanIfRxPduHrhIdRef=CanIfInitHohCfg/CN_TC37X_VCU_CAN00_c052b9c5_Rx, CanIfRxPduRef=Vcu_Uds_Func_Request_Tp_oTC37X_VCU_CAN00_3dbedef7_Rx
        Vcu_Uds_Phy_Request_Tp_oTC37X_VCU_CAN00_fc9370a6_Rx: CanIfRxPduCanId=1793, CanIfRxPduUserRxIndicationName=CanTp_RxIndication, CanIfRxPduUserRxIndicationType=PDUID_PDUINFOPTR, CanIfRxPduUserRxIndicationUL=CAN_TP, CanIfRxPduHrhIdRef=CanIfInitHohCfg/CN_TC37X_VCU_CAN00_c052b9c5_Rx, CanIfRxPduRef=Vcu_Uds_Phy_Request_Tp_oTC37X_VCU_CAN00_58c52463_Rx
        XCP_Request_oTC37X_VCU_CAN00_e22de59e_Rx: CanIfRxPduCanId=1542, CanIfRxPduUserRxIndicationName=Xcp_CanIfRxIndication, CanIfRxPduUserRxIndicationUL=XCP, CanIfRxPduHrhIdRef=CanIfInitHohCfg/CN_TC37X_VCU_CAN00_c052b9c5_Rx, CanIfRxPduRef=EcucPduCollection/XCP_Request_oTC37X_VCU_CAN00_3c25b45e_Rx
      24 x CanIfTxPduCfg, all with CanIfTxPduCanIdType=STANDARD_CAN, CanIfTxPduDlc=8:
        VCU_Minor_01_oKAMA_FP_EPT_0303_1cd15024_Tx: CanIfTxPduCanId=121, CanIfTxPduUserTxConfirmationName=PduR_CanIfTxConfirmation, CanIfTxPduUserTxConfirmationUL=PDUR, CanIfTxPduBufferRef=CanIfInitCfg/CHNL_f95a0907, CanIfTxPduRef=EcucPduCollection/VCU_Minor_01_oKAMA_FP_EPT_0303_45280963_Tx
        VCU_Minor_02_oKAMA_FP_EPT_0303_5fe2f6bf_Tx: CanIfTxPduCanId=126, CanIfTxPduUserTxConfirmationName=PduR_CanIfTxConfirmation, CanIfTxPduUserTxConfirmationUL=PDUR, CanIfTxPduBufferRef=CanIfInitCfg/CHNL_f95a0907, CanIfTxPduRef=EcucPduCollection/VCU_Minor_02_oKAMA_FP_EPT_0303_7ae377f6_Tx
        VCU_Tx_51Ch_NM_oTC37X_VCU_CAN00_560cc988_Tx: CanIfTxPduCanId=1308, CanIfTxPduUserTxConfirmationName=CanNm_TxConfirmation, CanIfTxPduUserTxConfirmationUL=CAN_NM, CanIfTxPduBufferRef=CanIfInitCfg/CHNL_d841867f, CanIfTxPduRef=EcucPduCollection/VCU_Tx_51Ch_NM_oTC37X_VCU_CAN00_0aa0ce62_Tx
        VCU_Tx_51Ch_NM_oTC37X_VCU_CAN01_587183bc_Tx: CanIfTxPduCanId=1308, CanIfTxPduUserTxConfirmationName=CanNm_TxConfirmation, CanIfTxPduUserTxConfirmationUL=CAN_NM, CanIfTxPduBufferRef=CanIfInitCfg/CHNL_131d55da, CanIfTxPduRef=EcucPduCollection/VCU_Tx_51Ch_NM_oTC37X_VCU_CAN01_9aba5863_Tx
        VCU_Tx_51Ch_NM_oTC37X_VCU_CAN03_448b17d4_Tx: CanIfTxPduCanId=1308, CanIfTxPduUserTxConfirmationName=CanNm_TxConfirmation, CanIfTxPduUserTxConfirmationUL=CAN_NM, CanIfTxPduBufferRef=CanIfInitCfg/CHNL_5ed5f4d1, CanIfTxPduRef=EcucPduCollection/VCU_Tx_51Ch_NM_oTC37X_VCU_CAN03_61fe7220_Tx
        VCU_Tx_51Ch_NM_oTC37X_VCU_CAN12_6b4cd41f_Tx: CanIfTxPduCanId=1308, CanIfTxPduUserTxConfirmationName=CanNm_TxConfirmation, CanIfTxPduUserTxConfirmationUL=CAN_NM, CanIfTxPduBufferRef=CanIfInitCfg/CHNL_33fe2cc0, CanIfTxPduRef=EcucPduCollection/VCU_Tx_51Ch_NM_oTC37X_VCU_CAN12_8673ce21_Tx
        VcuAdcTxMsg1_oTC37X_VCU_CAN01_29adaf4d_Tx: CanIfTxPduCanId=258, CanIfTxPduUserTxConfirmationName=PduR_CanIfTxConfirmation, CanIfTxPduUserTxConfirmationUL=PDUR, CanIfTxPduBufferRef=CanIfInitCfg/CHNL_131d55da, CanIfTxPduRef=EcucPduCollection/VcuAdcTxMsg1_oTC37X_VCU_CAN01_6685c7bf_Tx
        VcuAdcTxMsg2_oTC37X_VCU_CAN01_fa8a8e09_Tx: CanIfTxPduCanId=259, CanIfTxPduUserTxConfirmationName=PduR_CanIfTxConfirmation, CanIfTxPduUserTxConfirmationUL=PDUR, CanIfTxPduBufferRef=CanIfInitCfg/CHNL_131d55da, CanIfTxPduRef=EcucPduCollection/VcuAdcTxMsg2_oTC37X_VCU_CAN01_afb1dcb2_Tx
        VcuCan03TxMsg1_oTC37X_VCU_CAN03_b4f8e3c0_Tx: CanIfTxPduCanId=274, CanIfTxPduUserTxConfirmationName=PduR_CanIfTxConfirmation, CanIfTxPduUserTxConfirmationUL=PDUR, CanIfTxPduBufferRef=CanIfInitCfg/CHNL_5ed5f4d1, CanIfTxPduRef=EcucPduCollection/VcuCan03TxMsg1_oTC37X_VCU_CAN03_c0767973_Tx
        VcuCan03TxMsg2_oTC37X_VCU_CAN03_f7cb455b_Tx: CanIfTxPduCanId=275, CanIfTxPduUserTxConfirmationName=PduR_CanIfTxConfirmation, CanIfTxPduUserTxConfirmationUL=PDUR, CanIfTxPduBufferRef=CanIfInitCfg/CHNL_5ed5f4d1, CanIfTxPduRef=EcucPduCollection/VcuCan03TxMsg2_oTC37X_VCU_CAN03_0942627e_Tx
        VcuCan12TxMsg1_oTC37X_VCU_CAN12_a82524bb_Tx: CanIfTxPduCanId=53, CanIfTxPduUserTxConfirmationName=PduR_CanIfTxConfirmation, CanIfTxPduUserTxConfirmationUL=PDUR, CanIfTxPduBufferRef=CanIfInitCfg/CHNL_33fe2cc0, CanIfTxPduRef=EcucPduCollection/VcuCan12TxMsg1_oTC37X_VCU_CAN12_2c92f390_Tx
        VcuCan12TxMsg2_oTC37X_VCU_CAN12_eb168220_Tx: CanIfTxPduCanId=52, CanIfTxPduUserTxConfirmationName=PduR_CanIfTxConfirmation, CanIfTxPduUserTxConfirmationUL=PDUR, CanIfTxPduBufferRef=CanIfInitCfg/CHNL_33fe2cc0, CanIfTxPduRef=EcucPduCollection/VcuCan12TxMsg2_oTC37X_VCU_CAN12_e5a6e89d_Tx
        VcuTxIoMsg1_oTC37X_VCU_CAN00_644aaa1f_Tx: CanIfTxPduCanId=260, CanIfTxPduUserTxConfirmationName=PduR_CanIfTxConfirmation, CanIfTxPduUserTxConfirmationUL=PDUR, CanIfTxPduBufferRef=CanIfInitCfg/CHNL_d841867f, CanIfTxPduRef=EcucPduCollection/VcuTxIoMsg1_oTC37X_VCU_CAN00_869e33bc_Tx
        VcuTxIoMsg2_oTC37X_VCU_CAN00_0c9644c1_Tx: CanIfTxPduCanId=261, CanIfTxPduUserTxConfirmationName=PduR_CanIfTxConfirmation, CanIfTxPduUserTxConfirmationUL=PDUR, CanIfTxPduBufferRef=CanIfInitCfg/CHNL_d841867f, CanIfTxPduRef=EcucPduCollection/VcuTxIoMsg2_oTC37X_VCU_CAN00_4faa28b1_Tx
        VcuTxIoMsg3_oTC37X_VCU_CAN00_2b221e8b_Tx: CanIfTxPduCanId=262, CanIfTxPduUserTxConfirmationName=PduR_CanIfTxConfirmation, CanIfTxPduUserTxConfirmationUL=PDUR, CanIfTxPduBufferRef=CanIfInitCfg/CHNL_d841867f, CanIfTxPduRef=EcucPduCollection/VcuTxIoMsg3_oTC37X_VCU_CAN00_08b9de4a_Tx
        VcuTxIoMsg4_oTC37X_VCU_CAN00_dd2f997d_Tx: CanIfTxPduCanId=263, CanIfTxPduUserTxConfirmationName=PduR_CanIfTxConfirmation, CanIfTxPduUserTxConfirmationUL=PDUR, CanIfTxPduBufferRef=CanIfInitCfg/CHNL_d841867f, CanIfTxPduRef=EcucPduCollection/VcuTxIoMsg4_oTC37X_VCU_CAN00_06b318ea_Tx
        VcuTxIoMsg5_oTC37X_VCU_CAN00_fa9bc337_Tx: CanIfTxPduCanId=264, CanIfTxPduUserTxConfirmationName=PduR_CanIfTxConfirmation, CanIfTxPduUserTxConfirmationUL=PDUR, CanIfTxPduBufferRef=CanIfInitCfg/CHNL_d841867f, CanIfTxPduRef=EcucPduCollection/VcuTxIoMsg5_oTC37X_VCU_CAN00_41a0ee11_Tx
        VcuTxIoMsg6_oTC37X_VCU_CAN00_92472de9_Tx: CanIfTxPduCanId=265, CanIfTxPduUserTxConfirmationName=PduR_CanIfTxConfirmation, CanIfTxPduUserTxConfirmationUL=PDUR, CanIfTxPduBufferRef=CanIfInitCfg/CHNL_d841867f, CanIfTxPduRef=EcucPduCollection/VcuTxIoMsg6_oTC37X_VCU_CAN00_8894f51c_Tx
        VcuTxIoMsg7_oTC37X_VCU_CAN00_b5f377a3_Tx: CanIfTxPduCanId=266, CanIfTxPduUserTxConfirmationName=PduR_CanIfTxConfirmation, CanIfTxPduUserTxConfirmationUL=PDUR, CanIfTxPduBufferRef=CanIfInitCfg/CHNL_d841867f, CanIfTxPduRef=EcucPduCollection/VcuTxIoMsg7_oTC37X_VCU_CAN00_cf8703e7_Tx
        VcuTxIoMsg8_oTC37X_VCU_CAN00_a52d2444_Tx: CanIfTxPduCanId=267, CanIfTxPduUserTxConfirmationName=PduR_CanIfTxConfirmation, CanIfTxPduUserTxConfirmationUL=PDUR, CanIfTxPduBufferRef=CanIfInitCfg/CHNL_d841867f, CanIfTxPduRef=EcucPduCollection/VcuTxIoMsg8_oTC37X_VCU_CAN00_9481785c_Tx
        VcuTxMsg1_oTC37X_VCU_CAN00_78140f53_Tx: CanIfTxPduCanId=256, CanIfTxPduUserTxConfirmationName=PduR_CanIfTxConfirmation, CanIfTxPduUserTxConfirmationUL=PDUR, CanIfTxPduBufferRef=CanIfInitCfg/CHNL_d841867f, CanIfTxPduRef=EcucPduCollection/VcuTxMsg1_oTC37X_VCU_CAN00_c82dd125_Tx
        VcuTxMsg2_oTC37X_VCU_CAN00_674a89a8_Tx: CanIfTxPduCanId=257, CanIfTxPduUserTxConfirmationName=PduR_CanIfTxConfirmation, CanIfTxPduUserTxConfirmationUL=PDUR, CanIfTxPduBufferRef=CanIfInitCfg/CHNL_d841867f, CanIfTxPduRef=EcucPduCollection/VcuTxMsg2_oTC37X_VCU_CAN00_0119ca28_Tx
        Vcu_Uds_Response_Tp_oTC37X_VCU_CAN00_2ff8982b_Tx: CanIfTxPduCanId=1921, CanIfTxPduUserTxConfirmationName=CanTp_TxConfirmation, CanIfTxPduUserTxConfirmationUL=CAN_TP, CanIfTxPduBufferRef=CanIfInitCfg/CHNL_d841867f, CanIfTxPduRef=Vcu_Uds_Response_Tp_oTC37X_VCU_CAN00_834178f3_Tx
        XCP_Response_oTC37X_VCU_CAN00_933a9e7a_Tx: CanIfTxPduCanId=1543, CanIfTxPduUserTxConfirmationName=Xcp_CanIfTxConfirmation, CanIfTxPduUserTxConfirmationUL=XCP, CanIfTxPduBufferRef=CanIfInitCfg/CHNL_d841867f, CanIfTxPduRef=EcucPduCollection/XCP_Response_oTC37X_VCU_CAN00_34d2da2d_Tx
    CanIfPrivateCfg: CanIfPrivateSoftwareFilterType=LINEAR
    CanIfPublicCfg: CanIfPublicPnSupport=false
  module config CanNm
    CanNmGlobalConfig: CanNmPnEiraCalcEnabled=false, CanNmUserDataEnabled=true
      4 x CanNmChannelConfig, all with CanNmMsgCycleOffset=0, CanNmMsgCycleTime=0.5, CanNmMsgReducedTime=0.32, CanNmNodeId=28, CanNmRepeatMessageTime=1.5, CanNmTimeoutTime=2, CanNmUserDataLength=6, CanNmWaitBusSleepTime=2:
        TC37X_VCU_CAN00_CAN_cc8c31fa: CanNmComMNetworkHandleRef=ComMConfigSet/CN_TC37X_VCU_CAN00_07b6c9c8
          VCU_Tx_51Ch_NM_oTC37X_VCU_CAN00_0aa0ce62_Tx (CanNmTxPdu): CanNmTxPduRef=EcucPduCollection/VCU_Tx_51Ch_NM_oTC37X_VCU_CAN00_0aa0ce62_Tx
        TC37X_VCU_CAN01_CAN_f1ec184a: CanNmComMNetworkHandleRef=ComMConfigSet/CN_TC37X_VCU_CAN01_70b1f95e
          VCU_Tx_51Ch_NM_oTC37X_VCU_CAN01_9aba5863_Tx (CanNmTxPdu): CanNmTxPduRef=EcucPduCollection/VCU_Tx_51Ch_NM_oTC37X_VCU_CAN01_9aba5863_Tx
        TC37X_VCU_CAN03_CAN_8b2c4b2a: CanNmComMNetworkHandleRef=ComMConfigSet/CN_TC37X_VCU_CAN03_9ebf9872
          VCU_Tx_51Ch_NM_oTC37X_VCU_CAN03_61fe7220_Tx (CanNmTxPdu): CanNmTxPduRef=EcucPduCollection/VCU_Tx_51Ch_NM_oTC37X_VCU_CAN03_61fe7220_Tx
        TC37X_VCU_CAN12_CAN_7d10b13f: CanNmComMNetworkHandleRef=ComMConfigSet/CN_TC37X_VCU_CAN12_f0a399a5
          VCU_Tx_51Ch_NM_oTC37X_VCU_CAN12_8673ce21_Tx (CanNmTxPdu): CanNmTxPduRef=EcucPduCollection/VCU_Tx_51Ch_NM_oTC37X_VCU_CAN12_8673ce21_Tx
  module config CanSM
    CanSMConfiguration
      5 x CanSMManagerNetwork:
        CHNL_131d55da: CanSMComMNetworkHandleRef=ComMConfigSet/CN_TC37X_VCU_CAN01_70b1f95e
          CT_TC37X_VCU_CAN01_9a653c82 (CanSMController): CanSMControllerId=CanIfCtrlDrvCfg_7d254554/CT_TC37X_VCU_CAN01_55ccbf7a
        CHNL_33fe2cc0: CanSMComMNetworkHandleRef=ComMConfigSet/CN_TC37X_VCU_CAN12_f0a399a5
          CT_TC37X_VCU_CAN12_58747941 (CanSMController): CanSMControllerId=CanIfCtrlDrvCfg_7d254554/CT_TC37X_VCU_CAN12_d5dedf81
        CHNL_5ed5f4d1: CanSMComMNetworkHandleRef=ComMConfigSet/CN_TC37X_VCU_CAN03_9ebf9872
          CT_TC37X_VCU_CAN03_ca624c2b (CanSMController): CanSMControllerId=CanIfCtrlDrvCfg_7d254554/CT_TC37X_VCU_CAN03_bbc2de56
        CHNL_d841867f: CanSMComMNetworkHandleRef=ComMConfigSet/CN_TC37X_VCU_CAN00_07b6c9c8
          CT_TC37X_VCU_CAN00_5fde07f6 (CanSMController): CanSMControllerId=CanIfCtrlDrvCfg_7d254554/CT_TC37X_VCU_CAN00_22cb8fec
        CHNL_f95a0907: CanSMComMNetworkHandleRef=ComMConfigSet/CN_KAMA_FP_EPT_0303_275b3e6e
          CT_KAMA_FP_EPT_0303_62c0567e (CanSMController): CanSMControllerId=CanIfCtrlDrvCfg_7d254554/CT_KAMA_FP_EPT_0303_1b7da7f9
  module config CanTp
    CanTpConfig: CanTpMainFunctionPeriod=0.005
      TPCH_1341a116 (CanTpChannel): CanTpChannelMode=CANTP_MODE_FULL_DUPLEX
        CanTpRxNSdu_fe7a15ff (CanTpRxNSdu):
          CanTpRxAddressingFormat = CANTP_STANDARD
          CanTpRxDl = 8
          CanTpRxTaType = CANTP_PHYSICAL
          CanTpRxNSduRef = EcucPduCollection/Vcu_Uds_Phy_Request_oTC37X_VCU_CAN00_16119f6f_Rx
          CanTpRxNPdu_63ec38a0 (CanTpRxNPdu): CanTpRxNPduRef=Vcu_Uds_Phy_Request_Tp_oTC37X_VCU_CAN00_58c52463_Rx
          CanTpTxFcNPdu_63ec38a0 (CanTpTxFcNPdu): CanTpTxFcNPduRef=Vcu_Uds_Response_Tp_oTC37X_VCU_CAN00_834178f3_Tx
        CanTpTxNSdu_fe7a15ff (CanTpTxNSdu):
          CanTpTxAddressingFormat = CANTP_STANDARD
          CanTpTxDl = 8
          CanTpTxTaType = CANTP_PHYSICAL
          CanTpTxNSduRef = EcucPduCollection/Vcu_Uds_Response_oTC37X_VCU_CAN00_39638a1a_Tx
          CanTpRxFcNPdu_4116ec52 (CanTpRxFcNPdu): CanTpRxFcNPduRef=Vcu_Uds_Phy_Request_Tp_oTC37X_VCU_CAN00_58c52463_Rx
          CanTpTxNPdu_4116ec52 (CanTpTxNPdu): CanTpTxNPduRef=Vcu_Uds_Response_Tp_oTC37X_VCU_CAN00_834178f3_Tx
      TPCH_d230b3ef (CanTpChannel): CanTpChannelMode=CANTP_MODE_FULL_DUPLEX
        CanTpRxNSdu_c12348c5 (CanTpRxNSdu):
          CanTpRxAddressingFormat = CANTP_STANDARD
          CanTpRxDl = 8
          CanTpRxTaType = CANTP_FUNCTIONAL
          CanTpRxNSduRef = EcucPduCollection/Vcu_Uds_Func_Request_oTC37X_VCU_CAN00_455d4346_Rx
          CanTpRxNPdu_257d590c (CanTpRxNPdu): CanTpRxNPduRef=Vcu_Uds_Func_Request_Tp_oTC37X_VCU_CAN00_3dbedef7_Rx
  module config Com
    ComConfig
      45 x ComIPdu, all with ComIPduType=NORMAL:
        EDCU_EXV2_oLIN00_1f8750a5_Tx: ComIPduDirection=SEND, ComIPduGroupRef=VCU_oLIN00_Tx_1dc75bd5, ComIPduSignalRef=EDCU_EXV2_Cmd_Init_Rq_oEDCU_EXV2_oLIN00_0144aec9_Tx, ComIPduSignalRef=EDCU_EXV2_Cmd_Move_Enbl_oEDCU_EXV2_oLIN00_d6797517_Tx, ComIPduSignalRef=EDCU_EXV2_Cmd_Set_Rq_oEDCU_EXV2_oLIN00_66e5876a_Tx, ComPduIdRef=EcucPduCollection/EDCU_EXV2_oLIN00_1f8750a5_Tx
          ComTxIPdu: ComTxIPduUnusedAreasDefault=255
        EXV2_Status_oLIN00_d5e93929_Rx: ComIPduDirection=RECEIVE, ComIPduGroupRef=VCU_oLIN00_Rx_4b9dfc53, ComIPduSignalRef=EXV2_Fault_Stat_oEXV2_Status_oLIN00_ab6350b6_Rx, ComIPduSignalRef=EXV2_OvrTemp_Warn_oEXV2_Status_oLIN00_ba77659e_Rx, ComIPduSignalRef=EXV2_Pos_oEXV2_Status_oLIN00_da80603b_Rx, ComIPduSignalRef=EXV2_Run_Stat_oEXV2_Status_oLIN00_0e992e12_Rx, ComIPduSignalRef=EXV2_Volt_Stat_oEXV2_Status_oLIN00_c8727eb0_Rx, ComIPduSignalRef=EXV2_curInit_Stat_oEXV2_Status_oLIN00_b0ace0f5_Rx, ComIPduSignalRef=RsErr_EXV2_oEXV2_Status_oLIN00_5c35655a_Rx, ComPduIdRef=EcucPduCollection/EXV2_Status_oLIN00_d5e93929_Rx
        EXV_1_VCU_oLIN00_69d4ef5f_Rx: ComIPduDirection=RECEIVE, ComIPduGroupRef=VCU_oLIN00_Rx_4b9dfc53, ComIPduSignalRef=EXV1_CurrentInitState_oEXV_1_VCU_oLIN00_beca31e2_Rx, ComIPduSignalRef=EXV1_CurrentPosition_oEXV_1_VCU_oLIN00_6daec86f_Rx, ComIPduSignalRef=EXV1_FaultState_oEXV_1_VCU_oLIN00_72ff14f0_Rx, ComIPduSignalRef=EXV1_ResponseError_oEXV_1_VCU_oLIN00_cbce9ad1_Rx, ComIPduSignalRef=EXV1_RunState_oEXV_1_VCU_oLIN00_f0dc555f_Rx, ComIPduSignalRef=EXV1_TemperatureWarn_oEXV_1_VCU_oLIN00_a3317e4b_Rx, ComIPduSignalRef=EXV1_VoltageState_oEXV_1_VCU_oLIN00_31bbfd77_Rx, ComPduIdRef=EcucPduCollection/EXV_1_VCU_oLIN00_69d4ef5f_Rx
        EXV_2_VCU_oLIN00_1e4a3daf_Rx: ComIPduDirection=RECEIVE, ComIPduGroupRef=VCU_oLIN00_Rx_4b9dfc53, ComIPduSignalRef=EXV2_CurrentInitState_oEXV_2_VCU_oLIN00_adb498ec_Rx, ComIPduSignalRef=EXV2_CurrentPosition_oEXV_2_VCU_oLIN00_91e32486_Rx, ComIPduSignalRef=EXV2_FaultState_oEXV_2_VCU_oLIN00_41c0e318_Rx, ComIPduSignalRef=EXV2_ResponseError_oEXV_2_VCU_oLIN00_e747f934_Rx, ComIPduSignalRef=EXV2_RunState_oEXV_2_VCU_oLIN00_859c8088_Rx, ComIPduSignalRef=EXV2_TemperatureWarn_oEXV_2_VCU_oLIN00_5f7c92a2_Rx, ComIPduSignalRef=EXV2_VoltageState_oEXV_2_VCU_oLIN00_8f3a2738_Rx, ComPduIdRef=EcucPduCollection/EXV_2_VCU_oLIN00_1e4a3daf_Rx
        HVCH_Rsp01_oLIN00_a6e33eef_Rx: ComIPduDirection=RECEIVE, ComIPduGroupRef=VCU_oLIN00_Rx_4b9dfc53, ComIPduSignalRef=HVCH_CurrSens_Flt_oHVCH_Rsp01_oLIN00_09f7bc74_Rx, ComIPduSignalRef=HVCH_DutyCycle_oHVCH_Rsp01_oLIN00_ad1e6a22_Rx, ComIPduSignalRef=HVCH_ExtPwrSup_Flt_oHVCH_Rsp01_oLIN00_28926933_Rx, ComIPduSignalRef=HVCH_HV_DC_curr_oHVCH_Rsp01_oLIN00_f613e39d_Rx, ComIPduSignalRef=HVCH_HV_Voltage_Valid_oHVCH_Rsp01_oLIN00_2914831e_Rx, ComIPduSignalRef=HVCH_HV_voltage_oHVCH_Rsp01_oLIN00_3d3da318_Rx, ComIPduSignalRef=HVCH_InternalPCBTemp_oHVCH_Rsp01_oLIN00_398b53e8_Rx, ComIPduSignalRef=HVCH_LIN_Flt_oHVCH_Rsp01_oLIN00_9aaa25bf_Rx, ComIPduSignalRef=HVCH_MediumTemp_oHVCH_Rsp01_oLIN00_a3387de4_Rx, ComIPduSignalRef=HVCH_Off_ShrtCurr_oHVCH_Rsp01_oLIN00_bf58ab45_Rx, ComIPduSignalRef=HVCH_RsErr_oHVCH_Rsp01_oLIN00_527b0f8f_Rx, ComIPduSignalRef=HVCH_Status_oHVCH_Rsp01_oLIN00_60afdc75_Rx, ComIPduSignalRef=HVCH_TempLim_oHVCH_Rsp01_oLIN00_d22e6add_Rx, ComIPduSignalRef=HVCH_TempSens_Flt_oHVCH_Rsp01_oLIN00_66cb2c71_Rx, ComIPduSignalRef=HVCH_defectHeaterCircuits_oHVCH_Rsp01_oLIN00_61948e74_Rx, ComPduIdRef=EcucPduCollection/HVCH_Rsp01_oLIN00_a6e33eef_Rx
        HVCH_Rsp02_oLIN00_286c390c_Rx: ComIPduDirection=RECEIVE, ComIPduGroupRef=VCU_oLIN00_Rx_4b9dfc53, ComIPduSignalRef=HVCH_IntelTemp_oHVCH_Rsp02_oLIN00_2b487110_Rx, ComPduIdRef=EcucPduCollection/HVCH_Rsp02_oLIN00_286c390c_Rx
        PMP2_Sts_oLIN00_cab90b6b_Rx: ComIPduDirection=RECEIVE, ComIPduGroupRef=VCU_oLIN00_Rx_4b9dfc53, ComIPduSignalRef=PMP2_PumpDryRunningSta_oPMP2_Sts_oLIN00_3e217a22_Rx, ComIPduSignalRef=PMP2_PumpInputVolt_oPMP2_Sts_oLIN00_1fa0a533_Rx, ComIPduSignalRef=PMP2_PumpMotorSta_oPMP2_Sts_oLIN00_d6d3ab88_Rx, ComIPduSignalRef=PMP2_PumpPowerSta_oPMP2_Sts_oLIN00_1d0f1319_Rx, ComIPduSignalRef=PMP2_PumpTempSta_oPMP2_Sts_oLIN00_81f2fa55_Rx, ComIPduSignalRef=PMP2_RESP_ERROR_oPMP2_Sts_oLIN00_67b666eb_Rx, ComIPduSignalRef=PMP2_RealRPM_oPMP2_Sts_oLIN00_86d75572_Rx, ComPduIdRef=EcucPduCollection/PMP2_Sts_oLIN00_cab90b6b_Rx
        PMP3_Sts_oLIN00_511c4704_Rx: ComIPduDirection=RECEIVE, ComIPduGroupRef=VCU_oLIN00_Rx_4b9dfc53, ComIPduSignalRef=PMP3_PumpDryRunningSta_oPMP3_Sts_oLIN00_30f4e2d8_Rx, ComIPduSignalRef=PMP3_PumpInputVolt_oPMP3_Sts_oLIN00_75dfecf6_Rx, ComIPduSignalRef=PMP3_PumpMotorSta_oPMP3_Sts_oLIN00_43910f36_Rx, ComIPduSignalRef=PMP3_PumpPowerSta_oPMP3_Sts_oLIN00_884db7a7_Rx, ComIPduSignalRef=PMP3_PumpTempSta_oPMP3_Sts_oLIN00_26375532_Rx, ComIPduSignalRef=PMP3_RESP_ERROR_oPMP3_Sts_oLIN00_9f14f3a0_Rx, ComIPduSignalRef=PMP3_RealRPM_oPMP3_Sts_oLIN00_fa6fbf8a_Rx, ComPduIdRef=EcucPduCollection/PMP3_Sts_oLIN00_511c4704_Rx
        PMP_Cmd_oLIN00_3912b28b_Tx: ComIPduDirection=SEND, ComIPduGroupRef=VCU_oLIN00_Tx_1dc75bd5, ComIPduSignalRef=ECC_PMP2_SpdSet_oPMP_Cmd_oLIN00_8cabc4b7_Tx, ComIPduSignalRef=ECC_PMP3_SpdSet_oPMP_Cmd_oLIN00_0d8ea190_Tx, ComPduIdRef=EcucPduCollection/PMP_Cmd_oLIN00_3912b28b_Tx
          ComTxIPdu: ComTxIPduUnusedAreasDefault=255
        SVA_VCU_STD_oLIN00_4526aa1c_Rx: ComIPduDirection=RECEIVE, ComIPduGroupRef=VCU_oLIN00_Rx_4b9dfc53, ComIPduSignalRef=Act_Pos_sta_oSVA_VCU_STD_oLIN00_642c9ffa_Rx, ComIPduSignalRef=Blockage_Fault_STA_oSVA_VCU_STD_oLIN00_6c89246f_Rx, ComIPduSignalRef=Breakage_Fault_STA_oSVA_VCU_STD_oLIN00_a3ac9cf8_Rx, ComIPduSignalRef=Calibration_sta_oSVA_VCU_STD_oLIN00_dcb4af08_Rx, ComIPduSignalRef=LIN_Resp_Error_sta_oSVA_VCU_STD_oLIN00_47f7ca93_Rx, ComPduIdRef=EcucPduCollection/SVA_VCU_STD_oLIN00_4526aa1c_Rx
        TCU_HVCH_Cmd_oLIN00_385d5651_Tx: ComIPduDirection=SEND, ComIPduGroupRef=VCU_oLIN00_Tx_1dc75bd5, ComIPduSignalRef=TCU_HVCHMaxPowerLimit_oTCU_HVCH_Cmd_oLIN00_4bc53e0b_Tx, ComIPduSignalRef=TCU_HVCH_On_Rq_oTCU_HVCH_Cmd_oLIN00_9f442eaf_Tx, ComIPduSignalRef=TCU_HVCH_TmaxLim_output_oTCU_HVCH_Cmd_oLIN00_5e45d521_Tx, ComIPduSignalRef=TCU_HVCH_heating_rq_oTCU_HVCH_Cmd_oLIN00_5e3a32b2_Tx, ComPduIdRef=EcucPduCollection/TCU_HVCH_Cmd_oLIN00_385d5651_Tx
          ComTxIPdu: ComTxIPduUnusedAreasDefault=255
        VCU_EXV_1_oLIN00_50eec975_Tx: ComIPduDirection=SEND, ComIPduGroupRef=VCU_oLIN00_Tx_1dc75bd5, ComIPduSignalRef=TMM_EXV1_EnableRequest_oVCU_EXV_1_oLIN00_d988d266_Tx, ComIPduSignalRef=TMM_EXV1_PositionRequest_oVCU_EXV_1_oLIN00_cbd2de27_Tx, ComIPduSignalRef=TMM_EXV1_initRequest_oVCU_EXV_1_oLIN00_082350ea_Tx, ComPduIdRef=EcucPduCollection/VCU_EXV_1_oLIN00_50eec975_Tx
          ComTxIPdu: ComTxIPduUnusedAreasDefault=255
        VCU_EXV_2_oLIN00_de61ce96_Tx: ComIPduDirection=SEND, ComIPduGroupRef=VCU_oLIN00_Tx_1dc75bd5, ComIPduSignalRef=TMM_EXV2_EnableRequest_oVCU_EXV_2_oLIN00_0c106490_Tx, ComIPduSignalRef=TMM_EXV2_PositionRequest_oVCU_EXV_2_oLIN00_ce8ee7dd_Tx, ComIPduSignalRef=TMM_EXV2_initRequest_oVCU_EXV_2_oLIN00_95846e7a_Tx, ComPduIdRef=EcucPduCollection/VCU_EXV_2_oLIN00_de61ce96_Tx
          ComTxIPdu: ComTxIPduUnusedAreasDefault=255
        VCU_Minor_01_oKAMA_FP_EPT_0303_39c0a2ee_Tx: ComIPduDirection=SEND, ComIPduGroupRef=VCU_oKAMA_FP_EPT_0303_Tx_51b27697, ComIPduSignalRef=A_I_F_B_oVCU_Minor_01_oKAMA_FP_EPT_0303_576573ee_Tx, ComIPduSignalRef=MODE_F_B_oVCU_Minor_01_oKAMA_FP_EPT_0303_8d5db84c_Tx, ComIPduSignalRef=Tamb_oVCU_Minor_01_oKAMA_FP_EPT_0303_8a5abefe_Tx, ComIPduSignalRef=Tevap_Tchiller_out_oVCU_Minor_01_oKAMA_FP_EPT_0303_29906cec_Tx, ComIPduSignalRef=Tohx_in_oVCU_Minor_01_oKAMA_FP_EPT_0303_ef5c5e50_Tx, ComIPduSignalRef=Tohx_out_oVCU_Minor_01_oKAMA_FP_EPT_0303_63435844_Tx, ComPduIdRef=EcucPduCollection/VCU_Minor_01_oKAMA_FP_EPT_0303_39c0a2ee_Tx
          ComTxIPdu: ComMinimumDelayTime=0, ComTxIPduUnusedAreasDefault=0
            ComTxModeFalse
              ComTxMode: ComTxModeMode=PERIODIC, ComTxModeTimeOffset=0, ComTxModeTimePeriod=0.02
            ComTxModeTrue
              ComTxMode: ComTxModeMode=PERIODIC, ComTxModeTimeOffset=0, ComTxModeTimePeriod=0.02
        VCU_Minor_02_oKAMA_FP_EPT_0303_9a962447_Tx: ComIPduDirection=SEND, ComIPduGroupRef=VCU_oKAMA_FP_EPT_0303_Tx_51b27697, ComIPduSignalRef=COMP_Pdis_oVCU_Minor_02_oKAMA_FP_EPT_0303_4bfdbd85_Tx, ComIPduSignalRef=COMP_Psuc_oVCU_Minor_02_oKAMA_FP_EPT_0303_9659454d_Tx, ComIPduSignalRef=COMP_Tdis_oVCU_Minor_02_oKAMA_FP_EPT_0303_73ade512_Tx, ComIPduSignalRef=COMP_Tsuc_oVCU_Minor_02_oKAMA_FP_EPT_0303_ae091dda_Tx, ComIPduSignalRef=Tincar_oVCU_Minor_02_oKAMA_FP_EPT_0303_a42f9f70_Tx, ComPduIdRef=EcucPduCollection/VCU_Minor_02_oKAMA_FP_EPT_0303_9a962447_Tx
          ComTxIPdu: ComMinimumDelayTime=0, ComTxIPduUnusedAreasDefault=0
            ComTxModeFalse
              ComTxMode: ComTxModeMode=PERIODIC, ComTxModeTimeOffset=0, ComTxModeTimePeriod=0.02
            ComTxModeTrue
              ComTxMode: ComTxModeMode=PERIODIC, ComTxModeTimeOffset=0, ComTxModeTimePeriod=0.02
        VCU_Minor_03_oKAMA_FP_EPT_0303_4d74a41f_Rx: ComIPduDirection=RECEIVE, ComIPduGroupRef=VCU_oKAMA_FP_EPT_0303_Rx_07e8d111, ComIPduSignalRef=A_I_Actuator_With_F_B_request_oVCU_Minor_03_oKAMA_FP_EPT_0303_0324126f_Rx, ComIPduSignalRef=COOLING_FAN_request_oVCU_Minor_03_oKAMA_FP_EPT_0303_282b4f5d_Rx, ComIPduSignalRef=HVAC_Blower_request_oVCU_Minor_03_oKAMA_FP_EPT_0303_ea1e3327_Rx, ComIPduSignalRef=Mode_Actuator_request_oVCU_Minor_03_oKAMA_FP_EPT_0303_b0a0ba91_Rx, ComIPduSignalRef=SV1_request_oVCU_Minor_03_oKAMA_FP_EPT_0303_a1028998_Rx, ComIPduSignalRef=SV2_request_oVCU_Minor_03_oKAMA_FP_EPT_0303_424b3e3a_Rx, ComIPduSignalRef=SV3_request_oVCU_Minor_03_oKAMA_FP_EPT_0303_aa5cae9b_Rx, ComPduIdRef=EcucPduCollection/VCU_Minor_03_oKAMA_FP_EPT_0303_4d74a41f_Rx
        VCU_SVA_CMD_oLIN00_756d14f6_Tx: ComIPduDirection=SEND, ComIPduGroupRef=VCU_oLIN00_Tx_1dc75bd5, ComIPduSignalRef=Calibration_cmd_oVCU_SVA_CMD_oLIN00_6732180a_Tx, ComIPduSignalRef=Target_Pos_cmd_oVCU_SVA_CMD_oLIN00_b87f26ef_Tx, ComPduIdRef=EcucPduCollection/VCU_SVA_CMD_oLIN00_756d14f6_Tx
          ComTxIPdu: ComTxIPduUnusedAreasDefault=255
        VcuAdcTxMsg1_oTC37X_VCU_CAN01_fda515ee_Tx: ComIPduDirection=SEND, ComIPduGroupRef=VCU_oTC37X_VCU_CAN01_Tx_4e6d6cda, ComIPduSignalRef=VcuAdcTxMsg1_Sig0_oVcuAdcTxMsg1_oTC37X_VCU_CAN01_77707e8c_Tx, ComIPduSignalRef=VcuAdcTxMsg1_Sig1_oVcuAdcTxMsg1_oTC37X_VCU_CAN01_86aa7b26_Tx, ComIPduSignalRef=VcuAdcTxMsg1_Sig2_oVcuAdcTxMsg1_oTC37X_VCU_CAN01_4fb57399_Tx, ComIPduSignalRef=VcuAdcTxMsg1_Sig3_oVcuAdcTxMsg1_oTC37X_VCU_CAN01_be6f7633_Tx, ComPduIdRef=EcucPduCollection/VcuAdcTxMsg1_oTC37X_VCU_CAN01_fda515ee_Tx
          ComTxIPdu: ComMinimumDelayTime=0, ComTxIPduUnusedAreasDefault=0
            ComTxModeFalse
              ComTxMode: ComTxModeMode=PERIODIC, ComTxModeTimeOffset=0, ComTxModeTimePeriod=0.5
            ComTxModeTrue
              ComTxMode: ComTxModeMode=PERIODIC, ComTxModeTimeOffset=0, ComTxModeTimePeriod=0.5
        VcuAdcTxMsg2_oTC37X_VCU_CAN01_1723c88c_Tx: ComIPduDirection=SEND, ComIPduGroupRef=VCU_oTC37X_VCU_CAN01_Tx_4e6d6cda, ComIPduSignalRef=VcuAdcTxMsg2_Sig0_oVcuAdcTxMsg2_oTC37X_VCU_CAN01_c7979c8e_Tx, ComIPduSignalRef=VcuAdcTxMsg2_Sig1_oVcuAdcTxMsg2_oTC37X_VCU_CAN01_364d9924_Tx, ComIPduSignalRef=VcuAdcTxMsg2_Sig2_oVcuAdcTxMsg2_oTC37X_VCU_CAN01_ff52919b_Tx, ComIPduSignalRef=VcuAdcTxMsg2_Sig3_oVcuAdcTxMsg2_oTC37X_VCU_CAN01_0e889431_Tx, ComPduIdRef=EcucPduCollection/VcuAdcTxMsg2_oTC37X_VCU_CAN01_1723c88c_Tx
          ComTxIPdu: ComMinimumDelayTime=0, ComTxIPduUnusedAreasDefault=0
            ComTxModeFalse
              ComTxMode: ComTxModeMode=PERIODIC, ComTxModeTimeOffset=0, ComTxModeTimePeriod=0.5
            ComTxModeTrue
              ComTxMode: ComTxModeMode=PERIODIC, ComTxModeTimeOffset=0, ComTxModeTimePeriod=0.5
        VcuCan03RxMsg1_oTC37X_VCU_CAN03_77e3a75f_Rx: ComIPduDirection=RECEIVE, ComIPduGroupRef=VCU_oTC37X_VCU_CAN03_Rx_b23e03d7, ComIPduSignalRef=VcuRxMsg3_Sig0_oVcuCan03RxMsg1_oTC37X_VCU_CAN03_ab1f8c96_Rx, ComIPduSignalRef=VcuRxMsg3_Sig1_oVcuCan03RxMsg1_oTC37X_VCU_CAN03_8f9ddda0_Rx, ComIPduSignalRef=VcuRxMsg3_Sig2_oVcuCan03RxMsg1_oTC37X_VCU_CAN03_e21b2efa_Rx, ComIPduSignalRef=VcuRxMsg3_Sig3_oVcuCan03RxMsg1_oTC37X_VCU_CAN03_c6997fcc_Rx, ComPduIdRef=EcucPduCollection/VcuCan03RxMsg1_oTC37X_VCU_CAN03_77e3a75f_Rx
        VcuCan03RxMsg2_oTC37X_VCU_CAN03_9d657a3d_Rx: ComIPduDirection=RECEIVE, ComIPduGroupRef=VCU_oTC37X_VCU_CAN03_Rx_b23e03d7, ComIPduSignalRef=VcuRxMsg4_Sig0_oVcuCan03RxMsg2_oTC37X_VCU_CAN03_735765ea_Rx, ComIPduSignalRef=VcuRxMsg4_Sig1_oVcuCan03RxMsg2_oTC37X_VCU_CAN03_57d534dc_Rx, ComIPduSignalRef=VcuRxMsg4_Sig2_oVcuCan03RxMsg2_oTC37X_VCU_CAN03_3a53c786_Rx, ComIPduSignalRef=VcuRxMsg4_Sig3_oVcuCan03RxMsg2_oTC37X_VCU_CAN03_1ed196b0_Rx, ComPduIdRef=EcucPduCollection/VcuCan03RxMsg2_oTC37X_VCU_CAN03_9d657a3d_Rx
        VcuCan03TxMsg1_oTC37X_VCU_CAN03_9a29d525_Tx: ComIPduDirection=SEND, ComIPduGroupRef=VCU_oTC37X_VCU_CAN03_Tx_e464a451, ComIPduSignalRef=VcuAdcTxMsg1_Sig0_oVcuCan03TxMsg1_oTC37X_VCU_CAN03_1782ee05_Tx, ComIPduSignalRef=VcuAdcTxMsg1_Sig1_oVcuCan03TxMsg1_oTC37X_VCU_CAN03_3300bf33_Tx, ComIPduSignalRef=VcuAdcTxMsg1_Sig2_oVcuCan03TxMsg1_oTC37X_VCU_CAN03_5e864c69_Tx, ComIPduSignalRef=VcuAdcTxMsg1_Sig3_oVcuCan03TxMsg1_oTC37X_VCU_CAN03_7a041d5f_Tx, ComPduIdRef=EcucPduCollection/VcuCan03TxMsg1_oTC37X_VCU_CAN03_9a29d525_Tx
          ComTxIPdu: ComMinimumDelayTime=0, ComTxIPduUnusedAreasDefault=0
            ComTxModeFalse
              ComTxMode: ComTxModeMode=PERIODIC, ComTxModeTimeOffset=0, ComTxModeTimePeriod=0.5
            ComTxModeTrue
              ComTxMode: ComTxModeMode=PERIODIC, ComTxModeTimeOffset=0, ComTxModeTimePeriod=0.5
        VcuCan03TxMsg2_oTC37X_VCU_CAN03_70af0847_Tx: ComIPduDirection=SEND, ComIPduGroupRef=VCU_oTC37X_VCU_CAN03_Tx_e464a451, ComIPduSignalRef=VcuAdcTxMsg2_Sig0_oVcuCan03TxMsg2_oTC37X_VCU_CAN03_2e9f2f9c_Tx, ComIPduSignalRef=VcuAdcTxMsg2_Sig1_oVcuCan03TxMsg2_oTC37X_VCU_CAN03_0a1d7eaa_Tx, ComIPduSignalRef=VcuAdcTxMsg2_Sig2_oVcuCan03TxMsg2_oTC37X_VCU_CAN03_679b8df0_Tx, ComIPduSignalRef=VcuAdcTxMsg2_Sig3_oVcuCan03TxMsg2_oTC37X_VCU_CAN03_4319dcc6_Tx, ComPduIdRef=EcucPduCollection/VcuCan03TxMsg2_oTC37X_VCU_CAN03_70af0847_Tx
          ComTxIPdu: ComMinimumDelayTime=0, ComTxIPduUnusedAreasDefault=0
            ComTxModeFalse
              ComTxMode: ComTxModeMode=PERIODIC, ComTxModeTimeOffset=0, ComTxModeTimePeriod=0.5
            ComTxModeTrue
              ComTxMode: ComTxModeMode=PERIODIC, ComTxModeTimeOffset=0, ComTxModeTimePeriod=0.5
        VcuCan12RxMsg3_oTC37X_VCU_CAN12_38853822_Rx: ComIPduDirection=RECEIVE, ComIPduGroupRef=VCU_oTC37X_VCU_CAN12_Rx_37e24d02, ComIPduSignalRef=VcuCan12RxMsg3_Sig0_oVcuCan12RxMsg3_oTC37X_VCU_CAN12_5a65a77f_Rx, ComIPduSignalRef=VcuCan12RxMsg3_Sig1_oVcuCan12RxMsg3_oTC37X_VCU_CAN12_7ee7f649_Rx, ComIPduSignalRef=VcuCan12RxMsg3_Sig2_oVcuCan12RxMsg3_oTC37X_VCU_CAN12_13610513_Rx, ComIPduSignalRef=VcuCan12RxMsg3_Sig3_oVcuCan12RxMsg3_oTC37X_VCU_CAN12_37e35425_Rx, ComPduIdRef=EcucPduCollection/VcuCan12RxMsg3_oTC37X_VCU_CAN12_38853822_Rx
        VcuCan12RxMsg4_oTC37X_VCU_CAN12_d9ab3246_Rx: ComIPduDirection=RECEIVE, ComIPduGroupRef=VCU_oTC37X_VCU_CAN12_Rx_37e24d02, ComIPduSignalRef=VcuCan12RxMsg4_Sig0_oVcuCan12RxMsg4_oTC37X_VCU_CAN12_89859905_Rx, ComIPduSignalRef=VcuCan12RxMsg4_Sig1_oVcuCan12RxMsg4_oTC37X_VCU_CAN12_ad07c833_Rx, ComIPduSignalRef=VcuCan12RxMsg4_Sig2_oVcuCan12RxMsg4_oTC37X_VCU_CAN12_c0813b69_Rx, ComIPduSignalRef=VcuCan12RxMsg4_Sig3_oVcuCan12RxMsg4_oTC37X_VCU_CAN12_e4036a5f_Rx, ComPduIdRef=EcucPduCollection/VcuCan12RxMsg4_oTC37X_VCU_CAN12_d9ab3246_Rx
        VcuCan12TxMsg1_oTC37X_VCU_CAN12_d09b21db_Tx: ComIPduDirection=SEND, ComIPduGroupRef=VCU_oTC37X_VCU_CAN12_Tx_61b8ea84, ComIPduSignalRef=VcuCan12TxMsg1_Sig0_oVcuCan12TxMsg1_oTC37X_VCU_CAN12_d3993898_Tx, ComIPduSignalRef=VcuCan12TxMsg1_Sig1_oVcuCan12TxMsg1_oTC37X_VCU_CAN12_f71b69ae_Tx, ComIPduSignalRef=VcuCan12TxMsg1_Sig2_oVcuCan12TxMsg1_oTC37X_VCU_CAN12_9a9d9af4_Tx, ComIPduSignalRef=VcuCan12TxMsg1_Sig3_oVcuCan12TxMsg1_oTC37X_VCU_CAN12_be1fcbc2_Tx, ComPduIdRef=EcucPduCollection/VcuCan12TxMsg1_oTC37X_VCU_CAN12_d09b21db_Tx
          ComTxIPdu: ComMinimumDelayTime=0, ComTxIPduUnusedAreasDefault=0
            ComTxModeFalse
              ComTxMode: ComTxModeMode=PERIODIC, ComTxModeTimeOffset=0, ComTxModeTimePeriod=0.5
            ComTxModeTrue
              ComTxMode: ComTxModeMode=PERIODIC, ComTxModeTimeOffset=0, ComTxModeTimePeriod=0.5
        VcuCan12TxMsg2_oTC37X_VCU_CAN12_3a1dfcb9_Tx: ComIPduDirection=SEND, ComIPduGroupRef=VCU_oTC37X_VCU_CAN12_Tx_61b8ea84, ComIPduSignalRef=VcuCan12TxMsg2_Sig0_oVcuCan12TxMsg2_oTC37X_VCU_CAN12_ea84f901_Tx, ComIPduSignalRef=VcuCan12TxMsg2_Sig1_oVcuCan12TxMsg2_oTC37X_VCU_CAN12_ce06a837_Tx, ComIPduSignalRef=VcuCan12TxMsg2_Sig2_oVcuCan12TxMsg2_oTC37X_VCU_CAN12_a3805b6d_Tx, ComIPduSignalRef=VcuCan12TxMsg2_Sig3_oVcuCan12TxMsg2_oTC37X_VCU_CAN12_87020a5b_Tx, ComPduIdRef=EcucPduCollection/VcuCan12TxMsg2_oTC37X_VCU_CAN12_3a1dfcb9_Tx
          ComTxIPdu: ComMinimumDelayTime=0, ComTxIPduUnusedAreasDefault=0
            ComTxModeFalse
              ComTxMode: ComTxModeMode=PERIODIC, ComTxModeTimeOffset=0, ComTxModeTimePeriod=0.5
            ComTxModeTrue
              ComTxMode: ComTxModeMode=PERIODIC, ComTxModeTimeOffset=0, ComTxModeTimePeriod=0.5
        VcuRxMsg1_oTC37X_VCU_CAN00_78805594_Rx: ComIPduDirection=RECEIVE, ComIPduGroupRef=VCU_oTC37X_VCU_CAN00_Rx_a08bac39, ComIPduSignalRef=VcuRxMsg1_Sig0_oVcuRxMsg1_oTC37X_VCU_CAN00_13cef464_Rx, ComIPduSignalRef=VcuRxMsg1_Sig1_oVcuRxMsg1_oTC37X_VCU_CAN00_70c92d40_Rx, ComIPduSignalRef=VcuRxMsg1_Sig2_oVcuRxMsg1_oTC37X_VCU_CAN00_d5c1462c_Rx, ComIPduSignalRef=VcuRxMsg1_Sig3_oVcuRxMsg1_oTC37X_VCU_CAN00_b6c69f08_Rx, ComPduIdRef=EcucPduCollection/VcuRxMsg1_oTC37X_VCU_CAN00_78805594_Rx
        VcuRxMsg2_oTC37X_VCU_CAN00_920688f6_Rx: ComIPduDirection=RECEIVE, ComIPduGroupRef=VCU_oTC37X_VCU_CAN00_Rx_a08bac39, ComIPduSignalRef=VcuRxMsg2_Sig0_oVcuRxMsg2_oTC37X_VCU_CAN00_94ceda5c_Rx, ComIPduSignalRef=VcuRxMsg2_Sig1_oVcuRxMsg2_oTC37X_VCU_CAN00_f7c90378_Rx, ComIPduSignalRef=VcuRxMsg2_Sig2_oVcuRxMsg2_oTC37X_VCU_CAN00_52c16814_Rx, ComIPduSignalRef=VcuRxMsg2_Sig3_oVcuRxMsg2_oTC37X_VCU_CAN00_31c6b130_Rx, ComPduIdRef=EcucPduCollection/VcuRxMsg2_oTC37X_VCU_CAN00_920688f6_Rx
        VcuRxMsg3_oTC37X_VCU_CAN01_0a530e81_Rx: ComIPduDirection=RECEIVE, ComIPduGroupRef=VCU_oTC37X_VCU_CAN01_Rx_1837cb5c, ComIPduSignalRef=VcuRxMsg3_Sig0_oVcuRxMsg3_oTC37X_VCU_CAN01_28190d1d_Rx, ComIPduSignalRef=VcuRxMsg3_Sig1_oVcuRxMsg3_oTC37X_VCU_CAN01_4b1ed439_Rx, ComIPduSignalRef=VcuRxMsg3_Sig2_oVcuRxMsg3_oTC37X_VCU_CAN01_ee16bf55_Rx, ComIPduSignalRef=VcuRxMsg3_Sig3_oVcuRxMsg3_oTC37X_VCU_CAN01_8d116671_Rx, ComPduIdRef=EcucPduCollection/VcuRxMsg3_oTC37X_VCU_CAN01_0a530e81_Rx
        VcuRxMsg4_oTC37X_VCU_CAN01_eb7d04e5_Rx: ComIPduDirection=RECEIVE, ComIPduGroupRef=VCU_oTC37X_VCU_CAN01_Rx_1837cb5c, ComIPduSignalRef=VcuRxMsg4_Sig0_oVcuRxMsg4_oTC37X_VCU_CAN01_36b8b0fb_Rx, ComIPduSignalRef=VcuRxMsg4_Sig1_oVcuRxMsg4_oTC37X_VCU_CAN01_55bf69df_Rx, ComIPduSignalRef=VcuRxMsg4_Sig2_oVcuRxMsg4_oTC37X_VCU_CAN01_f0b702b3_Rx, ComIPduSignalRef=VcuRxMsg4_Sig3_oVcuRxMsg4_oTC37X_VCU_CAN01_93b0db97_Rx, ComPduIdRef=EcucPduCollection/VcuRxMsg4_oTC37X_VCU_CAN01_eb7d04e5_Rx
        VcuTxIoMsg1_oTC37X_VCU_CAN00_54884add_Tx: ComIPduDirection=SEND, ComIPduGroupRef=VCU_oTC37X_VCU_CAN00_Tx_f6d10bbf, ComIPduSignalRef=EXT1_Valid_oVcuTxIoMsg1_oTC37X_VCU_CAN00_caf787ea_Tx, ComIPduSignalRef=EXT2_Valid_oVcuTxIoMsg1_oTC37X_VCU_CAN00_9096b88a_Tx, ComIPduSignalRef=EXT_A_IN1_oVcuTxIoMsg1_oTC37X_VCU_CAN00_37348eff_Tx, ComIPduSignalRef=EXT_A_IN2_oVcuTxIoMsg1_oTC37X_VCU_CAN00_241cb78c_Tx, ComPduIdRef=EcucPduCollection/VcuTxIoMsg1_oTC37X_VCU_CAN00_54884add_Tx
          ComTxIPdu: ComMinimumDelayTime=0, ComTxIPduUnusedAreasDefault=0
            ComTxModeFalse
              ComTxMode: ComTxModeMode=PERIODIC, ComTxModeTimeOffset=0, ComTxModeTimePeriod=0.5
            ComTxModeTrue
              ComTxMode: ComTxModeMode=PERIODIC, ComTxModeTimeOffset=0, ComTxModeTimePeriod=0.5
        VcuTxIoMsg2_oTC37X_VCU_CAN00_be0e97bf_Tx: ComIPduDirection=SEND, ComIPduGroupRef=VCU_oTC37X_VCU_CAN00_Tx_f6d10bbf, ComIPduSignalRef=EXT3_Valid_oVcuTxIoMsg2_oTC37X_VCU_CAN00_fae072f7_Tx, ComIPduSignalRef=EXT4_Valid_oVcuTxIoMsg2_oTC37X_VCU_CAN00_ced21b28_Tx, ComIPduSignalRef=EXT_A_IN3_oVcuTxIoMsg2_oTC37X_VCU_CAN00_c07d823f_Tx, ComIPduSignalRef=EXT_A_IN4_oVcuTxIoMsg2_oTC37X_VCU_CAN00_e8ca1808_Tx, ComPduIdRef=EcucPduCollection/VcuTxIoMsg2_oTC37X_VCU_CAN00_be0e97bf_Tx
          ComTxIPdu: ComMinimumDelayTime=0, ComTxIPduUnusedAreasDefault=0
            ComTxModeFalse
              ComTxMode: ComTxModeMode=PERIODIC, ComTxModeTimeOffset=0, ComTxModeTimePeriod=0.5
            ComTxModeTrue
              ComTxMode: ComTxModeMode=PERIODIC, ComTxModeTimeOffset=0, ComTxModeTimePeriod=0.5
        VcuTxIoMsg3_oTC37X_VCU_CAN00_515c215e_Tx: ComIPduDirection=SEND, ComIPduGroupRef=VCU_oTC37X_VCU_CAN00_Tx_f6d10bbf, ComIPduSignalRef=EXT5_Valid_oVcuTxIoMsg3_oTC37X_VCU_CAN00_a170bad6_Tx, ComIPduSignalRef=EXT6_Valid_oVcuTxIoMsg3_oTC37X_VCU_CAN00_fb1185b6_Tx, ComIPduSignalRef=EXT_A_IN5_oVcuTxIoMsg3_oTC37X_VCU_CAN00_097f4638_Tx, ComIPduSignalRef=EXT_A_IN6_oVcuTxIoMsg3_oTC37X_VCU_CAN00_1a577f4b_Tx, ComPduIdRef=EcucPduCollection/VcuTxIoMsg3_oTC37X_VCU_CAN00_515c215e_Tx
          ComTxIPdu: ComMinimumDelayTime=0, ComTxIPduUnusedAreasDefault=0
            ComTxModeFalse
              ComTxMode: ComTxModeMode=PERIODIC, ComTxModeTimeOffset=0, ComTxModeTimePeriod=0.5
            ComTxModeTrue
              ComTxMode: ComTxModeMode=PERIODIC, ComTxModeTimeOffset=0, ComTxModeTimePeriod=0.5
        VcuTxIoMsg4_oTC37X_VCU_CAN00_b0722b3a_Tx: ComIPduDirection=SEND, ComIPduGroupRef=VCU_oTC37X_VCU_CAN00_Tx_f6d10bbf, ComIPduSignalRef=EXT7_Valid_oVcuTxIoMsg4_oTC37X_VCU_CAN00_9acf98cd_Tx, ComIPduSignalRef=EXT8_Valid_oVcuTxIoMsg4_oTC37X_VCU_CAN00_725b5c6c_Tx, ComIPduSignalRef=EXT_A_IN7_oVcuTxIoMsg4_oTC37X_VCU_CAN00_f59e9dfe_Tx, ComIPduSignalRef=EXT_A_IN8_oVcuTxIoMsg4_oTC37X_VCU_CAN00_aa164141_Tx, ComPduIdRef=EcucPduCollection/VcuTxIoMsg4_oTC37X_VCU_CAN00_b0722b3a_Tx
          ComTxIPdu: ComMinimumDelayTime=0, ComTxIPduUnusedAreasDefault=0
            ComTxModeFalse
              ComTxMode: ComTxModeMode=PERIODIC, ComTxModeTimeOffset=0, ComTxModeTimePeriod=0.5
            ComTxModeTrue
              ComTxMode: ComTxModeMode=PERIODIC, ComTxModeTimeOffset=0, ComTxModeTimePeriod=0.5
        VcuTxIoMsg5_oTC37X_VCU_CAN00_5f209ddb_Tx: ComIPduDirection=SEND, ComIPduGroupRef=VCU_oTC37X_VCU_CAN00_Tx_f6d10bbf, ComIPduSignalRef=EXT10_Valid_oVcuTxIoMsg5_oTC37X_VCU_CAN00_ba532916_Tx, ComIPduSignalRef=EXT9_Valid_oVcuTxIoMsg5_oTC37X_VCU_CAN00_1df9fd92_Tx, ComIPduSignalRef=EXT_A_IN10_oVcuTxIoMsg5_oTC37X_VCU_CAN00_83e5b725_Tx, ComIPduSignalRef=EXT_A_IN9_oVcuTxIoMsg5_oTC37X_VCU_CAN00_4ba31f71_Tx, ComPduIdRef=EcucPduCollection/VcuTxIoMsg5_oTC37X_VCU_CAN00_5f209ddb_Tx
          ComTxIPdu: ComMinimumDelayTime=0, ComTxIPduUnusedAreasDefault=0
            ComTxModeFalse
              ComTxMode: ComTxModeMode=PERIODIC, ComTxModeTimeOffset=0, ComTxModeTimePeriod=0.5
            ComTxModeTrue
              ComTxMode: ComTxModeMode=PERIODIC, ComTxModeTimeOffset=0, ComTxModeTimePeriod=0.5
        VcuTxIoMsg6_oTC37X_VCU_CAN00_b5a640b9_Tx: ComIPduDirection=SEND, ComIPduGroupRef=VCU_oTC37X_VCU_CAN00_Tx_f6d10bbf, ComIPduSignalRef=EXT11_Valid_oVcuTxIoMsg6_oTC37X_VCU_CAN00_d025e36b_Tx, ComIPduSignalRef=EXT12_Valid_oVcuTxIoMsg6_oTC37X_VCU_CAN00_8a44dc0b_Tx, ComIPduSignalRef=EXT_A_IN11_oVcuTxIoMsg6_oTC37X_VCU_CAN00_67848296_Tx, ComIPduSignalRef=EXT_A_IN12_oVcuTxIoMsg6_oTC37X_VCU_CAN00_74acbbe5_Tx, ComPduIdRef=EcucPduCollection/VcuTxIoMsg6_oTC37X_VCU_CAN00_b5a640b9_Tx
          ComTxIPdu: ComMinimumDelayTime=0, ComTxIPduUnusedAreasDefault=0
            ComTxModeFalse
              ComTxMode: ComTxModeMode=PERIODIC, ComTxModeTimeOffset=0, ComTxModeTimePeriod=0.5
            ComTxModeTrue
              ComTxMode: ComTxModeMode=PERIODIC, ComTxModeTimeOffset=0, ComTxModeTimePeriod=0.5
        VcuTxIoMsg7_oTC37X_VCU_CAN00_5af4f658_Tx: ComIPduDirection=SEND, ComIPduGroupRef=VCU_oTC37X_VCU_CAN00_Tx_f6d10bbf, ComIPduSignalRef=EXT13_Valid_oVcuTxIoMsg7_oTC37X_VCU_CAN00_e5e67df5_Tx, ComIPduSignalRef=EXT14_Valid_oVcuTxIoMsg7_oTC37X_VCU_CAN00_d1d4142a_Tx, ComIPduSignalRef=EXT_A_IN13_oVcuTxIoMsg7_oTC37X_VCU_CAN00_9519e5d5_Tx, ComIPduSignalRef=EXT_A_IN14_oVcuTxIoMsg7_oTC37X_VCU_CAN00_bdae7fe2_Tx, ComPduIdRef=EcucPduCollection/VcuTxIoMsg7_oTC37X_VCU_CAN00_5af4f658_Tx
          ComTxIPdu: ComMinimumDelayTime=0, ComTxIPduUnusedAreasDefault=0
            ComTxModeFalse
              ComTxMode: ComTxModeMode=PERIODIC, ComTxModeTimeOffset=0, ComTxModeTimePeriod=0.5
            ComTxModeTrue
              ComTxMode: ComTxModeMode=PERIODIC, ComTxModeTimeOffset=0, ComTxModeTimePeriod=0.5
        VcuTxIoMsg8_oTC37X_VCU_CAN00_ac8b5230_Tx: ComIPduDirection=SEND, ComIPduGroupRef=VCU_oTC37X_VCU_CAN00_Tx_f6d10bbf, ComIPduSignalRef=EXT15_Valid_oVcuTxIoMsg8_oTC37X_VCU_CAN00_a75ba75d_Tx, ComIPduSignalRef=EXT16_Valid_oVcuTxIoMsg8_oTC37X_VCU_CAN00_fd3a983d_Tx, ComIPduSignalRef=EXT_A_IN15_oVcuTxIoMsg8_oTC37X_VCU_CAN00_4536335b_Tx, ComIPduSignalRef=EXT_A_IN16_oVcuTxIoMsg8_oTC37X_VCU_CAN00_561e0a28_Tx, ComPduIdRef=EcucPduCollection/VcuTxIoMsg8_oTC37X_VCU_CAN00_ac8b5230_Tx
          ComTxIPdu: ComMinimumDelayTime=0, ComTxIPduUnusedAreasDefault=0
            ComTxModeFalse
              ComTxMode: ComTxModeMode=PERIODIC, ComTxModeTimeOffset=0, ComTxModeTimePeriod=0.5
            ComTxModeTrue
              ComTxMode: ComTxModeMode=PERIODIC, ComTxModeTimeOffset=0, ComTxModeTimePeriod=0.5
        VcuTxMsg1_oTC37X_VCU_CAN00_954a27ee_Tx: ComIPduDirection=SEND, ComIPduGroupRef=VCU_oTC37X_VCU_CAN00_Tx_f6d10bbf, ComIPduSignalRef=VcuTxMsg1_Sig0_oVcuTxMsg1_oTC37X_VCU_CAN00_8243b9a9_Tx, ComIPduSignalRef=VcuTxMsg1_Sig1_oVcuTxMsg1_oTC37X_VCU_CAN00_e144608d_Tx, ComIPduSignalRef=VcuTxMsg1_Sig2_oVcuTxMsg1_oTC37X_VCU_CAN00_444c0be1_Tx, ComIPduSignalRef=VcuTxMsg1_Sig3_oVcuTxMsg1_oTC37X_VCU_CAN00_274bd2c5_Tx, ComPduIdRef=EcucPduCollection/VcuTxMsg1_oTC37X_VCU_CAN00_954a27ee_Tx
          ComTxIPdu: ComMinimumDelayTime=0, ComTxIPduUnusedAreasDefault=0
            ComTxModeFalse
              ComTxMode: ComTxModeMode=PERIODIC, ComTxModeTimeOffset=0, ComTxModeTimePeriod=0.5
            ComTxModeTrue
              ComTxMode: ComTxModeMode=PERIODIC, ComTxModeTimeOffset=0, ComTxModeTimePeriod=0.5
        VcuTxMsg2_oTC37X_VCU_CAN00_7fccfa8c_Tx: ComIPduDirection=SEND, ComIPduGroupRef=VCU_oTC37X_VCU_CAN00_Tx_f6d10bbf, ComIPduSignalRef=VcuTxMsg2_Sig0_oVcuTxMsg2_oTC37X_VCU_CAN00_05439791_Tx, ComIPduSignalRef=VcuTxMsg2_Sig1_oVcuTxMsg2_oTC37X_VCU_CAN00_66444eb5_Tx, ComIPduSignalRef=VcuTxMsg2_Sig2_oVcuTxMsg2_oTC37X_VCU_CAN00_c34c25d9_Tx, ComIPduSignalRef=VcuTxMsg2_Sig3_oVcuTxMsg2_oTC37X_VCU_CAN00_a04bfcfd_Tx, ComPduIdRef=EcucPduCollection/VcuTxMsg2_oTC37X_VCU_CAN00_7fccfa8c_Tx
          ComTxIPdu: ComMinimumDelayTime=0, ComTxIPduUnusedAreasDefault=0
            ComTxModeFalse
              ComTxMode: ComTxModeMode=PERIODIC, ComTxModeTimeOffset=0, ComTxModeTimePeriod=0.5
            ComTxModeTrue
              ComTxMode: ComTxModeMode=PERIODIC, ComTxModeTimeOffset=0, ComTxModeTimePeriod=0.5
        Vcu_Lin0_RxMsg1_oLIN01_24780c64_Rx: ComIPduDirection=RECEIVE, ComIPduGroupRef=VCU_oLIN01_Rx_f3219b36, ComIPduSignalRef=Vcu_Lin0_RxMsg1_Sig0_oVcu_Lin0_RxMsg1_oLIN01_6c375668_Rx, ComIPduSignalRef=Vcu_Lin0_RxMsg1_Sig1_oVcu_Lin0_RxMsg1_oLIN01_c9bcc666_Rx, ComIPduSignalRef=Vcu_Lin0_RxMsg2_Sig2_oVcu_Lin0_RxMsg1_oLIN01_b8f0552d_Rx, ComIPduSignalRef=Vcu_Lin0_RxMsg2_Sig3_oVcu_Lin0_RxMsg1_oLIN01_1d7bc523_Rx, ComPduIdRef=EcucPduCollection/Vcu_Lin0_RxMsg1_oLIN01_24780c64_Rx
        Vcu_Lin0_RxMsg2_oLIN01_aaf70b87_Rx: ComIPduDirection=RECEIVE, ComIPduGroupRef=VCU_oLIN01_Rx_f3219b36, ComIPduSignalRef=Vcu_Lin0_RxMsg2_Sig0_oVcu_Lin0_RxMsg2_oLIN01_a6197493_Rx, ComIPduSignalRef=Vcu_Lin0_RxMsg2_Sig1_oVcu_Lin0_RxMsg2_oLIN01_0392e49d_Rx, ComIPduSignalRef=Vcu_Lin0_RxMsg2_Sig2_oVcu_Lin0_RxMsg2_oLIN01_367f52ce_Rx, ComIPduSignalRef=Vcu_Lin0_RxMsg2_Sig3_oVcu_Lin0_RxMsg2_oLIN01_93f4c2c0_Rx, ComPduIdRef=EcucPduCollection/Vcu_Lin0_RxMsg2_oLIN01_aaf70b87_Rx
        Vcu_Lin0_TxMsg1_oLIN01_849dd3b9_Tx: ComIPduDirection=SEND, ComIPduGroupRef=VCU_oLIN01_Tx_a57b3cb0, ComIPduSignalRef=Vcu_Lin0_TxMsg1_Sig0_oVcu_Lin0_TxMsg1_oLIN01_0005f3c6_Tx, ComIPduSignalRef=Vcu_Lin0_TxMsg1_Sig1_oVcu_Lin0_TxMsg1_oLIN01_a58e63c8_Tx, ComIPduSignalRef=Vcu_Lin0_TxMsg1_Sig2_oVcu_Lin0_TxMsg1_oLIN01_9063d59b_Tx, ComIPduSignalRef=Vcu_Lin0_TxMsg1_Sig3_oVcu_Lin0_TxMsg1_oLIN01_35e84595_Tx, ComPduIdRef=EcucPduCollection/Vcu_Lin0_TxMsg1_oLIN01_849dd3b9_Tx
          ComTxIPdu: ComTxIPduUnusedAreasDefault=255
        Vcu_Lin0_TxMsg2_oLIN01_0a12d45a_Tx: ComIPduDirection=SEND, ComIPduGroupRef=VCU_oLIN01_Tx_a57b3cb0, ComIPduSignalRef=Vcu_Lin0_TxMsg2_Sig0_oVcu_Lin0_TxMsg2_oLIN01_ca2bd13d_Tx, ComIPduSignalRef=Vcu_Lin0_TxMsg2_Sig1_oVcu_Lin0_TxMsg2_oLIN01_6fa04133_Tx, ComIPduSignalRef=Vcu_Lin0_TxMsg2_Sig2_oVcu_Lin0_TxMsg2_oLIN01_5a4df760_Tx, ComIPduSignalRef=Vcu_Lin0_TxMsg2_Sig3_oVcu_Lin0_TxMsg2_oLIN01_ffc6676e_Tx, ComPduIdRef=EcucPduCollection/Vcu_Lin0_TxMsg2_oLIN01_0a12d45a_Tx
          ComTxIPdu: ComTxIPduUnusedAreasDefault=255
      14 x ComIPduGroup:
        VCU_oKAMA_FP_EPT_0303_Rx_07e8d111
        VCU_oKAMA_FP_EPT_0303_Tx_51b27697
        VCU_oLIN00_Rx_4b9dfc53
        VCU_oLIN00_Tx_1dc75bd5
        VCU_oLIN01_Rx_f3219b36
        VCU_oLIN01_Tx_a57b3cb0
        VCU_oTC37X_VCU_CAN00_Rx_a08bac39
        VCU_oTC37X_VCU_CAN00_Tx_f6d10bbf
        VCU_oTC37X_VCU_CAN01_Rx_1837cb5c
        VCU_oTC37X_VCU_CAN01_Tx_4e6d6cda
        VCU_oTC37X_VCU_CAN03_Rx_b23e03d7
        VCU_oTC37X_VCU_CAN03_Tx_e464a451
        VCU_oTC37X_VCU_CAN12_Rx_37e24d02
        VCU_oTC37X_VCU_CAN12_Tx_61b8ea84
      203 x ComSignal:
        A_I_Actuator_With_F_B_request_oVCU_Minor_03_oKAMA_FP_EPT_0303_0324126f_Rx: ComBitPosition=4, ComBitSize=2, ComSignalEndianness=BIG_ENDIAN, ComSignalInitValue=0, ComSignalType=UINT8, ComTimeout=0, ComSystemTemplateSystemSignalRef=A_I_Actuator_With_F_B_request
        A_I_F_B_oVCU_Minor_01_oKAMA_FP_EPT_0303_576573ee_Tx: ComBitPosition=7, ComBitSize=6, ComSignalEndianness=BIG_ENDIAN, ComSignalInitValue=0, ComSignalType=UINT8, ComTimeout=0, ComTransferProperty=PENDING, ComSystemTemplateSystemSignalRef=A_I_F_B
        Act_Pos_sta_oSVA_VCU_STD_oLIN00_642c9ffa_Rx: ComBitPosition=8, ComBitSize=12, ComSignalEndianness=LITTLE_ENDIAN, ComSignalInitValue=0, ComSignalType=UINT16, ComSystemTemplateSystemSignalRef=Act_Pos_sta
        Blockage_Fault_STA_oSVA_VCU_STD_oLIN00_6c89246f_Rx: ComBitPosition=2, ComBitSize=1, ComSignalEndianness=LITTLE_ENDIAN, ComSignalInitValue=0, ComSignalType=BOOLEAN, ComSystemTemplateSystemSignalRef=Blockage_Fault_STA
        Breakage_Fault_STA_oSVA_VCU_STD_oLIN00_a3ac9cf8_Rx: ComBitPosition=3, ComBitSize=1, ComSignalEndianness=LITTLE_ENDIAN, ComSignalInitValue=0, ComSignalType=BOOLEAN, ComSystemTemplateSystemSignalRef=Breakage_Fault_STA
        COMP_Pdis_oVCU_Minor_02_oKAMA_FP_EPT_0303_4bfdbd85_Tx: ComBitPosition=23, ComBitSize=6, ComSignalEndianness=BIG_ENDIAN, ComSignalInitValue=0, ComSignalType=UINT8, ComTimeout=0, ComTransferProperty=PENDING, ComSystemTemplateSystemSignalRef=COMP_Pdis
        COMP_Psuc_oVCU_Minor_02_oKAMA_FP_EPT_0303_9659454d_Tx: ComBitPosition=7, ComBitSize=6, ComSignalEndianness=BIG_ENDIAN, ComSignalInitValue=0, ComSignalType=UINT8, ComTimeout=0, ComTransferProperty=PENDING, ComSystemTemplateSystemSignalRef=COMP_Psuc
        COMP_Tdis_oVCU_Minor_02_oKAMA_FP_EPT_0303_73ade512_Tx: ComBitPosition=31, ComBitSize=6, ComSignalEndianness=BIG_ENDIAN, ComSignalInitValue=0, ComSignalType=UINT8, ComTimeout=0, ComTransferProperty=PENDING, ComSystemTemplateSystemSignalRef=COMP_Tdis
        COMP_Tsuc_oVCU_Minor_02_oKAMA_FP_EPT_0303_ae091dda_Tx: ComBitPosition=15, ComBitSize=6, ComSignalEndianness=BIG_ENDIAN, ComSignalInitValue=0, ComSignalType=UINT8, ComTimeout=0, ComTransferProperty=PENDING, ComSystemTemplateSystemSignalRef=COMP_Tsuc
        COOLING_FAN_request_oVCU_Minor_03_oKAMA_FP_EPT_0303_282b4f5d_Rx: ComBitPosition=15, ComBitSize=7, ComSignalEndianness=BIG_ENDIAN, ComSignalInitValue=0, ComSignalType=UINT8, ComTimeout=0, ComSystemTemplateSystemSignalRef=COOLING_FAN_request
        Calibration_cmd_oVCU_SVA_CMD_oLIN00_6732180a_Tx: ComBitPosition=8, ComBitSize=1, ComSignalEndianness=LITTLE_ENDIAN, ComSignalInitValue=0, ComSignalType=BOOLEAN, ComSystemTemplateSystemSignalRef=Calibration_cmd
        Calibration_sta_oSVA_VCU_STD_oLIN00_dcb4af08_Rx: ComBitPosition=0, ComBitSize=2, ComSignalEndianness=LITTLE_ENDIAN, ComSignalInitValue=0, ComSignalType=UINT8, ComSystemTemplateSystemSignalRef=Calibration_sta
        ECC_PMP2_SpdSet_oPMP_Cmd_oLIN00_8cabc4b7_Tx: ComBitPosition=8, ComBitSize=8, ComSignalEndianness=LITTLE_ENDIAN, ComSignalInitValue=0, ComSignalType=UINT8, ComSystemTemplateSystemSignalRef=ECC_PMP2_SpdSet
        ECC_PMP3_SpdSet_oPMP_Cmd_oLIN00_0d8ea190_Tx: ComBitPosition=16, ComBitSize=8, ComSignalEndianness=LITTLE_ENDIAN, ComSignalInitValue=0, ComSignalType=UINT8, ComSystemTemplateSystemSignalRef=ECC_PMP3_SpdSet
        EDCU_EXV2_Cmd_Init_Rq_oEDCU_EXV2_oLIN00_0144aec9_Tx: ComBitPosition=24, ComBitSize=3, ComSignalEndianness=LITTLE_ENDIAN, ComSignalInitValue=0, ComSignalType=UINT8, ComSystemTemplateSystemSignalRef=EDCU_EXV2_Cmd_Init_Rq
        EDCU_EXV2_Cmd_Move_Enbl_oEDCU_EXV2_oLIN00_d6797517_Tx: ComBitPosition=16, ComBitSize=1, ComSignalEndianness=LITTLE_ENDIAN, ComSignalInitValue=0, ComSignalType=BOOLEAN, ComSystemTemplateSystemSignalRef=EDCU_EXV2_Cmd_Move_Enbl
        EDCU_EXV2_Cmd_Set_Rq_oEDCU_EXV2_oLIN00_66e5876a_Tx: ComBitPosition=0, ComBitSize=16, ComSignalEndianness=LITTLE_ENDIAN, ComSignalInitValue=0, ComSignalType=UINT16, ComSystemTemplateSystemSignalRef=EDCU_EXV2_Cmd_Set_Rq
        EXT10_Valid_oVcuTxIoMsg5_oTC37X_VCU_CAN00_ba532916_Tx: ComBitPosition=48, ComBitSize=16, ComSignalEndianness=LITTLE_ENDIAN, ComSignalInitValue=0, ComSignalType=UINT16, ComTimeout=0, ComTransferProperty=PENDING, ComSystemTemplateSystemSignalRef=EXT10_Valid
        EXT11_Valid_oVcuTxIoMsg6_oTC37X_VCU_CAN00_d025e36b_Tx: ComBitPosition=16, ComBitSize=16, ComSignalEndianness=LITTLE_ENDIAN, ComSignalInitValue=0, ComSignalType=UINT16, ComTimeout=0, ComTransferProperty=PENDING, ComSystemTemplateSystemSignalRef=EXT11_Valid
        EXT12_Valid_oVcuTxIoMsg6_oTC37X_VCU_CAN00_8a44dc0b_Tx: ComBitPosition=48, ComBitSize=16, ComSignalEndianness=LITTLE_ENDIAN, ComSignalInitValue=0, ComSignalType=UINT16, ComTimeout=0, ComTransferProperty=PENDING, ComSystemTemplateSystemSignalRef=EXT12_Valid
        EXT13_Valid_oVcuTxIoMsg7_oTC37X_VCU_CAN00_e5e67df5_Tx: ComBitPosition=16, ComBitSize=16, ComSignalEndianness=LITTLE_ENDIAN, ComSignalInitValue=0, ComSignalType=UINT16, ComTimeout=0, ComTransferProperty=PENDING, ComSystemTemplateSystemSignalRef=EXT13_Valid
        EXT14_Valid_oVcuTxIoMsg7_oTC37X_VCU_CAN00_d1d4142a_Tx: ComBitPosition=48, ComBitSize=16, ComSignalEndianness=LITTLE_ENDIAN, ComSignalInitValue=0, ComSignalType=UINT16, ComTimeout=0, ComTransferProperty=PENDING, ComSystemTemplateSystemSignalRef=EXT14_Valid
        EXT15_Valid_oVcuTxIoMsg8_oTC37X_VCU_CAN00_a75ba75d_Tx: ComBitPosition=16, ComBitSize=16, ComSignalEndianness=LITTLE_ENDIAN, ComSignalInitValue=0, ComSignalType=UINT16, ComTimeout=0, ComTransferProperty=PENDING, ComSystemTemplateSystemSignalRef=EXT15_Valid
        EXT16_Valid_oVcuTxIoMsg8_oTC37X_VCU_CAN00_fd3a983d_Tx: ComBitPosition=48, ComBitSize=16, ComSignalEndianness=LITTLE_ENDIAN, ComSignalInitValue=0, ComSignalType=UINT16, ComTimeout=0, ComTransferProperty=PENDING, ComSystemTemplateSystemSignalRef=EXT16_Valid
        EXT1_Valid_oVcuTxIoMsg1_oTC37X_VCU_CAN00_caf787ea_Tx: ComBitPosition=16, ComBitSize=16, ComSignalEndianness=LITTLE_ENDIAN, ComSignalInitValue=0, ComSignalType=UINT16, ComTimeout=0, ComTransferProperty=PENDING, ComSystemTemplateSystemSignalRef=EXT1_Valid
        EXT2_Valid_oVcuTxIoMsg1_oTC37X_VCU_CAN00_9096b88a_Tx: ComBitPosition=48, ComBitSize=16, ComSignalEndianness=LITTLE_ENDIAN, ComSignalInitValue=0, ComSignalType=UINT16, ComTimeout=0, ComTransferProperty=PENDING, ComSystemTemplateSystemSignalRef=EXT2_Valid
        EXT3_Valid_oVcuTxIoMsg2_oTC37X_VCU_CAN00_fae072f7_Tx: ComBitPosition=16, ComBitSize=16, ComSignalEndianness=LITTLE_ENDIAN, ComSignalInitValue=0, ComSignalType=UINT16, ComTimeout=0, ComTransferProperty=PENDING, ComSystemTemplateSystemSignalRef=EXT3_Valid
        EXT4_Valid_oVcuTxIoMsg2_oTC37X_VCU_CAN00_ced21b28_Tx: ComBitPosition=48, ComBitSize=16, ComSignalEndianness=LITTLE_ENDIAN, ComSignalInitValue=0, ComSignalType=UINT16, ComTimeout=0, ComTransferProperty=PENDING, ComSystemTemplateSystemSignalRef=EXT4_Valid
        EXT5_Valid_oVcuTxIoMsg3_oTC37X_VCU_CAN00_a170bad6_Tx: ComBitPosition=16, ComBitSize=16, ComSignalEndianness=LITTLE_ENDIAN, ComSignalInitValue=0, ComSignalType=UINT16, ComTimeout=0, ComTransferProperty=PENDING, ComSystemTemplateSystemSignalRef=EXT5_Valid
        EXT6_Valid_oVcuTxIoMsg3_oTC37X_VCU_CAN00_fb1185b6_Tx: ComBitPosition=48, ComBitSize=16, ComSignalEndianness=LITTLE_ENDIAN, ComSignalInitValue=0, ComSignalType=UINT16, ComTimeout=0, ComTransferProperty=PENDING, ComSystemTemplateSystemSignalRef=EXT6_Valid
        EXT7_Valid_oVcuTxIoMsg4_oTC37X_VCU_CAN00_9acf98cd_Tx: ComBitPosition=16, ComBitSize=16, ComSignalEndianness=LITTLE_ENDIAN, ComSignalInitValue=0, ComSignalType=UINT16, ComTimeout=0, ComTransferProperty=PENDING, ComSystemTemplateSystemSignalRef=EXT7_Valid
        EXT8_Valid_oVcuTxIoMsg4_oTC37X_VCU_CAN00_725b5c6c_Tx: ComBitPosition=48, ComBitSize=16, ComSignalEndianness=LITTLE_ENDIAN, ComSignalInitValue=0, ComSignalType=UINT16, ComTimeout=0, ComTransferProperty=PENDING, ComSystemTemplateSystemSignalRef=EXT8_Valid
        EXT9_Valid_oVcuTxIoMsg5_oTC37X_VCU_CAN00_1df9fd92_Tx: ComBitPosition=16, ComBitSize=16, ComSignalEndianness=LITTLE_ENDIAN, ComSignalInitValue=0, ComSignalType=UINT16, ComTimeout=0, ComTransferProperty=PENDING, ComSystemTemplateSystemSignalRef=EXT9_Valid
        EXT_A_IN10_oVcuTxIoMsg5_oTC37X_VCU_CAN00_83e5b725_Tx: ComBitPosition=32, ComBitSize=16, ComSignalEndianness=LITTLE_ENDIAN, ComSignalInitValue=0, ComSignalType=SINT16, ComTimeout=0, ComTransferProperty=PENDING, ComSystemTemplateSystemSignalRef=EXT_A_IN10
        EXT_A_IN11_oVcuTxIoMsg6_oTC37X_VCU_CAN00_67848296_Tx: ComBitPosition=0, ComBitSize=16, ComSignalEndianness=LITTLE_ENDIAN, ComSignalInitValue=0, ComSignalType=SINT16, ComTimeout=0, ComTransferProperty=PENDING, ComSystemTemplateSystemSignalRef=EXT_A_IN11
        EXT_A_IN12_oVcuTxIoMsg6_oTC37X_VCU_CAN00_74acbbe5_Tx: ComBitPosition=32, ComBitSize=16, ComSignalEndianness=LITTLE_ENDIAN, ComSignalInitValue=0, ComSignalType=SINT16, ComTimeout=0, ComTransferProperty=PENDING, ComSystemTemplateSystemSignalRef=EXT_A_IN12
        EXT_A_IN13_oVcuTxIoMsg7_oTC37X_VCU_CAN00_9519e5d5_Tx: ComBitPosition=0, ComBitSize=16, ComSignalEndianness=LITTLE_ENDIAN, ComSignalInitValue=0, ComSignalType=SINT16, ComTimeout=0, ComTransferProperty=PENDING, ComSystemTemplateSystemSignalRef=EXT_A_IN13
        EXT_A_IN14_oVcuTxIoMsg7_oTC37X_VCU_CAN00_bdae7fe2_Tx: ComBitPosition=32, ComBitSize=16, ComSignalEndianness=LITTLE_ENDIAN, ComSignalInitValue=0, ComSignalType=SINT16, ComTimeout=0, ComTransferProperty=PENDING, ComSystemTemplateSystemSignalRef=EXT_A_IN14
        EXT_A_IN15_oVcuTxIoMsg8_oTC37X_VCU_CAN00_4536335b_Tx: ComBitPosition=0, ComBitSize=16, ComSignalEndianness=LITTLE_ENDIAN, ComSignalInitValue=0, ComSignalType=SINT16, ComTimeout=0, ComTransferProperty=PENDING, ComSystemTemplateSystemSignalRef=EXT_A_IN15
        EXT_A_IN16_oVcuTxIoMsg8_oTC37X_VCU_CAN00_561e0a28_Tx: ComBitPosition=32, ComBitSize=16, ComSignalEndianness=LITTLE_ENDIAN, ComSignalInitValue=0, ComSignalType=SINT16, ComTimeout=0, ComTransferProperty=PENDING, ComSystemTemplateSystemSignalRef=EXT_A_IN16
        EXT_A_IN1_oVcuTxIoMsg1_oTC37X_VCU_CAN00_37348eff_Tx: ComBitPosition=0, ComBitSize=16, ComSignalEndianness=LITTLE_ENDIAN, ComSignalInitValue=0, ComSignalType=SINT16, ComTimeout=0, ComTransferProperty=PENDING, ComSystemTemplateSystemSignalRef=EXT_A_IN1
        EXT_A_IN2_oVcuTxIoMsg1_oTC37X_VCU_CAN00_241cb78c_Tx: ComBitPosition=32, ComBitSize=16, ComSignalEndianness=LITTLE_ENDIAN, ComSignalInitValue=0, ComSignalType=SINT16, ComTimeout=0, ComTransferProperty=PENDING, ComSystemTemplateSystemSignalRef=EXT_A_IN2
        EXT_A_IN3_oVcuTxIoMsg2_oTC37X_VCU_CAN00_c07d823f_Tx: ComBitPosition=0, ComBitSize=16, ComSignalEndianness=LITTLE_ENDIAN, ComSignalInitValue=0, ComSignalType=SINT16, ComTimeout=0, ComTransferProperty=PENDING, ComSystemTemplateSystemSignalRef=EXT_A_IN3
        EXT_A_IN4_oVcuTxIoMsg2_oTC37X_VCU_CAN00_e8ca1808_Tx: ComBitPosition=32, ComBitSize=16, ComSignalEndianness=LITTLE_ENDIAN, ComSignalInitValue=0, ComSignalType=SINT16, ComTimeout=0, ComTransferProperty=PENDING, ComSystemTemplateSystemSignalRef=EXT_A_IN4
        EXT_A_IN5_oVcuTxIoMsg3_oTC37X_VCU_CAN00_097f4638_Tx: ComBitPosition=0, ComBitSize=16, ComSignalEndianness=LITTLE_ENDIAN, ComSignalInitValue=0, ComSignalType=SINT16, ComTimeout=0, ComTransferProperty=PENDING, ComSystemTemplateSystemSignalRef=EXT_A_IN5
        EXT_A_IN6_oVcuTxIoMsg3_oTC37X_VCU_CAN00_1a577f4b_Tx: ComBitPosition=32, ComBitSize=16, ComSignalEndianness=LITTLE_ENDIAN, ComSignalInitValue=0, ComSignalType=SINT16, ComTimeout=0, ComTransferProperty=PENDING, ComSystemTemplateSystemSignalRef=EXT_A_IN6
        EXT_A_IN7_oVcuTxIoMsg4_oTC37X_VCU_CAN00_f59e9dfe_Tx: ComBitPosition=0, ComBitSize=16, ComSignalEndianness=LITTLE_ENDIAN, ComSignalInitValue=0, ComSignalType=SINT16, ComTimeout=0, ComTransferProperty=PENDING, ComSystemTemplateSystemSignalRef=EXT_A_IN7
        EXT_A_IN8_oVcuTxIoMsg4_oTC37X_VCU_CAN00_aa164141_Tx: ComBitPosition=32, ComBitSize=16, ComSignalEndianness=LITTLE_ENDIAN, ComSignalInitValue=0, ComSignalType=SINT16, ComTimeout=0, ComTransferProperty=PENDING, ComSystemTemplateSystemSignalRef=EXT_A_IN8
        EXT_A_IN9_oVcuTxIoMsg5_oTC37X_VCU_CAN00_4ba31f71_Tx: ComBitPosition=0, ComBitSize=16, ComSignalEndianness=LITTLE_ENDIAN, ComSignalInitValue=0, ComSignalType=SINT16, ComTimeout=0, ComTransferProperty=PENDING, ComSystemTemplateSystemSignalRef=EXT_A_IN9
        EXV1_CurrentInitState_oEXV_1_VCU_oLIN00_beca31e2_Rx: ComBitPosition=1, ComBitSize=2, ComSignalEndianness=LITTLE_ENDIAN, ComSignalInitValue=0, ComSignalType=UINT8, ComSystemTemplateSystemSignalRef=EXV1_CurrentInitState
        EXV1_CurrentPosition_oEXV_1_VCU_oLIN00_6daec86f_Rx: ComBitPosition=16, ComBitSize=16, ComSignalEndianness=LITTLE_ENDIAN, ComSignalInitValue=0, ComSignalType=UINT16, ComSystemTemplateSystemSignalRef=EXV1_CurrentPosition
        EXV1_FaultState_oEXV_1_VCU_oLIN00_72ff14f0_Rx: ComBitPosition=4, ComBitSize=4, ComSignalEndianness=LITTLE_ENDIAN, ComSignalInitValue=0, ComSignalType=UINT8, ComSystemTemplateSystemSignalRef=EXV1_FaultState
        EXV1_ResponseError_oEXV_1_VCU_oLIN00_cbce9ad1_Rx: ComBitPosition=0, ComBitSize=1, ComSignalEndianness=LITTLE_ENDIAN, ComSignalInitValue=0, ComSignalType=BOOLEAN, ComSystemTemplateSystemSignalRef=EXV1_ResponseError
        EXV1_RunState_oEXV_1_VCU_oLIN00_f0dc555f_Rx: ComBitPosition=3, ComBitSize=1, ComSignalEndianness=LITTLE_ENDIAN, ComSignalInitValue=0, ComSignalType=BOOLEAN, ComSystemTemplateSystemSignalRef=EXV1_RunState
        EXV1_TemperatureWarn_oEXV_1_VCU_oLIN00_a3317e4b_Rx: ComBitPosition=10, ComBitSize=2, ComSignalEndianness=LITTLE_ENDIAN, ComSignalInitValue=0, ComSignalType=UINT8, ComSystemTemplateSystemSignalRef=EXV1_TemperatureWarn
        EXV1_VoltageState_oEXV_1_VCU_oLIN00_31bbfd77_Rx: ComBitPosition=8, ComBitSize=2, ComSignalEndianness=LITTLE_ENDIAN, ComSignalInitValue=0, ComSignalType=UINT8, ComSystemTemplateSystemSignalRef=EXV1_VoltageState
        EXV2_CurrentInitState_oEXV_2_VCU_oLIN00_adb498ec_Rx: ComBitPosition=1, ComBitSize=2, ComSignalEndianness=LITTLE_ENDIAN, ComSignalInitValue=0, ComSignalType=UINT8, ComSystemTemplateSystemSignalRef=EXV2_CurrentInitState
        EXV2_CurrentPosition_oEXV_2_VCU_oLIN00_91e32486_Rx: ComBitPosition=16, ComBitSize=16, ComSignalEndianness=LITTLE_ENDIAN, ComSignalInitValue=0, ComSignalType=UINT16, ComSystemTemplateSystemSignalRef=EXV2_CurrentPosition
        EXV2_FaultState_oEXV_2_VCU_oLIN00_41c0e318_Rx: ComBitPosition=4, ComBitSize=4, ComSignalEndianness=LITTLE_ENDIAN, ComSignalInitValue=0, ComSignalType=UINT8, ComSystemTemplateSystemSignalRef=EXV2_FaultState
        EXV2_Fault_Stat_oEXV2_Status_oLIN00_ab6350b6_Rx: ComBitPosition=8, ComBitSize=4, ComSignalEndianness=LITTLE_ENDIAN, ComSignalInitValue=0, ComSignalType=UINT8, ComSystemTemplateSystemSignalRef=EXV2_Fault_Stat
        EXV2_OvrTemp_Warn_oEXV2_Status_oLIN00_ba77659e_Rx: ComBitPosition=14, ComBitSize=2, ComSignalEndianness=LITTLE_ENDIAN, ComSignalInitValue=0, ComSignalType=UINT8, ComSystemTemplateSystemSignalRef=EXV2_OvrTemp_Warn
        EXV2_Pos_oEXV2_Status_oLIN00_da80603b_Rx: ComBitPosition=16, ComBitSize=16, ComSignalEndianness=LITTLE_ENDIAN, ComSignalInitValue=0, ComSignalType=UINT16, ComSystemTemplateSystemSignalRef=EXV2_Pos
        EXV2_ResponseError_oEXV_2_VCU_oLIN00_e747f934_Rx: ComBitPosition=0, ComBitSize=1, ComSignalEndianness=LITTLE_ENDIAN, ComSignalInitValue=0, ComSignalType=BOOLEAN, ComSystemTemplateSystemSignalRef=EXV2_ResponseError
        EXV2_RunState_oEXV_2_VCU_oLIN00_859c8088_Rx: ComBitPosition=3, ComBitSize=1, ComSignalEndianness=LITTLE_ENDIAN, ComSignalInitValue=0, ComSignalType=BOOLEAN, ComSystemTemplateSystemSignalRef=EXV2_RunState
        EXV2_Run_Stat_oEXV2_Status_oLIN00_0e992e12_Rx: ComBitPosition=4, ComBitSize=1, ComSignalEndianness=LITTLE_ENDIAN, ComSignalInitValue=0, ComSignalType=BOOLEAN, ComSystemTemplateSystemSignalRef=EXV2_Run_Stat
        EXV2_TemperatureWarn_oEXV_2_VCU_oLIN00_5f7c92a2_Rx: ComBitPosition=10, ComBitSize=2, ComSignalEndianness=LITTLE_ENDIAN, ComSignalInitValue=0, ComSignalType=UINT8, ComSystemTemplateSystemSignalRef=EXV2_TemperatureWarn
        EXV2_Volt_Stat_oEXV2_Status_oLIN00_c8727eb0_Rx: ComBitPosition=12, ComBitSize=2, ComSignalEndianness=LITTLE_ENDIAN, ComSignalInitValue=0, ComSignalType=UINT8, ComSystemTemplateSystemSignalRef=EXV2_Volt_Stat
        EXV2_VoltageState_oEXV_2_VCU_oLIN00_8f3a2738_Rx: ComBitPosition=8, ComBitSize=2, ComSignalEndianness=LITTLE_ENDIAN, ComSignalInitValue=0, ComSignalType=UINT8, ComSystemTemplateSystemSignalRef=EXV2_VoltageState
        EXV2_curInit_Stat_oEXV2_Status_oLIN00_b0ace0f5_Rx: ComBitPosition=2, ComBitSize=2, ComSignalEndianness=LITTLE_ENDIAN, ComSignalInitValue=0, ComSignalType=UINT8, ComSystemTemplateSystemSignalRef=EXV2_curInit_Stat
        HVAC_Blower_request_oVCU_Minor_03_oKAMA_FP_EPT_0303_ea1e3327_Rx: ComBitPosition=23, ComBitSize=7, ComSignalEndianness=BIG_ENDIAN, ComSignalInitValue=0, ComSignalType=UINT8, ComTimeout=0, ComSystemTemplateSystemSignalRef=HVAC_Blower_request
        HVCH_CurrSens_Flt_oHVCH_Rsp01_oLIN00_09f7bc74_Rx: ComBitPosition=56, ComBitSize=5, ComSignalEndianness=LITTLE_ENDIAN, ComSignalInitValue=0, ComSignalType=UINT8, ComSystemTemplateSystemSignalRef=HVCH_CurrSens_Flt
        HVCH_DutyCycle_oHVCH_Rsp01_oLIN00_ad1e6a22_Rx: ComBitPosition=24, ComBitSize=8, ComSignalEndianness=LITTLE_ENDIAN, ComSignalInitValue=50, ComSignalType=UINT8, ComSystemTemplateSystemSignalRef=HVCH_DutyCycle
        HVCH_ExtPwrSup_Flt_oHVCH_Rsp01_oLIN00_28926933_Rx: ComBitPosition=45, ComBitSize=1, ComSignalEndianness=LITTLE_ENDIAN, ComSignalInitValue=0, ComSignalType=BOOLEAN, ComSystemTemplateSystemSignalRef=HVCH_ExtPwrSup_Flt
        HVCH_HV_DC_curr_oHVCH_Rsp01_oLIN00_f613e39d_Rx: ComBitPosition=0, ComBitSize=8, ComSignalEndianness=LITTLE_ENDIAN, ComSignalInitValue=0, ComSignalType=UINT8, ComSystemTemplateSystemSignalRef=HVCH_HV_DC_curr
        HVCH_HV_Voltage_Valid_oHVCH_Rsp01_oLIN00_2914831e_Rx: ComBitPosition=40, ComBitSize=2, ComSignalEndianness=LITTLE_ENDIAN, ComSignalInitValue=0, ComSignalType=UINT8, ComSystemTemplateSystemSignalRef=HVCH_HV_Voltage_Valid
        HVCH_HV_voltage_oHVCH_Rsp01_oLIN00_3d3da318_Rx: ComBitPosition=8, ComBitSize=8, ComSignalEndianness=LITTLE_ENDIAN, ComSignalInitValue=0, ComSignalType=UINT8, ComSystemTemplateSystemSignalRef=HVCH_HV_voltage
        HVCH_IntelTemp_oHVCH_Rsp02_oLIN00_2b487110_Rx: ComBitPosition=0, ComBitSize=8, ComSignalEndianness=LITTLE_ENDIAN, ComSignalInitValue=0, ComSignalType=UINT8, ComSystemTemplateSystemSignalRef=HVCH_IntelTemp
        HVCH_InternalPCBTemp_oHVCH_Rsp01_oLIN00_398b53e8_Rx: ComBitPosition=48, ComBitSize=8, ComSignalEndianness=LITTLE_ENDIAN, ComSignalInitValue=0, ComSignalType=UINT8, ComSystemTemplateSystemSignalRef=HVCH_InternalPCBTemp
        HVCH_LIN_Flt_oHVCH_Rsp01_oLIN00_9aaa25bf_Rx: ComBitPosition=44, ComBitSize=1, ComSignalEndianness=LITTLE_ENDIAN, ComSignalInitValue=0, ComSignalType=BOOLEAN, ComSystemTemplateSystemSignalRef=HVCH_LIN_Flt
        HVCH_MediumTemp_oHVCH_Rsp01_oLIN00_a3387de4_Rx: ComBitPosition=16, ComBitSize=8, ComSignalEndianness=LITTLE_ENDIAN, ComSignalInitValue=0, ComSignalType=UINT8, ComSystemTemplateSystemSignalRef=HVCH_MediumTemp
        HVCH_Off_ShrtCurr_oHVCH_Rsp01_oLIN00_bf58ab45_Rx: ComBitPosition=46, ComBitSize=1, ComSignalEndianness=LITTLE_ENDIAN, ComSignalInitValue=0, ComSignalType=BOOLEAN, ComSystemTemplateSystemSignalRef=HVCH_Off_ShrtCurr
        HVCH_RsErr_oHVCH_Rsp01_oLIN00_527b0f8f_Rx: ComBitPosition=61, ComBitSize=1, ComSignalEndianness=LITTLE_ENDIAN, ComSignalInitValue=0, ComSignalType=BOOLEAN, ComSystemTemplateSystemSignalRef=HVCH_RsErr
        HVCH_Status_oHVCH_Rsp01_oLIN00_60afdc75_Rx: ComBitPosition=32, ComBitSize=3, ComSignalEndianness=LITTLE_ENDIAN, ComSignalInitValue=0, ComSignalType=UINT8, ComSystemTemplateSystemSignalRef=HVCH_Status
        HVCH_TempLim_oHVCH_Rsp01_oLIN00_d22e6add_Rx: ComBitPosition=43, ComBitSize=1, ComSignalEndianness=LITTLE_ENDIAN, ComSignalInitValue=0, ComSignalType=BOOLEAN, ComSystemTemplateSystemSignalRef=HVCH_TempLim
        HVCH_TempSens_Flt_oHVCH_Rsp01_oLIN00_66cb2c71_Rx: ComBitPosition=42, ComBitSize=1, ComSignalEndianness=LITTLE_ENDIAN, ComSignalInitValue=0, ComSignalType=BOOLEAN, ComSystemTemplateSystemSignalRef=HVCH_TempSens_Flt
        HVCH_defectHeaterCircuits_oHVCH_Rsp01_oLIN00_61948e74_Rx: ComBitPosition=35, ComBitSize=3, ComSignalEndianness=LITTLE_ENDIAN, ComSignalInitValue=0, ComSignalType=UINT8, ComSystemTemplateSystemSignalRef=HVCH_defectHeaterCircuits
        LIN_Resp_Error_sta_oSVA_VCU_STD_oLIN00_47f7ca93_Rx: ComBitPosition=32, ComBitSize=1, ComSignalEndianness=LITTLE_ENDIAN, ComSignalInitValue=0, ComSignalType=BOOLEAN, ComSystemTemplateSystemSignalRef=LIN_Resp_Error_sta
        MODE_F_B_oVCU_Minor_01_oKAMA_FP_EPT_0303_8d5db84c_Tx: ComBitPosition=15, ComBitSize=6, ComSignalEndianness=BIG_ENDIAN, ComSignalInitValue=0, ComSignalType=UINT8, ComTimeout=0, ComTransferProperty=PENDING, ComSystemTemplateSystemSignalRef=MODE_F_B
        Mode_Actuator_request_oVCU_Minor_03_oKAMA_FP_EPT_0303_b0a0ba91_Rx: ComBitPosition=2, ComBitSize=2, ComSignalEndianness=BIG_ENDIAN, ComSignalInitValue=0, ComSignalType=UINT8, ComTimeout=0, ComSystemTemplateSystemSignalRef=Mode_Actuator_request
        PMP2_PumpDryRunningSta_oPMP2_Sts_oLIN00_3e217a22_Rx: ComBitPosition=3, ComBitSize=1, ComSignalEndianness=LITTLE_ENDIAN, ComSignalInitValue=0, ComSignalType=BOOLEAN, ComSystemTemplateSystemSignalRef=PMP2_PumpDryRunningSta
        PMP2_PumpInputVolt_oPMP2_Sts_oLIN00_1fa0a533_Rx: ComBitPosition=8, ComBitSize=8, ComSignalEndianness=LITTLE_ENDIAN, ComSignalInitValue=0, ComSignalType=UINT8, ComSystemTemplateSystemSignalRef=PMP2_PumpInputVolt
        PMP2_PumpMotorSta_oPMP2_Sts_oLIN00_d6d3ab88_Rx: ComBitPosition=1, ComBitSize=2, ComSignalEndianness=LITTLE_ENDIAN, ComSignalInitValue=0, ComSignalType=UINT8, ComSystemTemplateSystemSignalRef=PMP2_PumpMotorSta
        PMP2_PumpPowerSta_oPMP2_Sts_oLIN00_1d0f1319_Rx: ComBitPosition=4, ComBitSize=2, ComSignalEndianness=LITTLE_ENDIAN, ComSignalInitValue=0, ComSignalType=UINT8, ComSystemTemplateSystemSignalRef=PMP2_PumpPowerSta
        PMP2_PumpTempSta_oPMP2_Sts_oLIN00_81f2fa55_Rx: ComBitPosition=6, ComBitSize=2, ComSignalEndianness=LITTLE_ENDIAN, ComSignalInitValue=0, ComSignalType=UINT8, ComSystemTemplateSystemSignalRef=PMP2_PumpTempSta
        PMP2_RESP_ERROR_oPMP2_Sts_oLIN00_67b666eb_Rx: ComBitPosition=0, ComBitSize=1, ComSignalEndianness=LITTLE_ENDIAN, ComSignalInitValue=0, ComSignalType=BOOLEAN, ComSystemTemplateSystemSignalRef=PMP2_RESP_ERROR
        PMP2_RealRPM_oPMP2_Sts_oLIN00_86d75572_Rx: ComBitPosition=24, ComBitSize=8, ComSignalEndianness=LITTLE_ENDIAN, ComSignalInitValue=0, ComSignalType=UINT8, ComSystemTemplateSystemSignalRef=PMP2_RealRPM
        PMP3_PumpDryRunningSta_oPMP3_Sts_oLIN00_30f4e2d8_Rx: ComBitPosition=3, ComBitSize=1, ComSignalEndianness=LITTLE_ENDIAN, ComSignalInitValue=0, ComSignalType=BOOLEAN, ComSystemTemplateSystemSignalRef=PMP3_PumpDryRunningSta
        PMP3_PumpInputVolt_oPMP3_Sts_oLIN00_75dfecf6_Rx: ComBitPosition=8, ComBitSize=8, ComSignalEndianness=LITTLE_ENDIAN, ComSignalInitValue=0, ComSignalType=UINT8, ComSystemTemplateSystemSignalRef=PMP3_PumpInputVolt
        PMP3_PumpMotorSta_oPMP3_Sts_oLIN00_43910f36_Rx: ComBitPosition=1, ComBitSize=2, ComSignalEndianness=LITTLE_ENDIAN, ComSignalInitValue=0, ComSignalType=UINT8, ComSystemTemplateSystemSignalRef=PMP3_PumpMotorSta
        PMP3_PumpPowerSta_oPMP3_Sts_oLIN00_884db7a7_Rx: ComBitPosition=4, ComBitSize=2, ComSignalEndianness=LITTLE_ENDIAN, ComSignalInitValue=0, ComSignalType=UINT8, ComSystemTemplateSystemSignalRef=PMP3_PumpPowerSta
        PMP3_PumpTempSta_oPMP3_Sts_oLIN00_26375532_Rx: ComBitPosition=6, ComBitSize=2, ComSignalEndianness=LITTLE_ENDIAN, ComSignalInitValue=0, ComSignalType=UINT8, ComSystemTemplateSystemSignalRef=PMP3_PumpTempSta
        PMP3_RESP_ERROR_oPMP3_Sts_oLIN00_9f14f3a0_Rx: ComBitPosition=0, ComBitSize=1, ComSignalEndianness=LITTLE_ENDIAN, ComSignalInitValue=0, ComSignalType=BOOLEAN, ComSystemTemplateSystemSignalRef=PMP3_RESP_ERROR
        PMP3_RealRPM_oPMP3_Sts_oLIN00_fa6fbf8a_Rx: ComBitPosition=24, ComBitSize=8, ComSignalEndianness=LITTLE_ENDIAN, ComSignalInitValue=0, ComSignalType=UINT8, ComSystemTemplateSystemSignalRef=PMP3_RealRPM
        RsErr_EXV2_oEXV2_Status_oLIN00_5c35655a_Rx: ComBitPosition=0, ComBitSize=1, ComSignalEndianness=LITTLE_ENDIAN, ComSignalInitValue=0, ComSignalType=BOOLEAN, ComSystemTemplateSystemSignalRef=RsErr_EXV2
        SV1_request_oVCU_Minor_03_oKAMA_FP_EPT_0303_a1028998_Rx: ComBitPosition=7, ComBitSize=1, ComSignalEndianness=BIG_ENDIAN, ComSignalInitValue=0, ComSignalType=BOOLEAN, ComTimeout=0, ComSystemTemplateSystemSignalRef=SV1_request
        SV2_request_oVCU_Minor_03_oKAMA_FP_EPT_0303_424b3e3a_Rx: ComBitPosition=6, ComBitSize=1, ComSignalEndianness=BIG_ENDIAN, ComSignalInitValue=0, ComSignalType=BOOLEAN, ComTimeout=0, ComSystemTemplateSystemSignalRef=SV2_request
        SV3_request_oVCU_Minor_03_oKAMA_FP_EPT_0303_aa5cae9b_Rx: ComBitPosition=5, ComBitSize=1, ComSignalEndianness=BIG_ENDIAN, ComSignalInitValue=0, ComSignalType=BOOLEAN, ComTimeout=0, ComSystemTemplateSystemSignalRef=SV3_request
        TCU_HVCHMaxPowerLimit_oTCU_HVCH_Cmd_oLIN00_4bc53e0b_Tx: ComBitPosition=16, ComBitSize=8, ComSignalEndianness=LITTLE_ENDIAN, ComSignalInitValue=0, ComSignalType=UINT8, ComSystemTemplateSystemSignalRef=TCU_HVCHMaxPowerLimit
        TCU_HVCH_On_Rq_oTCU_HVCH_Cmd_oLIN00_9f442eaf_Tx: ComBitPosition=8, ComBitSize=2, ComSignalDataInvalidValue=3, ComSignalEndianness=LITTLE_ENDIAN, ComSignalInitValue=0, ComSignalType=UINT8, ComSystemTemplateSystemSignalRef=TCU_HVCH_On_Rq
        TCU_HVCH_TmaxLim_output_oTCU_HVCH_Cmd_oLIN00_5e45d521_Tx: ComBitPosition=24, ComBitSize=8, ComSignalEndianness=LITTLE_ENDIAN, ComSignalInitValue=0, ComSignalType=UINT8, ComSystemTemplateSystemSignalRef=TCU_HVCH_TmaxLim_output
        TCU_HVCH_heating_rq_oTCU_HVCH_Cmd_oLIN00_5e3a32b2_Tx: ComBitPosition=0, ComBitSize=7, ComSignalEndianness=LITTLE_ENDIAN, ComSignalInitValue=0, ComSignalType=UINT8, ComSystemTemplateSystemSignalRef=TCU_HVCH_heating_rq
        TMM_EXV1_EnableRequest_oVCU_EXV_1_oLIN00_d988d266_Tx: ComBitPosition=16, ComBitSize=1, ComSignalEndianness=LITTLE_ENDIAN, ComSignalInitValue=0, ComSignalType=BOOLEAN, ComSystemTemplateSystemSignalRef=TMM_EXV1_EnableRequest
        TMM_EXV1_PositionRequest_oVCU_EXV_1_oLIN00_cbd2de27_Tx: ComBitPosition=0, ComBitSize=16, ComSignalEndianness=LITTLE_ENDIAN, ComSignalInitValue=0, ComSignalType=UINT16, ComSystemTemplateSystemSignalRef=TMM_EXV1_PositionRequest
        TMM_EXV1_initRequest_oVCU_EXV_1_oLIN00_082350ea_Tx: ComBitPosition=24, ComBitSize=3, ComSignalEndianness=LITTLE_ENDIAN, ComSignalInitValue=0, ComSignalType=UINT8, ComSystemTemplateSystemSignalRef=TMM_EXV1_initRequest
        TMM_EXV2_EnableRequest_oVCU_EXV_2_oLIN00_0c106490_Tx: ComBitPosition=16, ComBitSize=1, ComSignalEndianness=LITTLE_ENDIAN, ComSignalInitValue=0, ComSignalType=BOOLEAN, ComSystemTemplateSystemSignalRef=TMM_EXV2_EnableRequest
        TMM_EXV2_PositionRequest_oVCU_EXV_2_oLIN00_ce8ee7dd_Tx: ComBitPosition=0, ComBitSize=16, ComSignalEndianness=LITTLE_ENDIAN, ComSignalInitValue=0, ComSignalType=UINT16, ComSystemTemplateSystemSignalRef=TMM_EXV2_PositionRequest
        TMM_EXV2_initRequest_oVCU_EXV_2_oLIN00_95846e7a_Tx: ComBitPosition=24, ComBitSize=3, ComSignalEndianness=LITTLE_ENDIAN, ComSignalInitValue=0, ComSignalType=UINT8, ComSystemTemplateSystemSignalRef=TMM_EXV2_initRequest
        Tamb_oVCU_Minor_01_oKAMA_FP_EPT_0303_8a5abefe_Tx: ComBitPosition=23, ComBitSize=6, ComSignalEndianness=BIG_ENDIAN, ComSignalInitValue=0, ComSignalType=UINT8, ComTimeout=0, ComTransferProperty=PENDING, ComSystemTemplateSystemSignalRef=Tamb
        Target_Pos_cmd_oVCU_SVA_CMD_oLIN00_b87f26ef_Tx: ComBitPosition=16, ComBitSize=12, ComSignalEndianness=LITTLE_ENDIAN, ComSignalInitValue=0, ComSignalType=UINT16, ComSystemTemplateSystemSignalRef=Target_Pos_cmd
        Tevap_Tchiller_out_oVCU_Minor_01_oKAMA_FP_EPT_0303_29906cec_Tx: ComBitPosition=31, ComBitSize=6, ComSignalEndianness=BIG_ENDIAN, ComSignalInitValue=0, ComSignalType=UINT8, ComTimeout=0, ComTransferProperty=PENDING, ComSystemTemplateSystemSignalRef=Tevap_Tchiller_out
        Tincar_oVCU_Minor_02_oKAMA_FP_EPT_0303_a42f9f70_Tx: ComBitPosition=39, ComBitSize=6, ComSignalEndianness=BIG_ENDIAN, ComSignalInitValue=0, ComSignalType=UINT8, ComTimeout=0, ComTransferProperty=PENDING, ComSystemTemplateSystemSignalRef=Tincar
        Tohx_in_oVCU_Minor_01_oKAMA_FP_EPT_0303_ef5c5e50_Tx: ComBitPosition=47, ComBitSize=6, ComSignalEndianness=BIG_ENDIAN, ComSignalInitValue=0, ComSignalType=UINT8, ComTimeout=0, ComTransferProperty=PENDING, ComSystemTemplateSystemSignalRef=Tohx_in
        Tohx_out_oVCU_Minor_01_oKAMA_FP_EPT_0303_63435844_Tx: ComBitPosition=39, ComBitSize=6, ComSignalEndianness=BIG_ENDIAN, ComSignalInitValue=0, ComSignalType=UINT8, ComTimeout=0, ComTransferProperty=PENDING, ComSystemTemplateSystemSignalRef=Tohx_out
        VcuAdcTxMsg1_Sig0_oVcuAdcTxMsg1_oTC37X_VCU_CAN01_77707e8c_Tx: ComBitPosition=0, ComBitSize=16, ComSignalEndianness=LITTLE_ENDIAN, ComSignalInitValue=0, ComSignalType=SINT16, ComTimeout=0, ComTransferProperty=PENDING, ComSystemTemplateSystemSignalRef=VcuAdcTxMsg1_Sig0
        VcuAdcTxMsg1_Sig0_oVcuCan03TxMsg1_oTC37X_VCU_CAN03_1782ee05_Tx: ComBitPosition=0, ComBitSize=16, ComSignalEndianness=LITTLE_ENDIAN, ComSignalInitValue=0, ComSignalType=SINT16, ComTimeout=0, ComTransferProperty=PENDING, ComSystemTemplateSystemSignalRef=VcuAdcTxMsg1_Sig0
        VcuAdcTxMsg1_Sig1_oVcuAdcTxMsg1_oTC37X_VCU_CAN01_86aa7b26_Tx: ComBitPosition=16, ComBitSize=16, ComSignalEndianness=LITTLE_ENDIAN, ComSignalInitValue=0, ComSignalType=SINT16, ComTimeout=0, ComTransferProperty=PENDING, ComSystemTemplateSystemSignalRef=VcuAdcTxMsg1_Sig1
        VcuAdcTxMsg1_Sig1_oVcuCan03TxMsg1_oTC37X_VCU_CAN03_3300bf33_Tx: ComBitPosition=16, ComBitSize=16, ComSignalEndianness=LITTLE_ENDIAN, ComSignalInitValue=0, ComSignalType=SINT16, ComTimeout=0, ComTransferProperty=PENDING, ComSystemTemplateSystemSignalRef=VcuAdcTxMsg1_Sig1
        VcuAdcTxMsg1_Sig2_oVcuAdcTxMsg1_oTC37X_VCU_CAN01_4fb57399_Tx: ComBitPosition=32, ComBitSize=16, ComSignalEndianness=LITTLE_ENDIAN, ComSignalInitValue=0, ComSignalType=SINT16, ComTimeout=0, ComTransferProperty=PENDING, ComSystemTemplateSystemSignalRef=VcuAdcTxMsg1_Sig2
        VcuAdcTxMsg1_Sig2_oVcuCan03TxMsg1_oTC37X_VCU_CAN03_5e864c69_Tx: ComBitPosition=32, ComBitSize=16, ComSignalEndianness=LITTLE_ENDIAN, ComSignalInitValue=0, ComSignalType=SINT16, ComTimeout=0, ComTransferProperty=PENDING, ComSystemTemplateSystemSignalRef=VcuAdcTxMsg1_Sig2
        VcuAdcTxMsg1_Sig3_oVcuAdcTxMsg1_oTC37X_VCU_CAN01_be6f7633_Tx: ComBitPosition=48, ComBitSize=16, ComSignalEndianness=LITTLE_ENDIAN, ComSignalInitValue=0, ComSignalType=SINT16, ComTimeout=0, ComTransferProperty=PENDING, ComSystemTemplateSystemSignalRef=VcuAdcTxMsg1_Sig3
        VcuAdcTxMsg1_Sig3_oVcuCan03TxMsg1_oTC37X_VCU_CAN03_7a041d5f_Tx: ComBitPosition=48, ComBitSize=16, ComSignalEndianness=LITTLE_ENDIAN, ComSignalInitValue=0, ComSignalType=SINT16, ComTimeout=0, ComTransferProperty=PENDING, ComSystemTemplateSystemSignalRef=VcuAdcTxMsg1_Sig3
        VcuAdcTxMsg2_Sig0_oVcuAdcTxMsg2_oTC37X_VCU_CAN01_c7979c8e_Tx: ComBitPosition=0, ComBitSize=16, ComSignalEndianness=LITTLE_ENDIAN, ComSignalInitValue=0, ComSignalType=SINT16, ComTimeout=0, ComTransferProperty=PENDING, ComSystemTemplateSystemSignalRef=VcuAdcTxMsg2_Sig0
        VcuAdcTxMsg2_Sig0_oVcuCan03TxMsg2_oTC37X_VCU_CAN03_2e9f2f9c_Tx: ComBitPosition=0, ComBitSize=16, ComSignalEndianness=LITTLE_ENDIAN, ComSignalInitValue=0, ComSignalType=SINT16, ComTimeout=0, ComTransferProperty=PENDING, ComSystemTemplateSystemSignalRef=VcuAdcTxMsg2_Sig0
        VcuAdcTxMsg2_Sig1_oVcuAdcTxMsg2_oTC37X_VCU_CAN01_364d9924_Tx: ComBitPosition=16, ComBitSize=16, ComSignalEndianness=LITTLE_ENDIAN, ComSignalInitValue=0, ComSignalType=SINT16, ComTimeout=0, ComTransferProperty=PENDING, ComSystemTemplateSystemSignalRef=VcuAdcTxMsg2_Sig1
        VcuAdcTxMsg2_Sig1_oVcuCan03TxMsg2_oTC37X_VCU_CAN03_0a1d7eaa_Tx: ComBitPosition=16, ComBitSize=16, ComSignalEndianness=LITTLE_ENDIAN, ComSignalInitValue=0, ComSignalType=SINT16, ComTimeout=0, ComTransferProperty=PENDING, ComSystemTemplateSystemSignalRef=VcuAdcTxMsg2_Sig1
        VcuAdcTxMsg2_Sig2_oVcuAdcTxMsg2_oTC37X_VCU_CAN01_ff52919b_Tx: ComBitPosition=32, ComBitSize=16, ComSignalEndianness=LITTLE_ENDIAN, ComSignalInitValue=0, ComSignalType=SINT16, ComTimeout=0, ComTransferProperty=PENDING, ComSystemTemplateSystemSignalRef=VcuAdcTxMsg2_Sig2
        VcuAdcTxMsg2_Sig2_oVcuCan03TxMsg2_oTC37X_VCU_CAN03_679b8df0_Tx: ComBitPosition=32, ComBitSize=16, ComSignalEndianness=LITTLE_ENDIAN, ComSignalInitValue=0, ComSignalType=SINT16, ComTimeout=0, ComTransferProperty=PENDING, ComSystemTemplateSystemSignalRef=VcuAdcTxMsg2_Sig2
        VcuAdcTxMsg2_Sig3_oVcuAdcTxMsg2_oTC37X_VCU_CAN01_0e889431_Tx: ComBitPosition=48, ComBitSize=16, ComSignalEndianness=LITTLE_ENDIAN, ComSignalInitValue=0, ComSignalType=SINT16, ComTimeout=0, ComTransferProperty=PENDING, ComSystemTemplateSystemSignalRef=VcuAdcTxMsg2_Sig3
        VcuAdcTxMsg2_Sig3_oVcuCan03TxMsg2_oTC37X_VCU_CAN03_4319dcc6_Tx: ComBitPosition=48, ComBitSize=16, ComSignalEndianness=LITTLE_ENDIAN, ComSignalInitValue=0, ComSignalType=SINT16, ComTimeout=0, ComTransferProperty=PENDING, ComSystemTemplateSystemSignalRef=VcuAdcTxMsg2_Sig3
        VcuCan12RxMsg3_Sig0_oVcuCan12RxMsg3_oTC37X_VCU_CAN12_5a65a77f_Rx: ComBitPosition=0, ComBitSize=16, ComSignalEndianness=LITTLE_ENDIAN, ComSignalInitValue=0, ComSignalType=SINT16, ComTimeout=0, ComSystemTemplateSystemSignalRef=VcuCan12RxMsg3_Sig0
        VcuCan12RxMsg3_Sig1_oVcuCan12RxMsg3_oTC37X_VCU_CAN12_7ee7f649_Rx: ComBitPosition=16, ComBitSize=16, ComSignalEndianness=LITTLE_ENDIAN, ComSignalInitValue=0, ComSignalType=SINT16, ComTimeout=0, ComSystemTemplateSystemSignalRef=VcuCan12RxMsg3_Sig1
        VcuCan12RxMsg3_Sig2_oVcuCan12RxMsg3_oTC37X_VCU_CAN12_13610513_Rx: ComBitPosition=32, ComBitSize=16, ComSignalEndianness=LITTLE_ENDIAN, ComSignalInitValue=0, ComSignalType=SINT16, ComTimeout=0, ComSystemTemplateSystemSignalRef=VcuCan12RxMsg3_Sig2
        VcuCan12RxMsg3_Sig3_oVcuCan12RxMsg3_oTC37X_VCU_CAN12_37e35425_Rx: ComBitPosition=48, ComBitSize=16, ComSignalEndianness=LITTLE_ENDIAN, ComSignalInitValue=0, ComSignalType=SINT16, ComTimeout=0, ComSystemTemplateSystemSignalRef=VcuCan12RxMsg3_Sig3
        VcuCan12RxMsg4_Sig0_oVcuCan12RxMsg4_oTC37X_VCU_CAN12_89859905_Rx: ComBitPosition=0, ComBitSize=16, ComSignalEndianness=LITTLE_ENDIAN, ComSignalInitValue=0, ComSignalType=SINT16, ComTimeout=0, ComSystemTemplateSystemSignalRef=VcuCan12RxMsg4_Sig0
        VcuCan12RxMsg4_Sig1_oVcuCan12RxMsg4_oTC37X_VCU_CAN12_ad07c833_Rx: ComBitPosition=16, ComBitSize=16, ComSignalEndianness=LITTLE_ENDIAN, ComSignalInitValue=0, ComSignalType=SINT16, ComTimeout=0, ComSystemTemplateSystemSignalRef=VcuCan12RxMsg4_Sig1
        VcuCan12RxMsg4_Sig2_oVcuCan12RxMsg4_oTC37X_VCU_CAN12_c0813b69_Rx: ComBitPosition=32, ComBitSize=16, ComSignalEndianness=LITTLE_ENDIAN, ComSignalInitValue=0, ComSignalType=SINT16, ComTimeout=0, ComSystemTemplateSystemSignalRef=VcuCan12RxMsg4_Sig2
        VcuCan12RxMsg4_Sig3_oVcuCan12RxMsg4_oTC37X_VCU_CAN12_e4036a5f_Rx: ComBitPosition=48, ComBitSize=16, ComSignalEndianness=LITTLE_ENDIAN, ComSignalInitValue=0, ComSignalType=SINT16, ComTimeout=0, ComSystemTemplateSystemSignalRef=VcuCan12RxMsg4_Sig3
        VcuCan12TxMsg1_Sig0_oVcuCan12TxMsg1_oTC37X_VCU_CAN12_d3993898_Tx: ComBitPosition=0, ComBitSize=16, ComSignalEndianness=LITTLE_ENDIAN, ComSignalInitValue=0, ComSignalType=SINT16, ComTimeout=0, ComTransferProperty=PENDING, ComSystemTemplateSystemSignalRef=VcuCan12TxMsg1_Sig0
        VcuCan12TxMsg1_Sig1_oVcuCan12TxMsg1_oTC37X_VCU_CAN12_f71b69ae_Tx: ComBitPosition=16, ComBitSize=16, ComSignalEndianness=LITTLE_ENDIAN, ComSignalInitValue=0, ComSignalType=SINT16, ComTimeout=0, ComTransferProperty=PENDING, ComSystemTemplateSystemSignalRef=VcuCan12TxMsg1_Sig1
        VcuCan12TxMsg1_Sig2_oVcuCan12TxMsg1_oTC37X_VCU_CAN12_9a9d9af4_Tx: ComBitPosition=32, ComBitSize=16, ComSignalEndianness=LITTLE_ENDIAN, ComSignalInitValue=0, ComSignalType=SINT16, ComTimeout=0, ComTransferProperty=PENDING, ComSystemTemplateSystemSignalRef=VcuCan12TxMsg1_Sig2
        VcuCan12TxMsg1_Sig3_oVcuCan12TxMsg1_oTC37X_VCU_CAN12_be1fcbc2_Tx: ComBitPosition=48, ComBitSize=16, ComSignalEndianness=LITTLE_ENDIAN, ComSignalInitValue=0, ComSignalType=SINT16, ComTimeout=0, ComTransferProperty=PENDING, ComSystemTemplateSystemSignalRef=VcuCan12TxMsg1_Sig3
        VcuCan12TxMsg2_Sig0_oVcuCan12TxMsg2_oTC37X_VCU_CAN12_ea84f901_Tx: ComBitPosition=0, ComBitSize=16, ComSignalEndianness=LITTLE_ENDIAN, ComSignalInitValue=0, ComSignalType=SINT16, ComTimeout=0, ComTransferProperty=PENDING, ComSystemTemplateSystemSignalRef=VcuCan12TxMsg2_Sig0
        VcuCan12TxMsg2_Sig1_oVcuCan12TxMsg2_oTC37X_VCU_CAN12_ce06a837_Tx: ComBitPosition=16, ComBitSize=16, ComSignalEndianness=LITTLE_ENDIAN, ComSignalInitValue=0, ComSignalType=SINT16, ComTimeout=0, ComTransferProperty=PENDING, ComSystemTemplateSystemSignalRef=VcuCan12TxMsg2_Sig1
        VcuCan12TxMsg2_Sig2_oVcuCan12TxMsg2_oTC37X_VCU_CAN12_a3805b6d_Tx: ComBitPosition=32, ComBitSize=16, ComSignalEndianness=LITTLE_ENDIAN, ComSignalInitValue=0, ComSignalType=SINT16, ComTimeout=0, ComTransferProperty=PENDING, ComSystemTemplateSystemSignalRef=VcuCan12TxMsg2_Sig2
        VcuCan12TxMsg2_Sig3_oVcuCan12TxMsg2_oTC37X_VCU_CAN12_87020a5b_Tx: ComBitPosition=48, ComBitSize=16, ComSignalEndianness=LITTLE_ENDIAN, ComSignalInitValue=0, ComSignalType=SINT16, ComTimeout=0, ComTransferProperty=PENDING, ComSystemTemplateSystemSignalRef=VcuCan12TxMsg2_Sig3
        VcuRxMsg1_Sig0_oVcuRxMsg1_oTC37X_VCU_CAN00_13cef464_Rx: ComBitPosition=0, ComBitSize=16, ComSignalEndianness=LITTLE_ENDIAN, ComSignalInitValue=0, ComSignalType=SINT16, ComTimeout=0, ComSystemTemplateSystemSignalRef=VcuRxMsg1_Sig0
        VcuRxMsg1_Sig1_oVcuRxMsg1_oTC37X_VCU_CAN00_70c92d40_Rx: ComBitPosition=16, ComBitSize=16, ComSignalEndianness=LITTLE_ENDIAN, ComSignalInitValue=0, ComSignalType=SINT16, ComTimeout=0, ComSystemTemplateSystemSignalRef=VcuRxMsg1_Sig1
        VcuRxMsg1_Sig2_oVcuRxMsg1_oTC37X_VCU_CAN00_d5c1462c_Rx: ComBitPosition=32, ComBitSize=16, ComSignalEndianness=LITTLE_ENDIAN, ComSignalInitValue=0, ComSignalType=SINT16, ComTimeout=0, ComSystemTemplateSystemSignalRef=VcuRxMsg1_Sig2
        VcuRxMsg1_Sig3_oVcuRxMsg1_oTC37X_VCU_CAN00_b6c69f08_Rx: ComBitPosition=48, ComBitSize=16, ComSignalEndianness=LITTLE_ENDIAN, ComSignalInitValue=0, ComSignalType=SINT16, ComTimeout=0, ComSystemTemplateSystemSignalRef=VcuRxMsg1_Sig3
        VcuRxMsg2_Sig0_oVcuRxMsg2_oTC37X_VCU_CAN00_94ceda5c_Rx: ComBitPosition=0, ComBitSize=16, ComSignalEndianness=LITTLE_ENDIAN, ComSignalInitValue=0, ComSignalType=SINT16, ComTimeout=0, ComSystemTemplateSystemSignalRef=VcuRxMsg2_Sig0
        VcuRxMsg2_Sig1_oVcuRxMsg2_oTC37X_VCU_CAN00_f7c90378_Rx: ComBitPosition=16, ComBitSize=16, ComSignalEndianness=LITTLE_ENDIAN, ComSignalInitValue=0, ComSignalType=SINT16, ComTimeout=0, ComSystemTemplateSystemSignalRef=VcuRxMsg2_Sig1
        VcuRxMsg2_Sig2_oVcuRxMsg2_oTC37X_VCU_CAN00_52c16814_Rx: ComBitPosition=32, ComBitSize=16, ComSignalEndianness=LITTLE_ENDIAN, ComSignalInitValue=0, ComSignalType=SINT16, ComTimeout=0, ComSystemTemplateSystemSignalRef=VcuRxMsg2_Sig2
        VcuRxMsg2_Sig3_oVcuRxMsg2_oTC37X_VCU_CAN00_31c6b130_Rx: ComBitPosition=48, ComBitSize=16, ComSignalEndianness=LITTLE_ENDIAN, ComSignalInitValue=0, ComSignalType=SINT16, ComTimeout=0, ComSystemTemplateSystemSignalRef=VcuRxMsg2_Sig3
        VcuRxMsg3_Sig0_oVcuCan03RxMsg1_oTC37X_VCU_CAN03_ab1f8c96_Rx: ComBitPosition=0, ComBitSize=16, ComSignalEndianness=LITTLE_ENDIAN, ComSignalInitValue=0, ComSignalType=SINT16, ComTimeout=0, ComSystemTemplateSystemSignalRef=VcuRxMsg3_Sig0
        VcuRxMsg3_Sig0_oVcuRxMsg3_oTC37X_VCU_CAN01_28190d1d_Rx: ComBitPosition=0, ComBitSize=16, ComSignalEndianness=LITTLE_ENDIAN, ComSignalInitValue=0, ComSignalType=SINT16, ComTimeout=0, ComSystemTemplateSystemSignalRef=VcuRxMsg3_Sig0
        VcuRxMsg3_Sig1_oVcuCan03RxMsg1_oTC37X_VCU_CAN03_8f9ddda0_Rx: ComBitPosition=16, ComBitSize=16, ComSignalEndianness=LITTLE_ENDIAN, ComSignalInitValue=0, ComSignalType=SINT16, ComTimeout=0, ComSystemTemplateSystemSignalRef=VcuRxMsg3_Sig1
        VcuRxMsg3_Sig1_oVcuRxMsg3_oTC37X_VCU_CAN01_4b1ed439_Rx: ComBitPosition=16, ComBitSize=16, ComSignalEndianness=LITTLE_ENDIAN, ComSignalInitValue=0, ComSignalType=SINT16, ComTimeout=0, ComSystemTemplateSystemSignalRef=VcuRxMsg3_Sig1
        VcuRxMsg3_Sig2_oVcuCan03RxMsg1_oTC37X_VCU_CAN03_e21b2efa_Rx: ComBitPosition=32, ComBitSize=16, ComSignalEndianness=LITTLE_ENDIAN, ComSignalInitValue=0, ComSignalType=SINT16, ComTimeout=0, ComSystemTemplateSystemSignalRef=VcuRxMsg3_Sig2
        VcuRxMsg3_Sig2_oVcuRxMsg3_oTC37X_VCU_CAN01_ee16bf55_Rx: ComBitPosition=32, ComBitSize=16, ComSignalEndianness=LITTLE_ENDIAN, ComSignalInitValue=0, ComSignalType=SINT16, ComTimeout=0, ComSystemTemplateSystemSignalRef=VcuRxMsg3_Sig2
        VcuRxMsg3_Sig3_oVcuCan03RxMsg1_oTC37X_VCU_CAN03_c6997fcc_Rx: ComBitPosition=48, ComBitSize=16, ComSignalEndianness=LITTLE_ENDIAN, ComSignalInitValue=0, ComSignalType=SINT16, ComTimeout=0, ComSystemTemplateSystemSignalRef=VcuRxMsg3_Sig3
        VcuRxMsg3_Sig3_oVcuRxMsg3_oTC37X_VCU_CAN01_8d116671_Rx: ComBitPosition=48, ComBitSize=16, ComSignalEndianness=LITTLE_ENDIAN, ComSignalInitValue=0, ComSignalType=SINT16, ComTimeout=0, ComSystemTemplateSystemSignalRef=VcuRxMsg3_Sig3
        VcuRxMsg4_Sig0_oVcuCan03RxMsg2_oTC37X_VCU_CAN03_735765ea_Rx: ComBitPosition=0, ComBitSize=16, ComSignalEndianness=LITTLE_ENDIAN, ComSignalInitValue=0, ComSignalType=SINT16, ComTimeout=0, ComSystemTemplateSystemSignalRef=VcuRxMsg4_Sig0
        VcuRxMsg4_Sig0_oVcuRxMsg4_oTC37X_VCU_CAN01_36b8b0fb_Rx: ComBitPosition=0, ComBitSize=16, ComSignalEndianness=LITTLE_ENDIAN, ComSignalInitValue=0, ComSignalType=SINT16, ComTimeout=0, ComSystemTemplateSystemSignalRef=VcuRxMsg4_Sig0
        VcuRxMsg4_Sig1_oVcuCan03RxMsg2_oTC37X_VCU_CAN03_57d534dc_Rx: ComBitPosition=16, ComBitSize=16, ComSignalEndianness=LITTLE_ENDIAN, ComSignalInitValue=0, ComSignalType=SINT16, ComTimeout=0, ComSystemTemplateSystemSignalRef=VcuRxMsg4_Sig1
        VcuRxMsg4_Sig1_oVcuRxMsg4_oTC37X_VCU_CAN01_55bf69df_Rx: ComBitPosition=16, ComBitSize=16, ComSignalEndianness=LITTLE_ENDIAN, ComSignalInitValue=0, ComSignalType=SINT16, ComTimeout=0, ComSystemTemplateSystemSignalRef=VcuRxMsg4_Sig1
        VcuRxMsg4_Sig2_oVcuCan03RxMsg2_oTC37X_VCU_CAN03_3a53c786_Rx: ComBitPosition=32, ComBitSize=16, ComSignalEndianness=LITTLE_ENDIAN, ComSignalInitValue=0, ComSignalType=SINT16, ComTimeout=0, ComSystemTemplateSystemSignalRef=VcuRxMsg4_Sig2
        VcuRxMsg4_Sig2_oVcuRxMsg4_oTC37X_VCU_CAN01_f0b702b3_Rx: ComBitPosition=32, ComBitSize=16, ComSignalEndianness=LITTLE_ENDIAN, ComSignalInitValue=0, ComSignalType=SINT16, ComTimeout=0, ComSystemTemplateSystemSignalRef=VcuRxMsg4_Sig2
        VcuRxMsg4_Sig3_oVcuCan03RxMsg2_oTC37X_VCU_CAN03_1ed196b0_Rx: ComBitPosition=48, ComBitSize=16, ComSignalEndianness=LITTLE_ENDIAN, ComSignalInitValue=0, ComSignalType=SINT16, ComTimeout=0, ComSystemTemplateSystemSignalRef=VcuRxMsg4_Sig3
        VcuRxMsg4_Sig3_oVcuRxMsg4_oTC37X_VCU_CAN01_93b0db97_Rx: ComBitPosition=48, ComBitSize=16, ComSignalEndianness=LITTLE_ENDIAN, ComSignalInitValue=0, ComSignalType=SINT16, ComTimeout=0, ComSystemTemplateSystemSignalRef=VcuRxMsg4_Sig3
        VcuTxMsg1_Sig0_oVcuTxMsg1_oTC37X_VCU_CAN00_8243b9a9_Tx: ComBitPosition=0, ComBitSize=16, ComSignalEndianness=LITTLE_ENDIAN, ComSignalInitValue=0, ComSignalType=SINT16, ComTimeout=0, ComTransferProperty=PENDING, ComSystemTemplateSystemSignalRef=VcuTxMsg1_Sig0
        VcuTxMsg1_Sig1_oVcuTxMsg1_oTC37X_VCU_CAN00_e144608d_Tx: ComBitPosition=16, ComBitSize=16, ComSignalEndianness=LITTLE_ENDIAN, ComSignalInitValue=0, ComSignalType=SINT16, ComTimeout=0, ComTransferProperty=PENDING, ComSystemTemplateSystemSignalRef=VcuTxMsg1_Sig1
        VcuTxMsg1_Sig2_oVcuTxMsg1_oTC37X_VCU_CAN00_444c0be1_Tx: ComBitPosition=32, ComBitSize=16, ComSignalEndianness=LITTLE_ENDIAN, ComSignalInitValue=0, ComSignalType=SINT16, ComTimeout=0, ComTransferProperty=PENDING, ComSystemTemplateSystemSignalRef=VcuTxMsg1_Sig2
        VcuTxMsg1_Sig3_oVcuTxMsg1_oTC37X_VCU_CAN00_274bd2c5_Tx: ComBitPosition=48, ComBitSize=16, ComSignalEndianness=LITTLE_ENDIAN, ComSignalInitValue=0, ComSignalType=SINT16, ComTimeout=0, ComTransferProperty=PENDING, ComSystemTemplateSystemSignalRef=VcuTxMsg1_Sig3
        VcuTxMsg2_Sig0_oVcuTxMsg2_oTC37X_VCU_CAN00_05439791_Tx: ComBitPosition=0, ComBitSize=16, ComSignalEndianness=LITTLE_ENDIAN, ComSignalInitValue=0, ComSignalType=SINT16, ComTimeout=0, ComTransferProperty=PENDING, ComSystemTemplateSystemSignalRef=VcuTxMsg2_Sig0
        VcuTxMsg2_Sig1_oVcuTxMsg2_oTC37X_VCU_CAN00_66444eb5_Tx: ComBitPosition=16, ComBitSize=16, ComSignalEndianness=LITTLE_ENDIAN, ComSignalInitValue=0, ComSignalType=SINT16, ComTimeout=0, ComTransferProperty=PENDING, ComSystemTemplateSystemSignalRef=VcuTxMsg2_Sig1
        VcuTxMsg2_Sig2_oVcuTxMsg2_oTC37X_VCU_CAN00_c34c25d9_Tx: ComBitPosition=32, ComBitSize=16, ComSignalEndianness=LITTLE_ENDIAN, ComSignalInitValue=0, ComSignalType=SINT16, ComTimeout=0, ComTransferProperty=PENDING, ComSystemTemplateSystemSignalRef=VcuTxMsg2_Sig2
        VcuTxMsg2_Sig3_oVcuTxMsg2_oTC37X_VCU_CAN00_a04bfcfd_Tx: ComBitPosition=48, ComBitSize=16, ComSignalEndianness=LITTLE_ENDIAN, ComSignalInitValue=0, ComSignalType=SINT16, ComTimeout=0, ComTransferProperty=PENDING, ComSystemTemplateSystemSignalRef=VcuTxMsg2_Sig3
        Vcu_Lin0_RxMsg1_Sig0_oVcu_Lin0_RxMsg1_oLIN01_6c375668_Rx: ComBitPosition=8, ComBitSize=8, ComSignalEndianness=LITTLE_ENDIAN, ComSignalInitValue=0, ComSignalType=UINT8, ComSystemTemplateSystemSignalRef=Vcu_Lin0_RxMsg1_Sig0
        Vcu_Lin0_RxMsg1_Sig1_oVcu_Lin0_RxMsg1_oLIN01_c9bcc666_Rx: ComBitPosition=0, ComBitSize=8, ComSignalEndianness=LITTLE_ENDIAN, ComSignalInitValue=0, ComSignalType=UINT8, ComSystemTemplateSystemSignalRef=Vcu_Lin0_RxMsg1_Sig1
        Vcu_Lin0_RxMsg2_Sig0_oVcu_Lin0_RxMsg2_oLIN01_a6197493_Rx: ComBitPosition=0, ComBitSize=8, ComSignalEndianness=LITTLE_ENDIAN, ComSignalInitValue=0, ComSignalType=UINT8, ComSystemTemplateSystemSignalRef=Vcu_Lin0_RxMsg2_Sig0
        Vcu_Lin0_RxMsg2_Sig1_oVcu_Lin0_RxMsg2_oLIN01_0392e49d_Rx: ComBitPosition=8, ComBitSize=8, ComSignalEndianness=LITTLE_ENDIAN, ComSignalInitValue=0, ComSignalType=UINT8, ComSystemTemplateSystemSignalRef=Vcu_Lin0_RxMsg2_Sig1
        Vcu_Lin0_RxMsg2_Sig2_oVcu_Lin0_RxMsg1_oLIN01_b8f0552d_Rx: ComBitPosition=16, ComBitSize=8, ComSignalEndianness=LITTLE_ENDIAN, ComSignalInitValue=0, ComSignalType=UINT8, ComSystemTemplateSystemSignalRef=Vcu_Lin0_RxMsg2_Sig2
        Vcu_Lin0_RxMsg2_Sig2_oVcu_Lin0_RxMsg2_oLIN01_367f52ce_Rx: ComBitPosition=16, ComBitSize=8, ComSignalEndianness=LITTLE_ENDIAN, ComSignalInitValue=0, ComSignalType=UINT8, ComSystemTemplateSystemSignalRef=Vcu_Lin0_RxMsg2_Sig2
        Vcu_Lin0_RxMsg2_Sig3_oVcu_Lin0_RxMsg1_oLIN01_1d7bc523_Rx: ComBitPosition=24, ComBitSize=8, ComSignalEndianness=LITTLE_ENDIAN, ComSignalInitValue=0, ComSignalType=UINT8, ComSystemTemplateSystemSignalRef=Vcu_Lin0_RxMsg2_Sig3
        Vcu_Lin0_RxMsg2_Sig3_oVcu_Lin0_RxMsg2_oLIN01_93f4c2c0_Rx: ComBitPosition=32, ComBitSize=8, ComSignalEndianness=LITTLE_ENDIAN, ComSignalInitValue=0, ComSignalType=UINT8, ComSystemTemplateSystemSignalRef=Vcu_Lin0_RxMsg2_Sig3
        Vcu_Lin0_TxMsg1_Sig0_oVcu_Lin0_TxMsg1_oLIN01_0005f3c6_Tx: ComBitPosition=0, ComBitSize=8, ComSignalEndianness=LITTLE_ENDIAN, ComSignalInitValue=0, ComSignalType=UINT8, ComSystemTemplateSystemSignalRef=Vcu_Lin0_TxMsg1_Sig0
        Vcu_Lin0_TxMsg1_Sig1_oVcu_Lin0_TxMsg1_oLIN01_a58e63c8_Tx: ComBitPosition=8, ComBitSize=8, ComSignalEndianness=LITTLE_ENDIAN, ComSignalInitValue=0, ComSignalType=UINT8, ComSystemTemplateSystemSignalRef=Vcu_Lin0_TxMsg1_Sig1
        Vcu_Lin0_TxMsg1_Sig2_oVcu_Lin0_TxMsg1_oLIN01_9063d59b_Tx: ComBitPosition=16, ComBitSize=8, ComSignalEndianness=LITTLE_ENDIAN, ComSignalInitValue=0, ComSignalType=UINT8, ComSystemTemplateSystemSignalRef=Vcu_Lin0_TxMsg1_Sig2
        Vcu_Lin0_TxMsg1_Sig3_oVcu_Lin0_TxMsg1_oLIN01_35e84595_Tx: ComBitPosition=24, ComBitSize=8, ComSignalEndianness=LITTLE_ENDIAN, ComSignalInitValue=0, ComSignalType=UINT8, ComSystemTemplateSystemSignalRef=Vcu_Lin0_TxMsg1_Sig3
        Vcu_Lin0_TxMsg2_Sig0_oVcu_Lin0_TxMsg2_oLIN01_ca2bd13d_Tx: ComBitPosition=0, ComBitSize=8, ComSignalEndianness=LITTLE_ENDIAN, ComSignalInitValue=0, ComSignalType=UINT8, ComSystemTemplateSystemSignalRef=Vcu_Lin0_TxMsg2_Sig0
        Vcu_Lin0_TxMsg2_Sig1_oVcu_Lin0_TxMsg2_oLIN01_6fa04133_Tx: ComBitPosition=8, ComBitSize=8, ComSignalEndianness=LITTLE_ENDIAN, ComSignalInitValue=0, ComSignalType=UINT8, ComSystemTemplateSystemSignalRef=Vcu_Lin0_TxMsg2_Sig1
        Vcu_Lin0_TxMsg2_Sig2_oVcu_Lin0_TxMsg2_oLIN01_5a4df760_Tx: ComBitPosition=16, ComBitSize=8, ComSignalEndianness=LITTLE_ENDIAN, ComSignalInitValue=0, ComSignalType=UINT8, ComSystemTemplateSystemSignalRef=Vcu_Lin0_TxMsg2_Sig2
        Vcu_Lin0_TxMsg2_Sig3_oVcu_Lin0_TxMsg2_oLIN01_ffc6676e_Tx: ComBitPosition=24, ComBitSize=8, ComSignalEndianness=LITTLE_ENDIAN, ComSignalInitValue=0, ComSignalType=UINT8, ComSystemTemplateSystemSignalRef=Vcu_Lin0_TxMsg2_Sig3
    ComGeneral
  module config ComM
    ComMConfigSet: ComMPncEnabled=false
      7 x ComMChannel:
        CN_KAMA_FP_EPT_0303_275b3e6e: ComMBusType=COMM_BUS_TYPE_CAN, ComMChannelId=0
          ComMNetworkManagement: ComMNmVariant=NONE
          CN_KAMA_FP_EPT_0303_a7b96f1e (ComMUserPerChannel): ComMUserChannel=CN_KAMA_FP_EPT_0303_b67fd6a6
        CN_LIN00_b12a0454: ComMBusType=COMM_BUS_TYPE_LIN, ComMChannelId=5
          ComMNetworkManagement: ComMNmVariant=NONE
          CN_LIN00_8453a76d (ComMUserPerChannel): ComMUserChannel=CN_LIN00_984dfd9e
        CN_LIN01_c62d34c2: ComMBusType=COMM_BUS_TYPE_LIN, ComMChannelId=6
          ComMNetworkManagement: ComMNmVariant=NONE
          CN_LIN01_e1349c2b (ComMUserPerChannel): ComMUserChannel=CN_LIN01_778f96a0
        CN_TC37X_VCU_CAN00_07b6c9c8: ComMBusType=COMM_BUS_TYPE_CAN, ComMChannelId=1
          ComMNetworkManagement: ComMNmVariant=FULL
          CN_TC37X_VCU_CAN00_cc35f66d (ComMUserPerChannel): ComMUserChannel=CN_TC37X_VCU_CAN00_b1b4f272
        CN_TC37X_VCU_CAN01_70b1f95e: ComMBusType=COMM_BUS_TYPE_CAN, ComMChannelId=2
          ComMNetworkManagement: ComMNmVariant=FULL
          CN_TC37X_VCU_CAN01_a952cd2b (ComMUserPerChannel): ComMUserChannel=CN_TC37X_VCU_CAN01_5e76994c
        CN_TC37X_VCU_CAN03_9ebf9872: ComMBusType=COMM_BUS_TYPE_CAN, ComMChannelId=3
          ComMNetworkManagement: ComMNmVariant=FULL
          CN_TC37X_VCU_CAN03_639cbba7 (ComMUserPerChannel): ComMUserChannel=CN_TC37X_VCU_CAN03_5a834971
        CN_TC37X_VCU_CAN12_f0a399a5: ComMBusType=COMM_BUS_TYPE_CAN, ComMChannelId=4
          ComMNetworkManagement: ComMNmVariant=FULL
          CN_TC37X_VCU_CAN12_9921037f (ComMUserPerChannel): ComMUserChannel=CN_TC37X_VCU_CAN12_74cffd8f
      7 x ComMUser:
        CN_KAMA_FP_EPT_0303_b67fd6a6: ComMUserIdentifier=0
        CN_LIN00_984dfd9e: ComMUserIdentifier=5
        CN_LIN01_778f96a0: ComMUserIdentifier=6
        CN_TC37X_VCU_CAN00_b1b4f272: ComMUserIdentifier=1
        CN_TC37X_VCU_CAN01_5e76994c: ComMUserIdentifier=2
        CN_TC37X_VCU_CAN03_5a834971: ComMUserIdentifier=3
        CN_TC37X_VCU_CAN12_74cffd8f: ComMUserIdentifier=4
    ComMGeneral: ComMPncIdCounting=COMM_PNC_ID_COUNT_FROM_NM_MESSAGE, ComMPncSupport=false
  module config Dcm
    DcmConfigSet  # Diagnostics Data Import
      DcmDsl
        DcmDslProtocol
          DcmDslProtocolRow_29812fbf (DcmDslProtocolRow)
            DcmDslConnection_15e709a3 (DcmDslConnection)
              DcmDslMainConnection_f109a58a (DcmDslMainConnection)
                Vcu_Uds_Func_Request_oTC37X_VCU_CAN00_21e26bac_Rx_f99a7a58 (DcmDslProtocolRx):
                  DcmDslProtocolRxAddrType = DCM_FUNCTIONAL_TYPE
                  DcmDslProtocolRxPduId = 1
                  DcmDslProtocolRxComMChannelRef = ComMConfigSet/CN_TC37X_VCU_CAN00_07b6c9c8
                  DcmDslProtocolRxPduRef = Vcu_Uds_Func_Request_oTC37X_VCU_CAN00_21e26bac_Rx
                Vcu_Uds_Phy_Request_oTC37X_VCU_CAN00_d561dcee_Rx_7ba0ca16 (DcmDslProtocolRx):
                  DcmDslProtocolRxAddrType = DCM_PHYSICAL_TYPE
                  DcmDslProtocolRxPduId = 2
                  DcmDslProtocolRxComMChannelRef = ComMConfigSet/CN_TC37X_VCU_CAN00_07b6c9c8
                  DcmDslProtocolRxPduRef = Vcu_Uds_Phy_Request_oTC37X_VCU_CAN00_d561dcee_Rx
                Vcu_Uds_Response_oTC37X_VCU_CAN00_4d111be6_Tx_666acd3e (DcmDslProtocolTx): DcmDslTxConfirmationPduId=0, DcmDslProtocolTxPduRef=EcucPduCollection/Vcu_Uds_Response_oTC37X_VCU_CAN00_4d111be6_Tx
      DcmDsp: DcmDspMaxDidToRead=5  # Diagnostics Data Import
        ComControl (DcmDspComControl)  # Diagnostics Data Import
          DspComContolAllChannel (DcmDspComControlAllChannel)  # Diagnostics Data Import
        DcmDspSession  # Diagnostics Data Import
          3 x DcmDspSessionRow, all with DcmDspSessionP2ServerMax=0.05, DcmDspSessionP2StarServerMax=5:
            Extended: DcmDspSessionLevel=3, DcmDspSessionForBoot=DCM_NO_BOOT  # Diagnostics Data Import
            Programming: DcmDspSessionLevel=2  # Diagnostics Data Import
            Default: DcmDspSessionLevel=1, DcmDspSessionForBoot=DCM_NO_BOOT  # Diagnostics Data Import
        DcmDspSecurity  # Diagnostics Data Import
          Level_3 (DcmDspSecurityRow):  # Diagnostics Data Import
            DcmDspSecurityADRSize = 2
            DcmDspSecurityDelayTime = 10
            DcmDspSecurityDelayTimeOnBoot = 0
            DcmDspSecurityKeySize = 2
            DcmDspSecurityLevel = 2
            DcmDspSecurityNumAttDelay = 3
            DcmDspSecuritySeedSize = 2
          UnlockedL1 (DcmDspSecurityRow):  # Diagnostics Data Import
            DcmDspSecurityDelayTime = 10
            DcmDspSecurityDelayTimeOnBoot = 0
            DcmDspSecurityKeySize = 4
            DcmDspSecurityLevel = 1
            DcmDspSecurityNumAttDelay = 3
            DcmDspSecuritySeedSize = 4
        RoutineInfo_Vcu_Roution_00 (DcmDspRoutineInfo)  # Diagnostics Data Import
          DcmDspRoutineRequestResOut  # Diagnostics Data Import
            Out_New_Data_Object (DcmDspRoutineRequestResOutSignal): DcmDspRoutineSignalLength=16, DcmDspRoutineSignalType=UINT16, DcmDspRoutineSignalEndianness=BIG_ENDIAN, DcmDspRoutineSignalPos=0  # Diagnostics Data Import
          DcmDspRoutineStopOut  # Diagnostics Data Import
            Out_New_Data_Object (DcmDspRoutineStopOutSignal): DcmDspRoutineSignalLength=16, DcmDspRoutineSignalType=UINT16, DcmDspRoutineSignalEndianness=BIG_ENDIAN, DcmDspRoutineSignalPos=0  # Diagnostics Data Import
          DcmDspRoutineStopIn  # Diagnostics Data Import
            In_New_Data_Object (DcmDspRoutineStopInSignal): DcmDspRoutineSignalLength=16, DcmDspRoutineSignalType=UINT16, DcmDspRoutineSignalEndianness=BIG_ENDIAN, DcmDspRoutineSignalPos=0  # Diagnostics Data Import
          DcmDspStartRoutineOut  # Diagnostics Data Import
            Out_New_Data_Object (DcmDspStartRoutineOutSignal): DcmDspRoutineSignalLength=16, DcmDspRoutineSignalType=UINT16, DcmDspRoutineSignalEndianness=BIG_ENDIAN, DcmDspRoutineSignalPos=0  # Diagnostics Data Import
          DcmDspStartRoutineIn  # Diagnostics Data Import
            In_New_Data_Object (DcmDspStartRoutineInSignal): DcmDspRoutineSignalLength=16, DcmDspRoutineSignalType=UINT16, DcmDspRoutineSignalEndianness=BIG_ENDIAN, DcmDspRoutineSignalPos=0  # Diagnostics Data Import
          DcmDspRoutineAuthorization: DcmDspRoutineSessionRef=DcmDspSession/Programming, DcmDspRoutineSessionRef=DcmDspSession/Extended  # Diagnostics Data Import
        RoutineInfo_New_Routine_Control (DcmDspRoutineInfo)  # Diagnostics Data Import
          DcmDspRoutineAuthorization: DcmDspRoutineSessionRef=DcmDspSession/Programming, DcmDspRoutineSessionRef=DcmDspSession/Extended  # Diagnostics Data Import
        Vcu_Roution_00 (DcmDspRoutine):  # Diagnostics Data Import
          DcmDspRequestResultsRoutineSupported = true
          DcmDspStopRoutineSupported = true
          DcmDspRoutineIdentifier = 261
          DcmDspRoutineInfoRef = RoutineInfo_Vcu_Roution_00
        New_Routine_Control (DcmDspRoutine):  # Diagnostics Data Import
          DcmDspRequestResultsRoutineSupported = false
          DcmDspStopRoutineSupported = false
          DcmDspRoutineIdentifier = 256
          DcmDspRoutineInfoRef = RoutineInfo_New_Routine_Control
        18 x DcmDspDidInfo:
          DidInfo_New_Dynamically_Define_Non_Periodic_Data: DcmDspDidDynamicallyDefined=true  # Diagnostics Data Import
            DcmDspDidAccess  # Diagnostics Data Import
              DcmDspDidDefine: DcmDspDDDidMaxElements=5  # Diagnostics Data Import
              DcmDspDidRead  # Diagnostics Data Import
          DidInfo_DID_0xF1A3  # Diagnostics Data Import
            DcmDspDidAccess  # Diagnostics Data Import
              DcmDspDidWrite  # Diagnostics Data Import
              DcmDspDidRead  # Diagnostics Data Import
          DidInfo_DID_0xF1A2  # Diagnostics Data Import
            DcmDspDidAccess  # Diagnostics Data Import
              DcmDspDidWrite  # Diagnostics Data Import
              DcmDspDidRead  # Diagnostics Data Import
          DidInfo_DID_0xF1A1  # Diagnostics Data Import
            DcmDspDidAccess  # Diagnostics Data Import
              DcmDspDidWrite  # Diagnostics Data Import
              DcmDspDidRead  # Diagnostics Data Import
          DidInfo_DID_0xF1A0  # Diagnostics Data Import
            DcmDspDidAccess  # Diagnostics Data Import
              DcmDspDidWrite  # Diagnostics Data Import
              DcmDspDidRead  # Diagnostics Data Import
          DidInfo_DID_0xF194_1  # Diagnostics Data Import
            DcmDspDidAccess  # Diagnostics Data Import
              DcmDspDidWrite  # Diagnostics Data Import
              DcmDspDidRead  # Diagnostics Data Import
          DidInfo_Hardware_Version  # Diagnostics Data Import
            DcmDspDidAccess  # Diagnostics Data Import
              DcmDspDidWrite  # Diagnostics Data Import
              DcmDspDidRead  # Diagnostics Data Import
          DidInfo_Vehicle_Identification  # Diagnostics Data Import
            DcmDspDidAccess  # Diagnostics Data Import
              DcmDspDidWrite  # Diagnostics Data Import
              DcmDspDidRead  # Diagnostics Data Import
          DidInfo_SerialNumber  # Diagnostics Data Import
            DcmDspDidAccess  # Diagnostics Data Import
              DcmDspDidWrite  # Diagnostics Data Import
              DcmDspDidRead  # Diagnostics Data Import
          DidInfo_EcuIdentification  # Diagnostics Data Import
            DcmDspDidAccess  # Diagnostics Data Import
              DcmDspDidWrite  # Diagnostics Data Import
              DcmDspDidRead  # Diagnostics Data Import
          DidInfo_Spare_Part_Number  # Diagnostics Data Import
            DcmDspDidAccess  # Diagnostics Data Import
              DcmDspDidWrite  # Diagnostics Data Import
              DcmDspDidRead  # Diagnostics Data Import
          DidInfo_Boot_Software  # Diagnostics Data Import
            DcmDspDidAccess  # Diagnostics Data Import
              DcmDspDidWrite  # Diagnostics Data Import
              DcmDspDidRead  # Diagnostics Data Import
          DidInfo_VCU_DID_00  # Diagnostics Data Import
            DcmDspDidAccess  # Diagnostics Data Import
              DcmDspDidWrite  # Diagnostics Data Import
              DcmDspDidRead  # Diagnostics Data Import
          DidInfo_DID_0x0400  # Diagnostics Data Import
            DcmDspDidAccess  # Diagnostics Data Import
              DcmDspDidRead  # Diagnostics Data Import
          DidInfo_DID_0x0300  # Diagnostics Data Import
            DcmDspDidAccess  # Diagnostics Data Import
              DcmDspDidRead  # Diagnostics Data Import
              DcmDspDidControl:  # Diagnostics Data Import
                DcmDspDidFreezeCurrentState = true
                DcmDspDidResetToDefault = true
                DcmDspDidReturnControlToEcu = true
                DcmDspDidShortTermAdjustment = true
                DcmDspDidControlSessionRef = DcmDspSession/Extended
          DidInfo_DID_0x0200  # Diagnostics Data Import
            DcmDspDidAccess  # Diagnostics Data Import
              DcmDspDidWrite  # Diagnostics Data Import
              DcmDspDidRead  # Diagnostics Data Import
          DidInfo_DataDiagnosticIdentifier_DDI  # Diagnostics Data Import
            DcmDspDidAccess  # Diagnostics Data Import
              DcmDspDidWrite  # Diagnostics Data Import
              DcmDspDidRead  # Diagnostics Data Import
          DidInfo_DevelopmentData  # Diagnostics Data Import
            DcmDspDidAccess  # Diagnostics Data Import
              DcmDspDidWrite  # Diagnostics Data Import
              DcmDspDidRead  # Diagnostics Data Import
        18 x DcmDspDid:
          New_Dynamically_Define_Non_Periodic_Data: DcmDspDidIdentifier=62208, DcmDspDidInfoRef=DidInfo_New_Dynamically_Define_Non_Periodic_Data  # Diagnostics Data Import
          DID_0xF1A3: DcmDspDidIdentifier=61859, DcmDspDidInfoRef=DidInfo_DID_0xF1A3  # Diagnostics Data Import
            F1A3_Data (DcmDspDidSignal): DcmDspDidDataPos=0, DcmDspDidDataRef=DID_0xF1A3_F1A3_Data  # Diagnostics Data Import
          DID_0xF1A2: DcmDspDidIdentifier=61858, DcmDspDidInfoRef=DidInfo_DID_0xF1A2  # Diagnostics Data Import
            F1A2_Data (DcmDspDidSignal): DcmDspDidDataPos=0, DcmDspDidDataRef=DID_0xF1A2_F1A2_Data  # Diagnostics Data Import
          DID_0xF1A1: DcmDspDidIdentifier=61857, DcmDspDidInfoRef=DidInfo_DID_0xF1A1  # Diagnostics Data Import
            F1A1_Data (DcmDspDidSignal): DcmDspDidDataPos=0, DcmDspDidDataRef=DID_0xF1A1_F1A1_Data  # Diagnostics Data Import
          DID_0xF1A0: DcmDspDidIdentifier=61856, DcmDspDidInfoRef=DidInfo_DID_0xF1A0  # Diagnostics Data Import
            F1A0_Data (DcmDspDidSignal): DcmDspDidDataPos=0, DcmDspDidDataRef=DID_0xF1A0_F1A0_Data  # Diagnostics Data Import
          DID_0xF194_1: DcmDspDidIdentifier=61844, DcmDspDidInfoRef=DidInfo_DID_0xF194_1  # Diagnostics Data Import
            New_Data_Object (DcmDspDidSignal): DcmDspDidDataPos=0, DcmDspDidDataRef=DID_0xF194_1_New_Data_Object  # Diagnostics Data Import
          Hardware_Version: DcmDspDidIdentifier=61843, DcmDspDidInfoRef=DidInfo_Hardware_Version  # Diagnostics Data Import
            Hardware_Version_Number (DcmDspDidSignal): DcmDspDidDataPos=0, DcmDspDidDataRef=Hardware_Version_Hardware_Version_Number  # Diagnostics Data Import
          Vehicle_Identification: DcmDspDidIdentifier=61840, DcmDspDidInfoRef=DidInfo_Vehicle_Identification  # Diagnostics Data Import
            VIN (DcmDspDidSignal): DcmDspDidDataPos=0, DcmDspDidDataRef=Vehicle_Identification_VIN  # Diagnostics Data Import
          SerialNumber: DcmDspDidIdentifier=61836, DcmDspDidInfoRef=DidInfo_SerialNumber  # Diagnostics Data Import
            SerialNumber (DcmDspDidSignal): DcmDspDidDataPos=0, DcmDspDidDataRef=SerialNumber_SerialNumber  # Diagnostics Data Import
          EcuIdentification: DcmDspDidIdentifier=61833, DcmDspDidInfoRef=DidInfo_EcuIdentification  # Diagnostics Data Import
            Part_Number (DcmDspDidSignal): DcmDspDidDataPos=0, DcmDspDidDataRef=EcuIdentification_Part_Number  # Diagnostics Data Import
          Spare_Part_Number: DcmDspDidIdentifier=61831, DcmDspDidInfoRef=DidInfo_Spare_Part_Number  # Diagnostics Data Import
            Spare_Part_Number (DcmDspDidSignal): DcmDspDidDataPos=0, DcmDspDidDataRef=Spare_Part_Number_Spare_Part_Number  # Diagnostics Data Import
          Boot_Software: DcmDspDidIdentifier=61824, DcmDspDidInfoRef=DidInfo_Boot_Software  # Diagnostics Data Import
            Boot_Software_Identification (DcmDspDidSignal): DcmDspDidDataPos=8, DcmDspDidDataRef=Boot_Software_Boot_Software_Identification  # Diagnostics Data Import
            NumberOfModules (DcmDspDidSignal): DcmDspDidDataPos=0, DcmDspDidDataRef=Boot_Software_NumberOfModules  # Diagnostics Data Import
          VCU_DID_00: DcmDspDidIdentifier=4132, DcmDspDidInfoRef=DidInfo_VCU_DID_00  # Diagnostics Data Import
            DataRecord (DcmDspDidSignal): DcmDspDidDataPos=0, DcmDspDidDataRef=VCU_DID_00_DataRecord  # Diagnostics Data Import
          DID_0x0400: DcmDspDidIdentifier=1024, DcmDspDidInfoRef=DidInfo_DID_0x0400  # Diagnostics Data Import
            DID_Data (DcmDspDidSignal): DcmDspDidDataPos=0, DcmDspDidDataRef=DID_0x0400_DID_Data  # Diagnostics Data Import
          DID_0x0300: DcmDspDidIdentifier=768, DcmDspDidInfoRef=DidInfo_DID_0x0300  # Diagnostics Data Import
            DID_Data (DcmDspDidSignal): DcmDspDidDataPos=0, DcmDspDidDataRef=DID_0x0300_DID_Data  # Diagnostics Data Import
          DID_0x0200: DcmDspDidIdentifier=512, DcmDspDidInfoRef=DidInfo_DID_0x0200  # Diagnostics Data Import
            Data (DcmDspDidSignal): DcmDspDidDataPos=0, DcmDspDidDataRef=DID_0x0200_Data  # Diagnostics Data Import
          DataDiagnosticIdentifier_DDI: DcmDspDidIdentifier=257, DcmDspDidInfoRef=DidInfo_DataDiagnosticIdentifier_DDI  # Diagnostics Data Import
            DataDiagnosticIdentifier (DcmDspDidSignal): DcmDspDidDataPos=0, DcmDspDidDataRef=DataDiagnosticIdentifier_DDI_DataDiagnosticIdentifier  # Diagnostics Data Import
          DevelopmentData: DcmDspDidIdentifier=256, DcmDspDidInfoRef=DidInfo_DevelopmentData  # Diagnostics Data Import
            5 x DcmDspDidSignal:
              TransportLayerVersion: DcmDspDidDataPos=64, DcmDspDidDataRef=DevelopmentData_TransportLayerVersion  # Diagnostics Data Import
              DiagnosticModuleVersion: DcmDspDidDataPos=48, DcmDspDidDataRef=DevelopmentData_DiagnosticModuleVersion  # Diagnostics Data Import
              NmVersion: DcmDspDidDataPos=32, DcmDspDidDataRef=DevelopmentData_NmVersion  # Diagnostics Data Import
              CanDriverVersion: DcmDspDidDataPos=16, DcmDspDidDataRef=DevelopmentData_CanDriverVersion  # Diagnostics Data Import
              OperatingSystemVersion: DcmDspDidDataPos=0, DcmDspDidDataRef=DevelopmentData_OperatingSystemVersion  # Diagnostics Data Import
        DataInfo_DID_0xF1A3_F1A3_Data (DcmDspDataInfo): DcmDspDataFixedLength=true  # Diagnostics Data Import
        DID_0xF1A3_F1A3_Data (DcmDspData): DcmDspDataSize=16, DcmDspDataType=UINT16, DcmDspDataInfoRef=DataInfo_DID_0xF1A3_F1A3_Data  # Diagnostics Data Import
        DataInfo_DID_0xF1A2_F1A2_Data (DcmDspDataInfo): DcmDspDataFixedLength=true  # Diagnostics Data Import
        DID_0xF1A2_F1A2_Data (DcmDspData): DcmDspDataSize=16, DcmDspDataType=UINT16, DcmDspDataInfoRef=DataInfo_DID_0xF1A2_F1A2_Data  # Diagnostics Data Import
        DataInfo_DID_0xF1A1_F1A1_Data (DcmDspDataInfo): DcmDspDataFixedLength=true  # Diagnostics Data Import
        DID_0xF1A1_F1A1_Data (DcmDspData): DcmDspDataSize=16, DcmDspDataType=UINT16, DcmDspDataInfoRef=DataInfo_DID_0xF1A1_F1A1_Data  # Diagnostics Data Import
        DataInfo_DID_0xF1A0_F1A0_Data (DcmDspDataInfo): DcmDspDataFixedLength=true  # Diagnostics Data Import
        DID_0xF1A0_F1A0_Data (DcmDspData): DcmDspDataSize=16, DcmDspDataType=UINT16, DcmDspDataInfoRef=DataInfo_DID_0xF1A0_F1A0_Data  # Diagnostics Data Import
        DataInfo_DID_0xF194_1_New_Data_Object (DcmDspDataInfo): DcmDspDataFixedLength=true  # Diagnostics Data Import
        DID_0xF194_1_New_Data_Object (DcmDspData): DcmDspDataSize=8, DcmDspDataType=UINT8, DcmDspDataInfoRef=DataInfo_DID_0xF194_1_New_Data_Object  # Diagnostics Data Import
        DataInfo_Hardware_Version_Hardware_Version_Number (DcmDspDataInfo): DcmDspDataFixedLength=true  # Diagnostics Data Import
        Hardware_Version_Hardware_Version_Number (DcmDspData): DcmDspDataSize=32, DcmDspDataType=UINT32, DcmDspDataInfoRef=DataInfo_Hardware_Version_Hardware_Version_Number  # Diagnostics Data Import
        DataInfo_Vehicle_Identification_VIN (DcmDspDataInfo): DcmDspDataFixedLength=true  # Diagnostics Data Import
        Vehicle_Identification_VIN (DcmDspData): DcmDspDataSize=136, DcmDspDataType=UINT8_N, DcmDspDataInfoRef=DataInfo_Vehicle_Identification_VIN  # Diagnostics Data Import
        DataInfo_SerialNumber_SerialNumber (DcmDspDataInfo): DcmDspDataFixedLength=true  # Diagnostics Data Import
        SerialNumber_SerialNumber (DcmDspData): DcmDspDataSize=32, DcmDspDataType=UINT32, DcmDspDataInfoRef=DataInfo_SerialNumber_SerialNumber  # Diagnostics Data Import
        DataInfo_EcuIdentification_Part_Number (DcmDspDataInfo): DcmDspDataFixedLength=true  # Diagnostics Data Import
        EcuIdentification_Part_Number (DcmDspData): DcmDspDataSize=104, DcmDspDataType=UINT8_N, DcmDspDataInfoRef=DataInfo_EcuIdentification_Part_Number  # Diagnostics Data Import
        DataInfo_Spare_Part_Number_Spare_Part_Number (DcmDspDataInfo): DcmDspDataFixedLength=true  # Diagnostics Data Import
        Spare_Part_Number_Spare_Part_Number (DcmDspData): DcmDspDataSize=32, DcmDspDataType=UINT32, DcmDspDataInfoRef=DataInfo_Spare_Part_Number_Spare_Part_Number  # Diagnostics Data Import
        DataInfo_Boot_Software_Boot_Software_Identification (DcmDspDataInfo): DcmDspDataFixedLength=true  # Diagnostics Data Import
        Boot_Software_Boot_Software_Identification (DcmDspData): DcmDspDataSize=32, DcmDspDataType=UINT32, DcmDspDataInfoRef=DataInfo_Boot_Software_Boot_Software_Identification  # Diagnostics Data Import
        DataInfo_Boot_Software_NumberOfModules (DcmDspDataInfo): DcmDspDataFixedLength=true  # Diagnostics Data Import
        Boot_Software_NumberOfModules (DcmDspData): DcmDspDataSize=8, DcmDspDataType=UINT8, DcmDspDataInfoRef=DataInfo_Boot_Software_NumberOfModules  # Diagnostics Data Import
        DataInfo_VCU_DID_00_DataRecord (DcmDspDataInfo): DcmDspDataFixedLength=true  # Diagnostics Data Import
        VCU_DID_00_DataRecord (DcmDspData): DcmDspDataSize=32, DcmDspDataType=UINT32, DcmDspDataInfoRef=DataInfo_VCU_DID_00_DataRecord  # Diagnostics Data Import
        DataInfo_DID_0x0400_DID_Data (DcmDspDataInfo): DcmDspDataFixedLength=true  # Diagnostics Data Import
        DID_0x0400_DID_Data (DcmDspData): DcmDspDataSize=16, DcmDspDataType=UINT16, DcmDspDataInfoRef=DataInfo_DID_0x0400_DID_Data  # Diagnostics Data Import
        DataInfo_DID_0x0300_DID_Data (DcmDspDataInfo): DcmDspDataFixedLength=true  # Diagnostics Data Import
        DID_0x0300_DID_Data (DcmDspData): DcmDspDataConditionCheckReadFncUsed=false, DcmDspDataSize=32, DcmDspDataType=UINT32, DcmDspDataInfoRef=DataInfo_DID_0x0300_DID_Data  # Diagnostics Data Import
        DataInfo_DID_0x0200_Data (DcmDspDataInfo): DcmDspDataFixedLength=true  # Diagnostics Data Import
        DID_0x0200_Data (DcmDspData): DcmDspDataSize=8, DcmDspDataType=UINT8, DcmDspDataInfoRef=DataInfo_DID_0x0200_Data  # Diagnostics Data Import
        DataInfo_DataDiagnosticIdentifier_DDI_DataDiagnosticIdentifier (DcmDspDataInfo): DcmDspDataFixedLength=true  # Diagnostics Data Import
        DataDiagnosticIdentifier_DDI_DataDiagnosticIdentifier (DcmDspData): DcmDspDataSize=16, DcmDspDataType=UINT16, DcmDspDataInfoRef=DataInfo_DataDiagnosticIdentifier_DDI_DataDiagnosticIdentifier  # Diagnostics Data Import
        DataInfo_DevelopmentData_TransportLayerVersion (DcmDspDataInfo): DcmDspDataFixedLength=true  # Diagnostics Data Import
        DevelopmentData_TransportLayerVersion (DcmDspData): DcmDspDataSize=16, DcmDspDataType=UINT16, DcmDspDataInfoRef=DataInfo_DevelopmentData_TransportLayerVersion  # Diagnostics Data Import
        DataInfo_DevelopmentData_DiagnosticModuleVersion (DcmDspDataInfo): DcmDspDataFixedLength=true  # Diagnostics Data Import
        DevelopmentData_DiagnosticModuleVersion (DcmDspData): DcmDspDataSize=16, DcmDspDataType=UINT16, DcmDspDataInfoRef=DataInfo_DevelopmentData_DiagnosticModuleVersion  # Diagnostics Data Import
        DataInfo_DevelopmentData_NmVersion (DcmDspDataInfo): DcmDspDataFixedLength=true  # Diagnostics Data Import
        DevelopmentData_NmVersion (DcmDspData): DcmDspDataSize=16, DcmDspDataType=UINT16, DcmDspDataInfoRef=DataInfo_DevelopmentData_NmVersion  # Diagnostics Data Import
        DataInfo_DevelopmentData_CanDriverVersion (DcmDspDataInfo): DcmDspDataFixedLength=true  # Diagnostics Data Import
        DevelopmentData_CanDriverVersion (DcmDspData): DcmDspDataSize=16, DcmDspDataType=UINT16, DcmDspDataInfoRef=DataInfo_DevelopmentData_CanDriverVersion  # Diagnostics Data Import
        DataInfo_DevelopmentData_OperatingSystemVersion (DcmDspDataInfo): DcmDspDataFixedLength=true  # Diagnostics Data Import
        DevelopmentData_OperatingSystemVersion (DcmDspData): DcmDspDataSize=16, DcmDspDataType=UINT16, DcmDspDataInfoRef=DataInfo_DevelopmentData_OperatingSystemVersion  # Diagnostics Data Import
      DcmDsd  # Diagnostics Data Import
        DcmDsdServiceTable  # Diagnostics Data Import
          15 x DcmDsdService:
            ControlDtcSetting: DcmDsdSidTabServiceId=133, DcmDsdSidTabSubfuncAvail=true  # Diagnostics Data Import
              Disable (DcmDsdSubService): DcmDsdSubServiceId=2  # Diagnostics Data Import
              Enable (DcmDsdSubService): DcmDsdSubServiceId=1  # Diagnostics Data Import
            TesterPresent: DcmDsdSidTabServiceId=62, DcmDsdSidTabSubfuncAvail=true  # Diagnostics Data Import
              TesterPresent (DcmDsdSubService): DcmDsdSubServiceId=0  # Diagnostics Data Import
            WriteMemoryByAddress: DcmDsdSidTabServiceId=61, DcmDsdSidTabSubfuncAvail=false  # Diagnostics Data Import
            RoutineControl: DcmDsdSidTabServiceId=49, DcmDsdSidTabSubfuncAvail=true, DcmDsdSidTabSessionLevelRef=DcmDspSession/Programming, DcmDsdSidTabSessionLevelRef=DcmDspSession/Extended  # Diagnostics Data Import
            IoControlById: DcmDsdSidTabServiceId=47, DcmDsdSidTabSubfuncAvail=false, DcmDsdSidTabSessionLevelRef=DcmDspSession/Extended  # Diagnostics Data Import
            WriteDataById: DcmDsdSidTabServiceId=46, DcmDsdSidTabSubfuncAvail=false  # Diagnostics Data Import
            DynamicallyDefineDataId: DcmDsdSidTabServiceId=44, DcmDsdSidTabSubfuncAvail=true  # Diagnostics Data Import
              3 x DcmDsdSubService:
                DynDefClr: DcmDsdSubServiceId=3  # Diagnostics Data Import
                DynDefByAddr: DcmDsdSubServiceId=2  # Diagnostics Data Import
                DynDefById: DcmDsdSubServiceId=1  # Diagnostics Data Import
            CommunicationControl: DcmDsdSidTabServiceId=40, DcmDsdSidTabSubfuncAvail=true, DcmDsdSidTabSessionLevelRef=DcmDspSession/Programming, DcmDsdSidTabSessionLevelRef=DcmDspSession/Extended  # Diagnostics Data Import
              4 x DcmDsdSubService, all with DcmDsdSubServiceSessionLevelRef=DcmDspSession/Programming, DcmDsdSubServiceSessionLevelRef=DcmDspSession/Extended:
                DisableRxAndTx: DcmDsdSubServiceId=3  # Diagnostics Data Import
                DisableRxAndEnableTx: DcmDsdSubServiceId=2  # Diagnostics Data Import
                EnableRxAndDisableTx: DcmDsdSubServiceId=1  # Diagnostics Data Import
                EnableRxAndTx: DcmDsdSubServiceId=0  # Diagnostics Data Import
            SecurityAccess: DcmDsdSidTabServiceId=39, DcmDsdSidTabSubfuncAvail=true, DcmDsdSidTabSessionLevelRef=DcmDspSession/Programming, DcmDsdSidTabSessionLevelRef=DcmDspSession/Extended  # Diagnostics Data Import
              4 x DcmDsdSubService, all with DcmDsdSubServiceSessionLevelRef=DcmDspSession/Programming, DcmDsdSubServiceSessionLevelRef=DcmDspSession/Extended:
                sendKey_Send: DcmDsdSubServiceId=4  # Diagnostics Data Import
                requestSeed_Request: DcmDsdSubServiceId=3  # Diagnostics Data Import
                KeyLevel1_Send: DcmDsdSubServiceId=2  # Diagnostics Data Import
                SeedLevel1_Request: DcmDsdSubServiceId=1  # Diagnostics Data Import
            ReadMemoryByAddress: DcmDsdSidTabServiceId=35, DcmDsdSidTabSubfuncAvail=false  # Diagnostics Data Import
            ReadDataById: DcmDsdSidTabServiceId=34, DcmDsdSidTabSubfuncAvail=false  # Diagnostics Data Import
            ReadDtcInfo: DcmDsdSidTabServiceId=25, DcmDsdSidTabSubfuncAvail=true  # Diagnostics Data Import
              14 x DcmDsdSubService:
                RDTCFDC: DcmDsdSubServiceId=20  # Diagnostics Data Import
                RMRCDTC: DcmDsdSubServiceId=14  # Diagnostics Data Import
                RMRTFDTC: DcmDsdSubServiceId=13  # Diagnostics Data Import
                RFCDTC: DcmDsdSubServiceId=12  # Diagnostics Data Import
                RFTFDTC: DcmDsdSubServiceId=11  # Diagnostics Data Import
                RSUPDTC: DcmDsdSubServiceId=10  # Diagnostics Data Import
                RSIODTC: DcmDsdSubServiceId=9  # Diagnostics Data Import
                RDTCBSMR: DcmDsdSubServiceId=8  # Diagnostics Data Import
                RNODTCBSMR: DcmDsdSubServiceId=7  # Diagnostics Data Import
                RDTCEDRBDN: DcmDsdSubServiceId=6  # Diagnostics Data Import
                RDTCSSBDTC: DcmDsdSubServiceId=4  # Diagnostics Data Import
                RDTCSSI: DcmDsdSubServiceId=3  # Diagnostics Data Import
                RDTCBSM: DcmDsdSubServiceId=2  # Diagnostics Data Import
                RNODTCBSM: DcmDsdSubServiceId=1  # Diagnostics Data Import
            ClearDiagInfo: DcmDsdSidTabServiceId=20, DcmDsdSidTabSubfuncAvail=false  # Diagnostics Data Import
            EcuReset: DcmDsdSidTabServiceId=17, DcmDsdSidTabSubfuncAvail=true  # Diagnostics Data Import
              Soft (DcmDsdSubService): DcmDsdSubServiceId=3  # Diagnostics Data Import
              Hard (DcmDsdSubService): DcmDsdSubServiceId=1  # Diagnostics Data Import
            DiagSessionControl: DcmDsdSidTabServiceId=16, DcmDsdSidTabSubfuncAvail=true  # Diagnostics Data Import
              3 x DcmDsdSubService:
                Extended: DcmDsdSubServiceId=3  # Diagnostics Data Import
                Programming: DcmDsdSubServiceId=2  # Diagnostics Data Import
                Default: DcmDsdSubServiceId=1  # Diagnostics Data Import
      DcmGeneral: DcmResetToFblAfterSessionFinalResponseEnabled=false  # Diagnostics Data Import
  module config Dem
    DemGeneral:  # Diagnostics Data Import
      DemAgingCycleCounterProcessing = DEM_PROCESS_AGINGCTR_INTERN
      DemDebounceCounterBasedSupport = true
      DemEnableConditionSupport = true
      DemPTOSupport = false
      DemDtcStatusAvailabilityMask = 255
      DemTypeOfFreezeFrameRecordNumeration = DEM_FF_RECNUM_CALCULATED
      7 x DemDataClass:
        ExtendedDataRecord0x01_Fault_Aging_Counter: DemDataElementDataSize=1, DemDataElementInternalData=DEM_AGINGCTR_DOWNCNT, DemDataElementUsePort=USE_DATA_INTERNAL  # Diagnostics Data Import
        ExtendedDataRecord0x02_Fault_Aging_Counte_Up: DemDataElementDataSize=1, DemDataElementInternalData=DEM_AGINGCTR_UPCNT, DemDataElementUsePort=USE_DATA_INTERNAL  # Diagnostics Data Import
        ExtendedDataRecord0x01_Occurence_Counter: DemDataElementDataSize=1, DemDataElementInternalData=DEM_OCCCTR, DemDataElementUsePort=USE_DATA_INTERNAL  # Diagnostics Data Import
        DID_0xf1a3_F1A3_Data: DemDataElementDataSize=2, DemDataElementDataType=UINT16, DemDataElementEndianness=BIG_ENDIAN, DemDataElementUsePort=USE_DATA_CLIENT_SERVER_PORT, DemDataElementStoreNonVolatile=true  # Diagnostics Data Import
        DID_0xf1a2_F1A2_Data: DemDataElementDataSize=2, DemDataElementDataType=UINT16, DemDataElementEndianness=BIG_ENDIAN, DemDataElementUsePort=USE_DATA_CLIENT_SERVER_PORT, DemDataElementStoreNonVolatile=true  # Diagnostics Data Import
        DID_0xf1a1_F1A1_Data: DemDataElementDataSize=2, DemDataElementDataType=UINT16, DemDataElementEndianness=BIG_ENDIAN, DemDataElementUsePort=USE_DATA_CLIENT_SERVER_PORT, DemDataElementStoreNonVolatile=true  # Diagnostics Data Import
        DID_0xf1a0_F1A0_Data: DemDataElementDataSize=2, DemDataElementDataType=UINT16, DemDataElementEndianness=BIG_ENDIAN, DemDataElementUsePort=USE_DATA_CLIENT_SERVER_PORT, DemDataElementStoreNonVolatile=true  # Diagnostics Data Import
      PowerCycle (DemOperationCycle): DemOperationCycleType=DEM_OPCYC_POWER  # Diagnostics Data Import
      WarningIndicator (DemIndicator)  # Diagnostics Data Import
      FreezeFrameClass_8de652ca (DemFreezeFrameClass): DemDidClassRef=DemGeneral/DID_0xF1A0, DemDidClassRef=DemGeneral/DID_0xF1A1, DemDidClassRef=DemGeneral/DID_0xF1A2  # Diagnostics Data Import
      FreezeFrameClass_34739cdf (DemFreezeFrameClass):  # Diagnostics Data Import
        DemDidClassRef = DemGeneral/DID_0xF1A{0..3}
      ExtendedDataRecord0x02 (DemExtendedDataRecordClass): DemExtendedDataRecordNumber=2, DemDataClassRef=ExtendedDataRecord0x02_Fault_Aging_Counte_Up  # Diagnostics Data Import
      ExtendedDataRecord0x01 (DemExtendedDataRecordClass):  # Diagnostics Data Import
        DemExtendedDataRecordNumber = 1
        DemDataClassRef = ExtendedDataRecord0x01_Occurence_Counter
        DemDataClassRef = ExtendedDataRecord0x01_Fault_Aging_Counter
      EnableConditionGroup_Example_EnableCondition1 (DemEnableConditionGroup): DemEnableConditionRef=Example_EnableCondition1  # Diagnostics Data Import
      EnableConditionGroup_2f9cc720 (DemEnableConditionGroup): DemEnableConditionRef=Example_EnableCondition1, DemEnableConditionRef=Example_EnableCondition2  # Diagnostics Data Import
      ExtendedDataClass_4f5344cd (DemExtendedDataClass): DemExtendedDataRecordClassRef=ExtendedDataRecord0x01, DemExtendedDataRecordClassRef=ExtendedDataRecord0x02  # Diagnostics Data Import
      Example_EnableCondition2 (DemEnableCondition)  # Diagnostics Data Import
      Example_EnableCondition1 (DemEnableCondition)  # Diagnostics Data Import
      4 x DemDidClass:
        DID_0xF1A3: DemDidIdentifier=61859, DemDidDataClassRef=DID_0xf1a3_F1A3_Data  # Diagnostics Data Import
        DID_0xF1A2: DemDidIdentifier=61858, DemDidDataClassRef=DID_0xf1a2_F1A2_Data  # Diagnostics Data Import
        DID_0xF1A1: DemDidIdentifier=61857, DemDidDataClassRef=DID_0xf1a1_F1A1_Data  # Diagnostics Data Import
        DID_0xF1A0: DemDidIdentifier=61856, DemDidDataClassRef=DID_0xf1a0_F1A0_Data  # Diagnostics Data Import
    DemConfigSet  # Diagnostics Data Import
      CAN00_BUSOFF (DemEventParameter):  # Diagnostics Data Import
        DemEventKind = DEM_EVENT_KIND_SWC
        DemMaxNumberFreezeFrameRecords = 2
        DemDTCClassRef = DTCClass_CAN00_BUSOFF
        DemExtendedDataClassRef = ExtendedDataClass_4f5344cd
        DemFreezeFrameClassRef = FreezeFrameClass_8de652ca
        DemEventClass:  # Diagnostics Data Import
          DemAgingAllowed = true
          DemAgingCycleCounterThreshold = 40
          DemEventDestination = DEM_DTC_ORIGIN_PRIMARY_MEMORY
          DemEventPriority = 3
          DemEventSignificance = DEM_EVENT_SIGNIFICANCE_FAULT
          DemEventFailureCycleCounterThreshold = 3
          DemAgingCycleRef = PowerCycle
          DemOperationCycleRef = PowerCycle
          IndicatorAttribute_WarningIndicator (DemIndicatorAttribute): DemIndicatorFailureCycleSource=DEM_FAILURE_CYCLE_EVENT, DemIndicatorHealingCycleRef=PowerCycle, DemIndicatorRef=WarningIndicator  # Diagnostics Data Import
          DemDebounceAlgorithmClass  # Diagnostics Data Import
            DemDebounceCounterBased:  # Diagnostics Data Import
              DemDebounceCounterDecrementStepSize = 1
              DemDebounceCounterIncrementStepSize = 1
              DemDebounceCounterJumpDown = false
              DemDebounceCounterJumpUp = true
              DemDebounceCounterFailedThreshold = 40
              DemDebounceCounterPassedThreshold = -40
      DTCClass_CAN00_BUSOFF (DemDTCClass): DemDTCSeverity=DEM_DTC_SEV_NO_SEVERITY, DemUdsDTC=13631748  # Diagnostics Data Import
      DTC_0X000003 (DemEventParameter):  # Diagnostics Data Import
        DemEventKind = DEM_EVENT_KIND_SWC
        DemMaxNumberFreezeFrameRecords = 2
        DemDTCClassRef = DTCClass_DTC_0X000003
        DemExtendedDataClassRef = ExtendedDataClass_4f5344cd
        DemFreezeFrameClassRef = FreezeFrameClass_8de652ca
        DemEventClass:  # Diagnostics Data Import
          DemAgingAllowed = true
          DemAgingCycleCounterThreshold = 40
          DemEventDestination = DEM_DTC_ORIGIN_PRIMARY_MEMORY
          DemEventPriority = 2
          DemEventSignificance = DEM_EVENT_SIGNIFICANCE_FAULT
          DemEventFailureCycleCounterThreshold = 3
          DemAgingCycleRef = PowerCycle
          DemEnableConditionGroupRef = EnableConditionGroup_Example_EnableCondition1
          DemOperationCycleRef = PowerCycle
          IndicatorAttribute_WarningIndicator (DemIndicatorAttribute): DemIndicatorFailureCycleSource=DEM_FAILURE_CYCLE_EVENT, DemIndicatorHealingCycleRef=PowerCycle, DemIndicatorRef=WarningIndicator  # Diagnostics Data Import
          DemDebounceAlgorithmClass  # Diagnostics Data Import
            DemDebounceCounterBased:  # Diagnostics Data Import
              DemDebounceCounterDecrementStepSize = 32
              DemDebounceCounterIncrementStepSize = 32
              DemDebounceCounterJumpDown = false
              DemDebounceCounterJumpUp = false
              DemDebounceCounterFailedThreshold = 40
              DemDebounceCounterPassedThreshold = -40
      DTCClass_DTC_0X000003 (DemDTCClass): DemDTCSeverity=DEM_DTC_SEV_NO_SEVERITY, DemUdsDTC=771  # Diagnostics Data Import
      DTC_0X000002 (DemEventParameter):  # Diagnostics Data Import
        DemEventKind = DEM_EVENT_KIND_SWC
        DemMaxNumberFreezeFrameRecords = 2
        DemDTCClassRef = DTCClass_DTC_0X000002
        DemExtendedDataClassRef = ExtendedDataClass_4f5344cd
        DemFreezeFrameClassRef = FreezeFrameClass_34739cdf
        DemEventClass:  # Diagnostics Data Import
          DemAgingAllowed = true
          DemAgingCycleCounterThreshold = 40
          DemEventDestination = DEM_DTC_ORIGIN_PRIMARY_MEMORY
          DemEventPriority = 1
          DemEventSignificance = DEM_EVENT_SIGNIFICANCE_FAULT
          DemEventFailureCycleCounterThreshold = 3
          DemAgingCycleRef = PowerCycle
          DemEnableConditionGroupRef = EnableConditionGroup_2f9cc720
          DemOperationCycleRef = PowerCycle
          IndicatorAttribute_WarningIndicator (DemIndicatorAttribute): DemIndicatorFailureCycleSource=DEM_FAILURE_CYCLE_EVENT, DemIndicatorHealingCycleRef=PowerCycle, DemIndicatorRef=WarningIndicator  # Diagnostics Data Import
          DemDebounceAlgorithmClass  # Diagnostics Data Import
            DemDebounceCounterBased:  # Diagnostics Data Import
              DemDebounceCounterDecrementStepSize = 1
              DemDebounceCounterIncrementStepSize = 1
              DemDebounceCounterJumpDown = false
              DemDebounceCounterJumpUp = true
              DemDebounceCounterFailedThreshold = 40
              DemDebounceCounterPassedThreshold = -40
      DTCClass_DTC_0X000002 (DemDTCClass): DemDTCSeverity=DEM_DTC_SEV_NO_SEVERITY, DemUdsDTC=514  # Diagnostics Data Import
      DTC_0X000004 (DemEventParameter):  # Diagnostics Data Import
        DemEventKind = DEM_EVENT_KIND_SWC
        DemMaxNumberFreezeFrameRecords = 2
        DemDTCClassRef = DTCClass_DTC_0X000004
        DemExtendedDataClassRef = ExtendedDataClass_4f5344cd
        DemFreezeFrameClassRef = FreezeFrameClass_8de652ca
        DemEventClass:  # Diagnostics Data Import
          DemAgingAllowed = true
          DemAgingCycleCounterThreshold = 40
          DemEventDestination = DEM_DTC_ORIGIN_PRIMARY_MEMORY
          DemEventPriority = 4
          DemEventSignificance = DEM_EVENT_SIGNIFICANCE_FAULT
          DemEventFailureCycleCounterThreshold = 3
          DemAgingCycleRef = PowerCycle
          DemOperationCycleRef = PowerCycle
          IndicatorAttribute_WarningIndicator (DemIndicatorAttribute): DemIndicatorFailureCycleSource=DEM_FAILURE_CYCLE_EVENT, DemIndicatorHealingCycleRef=PowerCycle, DemIndicatorRef=WarningIndicator  # Diagnostics Data Import
          DemDebounceAlgorithmClass  # Diagnostics Data Import
            DemDebounceCounterBased:  # Diagnostics Data Import
              DemDebounceCounterDecrementStepSize = 1
              DemDebounceCounterIncrementStepSize = 1
              DemDebounceCounterJumpDown = false
              DemDebounceCounterJumpUp = true
              DemDebounceCounterFailedThreshold = 40
              DemDebounceCounterPassedThreshold = -40
      DTCClass_DTC_0X000004 (DemDTCClass): DemDTCSeverity=DEM_DTC_SEV_NO_SEVERITY, DemUdsDTC=4  # Diagnostics Data Import
  module config EcuC
    EcucPduCollection: PduIdTypeEnum=UINT8, PduLengthTypeEnum=UINT8
      149 x Pdu:
        EDCU_EXV2_oLIN00_18b050dc_Tx: DynamicLength=false, PduLength=8, SysTPduToFrameMappingRef=EDCU_EXV2
        EDCU_EXV2_oLIN00_1f8750a5_Tx: DynamicLength=false, PduLength=8
        EXV2_Status_oLIN00_7fcf9f75_Rx: DynamicLength=false, PduLength=8, SysTPduToFrameMappingRef=EXV2_Status
        EXV2_Status_oLIN00_d5e93929_Rx: DynamicLength=false, PduLength=8
        EXV_1_VCU_oLIN00_366267d6_Rx: DynamicLength=false, PduLength=8, SysTPduToFrameMappingRef=EXV_1_VCU
        EXV_1_VCU_oLIN00_69d4ef5f_Rx: DynamicLength=false, PduLength=8
        EXV_2_VCU_oLIN00_1e4a3daf_Rx: DynamicLength=false, PduLength=8
        EXV_2_VCU_oLIN00_85f64a15_Rx: DynamicLength=false, PduLength=8, SysTPduToFrameMappingRef=EXV_2_VCU
        HVCH_Rsp01_oLIN00_a6e33eef_Rx: DynamicLength=false, PduLength=8
        HVCH_Rsp01_oLIN00_d50f5fa3_Rx: DynamicLength=false, PduLength=8, SysTPduToFrameMappingRef=HVCH_Rsp01
        HVCH_Rsp02_oLIN00_286c390c_Rx: DynamicLength=false, PduLength=8
        HVCH_Rsp02_oLIN00_a3ea669e_Rx: DynamicLength=false, PduLength=8, SysTPduToFrameMappingRef=HVCH_Rsp02
        MasterReq_ERV_oLIN00_10f4fcd8_Tx: DynamicLength=true, PduLength=8
        MasterReq_ERV_oLIN00_f3aa7150_Tx: DynamicLength=true, PduLength=8
        MasterReq_EXV_1_oLIN00_52f4d550_Tx: DynamicLength=true, PduLength=8
        MasterReq_EXV_1_oLIN00_cdcee39b_Tx: DynamicLength=true, PduLength=8
        MasterReq_EXV_2_oLIN00_bb2bdaa6_Tx: DynamicLength=true, PduLength=8
        MasterReq_EXV_2_oLIN00_dc7bd2b3_Tx: DynamicLength=true, PduLength=8
        MasterReq_GWM_oLIN01_08407441_Tx: DynamicLength=true, PduLength=8
        MasterReq_GWM_oLIN01_25aef125_Tx: DynamicLength=true, PduLength=8
        MasterReq_HVCH_oLIN00_0c968313_Tx: DynamicLength=true, PduLength=8
        MasterReq_HVCH_oLIN00_726494b3_Tx: DynamicLength=true, PduLength=8
        MasterReq_PMP_1_oLIN00_14f05772_Tx: DynamicLength=true, PduLength=8
        MasterReq_PMP_1_oLIN00_90773f5d_Tx: DynamicLength=true, PduLength=8
        MasterReq_PMP_2_oLIN00_9a7f5091_Tx: DynamicLength=true, PduLength=8
        MasterReq_PMP_2_oLIN00_e6920660_Tx: DynamicLength=true, PduLength=8
        MasterReq_SVA_oLIN00_11d66449_Tx: DynamicLength=true, PduLength=8
        MasterReq_SVA_oLIN00_deabba25_Tx: DynamicLength=true, PduLength=8
        MasterReq_Tp_oLIN00_7147b638_Tx: DynamicLength=false, PduLength=8, SysTPduToFrameMappingRef=MasterReq_Tp
        MasterReq_Tp_oLIN01_a828173f_Tx: DynamicLength=false, PduLength=8, SysTPduToFrameMappingRef=MasterReq_Tp
        MasterReq_oLIN00_3234fe1b_Tx: DynamicLength=true, PduLength=8
        MasterReq_oLIN00_4a2bb011_Tx: DynamicLength=true, PduLength=8
        MasterReq_oLIN01_3d2c8087_Tx: DynamicLength=true, PduLength=8
        MasterReq_oLIN01_eb5b5f1c_Tx: DynamicLength=true, PduLength=8
        PMP2_Sts_oLIN00_200c907c_Rx: DynamicLength=false, PduLength=8, SysTPduToFrameMappingRef=PMP2_Sts
        PMP2_Sts_oLIN00_cab90b6b_Rx: DynamicLength=false, PduLength=8
        PMP3_Sts_oLIN00_4e808b3d_Rx: DynamicLength=false, PduLength=8, SysTPduToFrameMappingRef=PMP3_Sts
        PMP3_Sts_oLIN00_511c4704_Rx: DynamicLength=false, PduLength=8
        PMP_Cmd_oLIN00_3912b28b_Tx: DynamicLength=false, PduLength=8
        PMP_Cmd_oLIN00_6d889c97_Tx: DynamicLength=false, PduLength=8, SysTPduToFrameMappingRef=PMP_Cmd
        SVA_VCU_STD_oLIN00_4526aa1c_Rx: DynamicLength=false, PduLength=8
        SVA_VCU_STD_oLIN00_4f0795ef_Rx: DynamicLength=false, PduLength=8, SysTPduToFrameMappingRef=SVA_VCU_STD
        SlaveResp_ERV_oLIN00_4c387f1b_Rx: DynamicLength=true, PduLength=8
        SlaveResp_ERV_oLIN00_e833ce7b_Rx: DynamicLength=true, PduLength=8
        SlaveResp_EXV_1_oLIN00_1f09933d_Rx: DynamicLength=true, PduLength=8
        SlaveResp_EXV_1_oLIN00_39fbe7c0_Rx: DynamicLength=true, PduLength=8
        SlaveResp_EXV_2_oLIN00_4f1edefd_Rx: DynamicLength=true, PduLength=8
        SlaveResp_EXV_2_oLIN00_918694de_Rx: DynamicLength=true, PduLength=8
        SlaveResp_GWM_oLIN01_9a3cff6e_Rx: DynamicLength=true, PduLength=8
        SlaveResp_GWM_oLIN01_f08746e2_Rx: DynamicLength=true, PduLength=8
        SlaveResp_HVCH_oLIN00_43b1b673_Rx: DynamicLength=true, PduLength=8
        SlaveResp_HVCH_oLIN00_93d59ea5_Rx: DynamicLength=true, PduLength=8
        SlaveResp_PMP_1_oLIN00_590d111f_Rx: DynamicLength=true, PduLength=8
        SlaveResp_PMP_1_oLIN00_64423b06_Rx: DynamicLength=true, PduLength=8
        SlaveResp_PMP_2_oLIN00_12a7023b_Rx: DynamicLength=true, PduLength=8
        SlaveResp_PMP_2_oLIN00_d78216fc_Rx: DynamicLength=true, PduLength=8
        SlaveResp_SVA_oLIN00_6139b46e_Rx: DynamicLength=true, PduLength=8
        SlaveResp_SVA_oLIN00_e91156ea_Rx: DynamicLength=true, PduLength=8
        SlaveResp_Tp_oLIN00_3328eb0b_Rx: DynamicLength=false, PduLength=8, SysTPduToFrameMappingRef=SlaveResp_Tp
        SlaveResp_Tp_oLIN01_ea474a0c_Rx: DynamicLength=false, PduLength=8, SysTPduToFrameMappingRef=SlaveResp_Tp
        TCU_HVCH_Cmd_oLIN00_385d5651_Tx: DynamicLength=false, PduLength=4
        TCU_HVCH_Cmd_oLIN00_ddc31229_Tx: DynamicLength=false, PduLength=4, SysTPduToFrameMappingRef=TCU_HVCH_Cmd
        VCU_EXV_1_oLIN00_50eec975_Tx: DynamicLength=false, PduLength=8
        VCU_EXV_1_oLIN00_58a890ac_Tx: DynamicLength=false, PduLength=8, SysTPduToFrameMappingRef=VCU_EXV_1
        VCU_EXV_2_oLIN00_2e4da991_Tx: DynamicLength=false, PduLength=8, SysTPduToFrameMappingRef=VCU_EXV_2
        VCU_EXV_2_oLIN00_de61ce96_Tx: DynamicLength=false, PduLength=8
        VCU_Minor_01_oKAMA_FP_EPT_0303_39c0a2ee_Tx: DynamicLength=false, PduLength=8
        VCU_Minor_01_oKAMA_FP_EPT_0303_45280963_Tx: DynamicLength=false, PduLength=8, SysTPduToFrameMappingRef=VCU_Minor_01
        VCU_Minor_02_oKAMA_FP_EPT_0303_7ae377f6_Tx: DynamicLength=false, PduLength=8, SysTPduToFrameMappingRef=VCU_Minor_02
        VCU_Minor_02_oKAMA_FP_EPT_0303_9a962447_Tx: DynamicLength=false, PduLength=8
        VCU_Minor_03_oKAMA_FP_EPT_0303_4d74a41f_Rx: DynamicLength=false, PduLength=8
        VCU_Minor_03_oKAMA_FP_EPT_0303_d9755fba_Rx: DynamicLength=false, PduLength=8, SysTPduToFrameMappingRef=VCU_Minor_03
        VCU_Rx_500h_NM_oTC37X_VCU_CAN00_c4b96e15_Rx: DynamicLength=false, PduLength=8, SysTPduToFrameMappingRef=VCU_Rx_500h_NM
        VCU_Rx_500h_NM_oTC37X_VCU_CAN01_54a3f814_Rx: DynamicLength=false, PduLength=8, SysTPduToFrameMappingRef=VCU_Rx_500h_NM
        VCU_Rx_500h_NM_oTC37X_VCU_CAN03_afe7d257_Rx: DynamicLength=false, PduLength=8, SysTPduToFrameMappingRef=VCU_Rx_500h_NM
        VCU_Rx_500h_NM_oTC37X_VCU_CAN12_486a6e56_Rx: DynamicLength=false, PduLength=8, SysTPduToFrameMappingRef=VCU_Rx_500h_NM
        VCU_SVA_CMD_oLIN00_756d14f6_Tx: DynamicLength=false, PduLength=8
        VCU_SVA_CMD_oLIN00_89e2bb7b_Tx: DynamicLength=false, PduLength=8, SysTPduToFrameMappingRef=VCU_SVA_CMD
        VCU_Tx_51Ch_NM_oTC37X_VCU_CAN00_0aa0ce62_Tx: DynamicLength=false, PduLength=8, SysTPduToFrameMappingRef=VCU_Tx_51Ch_NM
        VCU_Tx_51Ch_NM_oTC37X_VCU_CAN01_9aba5863_Tx: DynamicLength=false, PduLength=8, SysTPduToFrameMappingRef=VCU_Tx_51Ch_NM
        VCU_Tx_51Ch_NM_oTC37X_VCU_CAN03_61fe7220_Tx: DynamicLength=false, PduLength=8, SysTPduToFrameMappingRef=VCU_Tx_51Ch_NM
        VCU_Tx_51Ch_NM_oTC37X_VCU_CAN12_8673ce21_Tx: DynamicLength=false, PduLength=8, SysTPduToFrameMappingRef=VCU_Tx_51Ch_NM
        VcuAdcTxMsg1_oTC37X_VCU_CAN01_6685c7bf_Tx: DynamicLength=false, PduLength=8, SysTPduToFrameMappingRef=VcuAdcTxMsg1
        VcuAdcTxMsg1_oTC37X_VCU_CAN01_fda515ee_Tx: DynamicLength=false, PduLength=8
        VcuAdcTxMsg2_oTC37X_VCU_CAN01_1723c88c_Tx: DynamicLength=false, PduLength=8
        VcuAdcTxMsg2_oTC37X_VCU_CAN01_afb1dcb2_Tx: DynamicLength=false, PduLength=8, SysTPduToFrameMappingRef=VcuAdcTxMsg2
        VcuCan03RxMsg1_oTC37X_VCU_CAN03_4dd213bb_Rx: DynamicLength=false, PduLength=8, SysTPduToFrameMappingRef=VcuCan03RxMsg1
        VcuCan03RxMsg1_oTC37X_VCU_CAN03_77e3a75f_Rx: DynamicLength=false, PduLength=8
        VcuCan03RxMsg2_oTC37X_VCU_CAN03_84e608b6_Rx: DynamicLength=false, PduLength=8, SysTPduToFrameMappingRef=VcuCan03RxMsg2
        VcuCan03RxMsg2_oTC37X_VCU_CAN03_9d657a3d_Rx: DynamicLength=false, PduLength=8
        VcuCan03TxMsg1_oTC37X_VCU_CAN03_9a29d525_Tx: DynamicLength=false, PduLength=8
        VcuCan03TxMsg1_oTC37X_VCU_CAN03_c0767973_Tx: DynamicLength=false, PduLength=8, SysTPduToFrameMappingRef=VcuCan03TxMsg1
        VcuCan03TxMsg2_oTC37X_VCU_CAN03_0942627e_Tx: DynamicLength=false, PduLength=8, SysTPduToFrameMappingRef=VcuCan03TxMsg2
        VcuCan03TxMsg2_oTC37X_VCU_CAN03_70af0847_Tx: DynamicLength=false, PduLength=8
        VcuCan12RxMsg3_oTC37X_VCU_CAN12_2f1174ae_Rx: DynamicLength=false, PduLength=8, SysTPduToFrameMappingRef=VcuCan12RxMsg3
        VcuCan12RxMsg3_oTC37X_VCU_CAN12_38853822_Rx: DynamicLength=false, PduLength=8
        VcuCan12RxMsg4_oTC37X_VCU_CAN12_211bb20e_Rx: DynamicLength=false, PduLength=8, SysTPduToFrameMappingRef=VcuCan12RxMsg4
        VcuCan12RxMsg4_oTC37X_VCU_CAN12_d9ab3246_Rx: DynamicLength=false, PduLength=8
        VcuCan12TxMsg1_oTC37X_VCU_CAN12_2c92f390_Tx: DynamicLength=false, PduLength=8, SysTPduToFrameMappingRef=VcuCan12TxMsg1
        VcuCan12TxMsg1_oTC37X_VCU_CAN12_d09b21db_Tx: DynamicLength=false, PduLength=8
        VcuCan12TxMsg2_oTC37X_VCU_CAN12_3a1dfcb9_Tx: DynamicLength=false, PduLength=8
        VcuCan12TxMsg2_oTC37X_VCU_CAN12_e5a6e89d_Tx: DynamicLength=false, PduLength=8, SysTPduToFrameMappingRef=VcuCan12TxMsg2
        VcuRxMsg1_oTC37X_VCU_CAN00_4589bbed_Rx: DynamicLength=false, PduLength=8, SysTPduToFrameMappingRef=VcuRxMsg1
        VcuRxMsg1_oTC37X_VCU_CAN00_78805594_Rx: DynamicLength=false, PduLength=8
        VcuRxMsg2_oTC37X_VCU_CAN00_8cbda0e0_Rx: DynamicLength=false, PduLength=8, SysTPduToFrameMappingRef=VcuRxMsg2
        VcuRxMsg2_oTC37X_VCU_CAN00_920688f6_Rx: DynamicLength=false, PduLength=8
        VcuRxMsg3_oTC37X_VCU_CAN01_0a530e81_Rx: DynamicLength=false, PduLength=8
        VcuRxMsg3_oTC37X_VCU_CAN01_5bb4c01a_Rx: DynamicLength=false, PduLength=8, SysTPduToFrameMappingRef=VcuRxMsg3
        VcuRxMsg4_oTC37X_VCU_CAN01_55be06ba_Rx: DynamicLength=false, PduLength=8, SysTPduToFrameMappingRef=VcuRxMsg4
        VcuRxMsg4_oTC37X_VCU_CAN01_eb7d04e5_Rx: DynamicLength=false, PduLength=8
        VcuTxIoMsg1_oTC37X_VCU_CAN00_54884add_Tx: DynamicLength=false, PduLength=8
        VcuTxIoMsg1_oTC37X_VCU_CAN00_869e33bc_Tx: DynamicLength=false, PduLength=8, SysTPduToFrameMappingRef=VcuTxIoMsg1
        VcuTxIoMsg2_oTC37X_VCU_CAN00_4faa28b1_Tx: DynamicLength=false, PduLength=8, SysTPduToFrameMappingRef=VcuTxIoMsg2
        VcuTxIoMsg2_oTC37X_VCU_CAN00_be0e97bf_Tx: DynamicLength=false, PduLength=8
        VcuTxIoMsg3_oTC37X_VCU_CAN00_08b9de4a_Tx: DynamicLength=false, PduLength=8, SysTPduToFrameMappingRef=VcuTxIoMsg3
        VcuTxIoMsg3_oTC37X_VCU_CAN00_515c215e_Tx: DynamicLength=false, PduLength=8
        VcuTxIoMsg4_oTC37X_VCU_CAN00_06b318ea_Tx: DynamicLength=false, PduLength=8, SysTPduToFrameMappingRef=VcuTxIoMsg4
        VcuTxIoMsg4_oTC37X_VCU_CAN00_b0722b3a_Tx: DynamicLength=false, PduLength=8
        VcuTxIoMsg5_oTC37X_VCU_CAN00_41a0ee11_Tx: DynamicLength=false, PduLength=8, SysTPduToFrameMappingRef=VcuTxIoMsg5
        VcuTxIoMsg5_oTC37X_VCU_CAN00_5f209ddb_Tx: DynamicLength=false, PduLength=8
        VcuTxIoMsg6_oTC37X_VCU_CAN00_8894f51c_Tx: DynamicLength=false, PduLength=8, SysTPduToFrameMappingRef=VcuTxIoMsg6
        VcuTxIoMsg6_oTC37X_VCU_CAN00_b5a640b9_Tx: DynamicLength=false, PduLength=8
        VcuTxIoMsg7_oTC37X_VCU_CAN00_5af4f658_Tx: DynamicLength=false, PduLength=8
        VcuTxIoMsg7_oTC37X_VCU_CAN00_cf8703e7_Tx: DynamicLength=false, PduLength=8, SysTPduToFrameMappingRef=VcuTxIoMsg7
        VcuTxIoMsg8_oTC37X_VCU_CAN00_9481785c_Tx: DynamicLength=false, PduLength=8, SysTPduToFrameMappingRef=VcuTxIoMsg8
        VcuTxIoMsg8_oTC37X_VCU_CAN00_ac8b5230_Tx: DynamicLength=false, PduLength=8
        VcuTxMsg1_oTC37X_VCU_CAN00_954a27ee_Tx: DynamicLength=false, PduLength=8
        VcuTxMsg1_oTC37X_VCU_CAN00_c82dd125_Tx: DynamicLength=false, PduLength=8, SysTPduToFrameMappingRef=VcuTxMsg1
        VcuTxMsg2_oTC37X_VCU_CAN00_0119ca28_Tx: DynamicLength=false, PduLength=8, SysTPduToFrameMappingRef=VcuTxMsg2
        VcuTxMsg2_oTC37X_VCU_CAN00_7fccfa8c_Tx: DynamicLength=false, PduLength=8
        Vcu_Lin0_RxMsg1_oLIN01_079b7478_Rx: DynamicLength=false, PduLength=8, SysTPduToFrameMappingRef=Vcu_Lin0_RxMsg1
        Vcu_Lin0_RxMsg1_oLIN01_24780c64_Rx: DynamicLength=false, PduLength=8
        Vcu_Lin0_RxMsg2_oLIN01_717e4d45_Rx: DynamicLength=false, PduLength=8, SysTPduToFrameMappingRef=Vcu_Lin0_RxMsg2
        Vcu_Lin0_RxMsg2_oLIN01_aaf70b87_Rx: DynamicLength=false, PduLength=8
        Vcu_Lin0_TxMsg1_oLIN01_02277a36_Tx: DynamicLength=false, PduLength=8, SysTPduToFrameMappingRef=Vcu_Lin0_TxMsg1
        Vcu_Lin0_TxMsg1_oLIN01_849dd3b9_Tx: DynamicLength=false, PduLength=8
        Vcu_Lin0_TxMsg2_oLIN01_0a12d45a_Tx: DynamicLength=false, PduLength=8
        Vcu_Lin0_TxMsg2_oLIN01_74c2430b_Tx: DynamicLength=false, PduLength=8, SysTPduToFrameMappingRef=Vcu_Lin0_TxMsg2
        Vcu_Uds_Func_Request_Tp_oTC37X_VCU_CAN00_3dbedef7_Rx: DynamicLength=false, PduLength=8, SysTPduToFrameMappingRef=Vcu_Uds_Func_Request_Tp
        Vcu_Uds_Func_Request_oTC37X_VCU_CAN00_21e26bac_Rx: DynamicLength=true, PduLength=7
        Vcu_Uds_Func_Request_oTC37X_VCU_CAN00_455d4346_Rx: DynamicLength=true, PduLength=7
        Vcu_Uds_Phy_Request_Tp_oTC37X_VCU_CAN00_58c52463_Rx: DynamicLength=false, PduLength=8, SysTPduToFrameMappingRef=Vcu_Uds_Phy_Request_Tp
        Vcu_Uds_Phy_Request_oTC37X_VCU_CAN00_16119f6f_Rx: DynamicLength=true, PduLength=8
        Vcu_Uds_Phy_Request_oTC37X_VCU_CAN00_d561dcee_Rx: DynamicLength=true, PduLength=8
        Vcu_Uds_Response_Tp_oTC37X_VCU_CAN00_834178f3_Tx: DynamicLength=false, PduLength=8, SysTPduToFrameMappingRef=Vcu_Uds_Response_Tp
        Vcu_Uds_Response_oTC37X_VCU_CAN00_39638a1a_Tx: DynamicLength=true, PduLength=8
        Vcu_Uds_Response_oTC37X_VCU_CAN00_4d111be6_Tx: DynamicLength=true, PduLength=8
        XCP_Request_oTC37X_VCU_CAN00_3c25b45e_Rx: DynamicLength=false, PduLength=8, SysTPduToFrameMappingRef=XCP_Request
        XCP_Response_oTC37X_VCU_CAN00_34d2da2d_Tx: DynamicLength=false, PduLength=8, SysTPduToFrameMappingRef=XCP_Response
  module config EcuM
    EcuMConfiguration
      EcuMCommonConfiguration
        EcuMDriverInitListOne
        EcuMDriverRestartList
        7 x EcuMWakeupSource:
          CN_KAMA_FP_EPT_0303_275b3e6e: EcuMWakeupSourceId=5, EcuMComMChannelRef=ComMConfigSet/CN_KAMA_FP_EPT_0303_275b3e6e
          CN_LIN00_b12a0454: EcuMWakeupSourceId=10, EcuMComMChannelRef=ComMConfigSet/CN_LIN00_b12a0454
          CN_LIN01_c62d34c2: EcuMWakeupSourceId=11, EcuMComMChannelRef=ComMConfigSet/CN_LIN01_c62d34c2
          CN_TC37X_VCU_CAN00_07b6c9c8: EcuMWakeupSourceId=6, EcuMComMChannelRef=ComMConfigSet/CN_TC37X_VCU_CAN00_07b6c9c8
          CN_TC37X_VCU_CAN01_70b1f95e: EcuMWakeupSourceId=7, EcuMComMChannelRef=ComMConfigSet/CN_TC37X_VCU_CAN01_70b1f95e
          CN_TC37X_VCU_CAN03_9ebf9872: EcuMWakeupSourceId=8, EcuMComMChannelRef=ComMConfigSet/CN_TC37X_VCU_CAN03_9ebf9872
          CN_TC37X_VCU_CAN12_f0a399a5: EcuMWakeupSourceId=9, EcuMComMChannelRef=ComMConfigSet/CN_TC37X_VCU_CAN12_f0a399a5
      EcuMFlexConfiguration: EcuMFlexModuleConfigurationRef=CanConfigSet, EcuMFlexModuleConfigurationRef=LinGlobalConfig
  module config Lin
    LinGlobalConfig
      CN_LIN00_b12a0454 (LinChannel): LinChannelBaudRate=19200, LinChannelId=0, LinChannelEcuMWakeupSource=EcuMCommonConfiguration/CN_LIN00_b12a0454  # LIN00
      CN_LIN01_c62d34c2 (LinChannel): LinChannelBaudRate=19200, LinChannelId=1, LinChannelEcuMWakeupSource=EcuMCommonConfiguration/CN_LIN01_c62d34c2  # LIN01
  module config LinIf
    LinIfGeneral: LinIfJ2602ResponseToleranceSupport=false
    LinIfGlobalConfig
      CHNL_45618847 (LinIfChannel): LinIfClusterTimeBase=0.005, LinIfChannelRef=LinGlobalConfig/CN_LIN00_b12a0454, LinIfComMNetworkHandleRef=ComMConfigSet/CN_LIN00_b12a0454
        16 x LinIfFrame:
          FT_EDCU_EXV2_cbc2ea70_Tx: LinIfChecksumType=ENHANCED, LinIfLength=8, LinIfPid=226
            LinIfPduDirection
              LinIfTxPdu_51fe7a72 (LinIfTxPdu): LinIfTxPduRef=EcucPduCollection/EDCU_EXV2_oLIN00_18b050dc_Tx
          FT_EXV2_Status_7cc3db8b_Rx: LinIfChecksumType=ENHANCED, LinIfLength=8, LinIfPid=146
            LinIfPduDirection
              LinIfRxPdu: LinIfRxPduRef=EcucPduCollection/EXV2_Status_oLIN00_7fcf9f75_Rx
          FT_EXV_1_VCU_83f01f29_Rx: LinIfChecksumType=ENHANCED, LinIfLength=8, LinIfPid=173
            LinIfPduDirection
              LinIfRxPdu: LinIfRxPduRef=EcucPduCollection/EXV_1_VCU_oLIN00_366267d6_Rx
          FT_EXV_2_VCU_c45065f9_Rx: LinIfChecksumType=ENHANCED, LinIfLength=8, LinIfPid=245
            LinIfPduDirection
              LinIfRxPdu: LinIfRxPduRef=EcucPduCollection/EXV_2_VCU_oLIN00_85f64a15_Rx
          FT_HVCH_Rsp01_09d67b55_Rx: LinIfChecksumType=ENHANCED, LinIfLength=8, LinIfPid=214
            LinIfPduDirection
              LinIfRxPdu: LinIfRxPduRef=EcucPduCollection/HVCH_Rsp01_oLIN00_d50f5fa3_Rx
          FT_HVCH_Rsp02_90df2aef_Rx: LinIfChecksumType=ENHANCED, LinIfLength=8, LinIfPid=151
            LinIfPduDirection
              LinIfRxPdu: LinIfRxPduRef=EcucPduCollection/HVCH_Rsp02_oLIN00_a3ea669e_Rx
          FT_MasterReq_355bc768_Tx: LinIfChecksumType=CLASSIC, LinIfFrameType=MRF, LinIfLength=8, LinIfPid=60
            LinIfPduDirection
              LinIfInternalPdu
          FT_PMP2_Sts_c93e4d7b_Rx: LinIfChecksumType=ENHANCED, LinIfLength=8, LinIfPid=166
            LinIfPduDirection
              LinIfRxPdu: LinIfRxPduRef=EcucPduCollection/PMP2_Sts_oLIN00_200c907c_Rx
          FT_PMP3_Sts_f45e64cb_Rx: LinIfChecksumType=ENHANCED, LinIfLength=8, LinIfPid=231
            LinIfPduDirection
              LinIfRxPdu: LinIfRxPduRef=EcucPduCollection/PMP3_Sts_oLIN00_4e808b3d_Rx
          FT_PMP_Cmd_bd05f3f5_Tx: LinIfChecksumType=ENHANCED, LinIfLength=8, LinIfPid=100
            LinIfPduDirection
              LinIfTxPdu_c5fc6a36 (LinIfTxPdu): LinIfTxPduRef=EcucPduCollection/PMP_Cmd_oLIN00_6d889c97_Tx
          FT_SVA_VCU_STD_d43d5185_Rx: LinIfChecksumType=ENHANCED, LinIfLength=8, LinIfPid=17
            LinIfPduDirection
              LinIfRxPdu: LinIfRxPduRef=EcucPduCollection/SVA_VCU_STD_oLIN00_4f0795ef_Rx
          FT_SlaveResp_9d5cbedc_Rx: LinIfChecksumType=CLASSIC, LinIfFrameType=SRF, LinIfLength=8, LinIfPid=125
            LinIfPduDirection
              LinIfInternalPdu
          FT_TCU_HVCH_Cmd_ccc60f64_Tx: LinIfChecksumType=ENHANCED, LinIfLength=4, LinIfPid=85
            LinIfPduDirection
              LinIfTxPdu_d8f856fb (LinIfTxPdu): LinIfTxPduRef=EcucPduCollection/TCU_HVCH_Cmd_oLIN00_ddc31229_Tx
          FT_VCU_EXV_1_3ba9d0d7_Tx: LinIfChecksumType=ENHANCED, LinIfLength=8, LinIfPid=31
            LinIfPduDirection
              LinIfTxPdu_66470162 (LinIfTxPdu): LinIfTxPduRef=EcucPduCollection/VCU_EXV_1_oLIN00_58a890ac_Tx
          FT_VCU_EXV_2_a2a0816d_Tx: LinIfChecksumType=ENHANCED, LinIfLength=8, LinIfPid=180
            LinIfPduDirection
              LinIfTxPdu_814bac9f (LinIfTxPdu): LinIfTxPduRef=EcucPduCollection/VCU_EXV_2_oLIN00_2e4da991_Tx
          FT_VCU_SVA_CMD_86a423b3_Tx: LinIfChecksumType=ENHANCED, LinIfLength=8, LinIfPid=80
            LinIfPduDirection
              LinIfTxPdu_d60e946c (LinIfTxPdu): LinIfTxPduRef=EcucPduCollection/VCU_SVA_CMD_oLIN00_89e2bb7b_Tx
        LinIfNodeType  # CT_LIN00
          CT_LIN00_7284c7d4 (LinIfMaster): LinIfJitter=0.0001
        NULLSchedule_CHNL_45618847 (LinIfScheduleTable): LinIfResumePosition=CONTINUE_AT_IT_POINT, LinIfRunMode=RUN_CONTINUOUS, LinIfScheduleMode=LINTP_APPLICATIVE_SCHEDULE, LinIfScheduleTableIndex=0
        TCU_LIN_Schedule_740f8639 (LinIfScheduleTable): LinIfRunMode=RUN_CONTINUOUS, LinIfScheduleTableIndex=1, LinIfScheduleTableName=
          14 x LinIfEntry:
            TCU_LIN_Schedule_00931437: LinIfDelay=0.1, LinIfEntryIndex=2, LinIfFrameRef=FT_VCU_EXV_1_3ba9d0d7_Tx
            TCU_LIN_Schedule_05477fb4: LinIfDelay=0.01, LinIfEntryIndex=0, LinIfFrameRef=FT_EDCU_EXV2_cbc2ea70_Tx
            TCU_LIN_Schedule_0b3bc331: LinIfDelay=0.01, LinIfEntryIndex=6, LinIfFrameRef=FT_PMP_Cmd_bd05f3f5_Tx
            TCU_LIN_Schedule_0b57a2ce: LinIfDelay=0.02, LinIfEntryIndex=11, LinIfFrameRef=FT_TCU_HVCH_Cmd_ccc60f64_Tx
            TCU_LIN_Schedule_0e83c94d: LinIfDelay=0.02, LinIfEntryIndex=13, LinIfFrameRef=FT_HVCH_Rsp02_90df2aef_Rx
            TCU_LIN_Schedule_0eefa8b2: LinIfDelay=0.1, LinIfEntryIndex=4, LinIfFrameRef=FT_VCU_EXV_2_a2a0816d_Tx
            TCU_LIN_Schedule_1216d1b8: LinIfDelay=0.01, LinIfEntryIndex=8, LinIfFrameRef=FT_PMP3_Sts_f45e64cb_Rx
            TCU_LIN_Schedule_e1bd1e53: LinIfDelay=0.1, LinIfEntryIndex=5, LinIfFrameRef=FT_EXV_2_VCU_c45065f9_Rx
            TCU_LIN_Schedule_e1d17fac: LinIfDelay=0.02, LinIfEntryIndex=12, LinIfFrameRef=FT_HVCH_Rsp01_09d67b55_Rx
            TCU_LIN_Schedule_e405142f: LinIfDelay=0.015, LinIfEntryIndex=10, LinIfFrameRef=FT_SVA_VCU_STD_d43d5185_Rx
            TCU_LIN_Schedule_e46975d0: LinIfDelay=0.01, LinIfEntryIndex=7, LinIfFrameRef=FT_PMP2_Sts_c93e4d7b_Rx
            TCU_LIN_Schedule_ea15c955: LinIfDelay=0.01, LinIfEntryIndex=1, LinIfFrameRef=FT_EXV2_Status_7cc3db8b_Rx
            TCU_LIN_Schedule_efc1a2d6: LinIfDelay=0.1, LinIfEntryIndex=3, LinIfFrameRef=FT_EXV_1_VCU_83f01f29_Rx
            TCU_LIN_Schedule_fd446759: LinIfDelay=0.015, LinIfEntryIndex=9, LinIfFrameRef=FT_VCU_SVA_CMD_86a423b3_Tx
      CHNL_8e3d5be2 (LinIfChannel): LinIfClusterTimeBase=0.005, LinIfChannelRef=LinGlobalConfig/CN_LIN01_c62d34c2, LinIfComMNetworkHandleRef=ComMConfigSet/CN_LIN01_c62d34c2
        6 x LinIfFrame, all with LinIfLength=8:
          FT_MasterReq_e2b94730_Tx: LinIfChecksumType=CLASSIC, LinIfFrameType=MRF, LinIfPid=60
            LinIfPduDirection
              LinIfInternalPdu
          FT_SlaveResp_4abe3e84_Rx: LinIfChecksumType=CLASSIC, LinIfFrameType=SRF, LinIfPid=125
            LinIfPduDirection
              LinIfInternalPdu
          FT_Vcu_Lin0_RxMsg1_83589417_Rx: LinIfChecksumType=ENHANCED, LinIfPid=32
            LinIfPduDirection
              LinIfRxPdu: LinIfRxPduRef=EcucPduCollection/Vcu_Lin0_RxMsg1_oLIN01_079b7478_Rx
          FT_Vcu_Lin0_RxMsg2_1a51c5ad_Rx: LinIfChecksumType=ENHANCED, LinIfPid=97
            LinIfPduDirection
              LinIfRxPdu: LinIfRxPduRef=EcucPduCollection/Vcu_Lin0_RxMsg2_oLIN01_717e4d45_Rx
          FT_Vcu_Lin0_TxMsg1_5501770a_Tx: LinIfChecksumType=ENHANCED, LinIfPid=94
            LinIfPduDirection
              LinIfTxPdu_76dd5725 (LinIfTxPdu): LinIfTxPduRef=EcucPduCollection/Vcu_Lin0_TxMsg1_oLIN01_02277a36_Tx
          FT_Vcu_Lin0_TxMsg2_cc0826b0_Tx: LinIfChecksumType=ENHANCED, LinIfPid=31
            LinIfPduDirection
              LinIfTxPdu_87e9e0e9 (LinIfTxPdu): LinIfTxPduRef=EcucPduCollection/Vcu_Lin0_TxMsg2_oLIN01_74c2430b_Tx
        LinIfNodeType  # CT_LIN01
          CT_LIN01_0583f742 (LinIfMaster): LinIfJitter=0.0001
        NULLSchedule (LinIfScheduleTable): LinIfResumePosition=CONTINUE_AT_IT_POINT, LinIfRunMode=RUN_CONTINUOUS, LinIfScheduleMode=LINTP_APPLICATIVE_SCHEDULE, LinIfScheduleTableIndex=0
        Vcu_Lin0_Schedule_0e999bb4 (LinIfScheduleTable): LinIfRunMode=RUN_CONTINUOUS, LinIfScheduleTableIndex=1, LinIfScheduleTableName=
          4 x LinIfEntry, all with LinIfDelay=0.02:
            Vcu_Lin0_Schedule_519d2303: LinIfEntryIndex=2, LinIfFrameRef=FT_Vcu_Lin0_RxMsg1_83589417_Rx
            Vcu_Lin0_Schedule_54494880: LinIfEntryIndex=0, LinIfFrameRef=FT_Vcu_Lin0_TxMsg1_5501770a_Tx
            Vcu_Lin0_Schedule_bb1bfe61: LinIfEntryIndex=1, LinIfFrameRef=FT_Vcu_Lin0_TxMsg2_cc0826b0_Tx
            Vcu_Lin0_Schedule_becf95e2: LinIfEntryIndex=3, LinIfFrameRef=FT_Vcu_Lin0_RxMsg2_1a51c5ad_Rx
  module config LinSM
    LinSMConfigSet
      CHNL_45618847 (LinSMChannel): LinSMNodeType=MASTER, LinSMComMNetworkHandleRef=ComMConfigSet/CN_LIN00_b12a0454
        CHNL_45618847_32a17f26 (LinSMSchedule): LinSMScheduleIndex=0, LinSMScheduleIndexRef=NULLSchedule_CHNL_45618847
        TCU_LIN_Schedule_740f8639 (LinSMSchedule): LinSMScheduleIndex=1, LinSMScheduleIndexRef=CHNL_45618847/TCU_LIN_Schedule_740f8639
      CHNL_8e3d5be2 (LinSMChannel): LinSMNodeType=MASTER, LinSMComMNetworkHandleRef=ComMConfigSet/CN_LIN01_c62d34c2
        CHNL_8e3d5be2_a66eb9f7 (LinSMSchedule): LinSMScheduleIndex=0, LinSMScheduleIndexRef=NULLSchedule
        Vcu_Lin0_Schedule_0e999bb4 (LinSMSchedule): LinSMScheduleIndex=1, LinSMScheduleIndexRef=CHNL_8e3d5be2/Vcu_Lin0_Schedule_0e999bb4
  module config LinTp
    LinTpGeneral: LinTpFunctionalRequestsSupported=true
    LinTpGlobalConfig
      CHNL_45618847 (LinTpChannelConfig): LinTpChannelRef=LinIfGlobalConfig/CHNL_45618847
      CHNL_8e3d5be2 (LinTpChannelConfig): LinTpChannelRef=LinIfGlobalConfig/CHNL_8e3d5be2
      8 x LinTpRxNSdu, all with LinTpDl=8:
        SlaveResp_ERV_oLIN00_e833ce7b_Rx: LinTpRxNSduNad=98, LinTpRxNSduChannelRef=LinIfGlobalConfig/CHNL_45618847, LinTpRxNSduPduRef=EcucPduCollection/SlaveResp_ERV_oLIN00_4c387f1b_Rx
        SlaveResp_EXV_1_oLIN00_1f09933d_Rx: LinTpRxNSduNad=99, LinTpRxNSduChannelRef=LinIfGlobalConfig/CHNL_45618847, LinTpRxNSduPduRef=EcucPduCollection/SlaveResp_EXV_1_oLIN00_39fbe7c0_Rx
        SlaveResp_EXV_2_oLIN00_918694de_Rx: LinTpRxNSduNad=100, LinTpRxNSduChannelRef=LinIfGlobalConfig/CHNL_45618847, LinTpRxNSduPduRef=EcucPduCollection/SlaveResp_EXV_2_oLIN00_4f1edefd_Rx
        SlaveResp_GWM_oLIN01_f08746e2_Rx: LinTpRxNSduNad=82, LinTpRxNSduChannelRef=LinIfGlobalConfig/CHNL_8e3d5be2, LinTpRxNSduPduRef=EcucPduCollection/SlaveResp_GWM_oLIN01_9a3cff6e_Rx
        SlaveResp_HVCH_oLIN00_43b1b673_Rx: LinTpRxNSduNad=91, LinTpRxNSduChannelRef=LinIfGlobalConfig/CHNL_45618847, LinTpRxNSduPduRef=EcucPduCollection/SlaveResp_HVCH_oLIN00_93d59ea5_Rx
        SlaveResp_PMP_1_oLIN00_590d111f_Rx: LinTpRxNSduNad=116, LinTpRxNSduChannelRef=LinIfGlobalConfig/CHNL_45618847, LinTpRxNSduPduRef=EcucPduCollection/SlaveResp_PMP_1_oLIN00_64423b06_Rx
        SlaveResp_PMP_2_oLIN00_d78216fc_Rx: LinTpRxNSduNad=117, LinTpRxNSduChannelRef=LinIfGlobalConfig/CHNL_45618847, LinTpRxNSduPduRef=EcucPduCollection/SlaveResp_PMP_2_oLIN00_12a7023b_Rx
        SlaveResp_SVA_oLIN00_e91156ea_Rx: LinTpRxNSduNad=101, LinTpRxNSduChannelRef=LinIfGlobalConfig/CHNL_45618847, LinTpRxNSduPduRef=EcucPduCollection/SlaveResp_SVA_oLIN00_6139b46e_Rx
      10 x LinTpTxNSdu:
        MasterReq_ERV_oLIN00_10f4fcd8_Tx: LinTpTxNSduNad=98, LinTpTxNSduChannelRef=LinIfGlobalConfig/CHNL_45618847, LinTpTxNSduPduRef=EcucPduCollection/MasterReq_ERV_oLIN00_f3aa7150_Tx
        MasterReq_EXV_1_oLIN00_52f4d550_Tx: LinTpTxNSduNad=99, LinTpTxNSduChannelRef=LinIfGlobalConfig/CHNL_45618847, LinTpTxNSduPduRef=EcucPduCollection/MasterReq_EXV_1_oLIN00_cdcee39b_Tx
        MasterReq_EXV_2_oLIN00_dc7bd2b3_Tx: LinTpTxNSduNad=100, LinTpTxNSduChannelRef=LinIfGlobalConfig/CHNL_45618847, LinTpTxNSduPduRef=EcucPduCollection/MasterReq_EXV_2_oLIN00_bb2bdaa6_Tx
        MasterReq_GWM_oLIN01_08407441_Tx: LinTpTxNSduNad=82, LinTpTxNSduChannelRef=LinIfGlobalConfig/CHNL_8e3d5be2, LinTpTxNSduPduRef=EcucPduCollection/MasterReq_GWM_oLIN01_25aef125_Tx
        MasterReq_HVCH_oLIN00_0c968313_Tx: LinTpTxNSduNad=91, LinTpTxNSduChannelRef=LinIfGlobalConfig/CHNL_45618847, LinTpTxNSduPduRef=EcucPduCollection/MasterReq_HVCH_oLIN00_726494b3_Tx
        MasterReq_PMP_1_oLIN00_14f05772_Tx: LinTpTxNSduNad=116, LinTpTxNSduChannelRef=LinIfGlobalConfig/CHNL_45618847, LinTpTxNSduPduRef=EcucPduCollection/MasterReq_PMP_1_oLIN00_90773f5d_Tx
        MasterReq_PMP_2_oLIN00_9a7f5091_Tx: LinTpTxNSduNad=117, LinTpTxNSduChannelRef=LinIfGlobalConfig/CHNL_45618847, LinTpTxNSduPduRef=EcucPduCollection/MasterReq_PMP_2_oLIN00_e6920660_Tx
        MasterReq_SVA_oLIN00_11d66449_Tx: LinTpTxNSduNad=101, LinTpTxNSduChannelRef=LinIfGlobalConfig/CHNL_45618847, LinTpTxNSduPduRef=EcucPduCollection/MasterReq_SVA_oLIN00_deabba25_Tx
        MasterReq_oLIN00_4a2bb011_Tx: LinTpTxNSduNad=126, LinTpTxNSduChannelRef=LinIfGlobalConfig/CHNL_45618847, LinTpTxNSduPduRef=EcucPduCollection/MasterReq_oLIN00_3234fe1b_Tx
        MasterReq_oLIN01_3d2c8087_Tx: LinTpTxNSduNad=126, LinTpTxNSduChannelRef=LinIfGlobalConfig/CHNL_8e3d5be2, LinTpTxNSduPduRef=EcucPduCollection/MasterReq_oLIN01_eb5b5f1c_Tx
  module config Nm
    4 x NmChannelConfig:
      CN_TC37X_VCU_CAN00_07b6c9c8: NmComMChannelRef=ComMConfigSet/CN_TC37X_VCU_CAN00_07b6c9c8
        TC37X_VCU_CAN00_CAN_cc8c31fa (NmBusType)
          NmStandardBusNmConfig: NmStandardBusType=NM_BUSNM_CANNM  # TC37X_VCU_CAN00_CAN
      CN_TC37X_VCU_CAN01_70b1f95e: NmComMChannelRef=ComMConfigSet/CN_TC37X_VCU_CAN01_70b1f95e
        TC37X_VCU_CAN01_CAN_f1ec184a (NmBusType)
          NmStandardBusNmConfig: NmStandardBusType=NM_BUSNM_CANNM  # TC37X_VCU_CAN01_CAN
      CN_TC37X_VCU_CAN03_9ebf9872: NmComMChannelRef=ComMConfigSet/CN_TC37X_VCU_CAN03_9ebf9872
        TC37X_VCU_CAN03_CAN_8b2c4b2a (NmBusType)
          NmStandardBusNmConfig: NmStandardBusType=NM_BUSNM_CANNM  # TC37X_VCU_CAN03_CAN
      CN_TC37X_VCU_CAN12_f0a399a5: NmComMChannelRef=ComMConfigSet/CN_TC37X_VCU_CAN12_f0a399a5
        TC37X_VCU_CAN12_CAN_7d10b13f (NmBusType)
          NmStandardBusNmConfig: NmStandardBusType=NM_BUSNM_CANNM  # TC37X_VCU_CAN12_CAN
    NmGlobalConfig
      NmGlobalFeatures: NmNodeIdEnabled=true, NmUserDataEnabled=true
      NmGlobalProperties
  module config PduR
    PduRGeneral
    PduRRoutingTables
      PduRRoutingTable
        66 x PduRRoutingPath:
          EDCU_EXV2_oLIN00_1f8750a5_Tx
            EDCU_EXV2_oLIN00_18b050dc_Tx (PduRDestPdu): PduRDestPduRef=EcucPduCollection/EDCU_EXV2_oLIN00_18b050dc_Tx
            PduRSrcPdu_0361509d (PduRSrcPdu): PduRSrcPduRef=EcucPduCollection/EDCU_EXV2_oLIN00_1f8750a5_Tx
          EXV2_Status_oLIN00_7fcf9f75_Rx
            EXV2_Status_oLIN00_7fcf9f75_Rx_c3f2be6b_Rx (PduRDestPdu): PduRDestPduRef=EcucPduCollection/EXV2_Status_oLIN00_d5e93929_Rx
            PduRSrcPdu_c3f2be6b (PduRSrcPdu): PduRSrcPduRef=EcucPduCollection/EXV2_Status_oLIN00_7fcf9f75_Rx
          EXV_1_VCU_oLIN00_366267d6_Rx
            EXV_1_VCU_oLIN00_366267d6_Rx_718a1cfb_Rx (PduRDestPdu): PduRDestPduRef=EcucPduCollection/EXV_1_VCU_oLIN00_69d4ef5f_Rx
            PduRSrcPdu_718a1cfb (PduRSrcPdu): PduRSrcPduRef=EcucPduCollection/EXV_1_VCU_oLIN00_366267d6_Rx
          EXV_2_VCU_oLIN00_85f64a15_Rx
            EXV_2_VCU_oLIN00_85f64a15_Rx_b894d38e_Rx (PduRDestPdu): PduRDestPduRef=EcucPduCollection/EXV_2_VCU_oLIN00_1e4a3daf_Rx
            PduRSrcPdu_b894d38e (PduRSrcPdu): PduRSrcPduRef=EcucPduCollection/EXV_2_VCU_oLIN00_85f64a15_Rx
          HVCH_Rsp01_oLIN00_d50f5fa3_Rx
            HVCH_Rsp01_oLIN00_d50f5fa3_Rx_aa2a3f7d_Rx (PduRDestPdu): PduRDestPduRef=EcucPduCollection/HVCH_Rsp01_oLIN00_a6e33eef_Rx
            PduRSrcPdu_aa2a3f7d (PduRSrcPdu): PduRSrcPduRef=EcucPduCollection/HVCH_Rsp01_oLIN00_d50f5fa3_Rx
          HVCH_Rsp02_oLIN00_a3ea669e_Rx
            HVCH_Rsp02_oLIN00_a3ea669e_Rx_90a9658c_Rx (PduRDestPdu): PduRDestPduRef=EcucPduCollection/HVCH_Rsp02_oLIN00_286c390c_Rx
            PduRSrcPdu_90a9658c (PduRSrcPdu): PduRSrcPduRef=EcucPduCollection/HVCH_Rsp02_oLIN00_a3ea669e_Rx
          MasterReq_ERV_oLIN00_10f4fcd8_Tx
            MasterReq_ERV_oLIN00_f3aa7150_Tx (PduRDestPdu): PduRDestPduRef=EcucPduCollection/MasterReq_ERV_oLIN00_f3aa7150_Tx
            PduRSrcPdu_a9b251eb (PduRSrcPdu): PduRSrcPduRef=EcucPduCollection/MasterReq_ERV_oLIN00_10f4fcd8_Tx
          MasterReq_EXV_1_oLIN00_52f4d550_Tx
            MasterReq_EXV_1_oLIN00_cdcee39b_Tx (PduRDestPdu): PduRDestPduRef=EcucPduCollection/MasterReq_EXV_1_oLIN00_cdcee39b_Tx
            PduRSrcPdu_971d7b9f (PduRSrcPdu): PduRSrcPduRef=EcucPduCollection/MasterReq_EXV_1_oLIN00_52f4d550_Tx
          MasterReq_EXV_2_oLIN00_dc7bd2b3_Tx
            MasterReq_EXV_2_oLIN00_bb2bdaa6_Tx (PduRDestPdu): PduRDestPduRef=EcucPduCollection/MasterReq_EXV_2_oLIN00_bb2bdaa6_Tx
            PduRSrcPdu_a4b1fa3e (PduRSrcPdu): PduRSrcPduRef=EcucPduCollection/MasterReq_EXV_2_oLIN00_dc7bd2b3_Tx
          MasterReq_GWM_oLIN01_08407441_Tx
            MasterReq_GWM_oLIN01_25aef125_Tx (PduRDestPdu): PduRDestPduRef=EcucPduCollection/MasterReq_GWM_oLIN01_25aef125_Tx
            PduRSrcPdu_de6654a5 (PduRSrcPdu): PduRSrcPduRef=EcucPduCollection/MasterReq_GWM_oLIN01_08407441_Tx
          MasterReq_HVCH_oLIN00_0c968313_Tx
            MasterReq_HVCH_oLIN00_726494b3_Tx (PduRDestPdu): PduRDestPduRef=EcucPduCollection/MasterReq_HVCH_oLIN00_726494b3_Tx
            PduRSrcPdu_08dc267f (PduRSrcPdu): PduRSrcPduRef=EcucPduCollection/MasterReq_HVCH_oLIN00_0c968313_Tx
          MasterReq_PMP_1_oLIN00_14f05772_Tx
            MasterReq_PMP_1_oLIN00_90773f5d_Tx (PduRDestPdu): PduRDestPduRef=EcucPduCollection/MasterReq_PMP_1_oLIN00_90773f5d_Tx
            PduRSrcPdu_c9d7bd8d (PduRSrcPdu): PduRSrcPduRef=EcucPduCollection/MasterReq_PMP_1_oLIN00_14f05772_Tx
          MasterReq_PMP_2_oLIN00_9a7f5091_Tx
            MasterReq_PMP_2_oLIN00_e6920660_Tx (PduRDestPdu): PduRDestPduRef=EcucPduCollection/MasterReq_PMP_2_oLIN00_e6920660_Tx
            PduRSrcPdu_c560d24d (PduRSrcPdu): PduRSrcPduRef=EcucPduCollection/MasterReq_PMP_2_oLIN00_9a7f5091_Tx
          MasterReq_SVA_oLIN00_11d66449_Tx
            MasterReq_SVA_oLIN00_deabba25_Tx (PduRDestPdu): PduRDestPduRef=EcucPduCollection/MasterReq_SVA_oLIN00_deabba25_Tx
            PduRSrcPdu_502f75b4 (PduRSrcPdu): PduRSrcPduRef=EcucPduCollection/MasterReq_SVA_oLIN00_11d66449_Tx
          MasterReq_oLIN00_4a2bb011_Tx
            MasterReq_oLIN00_3234fe1b_Tx (PduRDestPdu): PduRDestPduRef=EcucPduCollection/MasterReq_oLIN00_3234fe1b_Tx
            PduRSrcPdu_927d3065 (PduRSrcPdu): PduRSrcPduRef=EcucPduCollection/MasterReq_oLIN00_4a2bb011_Tx
          MasterReq_oLIN01_3d2c8087_Tx
            MasterReq_oLIN01_eb5b5f1c_Tx (PduRDestPdu): PduRDestPduRef=EcucPduCollection/MasterReq_oLIN01_eb5b5f1c_Tx
            PduRSrcPdu_e38dbced (PduRSrcPdu): PduRSrcPduRef=EcucPduCollection/MasterReq_oLIN01_3d2c8087_Tx
          PMP2_Sts_oLIN00_200c907c_Rx
            PMP2_Sts_oLIN00_200c907c_Rx_9a742e46_Rx (PduRDestPdu): PduRDestPduRef=EcucPduCollection/PMP2_Sts_oLIN00_cab90b6b_Rx
            PduRSrcPdu_9a742e46 (PduRSrcPdu): PduRSrcPduRef=EcucPduCollection/PMP2_Sts_oLIN00_200c907c_Rx
          PMP3_Sts_oLIN00_4e808b3d_Rx
            PMP3_Sts_oLIN00_4e808b3d_Rx_43cea622_Rx (PduRDestPdu): PduRDestPduRef=EcucPduCollection/PMP3_Sts_oLIN00_511c4704_Rx
            PduRSrcPdu_43cea622 (PduRSrcPdu): PduRSrcPduRef=EcucPduCollection/PMP3_Sts_oLIN00_4e808b3d_Rx
          PMP_Cmd_oLIN00_3912b28b_Tx
            PMP_Cmd_oLIN00_6d889c97_Tx (PduRDestPdu): PduRDestPduRef=EcucPduCollection/PMP_Cmd_oLIN00_6d889c97_Tx
            PduRSrcPdu_4bd8719a (PduRSrcPdu): PduRSrcPduRef=EcucPduCollection/PMP_Cmd_oLIN00_3912b28b_Tx
          SVA_VCU_STD_oLIN00_4f0795ef_Rx
            SVA_VCU_STD_oLIN00_4f0795ef_Rx_166cd16c_Rx (PduRDestPdu): PduRDestPduRef=EcucPduCollection/SVA_VCU_STD_oLIN00_4526aa1c_Rx
            PduRSrcPdu_166cd16c (PduRSrcPdu): PduRSrcPduRef=EcucPduCollection/SVA_VCU_STD_oLIN00_4f0795ef_Rx
          SlaveResp_ERV_oLIN00_4c387f1b_Rx
            SlaveResp_ERV_oLIN00_4c387f1b_Rx_faf94ab0_Rx (PduRDestPdu): PduRDestPduRef=EcucPduCollection/SlaveResp_ERV_oLIN00_e833ce7b_Rx
            PduRSrcPdu_faf94ab0 (PduRSrcPdu): PduRSrcPduRef=EcucPduCollection/SlaveResp_ERV_oLIN00_4c387f1b_Rx
          SlaveResp_EXV_1_oLIN00_39fbe7c0_Rx
            SlaveResp_EXV_1_oLIN00_39fbe7c0_Rx_5cd8da0b_Rx (PduRDestPdu): PduRDestPduRef=EcucPduCollection/SlaveResp_EXV_1_oLIN00_1f09933d_Rx
            PduRSrcPdu_5cd8da0b (PduRSrcPdu): PduRSrcPduRef=EcucPduCollection/SlaveResp_EXV_1_oLIN00_39fbe7c0_Rx
          SlaveResp_EXV_2_oLIN00_4f1edefd_Rx
            SlaveResp_EXV_2_oLIN00_4f1edefd_Rx_e51dcfec_Rx (PduRDestPdu): PduRDestPduRef=EcucPduCollection/SlaveResp_EXV_2_oLIN00_918694de_Rx
            PduRSrcPdu_e51dcfec (PduRSrcPdu): PduRSrcPduRef=EcucPduCollection/SlaveResp_EXV_2_oLIN00_4f1edefd_Rx
          SlaveResp_GWM_oLIN01_9a3cff6e_Rx
            SlaveResp_GWM_oLIN01_9a3cff6e_Rx_3bd099cd_Rx (PduRDestPdu): PduRDestPduRef=EcucPduCollection/SlaveResp_GWM_oLIN01_f08746e2_Rx
            PduRSrcPdu_3bd099cd (PduRSrcPdu): PduRSrcPduRef=EcucPduCollection/SlaveResp_GWM_oLIN01_9a3cff6e_Rx
          SlaveResp_HVCH_oLIN00_93d59ea5_Rx
            SlaveResp_HVCH_oLIN00_93d59ea5_Rx_2d50b796_Rx (PduRDestPdu): PduRDestPduRef=EcucPduCollection/SlaveResp_HVCH_oLIN00_43b1b673_Rx
            PduRSrcPdu_2d50b796 (PduRSrcPdu): PduRSrcPduRef=EcucPduCollection/SlaveResp_HVCH_oLIN00_93d59ea5_Rx
          SlaveResp_PMP_1_oLIN00_64423b06_Rx
            SlaveResp_PMP_1_oLIN00_64423b06_Rx_e889db0f_Rx (PduRDestPdu): PduRDestPduRef=EcucPduCollection/SlaveResp_PMP_1_oLIN00_590d111f_Rx
            PduRSrcPdu_e889db0f (PduRSrcPdu): PduRSrcPduRef=EcucPduCollection/SlaveResp_PMP_1_oLIN00_64423b06_Rx
          SlaveResp_PMP_2_oLIN00_12a7023b_Rx
            SlaveResp_PMP_2_oLIN00_12a7023b_Rx_2d890913_Rx (PduRDestPdu): PduRDestPduRef=EcucPduCollection/SlaveResp_PMP_2_oLIN00_d78216fc_Rx
            PduRSrcPdu_2d890913 (PduRSrcPdu): PduRSrcPduRef=EcucPduCollection/SlaveResp_PMP_2_oLIN00_12a7023b_Rx
          SlaveResp_SVA_oLIN00_6139b46e_Rx
            SlaveResp_SVA_oLIN00_6139b46e_Rx_04ff3713_Rx (PduRDestPdu): PduRDestPduRef=EcucPduCollection/SlaveResp_SVA_oLIN00_e91156ea_Rx
            PduRSrcPdu_04ff3713 (PduRSrcPdu): PduRSrcPduRef=EcucPduCollection/SlaveResp_SVA_oLIN00_6139b46e_Rx
          TCU_HVCH_Cmd_oLIN00_385d5651_Tx
            TCU_HVCH_Cmd_oLIN00_ddc31229_Tx (PduRDestPdu): PduRDestPduRef=EcucPduCollection/TCU_HVCH_Cmd_oLIN00_ddc31229_Tx
            PduRSrcPdu_6a17111c (PduRSrcPdu): PduRSrcPduRef=EcucPduCollection/TCU_HVCH_Cmd_oLIN00_385d5651_Tx
          VCU_EXV_1_oLIN00_50eec975_Tx
            VCU_EXV_1_oLIN00_58a890ac_Tx (PduRDestPdu): PduRDestPduRef=EcucPduCollection/VCU_EXV_1_oLIN00_58a890ac_Tx
            PduRSrcPdu_91ca29f5 (PduRSrcPdu): PduRSrcPduRef=EcucPduCollection/VCU_EXV_1_oLIN00_50eec975_Tx
          VCU_EXV_2_oLIN00_de61ce96_Tx
            VCU_EXV_2_oLIN00_2e4da991_Tx (PduRDestPdu): PduRDestPduRef=EcucPduCollection/VCU_EXV_2_oLIN00_2e4da991_Tx
            PduRSrcPdu_9414725b (PduRSrcPdu): PduRSrcPduRef=EcucPduCollection/VCU_EXV_2_oLIN00_de61ce96_Tx
          VCU_Minor_01_oKAMA_FP_EPT_0303_39c0a2ee_Tx
            VCU_Minor_01_oKAMA_FP_EPT_0303_45280963_Tx (PduRDestPdu): PduRDestPduRef=EcucPduCollection/VCU_Minor_01_oKAMA_FP_EPT_0303_45280963_Tx
            PduRSrcPdu_73c8c9ca (PduRSrcPdu): PduRSrcPduRef=EcucPduCollection/VCU_Minor_01_oKAMA_FP_EPT_0303_39c0a2ee_Tx
          VCU_Minor_02_oKAMA_FP_EPT_0303_9a962447_Tx
            VCU_Minor_02_oKAMA_FP_EPT_0303_7ae377f6_Tx (PduRDestPdu): PduRDestPduRef=EcucPduCollection/VCU_Minor_02_oKAMA_FP_EPT_0303_7ae377f6_Tx
            PduRSrcPdu_a98c9d8b (PduRSrcPdu): PduRSrcPduRef=EcucPduCollection/VCU_Minor_02_oKAMA_FP_EPT_0303_9a962447_Tx
          VCU_Minor_03_oKAMA_FP_EPT_0303_d9755fba_Rx
            VCU_Minor_03_oKAMA_FP_EPT_0303_d9755fba_Rx_7341a555_Rx (PduRDestPdu): PduRDestPduRef=EcucPduCollection/VCU_Minor_03_oKAMA_FP_EPT_0303_4d74a41f_Rx
            PduRSrcPdu_7341a555 (PduRSrcPdu): PduRSrcPduRef=EcucPduCollection/VCU_Minor_03_oKAMA_FP_EPT_0303_d9755fba_Rx
          VCU_SVA_CMD_oLIN00_756d14f6_Tx
            VCU_SVA_CMD_oLIN00_89e2bb7b_Tx (PduRDestPdu): PduRDestPduRef=EcucPduCollection/VCU_SVA_CMD_oLIN00_89e2bb7b_Tx
            PduRSrcPdu_b06eca36 (PduRSrcPdu): PduRSrcPduRef=EcucPduCollection/VCU_SVA_CMD_oLIN00_756d14f6_Tx
          VcuAdcTxMsg1_oTC37X_VCU_CAN01_fda515ee_Tx
            VcuAdcTxMsg1_oTC37X_VCU_CAN01_6685c7bf_Tx (PduRDestPdu): PduRDestPduRef=EcucPduCollection/VcuAdcTxMsg1_oTC37X_VCU_CAN01_6685c7bf_Tx
            PduRSrcPdu_f8c9b934 (PduRSrcPdu): PduRSrcPduRef=EcucPduCollection/VcuAdcTxMsg1_oTC37X_VCU_CAN01_fda515ee_Tx
          VcuAdcTxMsg2_oTC37X_VCU_CAN01_1723c88c_Tx
            VcuAdcTxMsg2_oTC37X_VCU_CAN01_afb1dcb2_Tx (PduRDestPdu): PduRDestPduRef=EcucPduCollection/VcuAdcTxMsg2_oTC37X_VCU_CAN01_afb1dcb2_Tx
            PduRSrcPdu_df42a212 (PduRSrcPdu): PduRSrcPduRef=EcucPduCollection/VcuAdcTxMsg2_oTC37X_VCU_CAN01_1723c88c_Tx
          VcuCan03RxMsg1_oTC37X_VCU_CAN03_4dd213bb_Rx
            VcuCan03RxMsg1_oTC37X_VCU_CAN03_4dd213bb_Rx_4e610413_Rx (PduRDestPdu): PduRDestPduRef=EcucPduCollection/VcuCan03RxMsg1_oTC37X_VCU_CAN03_77e3a75f_Rx
            PduRSrcPdu_4e610413 (PduRSrcPdu): PduRSrcPduRef=EcucPduCollection/VcuCan03RxMsg1_oTC37X_VCU_CAN03_4dd213bb_Rx
          VcuCan03RxMsg2_oTC37X_VCU_CAN03_84e608b6_Rx
            VcuCan03RxMsg2_oTC37X_VCU_CAN03_84e608b6_Rx_a2204cbf_Rx (PduRDestPdu): PduRDestPduRef=EcucPduCollection/VcuCan03RxMsg2_oTC37X_VCU_CAN03_9d657a3d_Rx
            PduRSrcPdu_a2204cbf (PduRSrcPdu): PduRSrcPduRef=EcucPduCollection/VcuCan03RxMsg2_oTC37X_VCU_CAN03_84e608b6_Rx
          VcuCan03TxMsg1_oTC37X_VCU_CAN03_9a29d525_Tx
            VcuCan03TxMsg1_oTC37X_VCU_CAN03_c0767973_Tx (PduRDestPdu): PduRDestPduRef=EcucPduCollection/VcuCan03TxMsg1_oTC37X_VCU_CAN03_c0767973_Tx
            PduRSrcPdu_6c0ea6d2 (PduRSrcPdu): PduRSrcPduRef=EcucPduCollection/VcuCan03TxMsg1_oTC37X_VCU_CAN03_9a29d525_Tx
          VcuCan03TxMsg2_oTC37X_VCU_CAN03_70af0847_Tx
            VcuCan03TxMsg2_oTC37X_VCU_CAN03_0942627e_Tx (PduRDestPdu): PduRDestPduRef=EcucPduCollection/VcuCan03TxMsg2_oTC37X_VCU_CAN03_0942627e_Tx
            PduRSrcPdu_a59b3a32 (PduRSrcPdu): PduRSrcPduRef=EcucPduCollection/VcuCan03TxMsg2_oTC37X_VCU_CAN03_70af0847_Tx
          VcuCan12RxMsg3_oTC37X_VCU_CAN12_2f1174ae_Rx
            VcuCan12RxMsg3_oTC37X_VCU_CAN12_2f1174ae_Rx_9d116735_Rx (PduRDestPdu): PduRDestPduRef=EcucPduCollection/VcuCan12RxMsg3_oTC37X_VCU_CAN12_38853822_Rx
            PduRSrcPdu_9d116735 (PduRSrcPdu): PduRSrcPduRef=EcucPduCollection/VcuCan12RxMsg3_oTC37X_VCU_CAN12_2f1174ae_Rx
          VcuCan12RxMsg4_oTC37X_VCU_CAN12_211bb20e_Rx
            VcuCan12RxMsg4_oTC37X_VCU_CAN12_211bb20e_Rx_0a95646f_Rx (PduRDestPdu): PduRDestPduRef=EcucPduCollection/VcuCan12RxMsg4_oTC37X_VCU_CAN12_d9ab3246_Rx
            PduRSrcPdu_0a95646f (PduRSrcPdu): PduRSrcPduRef=EcucPduCollection/VcuCan12RxMsg4_oTC37X_VCU_CAN12_211bb20e_Rx
          VcuCan12TxMsg1_oTC37X_VCU_CAN12_d09b21db_Tx
            VcuCan12TxMsg1_oTC37X_VCU_CAN12_2c92f390_Tx (PduRDestPdu): PduRDestPduRef=EcucPduCollection/VcuCan12TxMsg1_oTC37X_VCU_CAN12_2c92f390_Tx
            PduRSrcPdu_6cefc258 (PduRSrcPdu): PduRSrcPduRef=EcucPduCollection/VcuCan12TxMsg1_oTC37X_VCU_CAN12_d09b21db_Tx
          VcuCan12TxMsg2_oTC37X_VCU_CAN12_3a1dfcb9_Tx
            VcuCan12TxMsg2_oTC37X_VCU_CAN12_e5a6e89d_Tx (PduRDestPdu): PduRDestPduRef=EcucPduCollection/VcuCan12TxMsg2_oTC37X_VCU_CAN12_e5a6e89d_Tx
            PduRSrcPdu_573a7055 (PduRSrcPdu): PduRSrcPduRef=EcucPduCollection/VcuCan12TxMsg2_oTC37X_VCU_CAN12_3a1dfcb9_Tx
          VcuRxMsg1_oTC37X_VCU_CAN00_4589bbed_Rx
            VcuRxMsg1_oTC37X_VCU_CAN00_4589bbed_Rx_6711bd67_Rx (PduRDestPdu): PduRDestPduRef=EcucPduCollection/VcuRxMsg1_oTC37X_VCU_CAN00_78805594_Rx
            PduRSrcPdu_6711bd67 (PduRSrcPdu): PduRSrcPduRef=EcucPduCollection/VcuRxMsg1_oTC37X_VCU_CAN00_4589bbed_Rx
          VcuRxMsg2_oTC37X_VCU_CAN00_8cbda0e0_Rx
            VcuRxMsg2_oTC37X_VCU_CAN00_8cbda0e0_Rx_803efadc_Rx (PduRDestPdu): PduRDestPduRef=EcucPduCollection/VcuRxMsg2_oTC37X_VCU_CAN00_920688f6_Rx
            PduRSrcPdu_803efadc (PduRSrcPdu): PduRSrcPduRef=EcucPduCollection/VcuRxMsg2_oTC37X_VCU_CAN00_8cbda0e0_Rx
          VcuRxMsg3_oTC37X_VCU_CAN01_5bb4c01a_Rx
            VcuRxMsg3_oTC37X_VCU_CAN01_5bb4c01a_Rx_3905054b_Rx (PduRDestPdu): PduRDestPduRef=EcucPduCollection/VcuRxMsg3_oTC37X_VCU_CAN01_0a530e81_Rx
            PduRSrcPdu_3905054b (PduRSrcPdu): PduRSrcPduRef=EcucPduCollection/VcuRxMsg3_oTC37X_VCU_CAN01_5bb4c01a_Rx
          VcuRxMsg4_oTC37X_VCU_CAN01_55be06ba_Rx
            VcuRxMsg4_oTC37X_VCU_CAN01_55be06ba_Rx_f5b46736_Rx (PduRDestPdu): PduRDestPduRef=EcucPduCollection/VcuRxMsg4_oTC37X_VCU_CAN01_eb7d04e5_Rx
            PduRSrcPdu_f5b46736 (PduRSrcPdu): PduRSrcPduRef=EcucPduCollection/VcuRxMsg4_oTC37X_VCU_CAN01_55be06ba_Rx
          VcuTxIoMsg1_oTC37X_VCU_CAN00_54884add_Tx
            VcuTxIoMsg1_oTC37X_VCU_CAN00_869e33bc_Tx (PduRDestPdu): PduRDestPduRef=EcucPduCollection/VcuTxIoMsg1_oTC37X_VCU_CAN00_869e33bc_Tx
            PduRSrcPdu_96b222db (PduRSrcPdu): PduRSrcPduRef=EcucPduCollection/VcuTxIoMsg1_oTC37X_VCU_CAN00_54884add_Tx
          VcuTxIoMsg2_oTC37X_VCU_CAN00_be0e97bf_Tx
            VcuTxIoMsg2_oTC37X_VCU_CAN00_4faa28b1_Tx (PduRDestPdu): PduRDestPduRef=EcucPduCollection/VcuTxIoMsg2_oTC37X_VCU_CAN00_4faa28b1_Tx
            PduRSrcPdu_3ef2d11c (PduRSrcPdu): PduRSrcPduRef=EcucPduCollection/VcuTxIoMsg2_oTC37X_VCU_CAN00_be0e97bf_Tx
          VcuTxIoMsg3_oTC37X_VCU_CAN00_515c215e_Tx
            VcuTxIoMsg3_oTC37X_VCU_CAN00_08b9de4a_Tx (PduRDestPdu): PduRDestPduRef=EcucPduCollection/VcuTxIoMsg3_oTC37X_VCU_CAN00_08b9de4a_Tx
            PduRSrcPdu_23c89b9b (PduRSrcPdu): PduRSrcPduRef=EcucPduCollection/VcuTxIoMsg3_oTC37X_VCU_CAN00_515c215e_Tx
          VcuTxIoMsg4_oTC37X_VCU_CAN00_b0722b3a_Tx
            VcuTxIoMsg4_oTC37X_VCU_CAN00_06b318ea_Tx (PduRDestPdu): PduRDestPduRef=EcucPduCollection/VcuTxIoMsg4_oTC37X_VCU_CAN00_06b318ea_Tx
            PduRSrcPdu_15ef524a (PduRSrcPdu): PduRSrcPduRef=EcucPduCollection/VcuTxIoMsg4_oTC37X_VCU_CAN00_b0722b3a_Tx
          VcuTxIoMsg5_oTC37X_VCU_CAN00_5f209ddb_Tx
            VcuTxIoMsg5_oTC37X_VCU_CAN00_41a0ee11_Tx (PduRDestPdu): PduRDestPduRef=EcucPduCollection/VcuTxIoMsg5_oTC37X_VCU_CAN00_41a0ee11_Tx
            PduRSrcPdu_886ac60a (PduRSrcPdu): PduRSrcPduRef=EcucPduCollection/VcuTxIoMsg5_oTC37X_VCU_CAN00_5f209ddb_Tx
          VcuTxIoMsg6_oTC37X_VCU_CAN00_b5a640b9_Tx
            VcuTxIoMsg6_oTC37X_VCU_CAN00_8894f51c_Tx (PduRDestPdu): PduRDestPduRef=EcucPduCollection/VcuTxIoMsg6_oTC37X_VCU_CAN00_8894f51c_Tx
            PduRSrcPdu_275934e8 (PduRSrcPdu): PduRSrcPduRef=EcucPduCollection/VcuTxIoMsg6_oTC37X_VCU_CAN00_b5a640b9_Tx
          VcuTxIoMsg7_oTC37X_VCU_CAN00_5af4f658_Tx
            VcuTxIoMsg7_oTC37X_VCU_CAN00_cf8703e7_Tx (PduRDestPdu): PduRDestPduRef=EcucPduCollection/VcuTxIoMsg7_oTC37X_VCU_CAN00_cf8703e7_Tx
            PduRSrcPdu_8c9b3cfc (PduRSrcPdu): PduRSrcPduRef=EcucPduCollection/VcuTxIoMsg7_oTC37X_VCU_CAN00_5af4f658_Tx
          VcuTxIoMsg8_oTC37X_VCU_CAN00_ac8b5230_Tx
            VcuTxIoMsg8_oTC37X_VCU_CAN00_9481785c_Tx (PduRDestPdu): PduRDestPduRef=EcucPduCollection/VcuTxIoMsg8_oTC37X_VCU_CAN00_9481785c_Tx
            PduRSrcPdu_27dcf988 (PduRSrcPdu): PduRSrcPduRef=EcucPduCollection/VcuTxIoMsg8_oTC37X_VCU_CAN00_ac8b5230_Tx
          VcuTxMsg1_oTC37X_VCU_CAN00_954a27ee_Tx
            VcuTxMsg1_oTC37X_VCU_CAN00_c82dd125_Tx (PduRDestPdu): PduRDestPduRef=EcucPduCollection/VcuTxMsg1_oTC37X_VCU_CAN00_c82dd125_Tx
            PduRSrcPdu_91d52164 (PduRSrcPdu): PduRSrcPduRef=EcucPduCollection/VcuTxMsg1_oTC37X_VCU_CAN00_954a27ee_Tx
          VcuTxMsg2_oTC37X_VCU_CAN00_7fccfa8c_Tx
            VcuTxMsg2_oTC37X_VCU_CAN00_0119ca28_Tx (PduRDestPdu): PduRDestPduRef=EcucPduCollection/VcuTxMsg2_oTC37X_VCU_CAN00_0119ca28_Tx
            PduRSrcPdu_69924b1b (PduRSrcPdu): PduRSrcPduRef=EcucPduCollection/VcuTxMsg2_oTC37X_VCU_CAN00_7fccfa8c_Tx
          Vcu_Lin0_RxMsg1_oLIN01_079b7478_Rx
            Vcu_Lin0_RxMsg1_oLIN01_079b7478_Rx_12331c6c_Rx (PduRDestPdu): PduRDestPduRef=EcucPduCollection/Vcu_Lin0_RxMsg1_oLIN01_24780c64_Rx
            PduRSrcPdu_12331c6c (PduRSrcPdu): PduRSrcPduRef=EcucPduCollection/Vcu_Lin0_RxMsg1_oLIN01_079b7478_Rx
          Vcu_Lin0_RxMsg2_oLIN01_717e4d45_Rx
            Vcu_Lin0_RxMsg2_oLIN01_717e4d45_Rx_d314568e_Rx (PduRDestPdu): PduRDestPduRef=EcucPduCollection/Vcu_Lin0_RxMsg2_oLIN01_aaf70b87_Rx
            PduRSrcPdu_d314568e (PduRSrcPdu): PduRSrcPduRef=EcucPduCollection/Vcu_Lin0_RxMsg2_oLIN01_717e4d45_Rx
          Vcu_Lin0_TxMsg1_oLIN01_849dd3b9_Tx
            Vcu_Lin0_TxMsg1_oLIN01_02277a36_Tx (PduRDestPdu): PduRDestPduRef=EcucPduCollection/Vcu_Lin0_TxMsg1_oLIN01_02277a36_Tx
            PduRSrcPdu_ff5e60c1 (PduRSrcPdu): PduRSrcPduRef=EcucPduCollection/Vcu_Lin0_TxMsg1_oLIN01_849dd3b9_Tx
          Vcu_Lin0_TxMsg2_oLIN01_0a12d45a_Tx
            Vcu_Lin0_TxMsg2_oLIN01_74c2430b_Tx (PduRDestPdu): PduRDestPduRef=EcucPduCollection/Vcu_Lin0_TxMsg2_oLIN01_74c2430b_Tx
            PduRSrcPdu_0417dd35 (PduRSrcPdu): PduRSrcPduRef=EcucPduCollection/Vcu_Lin0_TxMsg2_oLIN01_0a12d45a_Tx
          Vcu_Uds_Func_Request_oTC37X_VCU_CAN00_455d4346_Rx
            Vcu_Uds_Func_Request_oTC37X_VCU_CAN00_455d4346_Rx_4bac36fb_Rx (PduRDestPdu): PduRDestPduRef=Vcu_Uds_Func_Request_oTC37X_VCU_CAN00_21e26bac_Rx
            PduRSrcPdu_4bac36fb (PduRSrcPdu): PduRSrcPduRef=EcucPduCollection/Vcu_Uds_Func_Request_oTC37X_VCU_CAN00_455d4346_Rx
          Vcu_Uds_Phy_Request_oTC37X_VCU_CAN00_16119f6f_Rx
            Vcu_Uds_Phy_Request_oTC37X_VCU_CAN00_16119f6f_Rx_925fbf89_Rx (PduRDestPdu): PduRDestPduRef=Vcu_Uds_Phy_Request_oTC37X_VCU_CAN00_d561dcee_Rx
            PduRSrcPdu_925fbf89 (PduRSrcPdu): PduRSrcPduRef=EcucPduCollection/Vcu_Uds_Phy_Request_oTC37X_VCU_CAN00_16119f6f_Rx
          Vcu_Uds_Response_oTC37X_VCU_CAN00_4d111be6_Tx
            Vcu_Uds_Response_oTC37X_VCU_CAN00_39638a1a_Tx (PduRDestPdu): PduRDestPduRef=EcucPduCollection/Vcu_Uds_Response_oTC37X_VCU_CAN00_39638a1a_Tx
            PduRSrcPdu_1a8748e9 (PduRSrcPdu): PduRSrcPduRef=EcucPduCollection/Vcu_Uds_Response_oTC37X_VCU_CAN00_4d111be6_Tx
  module config Xcp
    XcpConfig
      XCP_Request_oTC37X_VCU_CAN00_3c25b45e_Rx (XcpPdu)
        XCP_Request_oTC37X_VCU_CAN00_3c25b45e_Rx (XcpRxPdu): XcpRxPduRef=EcucPduCollection/XCP_Request_oTC37X_VCU_CAN00_3c25b45e_Rx
      XCP_Response_oTC37X_VCU_CAN00_34d2da2d_Tx (XcpPdu)
        XCP_Response_oTC37X_VCU_CAN00_34d2da2d_Tx (XcpTxPdu): XcpTxPduRef=EcucPduCollection/XCP_Response_oTC37X_VCU_CAN00_34d2da2d_Tx
    XcpGeneral
