AUTOSAR XML (schema 00048)
package /InitialEcuC
  ecuc value collection InitialEcuC: ecuc-values=[Can, CanIf, CanNm, CanSM, Com, ComM, EcuC, EcuM, Nm, PduR, Xcp]
  module config Can
    CanConfigSet
      CT_TC37X_VCU_CAN00_22cb8fec (CanController):
        CanControllerActivation = true
        CanControllerDefaultBaudrate = CanControllerBaudrateConfig
        CanControllerSystemRef = CT_TC37X_VCU_CAN00
        CanWakeupSourceRef = EcuMCommonConfiguration/CN_TC37X_VCU_CAN00_07b6c9c8
        CanControllerBaudrateConfig: CanControllerBaudRate=500
          CanControllerFdBaudrateConfig: CanControllerFdBaudRate=500
      CN_TC37X_VCU_CAN00_07b6c9c8_Tx (CanHardwareObject): CanHandleType=BASIC, CanIdValue=0, CanObjectType=TRANSMIT, CanControllerRef=CanConfigSet/CT_TC37X_VCU_CAN00_22cb8fec
      CN_TC37X_VCU_CAN00_c052b9c5_Rx (CanHardwareObject): CanHandleType=BASIC, CanIdType=STANDARD, CanIdValue=0, CanObjectType=RECEIVE, CanControllerRef=CanConfigSet/CT_TC37X_VCU_CAN00_22cb8fec
    CanGeneral: CanIndex=0
  module config CanIf
    CanIfCtrlDrvCfg_7d254554 (CanIfCtrlDrvCfg): CanIfCtrlDrvInitHohConfigRef=CanIfInitHohCfg, CanIfCtrlDrvNameRef=CanGeneral
      CT_TC37X_VCU_CAN00_22cb8fec (CanIfCtrlCfg): CanIfCtrlCanCtrlRef=CanConfigSet/CT_TC37X_VCU_CAN00_22cb8fec
    CanIfInitCfg
      CHNL_d841867f (CanIfBufferCfg): CanIfBufferSize=0, CanIfBufferHthRef=CanIfInitHohCfg/CN_TC37X_VCU_CAN00_07b6c9c8_Tx
      CanIfInitHohCfg: CanIfInitRefCfgSet=CanConfigSet
        CN_TC37X_VCU_CAN00_c052b9c5_Rx (CanIfHrhCfg): CanIfHrhCanCtrlIdRef=CanIfCtrlDrvCfg_7d254554/CT_TC37X_VCU_CAN00_22cb8fec, CanIfHrhIdSymRef=CanConfigSet/CN_TC37X_VCU_CAN00_c052b9c5_Rx
        CN_TC37X_VCU_CAN00_07b6c9c8_Tx (CanIfHthCfg): CanIfHthCanCtrlIdRef=CanIfCtrlDrvCfg_7d254554/CT_TC37X_VCU_CAN00_22cb8fec, CanIfHthIdSymRef=CanConfigSet/CN_TC37X_VCU_CAN00_07b6c9c8_Tx
      4 x CanIfRxPduCfg, all with CanIfRxPduCanIdType=STANDARD_CAN, CanIfRxPduDlc=8, CanIfRxPduHrhIdRef=CanIfInitHohCfg/CN_TC37X_VCU_CAN00_c052b9c5_Rx:
        VCU_Rx_500h_NM_oTC37X_VCU_CAN00_2f971b6a_Rx: CanIfRxPduCanId=1280, CanIfRxPduUserRxIndicationName=CanNm_RxIndication, CanIfRxPduUserRxIndicationUL=CAN_NM, CanIfRxPduRef=VCU_Rx_500h_NM_oTC37X_VCU_CAN00_c4b96e15_Rx
        VcuRxMsg1_oTC37X_VCU_CAN00_c149044d_Rx: CanIfRxPduCanId=512, CanIfRxPduUserRxIndicationName=PduR_CanIfRxIndication, CanIfRxPduUserRxIndicationUL=PDUR, CanIfRxPduRef=EcucPduCollection/VcuRxMsg1_oTC37X_VCU_CAN00_4589bbed_Rx
        VcuRxMsg2_oTC37X_VCU_CAN00_de1782b6_Rx: CanIfRxPduCanId=513, CanIfRxPduUserRxIndicationName=PduR_CanIfRxIndication, CanIfRxPduUserRxIndicationUL=PDUR, CanIfRxPduRef=EcucPduCollection/VcuRxMsg2_oTC37X_VCU_CAN00_8cbda0e0_Rx
        XCP_Request_oTC37X_VCU_CAN00_e22de59e_Rx: CanIfRxPduCanId=1542, CanIfRxPduUserRxIndicationName=Xcp_CanIfRxIndication, CanIfRxPduUserRxIndicationUL=XCP, CanIfRxPduRef=EcucPduCollection/XCP_Request_oTC37X_VCU_CAN00_3c25b45e_Rx
      4 x CanIfTxPduCfg, all with CanIfTxPduCanIdType=STANDARD_FD_CAN, CanIfTxPduDlc=8, CanIfTxPduBufferRef=CanIfInitCfg/CHNL_d841867f:
        VCU_Tx_51Ch_NM_oTC37X_VCU_CAN00_560cc988_Tx: CanIfTxPduCanId=1308, CanIfTxPduUserTxConfirmationName=CanNm_TxConfirmation, CanIfTxPduUserTxConfirmationUL=CAN_NM, CanIfTxPduRef=EcucPduCollection/VCU_Tx_51Ch_NM_oTC37X_VCU_CAN00_0aa0ce62_Tx
        VcuTxMsg1_oTC37X_VCU_CAN00_78140f53_Tx: CanIfTxPduCanId=256, CanIfTxPduUserTxConfirmationName=PduR_CanIfTxConfirmation, CanIfTxPduUserTxConfirmationUL=PDUR, CanIfTxPduRef=EcucPduCollection/VcuTxMsg1_oTC37X_VCU_CAN00_c82dd125_Tx
        VcuTxMsg2_oTC37X_VCU_CAN00_674a89a8_Tx: CanIfTxPduCanId=257, CanIfTxPduUserTxConfirmationName=PduR_CanIfTxConfirmation, CanIfTxPduUserTxConfirmationUL=PDUR, CanIfTxPduRef=EcucPduCollection/VcuTxMsg2_oTC37X_VCU_CAN00_0119ca28_Tx
        XCP_Response_oTC37X_VCU_CAN00_933a9e7a_Tx: CanIfTxPduCanId=1543, CanIfTxPduUserTxConfirmationName=Xcp_CanIfTxConfirmation, CanIfTxPduUserTxConfirmationUL=XCP, CanIfTxPduRef=EcucPduCollection/XCP_Response_oTC37X_VCU_CAN00_34d2da2d_Tx
    CanIfPrivateCfg: CanIfPrivateSoftwareFilterType=LINEAR
    CanIfPublicCfg: CanIfPublicPnSupport=false
  module config CanNm
    CanNmGlobalConfig: CanNmPnEiraCalcEnabled=false, CanNmUserDataEnabled=true
      TC37X_VCU_CAN00_CAN_cc8c31fa (CanNmChannelConfig):
        CanNmMsgCycleOffset = 0
        CanNmMsgCycleTime = 0.5
        CanNmMsgReducedTime = 0.32
        CanNmNodeId = 28
        CanNmRepeatMessageTime = 1.5
        CanNmTimeoutTime = 2
        CanNmUserDataLength = 6
        CanNmWaitBusSleepTime = 2
        CanNmComMNetworkHandleRef = ComMConfigSet/CN_TC37X_VCU_CAN00_07b6c9c8
        VCU_Tx_51Ch_NM_oTC37X_VCU_CAN00_0aa0ce62_Tx (CanNmTxPdu): CanNmTxPduRef=EcucPduCollection/VCU_Tx_51Ch_NM_oTC37X_VCU_CAN00_0aa0ce62_Tx
  module config CanSM
    CanSMConfiguration
      CHNL_d841867f (CanSMManagerNetwork): CanSMComMNetworkHandleRef=ComMConfigSet/CN_TC37X_VCU_CAN00_07b6c9c8
        CT_TC37X_VCU_CAN00_5fde07f6 (CanSMController): CanSMControllerId=CanIfCtrlDrvCfg_7d254554/CT_TC37X_VCU_CAN00_22cb8fec
  module config Com
    ComConfig
      4 x ComIPdu, all with ComIPduType=NORMAL:
        VcuRxMsg1_oTC37X_VCU_CAN00_78805594_Rx: ComIPduDirection=RECEIVE, ComIPduGroupRef=VCU_oTC37X_VCU_CAN00_Rx_a08bac39, ComIPduSignalRef=VcuRxMsg1_Sig0_oVcuRxMsg1_oTC37X_VCU_CAN00_13cef464_Rx, ComIPduSignalRef=VcuRxMsg1_Sig1_oVcuRxMsg1_oTC37X_VCU_CAN00_70c92d40_Rx, ComIPduSignalRef=VcuRxMsg1_Sig2_oVcuRxMsg1_oTC37X_VCU_CAN00_d5c1462c_Rx, ComIPduSignalRef=VcuRxMsg1_Sig3_oVcuRxMsg1_oTC37X_VCU_CAN00_b6c69f08_Rx, ComPduIdRef=EcucPduCollection/VcuRxMsg1_oTC37X_VCU_CAN00_78805594_Rx
        VcuRxMsg2_oTC37X_VCU_CAN00_920688f6_Rx: ComIPduDirection=RECEIVE, ComIPduGroupRef=VCU_oTC37X_VCU_CAN00_Rx_a08bac39, ComIPduSignalRef=VcuRxMsg2_Sig0_oVcuRxMsg2_oTC37X_VCU_CAN00_94ceda5c_Rx, ComIPduSignalRef=VcuRxMsg2_Sig1_oVcuRxMsg2_oTC37X_VCU_CAN00_f7c90378_Rx, ComIPduSignalRef=VcuRxMsg2_Sig2_oVcuRxMsg2_oTC37X_VCU_CAN00_52c16814_Rx, ComIPduSignalRef=VcuRxMsg2_Sig3_oVcuRxMsg2_oTC37X_VCU_CAN00_31c6b130_Rx, ComPduIdRef=EcucPduCollection/VcuRxMsg2_oTC37X_VCU_CAN00_920688f6_Rx
        VcuTxMsg1_oTC37X_VCU_CAN00_954a27ee_Tx: ComIPduDirection=SEND, ComIPduGroupRef=VCU_oTC37X_VCU_CAN00_Tx_f6d10bbf, ComIPduSignalRef=VcuTxMsg1_Sig0_oVcuTxMsg1_oTC37X_VCU_CAN00_8243b9a9_Tx, ComIPduSignalRef=VcuTxMsg1_Sig1_oVcuTxMsg1_oTC37X_VCU_CAN00_e144608d_Tx, ComIPduSignalRef=VcuTxMsg1_Sig2_oVcuTxMsg1_oTC37X_VCU_CAN00_444c0be1_Tx, ComIPduSignalRef=VcuTxMsg1_Sig3_oVcuTxMsg1_oTC37X_VCU_CAN00_274bd2c5_Tx, ComPduIdRef=EcucPduCollection/VcuTxMsg1_oTC37X_VCU_CAN00_954a27ee_Tx
          ComTxIPdu: ComMinimumDelayTime=0, ComTxIPduUnusedAreasDefault=0
            ComTxModeFalse
              ComTxMode: ComTxModeMode=PERIODIC, ComTxModeTimeOffset=0, ComTxModeTimePeriod=0.5
            ComTxModeTrue
              ComTxMode: ComTxModeMode=PERIODIC, ComTxModeTimeOffset=0, ComTxModeTimePeriod=0.5
        VcuTxMsg2_oTC37X_VCU_CAN00_7fccfa8c_Tx: ComIPduDirection=SEND, ComIPduGroupRef=VCU_oTC37X_VCU_CAN00_Tx_f6d10bbf, ComIPduSignalRef=VcuTxMsg2_Sig0_oVcuTxMsg2_oTC37X_VCU_CAN00_05439791_Tx, ComIPduSignalRef=VcuTxMsg2_Sig1_oVcuTxMsg2_oTC37X_VCU_CAN00_66444eb5_Tx, ComIPduSignalRef=VcuTxMsg2_Sig2_oVcuTxMsg2_oTC37X_VCU_CAN00_c34c25d9_Tx, ComIPduSignalRef=VcuTxMsg2_Sig3_oVcuTxMsg2_oTC37X_VCU_CAN00_a04bfcfd_Tx, ComPduIdRef=EcucPduCollection/VcuTxMsg2_oTC37X_VCU_CAN00_7fccfa8c_Tx
          ComTxIPdu: ComMinimumDelayTime=0, ComTxIPduUnusedAreasDefault=0
            ComTxModeFalse
              ComTxMode: ComTxModeMode=PERIODIC, ComTxModeTimeOffset=0, ComTxModeTimePeriod=0.5
            ComTxModeTrue
              ComTxMode: ComTxModeMode=PERIODIC, ComTxModeTimeOffset=0, ComTxModeTimePeriod=0.5
      VCU_oTC37X_VCU_CAN00_Rx_a08bac39 (ComIPduGroup)
      VCU_oTC37X_VCU_CAN00_Tx_f6d10bbf (ComIPduGroup)
      16 x ComSignal, all with ComBitSize=16, ComSignalEndianness=LITTLE_ENDIAN, ComSignalInitValue=0, ComSignalType=SINT16, ComTimeout=0:
        VcuRxMsg1_Sig0_oVcuRxMsg1_oTC37X_VCU_CAN00_13cef464_Rx: ComBitPosition=0, ComSystemTemplateSystemSignalRef=VcuRxMsg1_Sig0
        VcuRxMsg1_Sig1_oVcuRxMsg1_oTC37X_VCU_CAN00_70c92d40_Rx: ComBitPosition=16, ComSystemTemplateSystemSignalRef=VcuRxMsg1_Sig1
        VcuRxMsg1_Sig2_oVcuRxMsg1_oTC37X_VCU_CAN00_d5c1462c_Rx: ComBitPosition=32, ComSystemTemplateSystemSignalRef=VcuRxMsg1_Sig2
        VcuRxMsg1_Sig3_oVcuRxMsg1_oTC37X_VCU_CAN00_b6c69f08_Rx: ComBitPosition=48, ComSystemTemplateSystemSignalRef=VcuRxMsg1_Sig3
        VcuRxMsg2_Sig0_oVcuRxMsg2_oTC37X_VCU_CAN00_94ceda5c_Rx: ComBitPosition=0, ComSystemTemplateSystemSignalRef=VcuRxMsg2_Sig0
        VcuRxMsg2_Sig1_oVcuRxMsg2_oTC37X_VCU_CAN00_f7c90378_Rx: ComBitPosition=16, ComSystemTemplateSystemSignalRef=VcuRxMsg2_Sig1
        VcuRxMsg2_Sig2_oVcuRxMsg2_oTC37X_VCU_CAN00_52c16814_Rx: ComBitPosition=32, ComSystemTemplateSystemSignalRef=VcuRxMsg2_Sig2
        VcuRxMsg2_Sig3_oVcuRxMsg2_oTC37X_VCU_CAN00_31c6b130_Rx: ComBitPosition=48, ComSystemTemplateSystemSignalRef=VcuRxMsg2_Sig3
        VcuTxMsg1_Sig0_oVcuTxMsg1_oTC37X_VCU_CAN00_8243b9a9_Tx: ComBitPosition=0, ComTransferProperty=PENDING, ComSystemTemplateSystemSignalRef=VcuTxMsg1_Sig0
        VcuTxMsg1_Sig1_oVcuTxMsg1_oTC37X_VCU_CAN00_e144608d_Tx: ComBitPosition=16, ComTransferProperty=PENDING, ComSystemTemplateSystemSignalRef=VcuTxMsg1_Sig1
        VcuTxMsg1_Sig2_oVcuTxMsg1_oTC37X_VCU_CAN00_444c0be1_Tx: ComBitPosition=32, ComTransferProperty=PENDING, ComSystemTemplateSystemSignalRef=VcuTxMsg1_Sig2
        VcuTxMsg1_Sig3_oVcuTxMsg1_oTC37X_VCU_CAN00_274bd2c5_Tx: ComBitPosition=48, ComTransferProperty=PENDING, ComSystemTemplateSystemSignalRef=VcuTxMsg1_Sig3
        VcuTxMsg2_Sig0_oVcuTxMsg2_oTC37X_VCU_CAN00_05439791_Tx: ComBitPosition=0, ComTransferProperty=PENDING, ComSystemTemplateSystemSignalRef=VcuTxMsg2_Sig0
        VcuTxMsg2_Sig1_oVcuTxMsg2_oTC37X_VCU_CAN00_66444eb5_Tx: ComBitPosition=16, ComTransferProperty=PENDING, ComSystemTemplateSystemSignalRef=VcuTxMsg2_Sig1
        VcuTxMsg2_Sig2_oVcuTxMsg2_oTC37X_VCU_CAN00_c34c25d9_Tx: ComBitPosition=32, ComTransferProperty=PENDING, ComSystemTemplateSystemSignalRef=VcuTxMsg2_Sig2
        VcuTxMsg2_Sig3_oVcuTxMsg2_oTC37X_VCU_CAN00_a04bfcfd_Tx: ComBitPosition=48, ComTransferProperty=PENDING, ComSystemTemplateSystemSignalRef=VcuTxMsg2_Sig3
    ComGeneral
  module config ComM
    ComMConfigSet: ComMPncEnabled=false
      CN_TC37X_VCU_CAN00_07b6c9c8 (ComMChannel): ComMBusType=COMM_BUS_TYPE_CAN, ComMChannelId=0
        ComMNetworkManagement: ComMNmVariant=FULL
        CN_TC37X_VCU_CAN00_cc35f66d (ComMUserPerChannel): ComMUserChannel=CN_TC37X_VCU_CAN00_b1b4f272
      CN_TC37X_VCU_CAN00_b1b4f272 (ComMUser): ComMUserIdentifier=0
    ComMGeneral: ComMPncIdCounting=COMM_PNC_ID_COUNT_FROM_NM_MESSAGE, ComMPncSupport=false
  module config EcuC
    EcucPduCollection: PduIdTypeEnum=UINT8, PduLengthTypeEnum=UINT8
      12 x Pdu, all with DynamicLength=false, PduLength=8:
        VCU_Rx_500h_NM_oTC37X_VCU_CAN00_c4b96e15_Rx: SysTPduToFrameMappingRef=VCU_Rx_500h_NM
        VCU_Tx_51Ch_NM_oTC37X_VCU_CAN00_0aa0ce62_Tx: SysTPduToFrameMappingRef=VCU_Tx_51Ch_NM
        VcuRxMsg1_oTC37X_VCU_CAN00_4589bbed_Rx: SysTPduToFrameMappingRef=VcuRxMsg1
        VcuRxMsg1_oTC37X_VCU_CAN00_78805594_Rx
        VcuRxMsg2_oTC37X_VCU_CAN00_8cbda0e0_Rx: SysTPduToFrameMappingRef=VcuRxMsg2
        VcuRxMsg2_oTC37X_VCU_CAN00_920688f6_Rx
        VcuTxMsg1_oTC37X_VCU_CAN00_954a27ee_Tx
        VcuTxMsg1_oTC37X_VCU_CAN00_c82dd125_Tx: SysTPduToFrameMappingRef=VcuTxMsg1
        VcuTxMsg2_oTC37X_VCU_CAN00_0119ca28_Tx: SysTPduToFrameMappingRef=VcuTxMsg2
        VcuTxMsg2_oTC37X_VCU_CAN00_7fccfa8c_Tx
        XCP_Request_oTC37X_VCU_CAN00_3c25b45e_Rx: SysTPduToFrameMappingRef=XCP_Request
        XCP_Response_oTC37X_VCU_CAN00_34d2da2d_Tx: SysTPduToFrameMappingRef=XCP_Response
  module config EcuM
    EcuMConfiguration
      EcuMCommonConfiguration
        EcuMDriverInitListOne
        EcuMDriverRestartList
        CN_TC37X_VCU_CAN00_07b6c9c8 (EcuMWakeupSource): EcuMWakeupSourceId=5, EcuMComMChannelRef=ComMConfigSet/CN_TC37X_VCU_CAN00_07b6c9c8
      EcuMFlexConfiguration: EcuMFlexModuleConfigurationRef=CanConfigSet
  module config Nm
    CN_TC37X_VCU_CAN00_07b6c9c8 (NmChannelConfig): NmComMChannelRef=ComMConfigSet/CN_TC37X_VCU_CAN00_07b6c9c8
      TC37X_VCU_CAN00_CAN_cc8c31fa (NmBusType)
        NmStandardBusNmConfig: NmStandardBusType=NM_BUSNM_CANNM  # TC37X_VCU_CAN00_CAN
    NmGlobalConfig
      NmGlobalFeatures: NmNodeIdEnabled=true, NmUserDataEnabled=true
      NmGlobalProperties
  module config PduR
    PduRGeneral
    PduRRoutingTables
      PduRRoutingTable
        4 x PduRRoutingPath:
          VcuRxMsg1_oTC37X_VCU_CAN00_4589bbed_Rx
            VcuRxMsg1_oTC37X_VCU_CAN00_4589bbed_Rx_6711bd67_Rx (PduRDestPdu): PduRDestPduRef=EcucPduCollection/VcuRxMsg1_oTC37X_VCU_CAN00_78805594_Rx
            PduRSrcPdu_6711bd67 (PduRSrcPdu): PduRSrcPduRef=EcucPduCollection/VcuRxMsg1_oTC37X_VCU_CAN00_4589bbed_Rx
          VcuRxMsg2_oTC37X_VCU_CAN00_8cbda0e0_Rx
            VcuRxMsg2_oTC37X_VCU_CAN00_8cbda0e0_Rx_803efadc_Rx (PduRDestPdu): PduRDestPduRef=EcucPduCollection/VcuRxMsg2_oTC37X_VCU_CAN00_920688f6_Rx
            PduRSrcPdu_803efadc (PduRSrcPdu): PduRSrcPduRef=EcucPduCollection/VcuRxMsg2_oTC37X_VCU_CAN00_8cbda0e0_Rx
          VcuTxMsg1_oTC37X_VCU_CAN00_954a27ee_Tx
            VcuTxMsg1_oTC37X_VCU_CAN00_c82dd125_Tx (PduRDestPdu): PduRDestPduRef=EcucPduCollection/VcuTxMsg1_oTC37X_VCU_CAN00_c82dd125_Tx
            PduRSrcPdu_91d52164 (PduRSrcPdu): PduRSrcPduRef=EcucPduCollection/VcuTxMsg1_oTC37X_VCU_CAN00_954a27ee_Tx
          VcuTxMsg2_oTC37X_VCU_CAN00_7fccfa8c_Tx
            VcuTxMsg2_oTC37X_VCU_CAN00_0119ca28_Tx (PduRDestPdu): PduRDestPduRef=EcucPduCollection/VcuTxMsg2_oTC37X_VCU_CAN00_0119ca28_Tx
            PduRSrcPdu_69924b1b (PduRSrcPdu): PduRSrcPduRef=EcucPduCollection/VcuTxMsg2_oTC37X_VCU_CAN00_7fccfa8c_Tx
  module config Xcp
    XcpConfig
      XCP_Request_oTC37X_VCU_CAN00_3c25b45e_Rx (XcpPdu)
        XCP_Request_oTC37X_VCU_CAN00_3c25b45e_Rx (XcpRxPdu): XcpRxPduRef=EcucPduCollection/XCP_Request_oTC37X_VCU_CAN00_3c25b45e_Rx
      XCP_Response_oTC37X_VCU_CAN00_34d2da2d_Tx (XcpPdu)
        XCP_Response_oTC37X_VCU_CAN00_34d2da2d_Tx (XcpTxPdu): XcpTxPduRef=EcucPduCollection/XCP_Response_oTC37X_VCU_CAN00_34d2da2d_Tx
    XcpGeneral
