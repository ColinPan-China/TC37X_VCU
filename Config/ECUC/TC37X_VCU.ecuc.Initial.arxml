[part 2 of 3: package /InitialEcuC]
AUTOSAR XML (schema 00048)
package /InitialEcuC  (continued)
  module config Com
    ComConfig
      87 x ComIPdu, all with ComIPduType=NORMAL:
        ACU_01_oATOM_CANFD_Matrix_CH_V600_202502_92b30981_Rx: ComIPduDirection=RECEIVE, ComIPduGroupRef=VCU_oATOM_CANFD_Matrix_CH_V600_202502_Rx_5e4659c4, ComIPduSignalGroupRef=SG_ACU_01_SigGroup_oACU_01_oATOM_CANFD_Matrix_CH_V600_202502_0a16dd9e_Rx, ComPduIdRef=EcucPduCollection/ACU_01_oATOM_CANFD_Matrix_CH_V600_202502_92b30981_Rx
        ACU_02_oATOM_CANFD_Matrix_CH_V600_202502_19603798_Rx: ComIPduDirection=RECEIVE, ComIPduGroupRef=VCU_oATOM_CANFD_Matrix_CH_V600_202502_Rx_5e4659c4, ComIPduSignalGroupRef=SG_ACU_02_SigGroup_oACU_02_oATOM_CANFD_Matrix_CH_V600_202502_3b90e790_Rx, ComPduIdRef=EcucPduCollection/ACU_02_oATOM_CANFD_Matrix_CH_V600_202502_19603798_Rx
        ACU_info_oATOM_CANFD_Matrix_CH_V600_202502_c3757d77_Rx: ComIPduDirection=RECEIVE, ComIPduGroupRef=VCU_oATOM_CANFD_Matrix_CH_V600_202502_Rx_5e4659c4, ComIPduSignalGroupRef=SG_ACU_info_SigGroup_oACU_info_oATOM_CANFD_Matrix_CH_V600_202502_5b63ef23_Rx, ComPduIdRef=EcucPduCollection/ACU_info_oATOM_CANFD_Matrix_CH_V600_202502_c3757d77_Rx
        ADCU_ACC_02_oATOM_CANFD_Matrix_CH_V600_202502_09e0da82_Rx: ComIPduDirection=RECEIVE, ComIPduGroupRef=VCU_oATOM_CANFD_Matrix_CH_V600_202502_Rx_5e4659c4, ComIPduSignalGroupRef=SG_ADCU_ACC_02_SigGroup_oADCU_ACC_02_oATOM_CANFD_Matrix_CH_V600_202502_1e479296_Rx, ComPduIdRef=EcucPduCollection/ADCU_ACC_02_oATOM_CANFD_Matrix_CH_V600_202502_09e0da82_Rx
        ADCU_AEB_01_oATOM_CANFD_Matrix_CH_V600_202502_73fc26ce_Rx: ComIPduDirection=RECEIVE, ComIPduGroupRef=VCU_oATOM_CANFD_Matrix_CH_V600_202502_Rx_5e4659c4, ComIPduSignalGroupRef=SG_ADCU_AEB_01_SigGroup_oADCU_AEB_01_oATOM_CANFD_Matrix_CH_V600_202502_50a93e3a_Rx, ComPduIdRef=EcucPduCollection/ADCU_AEB_01_oATOM_CANFD_Matrix_CH_V600_202502_73fc26ce_Rx
        ADCU_APS_01_oATOM_CANFD_Matrix_CH_V600_202502_d7aca41b_Rx: ComIPduDirection=RECEIVE, ComIPduGroupRef=VCU_oATOM_CANFD_Matrix_CH_V600_202502_Rx_5e4659c4, ComIPduSignalGroupRef=SG_ADCU_APS_01_SigGroup_oADCU_APS_01_oATOM_CANFD_Matrix_CH_V600_202502_c590572d_Rx, ComPduIdRef=EcucPduCollection/ADCU_APS_01_oATOM_CANFD_Matrix_CH_V600_202502_d7aca41b_Rx
        ADCU_APS_02_oATOM_CANFD_Matrix_CH_V600_202502_5c7f9a02_Rx: ComIPduDirection=RECEIVE, ComIPduGroupRef=VCU_oATOM_CANFD_Matrix_CH_V600_202502_Rx_5e4659c4, ComIPduSignalGroupRef=SG_ADCU_APS_02_SigGroup_oADCU_APS_02_oATOM_CANFD_Matrix_CH_V600_202502_67bc1f98_Rx, ComPduIdRef=EcucPduCollection/ADCU_APS_02_oATOM_CANFD_Matrix_CH_V600_202502_5c7f9a02_Rx
        ADCU_DA_oATOM_CANFD_Matrix_CH_V600_202502_c19ff818_Rx: ComIPduDirection=RECEIVE, ComIPduGroupRef=VCU_oATOM_CANFD_Matrix_CH_V600_202502_Rx_5e4659c4, ComIPduSignalGroupRef=SG_ADCU_DA_SigGroup_oADCU_DA_oATOM_CANFD_Matrix_CH_V600_202502_4133b6dd_Rx, ComPduIdRef=EcucPduCollection/ADCU_DA_oATOM_CANFD_Matrix_CH_V600_202502_c19ff818_Rx
        EDCU_EXV2_oLIN00_1f8750a5_Tx: ComIPduDirection=SEND, ComIPduGroupRef=VCU_oLIN00_Tx_1dc75bd5, ComIPduSignalRef=EDCU_EXV2_Cmd_Init_Rq_oEDCU_EXV2_oLIN00_0144aec9_Tx, ComIPduSignalRef=EDCU_EXV2_Cmd_Move_Enbl_oEDCU_EXV2_oLIN00_d6797517_Tx, ComIPduSignalRef=EDCU_EXV2_Cmd_Set_Rq_oEDCU_EXV2_oLIN00_66e5876a_Tx, ComPduIdRef=EcucPduCollection/EDCU_EXV2_oLIN00_1f8750a5_Tx
          ComTxIPdu: ComTxIPduUnusedAreasDefault=255
        EXV2_Status_oLIN00_d5e93929_Rx: ComIPduDirection=RECEIVE, ComIPduGroupRef=VCU_oLIN00_Rx_4b9dfc53, ComIPduSignalRef=EXV2_Fault_Stat_oEXV2_Status_oLIN00_ab6350b6_Rx, ComIPduSignalRef=EXV2_OvrTemp_Warn_oEXV2_Status_oLIN00_ba77659e_Rx, ComIPduSignalRef=EXV2_Pos_oEXV2_Status_oLIN00_da80603b_Rx, ComIPduSignalRef=EXV2_Run_Stat_oEXV2_Status_oLIN00_0e992e12_Rx, ComIPduSignalRef=EXV2_Volt_Stat_oEXV2_Status_oLIN00_c8727eb0_Rx, ComIPduSignalRef=EXV2_curInit_Stat_oEXV2_Status_oLIN00_b0ace0f5_Rx, ComIPduSignalRef=RsErr_EXV2_oEXV2_Status_oLIN00_5c35655a_Rx, ComPduIdRef=EcucPduCollection/EXV2_Status_oLIN00_d5e93929_Rx
        EXV_1_VCU_oLIN00_69d4ef5f_Rx: ComIPduDirection=RECEIVE, ComIPduGroupRef=VCU_oLIN00_Rx_4b9dfc53, ComIPduSignalRef=EXV1_CurrentInitState_oEXV_1_VCU_oLIN00_beca31e2_Rx, ComIPduSignalRef=EXV1_CurrentPosition_oEXV_1_VCU_oLIN00_6daec86f_Rx, ComIPduSignalRef=EXV1_FaultState_oEXV_1_VCU_oLIN00_72ff14f0_Rx, ComIPduSignalRef=EXV1_ResponseError_oEXV_1_VCU_oLIN00_cbce9ad1_Rx, ComIPduSignalRef=EXV1_RunState_oEXV_1_VCU_oLIN00_f0dc555f_Rx, ComIPduSignalRef=EXV1_TemperatureWarn_oEXV_1_VCU_oLIN00_a3317e4b_Rx, ComIPduSignalRef=EXV1_VoltageState_oEXV_1_VCU_oLIN00_31bbfd77_Rx, ComPduIdRef=EcucPduCollection/EXV_1_VCU_oLIN00_69d4ef5f_Rx
        EXV_2_VCU_oLIN00_1e4a3daf_Rx: ComIPduDirection=RECEIVE, ComIPduGroupRef=VCU_oLIN00_Rx_4b9dfc53, ComIPduSignalRef=EXV2_CurrentInitState_oEXV_2_VCU_oLIN00_adb498ec_Rx, ComIPduSignalRef=EXV2_CurrentPosition_oEXV_2_VCU_oLIN00_91e32486_Rx, ComIPduSignalRef=EXV2_FaultState_oEXV_2_VCU_oLIN00_41c0e318_Rx, ComIPduSignalRef=EXV2_ResponseError_oEXV_2_VCU_oLIN00_e747f934_Rx, ComIPduSignalRef=EXV2_RunState_oEXV_2_VCU_oLIN00_859c8088_Rx, ComIPduSignalRef=EXV2_TemperatureWarn_oEXV_2_VCU_oLIN00_5f7c92a2_Rx, ComIPduSignalRef=EXV2_VoltageState_oEXV_2_VCU_oLIN00_8f3a2738_Rx, ComPduIdRef=EcucPduCollection/EXV_2_VCU_oLIN00_1e4a3daf_Rx
        HVCH_Rsp01_oLIN00_a6e33eef_Rx: ComIPduDirection=RECEIVE, ComIPduGroupRef=VCU_oLIN00_Rx_4b9dfc53, ComIPduSignalRef=HVCH_CurrSens_Flt_oHVCH_Rsp01_oLIN00_09f7bc74_Rx, ComIPduSignalRef=HVCH_DutyCycle_oHVCH_Rsp01_oLIN00_ad1e6a22_Rx, ComIPduSignalRef=HVCH_ExtPwrSup_Flt_oHVCH_Rsp01_oLIN00_28926933_Rx, ComIPduSignalRef=HVCH_HV_DC_curr_oHVCH_Rsp01_oLIN00_f613e39d_Rx, ComIPduSignalRef=HVCH_HV_Voltage_Valid_oHVCH_Rsp01_oLIN00_2914831e_Rx, ComIPduSignalRef=HVCH_HV_voltage_oHVCH_Rsp01_oLIN00_3d3da318_Rx, ComIPduSignalRef=HVCH_InternalPCBTemp_oHVCH_Rsp01_oLIN00_398b53e8_Rx, ComIPduSignalRef=HVCH_LIN_Flt_oHVCH_Rsp01_oLIN00_9aaa25bf_Rx, ComIPduSignalRef=HVCH_MediumTemp_oHVCH_Rsp01_oLIN00_a3387de4_Rx, ComIPduSignalRef=HVCH_Off_ShrtCurr_oHVCH_Rsp01_oLIN00_bf58ab45_Rx, ComIPduSignalRef=HVCH_RsErr_oHVCH_Rsp01_oLIN00_527b0f8f_Rx, ComIPduSignalRef=HVCH_Status_oHVCH_Rsp01_oLIN00_60afdc75_Rx, ComIPduSignalRef=HVCH_TempLim_oHVCH_Rsp01_oLIN00_d22e6add_Rx, ComIPduSignalRef=HVCH_TempSens_Flt_oHVCH_Rsp01_oLIN00_66cb2c71_Rx, ComIPduSignalRef=HVCH_defectHeaterCircuits_oHVCH_Rsp01_oLIN00_61948e74_Rx, ComPduIdRef=EcucPduCollection/HVCH_Rsp01_oLIN00_a6e33eef_Rx
        HVCH_Rsp02_oLIN00_286c390c_Rx: ComIPduDirection=RECEIVE, ComIPduGroupRef=VCU_oLIN00_Rx_4b9dfc53, ComIPduSignalRef=HVCH_IntelTemp_oHVCH_Rsp02_oLIN00_2b487110_Rx, ComPduIdRef=EcucPduCollection/HVCH_Rsp02_oLIN00_286c390c_Rx
        IBS_ACC_oATOM_CANFD_Matrix_CH_V600_202502_ef8c28ba_Rx: ComIPduDirection=RECEIVE, ComIPduGroupRef=VCU_oATOM_CANFD_Matrix_CH_V600_202502_Rx_5e4659c4, ComIPduSignalGroupRef=SG_IBS_ACC_SigGroup_oIBS_ACC_oATOM_CANFD_Matrix_CH_V600_202502_c31bc8ab_Rx, ComPduIdRef=EcucPduCollection/IBS_ACC_oATOM_CANFD_Matrix_CH_V600_202502_ef8c28ba_Rx
        IBS_APS_oATOM_CANFD_Matrix_CH_V600_202502_25d77553_Rx: ComIPduDirection=RECEIVE, ComIPduGroupRef=VCU_oATOM_CANFD_Matrix_CH_V600_202502_Rx_5e4659c4, ComIPduSignalGroupRef=SG_IBS_APS_SigGroup_oIBS_APS_oATOM_CANFD_Matrix_CH_V600_202502_91bbe9ec_Rx, ComPduIdRef=EcucPduCollection/IBS_APS_oATOM_CANFD_Matrix_CH_V600_202502_25d77553_Rx
        IBS_Status_01_oATOM_CANFD_Matrix_CH_V600_202502_b0697754_Rx: ComIPduDirection=RECEIVE, ComIPduGroupRef=VCU_oATOM_CANFD_Matrix_CH_V600_202502_Rx_5e4659c4, ComIPduSignalGroupRef=SG_IBS_Status_01_SigGroup_oIBS_Status_01_oATOM_CANFD_Matrix_CH_V600_202502_bdf732ba_Rx, ComPduIdRef=EcucPduCollection/IBS_Status_01_oATOM_CANFD_Matrix_CH_V600_202502_b0697754_Rx
        IBS_Status_02_oATOM_CANFD_Matrix_CH_V600_202502_3bba494d_Rx: ComIPduDirection=RECEIVE, ComIPduGroupRef=VCU_oATOM_CANFD_Matrix_CH_V600_202502_Rx_5e4659c4, ComIPduSignalGroupRef=SG_IBS_Status_02_SigGroup_oIBS_Status_02_oATOM_CANFD_Matrix_CH_V600_202502_8df002b0_Rx, ComPduIdRef=EcucPduCollection/IBS_Status_02_oATOM_CANFD_Matrix_CH_V600_202502_3bba494d_Rx
        IBS_Status_03_oATOM_CANFD_Matrix_CH_V600_202502_f4245e85_Rx: ComIPduDirection=RECEIVE, ComIPduGroupRef=VCU_oATOM_CANFD_Matrix_CH_V600_202502_Rx_5e4659c4, ComIPduSignalGroupRef=SG_IBS_Status_03_SigGroup_oIBS_Status_03_oATOM_CANFD_Matrix_CH_V600_202502_2b221089_Rx, ComPduIdRef=EcucPduCollection/IBS_Status_03_oATOM_CANFD_Matrix_CH_V600_202502_f4245e85_Rx
        IBS_Status_04_oATOM_CANFD_Matrix_CH_V600_202502_f76d333e_Rx: ComIPduDirection=RECEIVE, ComIPduGroupRef=VCU_oATOM_CANFD_Matrix_CH_V600_202502_Rx_5e4659c4, ComIPduSignalGroupRef=SG_IBS_Status_04_SigGroup_oIBS_Status_04_oATOM_CANFD_Matrix_CH_V600_202502_edfe62a4_Rx, ComPduIdRef=EcucPduCollection/IBS_Status_04_oATOM_CANFD_Matrix_CH_V600_202502_f76d333e_Rx
        IBS_Status_06_oATOM_CANFD_Matrix_CH_V600_202502_b3201aef_Rx: ComIPduDirection=RECEIVE, ComIPduGroupRef=VCU_oATOM_CANFD_Matrix_CH_V600_202502_Rx_5e4659c4, ComIPduSignalGroupRef=SG_IBS_Status_06_SigGroup_oIBS_Status_06_oATOM_CANFD_Matrix_CH_V600_202502_7b2b4097_Rx, ComPduIdRef=EcucPduCollection/IBS_Status_06_oATOM_CANFD_Matrix_CH_V600_202502_b3201aef_Rx
        IBS_Torque_oATOM_CANFD_Matrix_CH_V600_202502_e4106cfa_Rx: ComIPduDirection=RECEIVE, ComIPduGroupRef=VCU_oATOM_CANFD_Matrix_CH_V600_202502_Rx_5e4659c4, ComIPduSignalGroupRef=SG_IBS_Torque_SigGroup_oIBS_Torque_oATOM_CANFD_Matrix_CH_V600_202502_5a2dd5ad_Rx, ComPduIdRef=EcucPduCollection/IBS_Torque_oATOM_CANFD_Matrix_CH_V600_202502_e4106cfa_Rx
        IBS_VCU_MotorControl_oATOM_CANFD_Matrix_CH_V600_202502_d229d0d9_Rx: ComIPduDirection=RECEIVE, ComIPduGroupRef=VCU_oATOM_CANFD_Matrix_CH_V600_202502_Rx_5e4659c4, ComIPduSignalGroupRef=SG_IBS_VCU_MotorControl_SigGroup_oIBS_VCU_MotorControl_oATOM_CANFD_Matrix_CH_V600_202502_9a811a5b_Rx, ComPduIdRef=EcucPduCollection/IBS_VCU_MotorControl_oATOM_CANFD_Matrix_CH_V600_202502_d229d0d9_Rx
        IBS_WheelSpeed_01_oATOM_CANFD_Matrix_CH_V600_202502_1c45b3ee_Rx: ComIPduDirection=RECEIVE, ComIPduGroupRef=VCU_oATOM_CANFD_Matrix_CH_V600_202502_Rx_5e4659c4, ComIPduSignalGroupRef=SG_IBS_WheelSpeed_01_SigGroup_oIBS_WheelSpeed_01_oATOM_CANFD_Matrix_CH_V600_202502_5773aa13_Rx, ComPduIdRef=EcucPduCollection/IBS_WheelSpeed_01_oATOM_CANFD_Matrix_CH_V600_202502_1c45b3ee_Rx
        IBS_WheelSpeed_02_oATOM_CANFD_Matrix_CH_V600_202502_97968df7_Rx: ComIPduDirection=RECEIVE, ComIPduGroupRef=VCU_oATOM_CANFD_Matrix_CH_V600_202502_Rx_5e4659c4, ComIPduSignalGroupRef=SG_IBS_WheelSpeed_02_SigGroup_oIBS_WheelSpeed_02_oATOM_CANFD_Matrix_CH_V600_202502_2d752b6e_Rx, ComPduIdRef=EcucPduCollection/IBS_WheelSpeed_02_oATOM_CANFD_Matrix_CH_V600_202502_97968df7_Rx
        PMP2_Sts_oLIN00_cab90b6b_Rx: ComIPduDirection=RECEIVE, ComIPduGroupRef=VCU_oLIN00_Rx_4b9dfc53, ComIPduSignalRef=PMP2_PumpDryRunningSta_oPMP2_Sts_oLIN00_3e217a22_Rx, ComIPduSignalRef=PMP2_PumpInputVolt_oPMP2_Sts_oLIN00_1fa0a533_Rx, ComIPduSignalRef=PMP2_PumpMotorSta_oPMP2_Sts_oLIN00_d6d3ab88_Rx, ComIPduSignalRef=PMP2_PumpPowerSta_oPMP2_Sts_oLIN00_1d0f1319_Rx, ComIPduSignalRef=PMP2_PumpTempSta_oPMP2_Sts_oLIN00_81f2fa55_Rx, ComIPduSignalRef=PMP2_RESP_ERROR_oPMP2_Sts_oLIN00_67b666eb_Rx, ComIPduSignalRef=PMP2_RealRPM_oPMP2_Sts_oLIN00_86d75572_Rx, ComPduIdRef=EcucPduCollection/PMP2_Sts_oLIN00_cab90b6b_Rx
        PMP3_Sts_oLIN00_511c4704_Rx: ComIPduDirection=RECEIVE, ComIPduGroupRef=VCU_oLIN00_Rx_4b9dfc53, ComIPduSignalRef=PMP3_PumpDryRunningSta_oPMP3_Sts_oLIN00_30f4e2d8_Rx, ComIPduSignalRef=PMP3_PumpInputVolt_oPMP3_Sts_oLIN00_75dfecf6_Rx, ComIPduSignalRef=PMP3_PumpMotorSta_oPMP3_Sts_oLIN00_43910f36_Rx, ComIPduSignalRef=PMP3_PumpPowerSta_oPMP3_Sts_oLIN00_884db7a7_Rx, ComIPduSignalRef=PMP3_PumpTempSta_oPMP3_Sts_oLIN00_26375532_Rx, ComIPduSignalRef=PMP3_RESP_ERROR_oPMP3_Sts_oLIN00_9f14f3a0_Rx, ComIPduSignalRef=PMP3_RealRPM_oPMP3_Sts_oLIN00_fa6fbf8a_Rx, ComPduIdRef=EcucPduCollection/PMP3_Sts_oLIN00_511c4704_Rx
        PMP_Cmd_oLIN00_3912b28b_Tx: ComIPduDirection=SEND, ComIPduGroupRef=VCU_oLIN00_Tx_1dc75bd5, ComIPduSignalRef=ECC_PMP2_SpdSet_oPMP_Cmd_oLIN00_8cabc4b7_Tx, ComIPduSignalRef=ECC_PMP3_SpdSet_oPMP_Cmd_oLIN00_0d8ea190_Tx, ComPduIdRef=EcucPduCollection/PMP_Cmd_oLIN00_3912b28b_Tx
          ComTxIPdu: ComTxIPduUnusedAreasDefault=255
        SGW_17_oATOM_CANFD_Matrix_CH_V600_202502_9b3e5336_Rx: ComIPduDirection=RECEIVE, ComIPduGroupRef=VCU_oATOM_CANFD_Matrix_CH_V600_202502_Rx_5e4659c4, ComIPduSignalGroupRef=SG_SGW_17_SigGroup_oSGW_17_oATOM_CANFD_Matrix_CH_V600_202502_804294b2_Rx, ComPduIdRef=EcucPduCollection/SGW_17_oATOM_CANFD_Matrix_CH_V600_202502_9b3e5336_Rx
        SVA_VCU_STD_oLIN00_4526aa1c_Rx: ComIPduDirection=RECEIVE, ComIPduGroupRef=VCU_oLIN00_Rx_4b9dfc53, ComIPduSignalRef=Act_Pos_sta_oSVA_VCU_STD_oLIN00_642c9ffa_Rx, ComIPduSignalRef=Blockage_Fault_STA_oSVA_VCU_STD_oLIN00_6c89246f_Rx, ComIPduSignalRef=Breakage_Fault_STA_oSVA_VCU_STD_oLIN00_a3ac9cf8_Rx, ComIPduSignalRef=Calibration_sta_oSVA_VCU_STD_oLIN00_dcb4af08_Rx, ComIPduSignalRef=LIN_Resp_Error_sta_oSVA_VCU_STD_oLIN00_47f7ca93_Rx, ComPduIdRef=EcucPduCollection/SVA_VCU_STD_oLIN00_4526aa1c_Rx
        TCU_HVCH_Cmd_oLIN00_385d5651_Tx: ComIPduDirection=SEND, ComIPduGroupRef=VCU_oLIN00_Tx_1dc75bd5, ComIPduSignalRef=TCU_HVCHMaxPowerLimit_oTCU_HVCH_Cmd_oLIN00_4bc53e0b_Tx, ComIPduSignalRef=TCU_HVCH_On_Rq_oTCU_HVCH_Cmd_oLIN00_9f442eaf_Tx, ComIPduSignalRef=TCU_HVCH_TmaxLim_output_oTCU_HVCH_Cmd_oLIN00_5e45d521_Tx, ComIPduSignalRef=TCU_HVCH_heating_rq_oTCU_HVCH_Cmd_oLIN00_5e3a32b2_Tx, ComPduIdRef=EcucPduCollection/TCU_HVCH_Cmd_oLIN00_385d5651_Tx
          ComTxIPdu: ComTxIPduUnusedAreasDefault=255
        VCU_02_oATOM_CANFD_Matrix_CH_V600_202502_17bac731_Tx: ComIPduDirection=SEND, ComIPduGroupRef=VCU_oATOM_CANFD_Matrix_CH_V600_202502_Tx_081cfe42, ComIPduSignalGroupRef=SG_VCU_02_SigGroup_oVCU_02_oATOM_CANFD_Matrix_CH_V600_202502_2fc20804_Tx, ComPduIdRef=EcucPduCollection/VCU_02_oATOM_CANFD_Matrix_CH_V600_202502_17bac731_Tx
          ComTxIPdu: ComMinimumDelayTime=0, ComTxIPduUnusedAreasDefault=0
            ComTxModeFalse
              ComTxMode: ComTxModeMode=PERIODIC, ComTxModeTimeOffset=0, ComTxModeTimePeriod=0.2
            ComTxModeTrue
              ComTxMode: ComTxModeMode=PERIODIC, ComTxModeTimeOffset=0, ComTxModeTimePeriod=0.2
        VCU_03_oATOM_CANFD_Matrix_CH_V600_202502_d824d0f9_Tx: ComIPduDirection=SEND, ComIPduGroupRef=VCU_oATOM_CANFD_Matrix_CH_V600_202502_Tx_081cfe42, ComIPduSignalGroupRef=SG_VCU_03_SigGroup_oVCU_03_oATOM_CANFD_Matrix_CH_V600_202502_8990e3c1_Tx, ComPduIdRef=EcucPduCollection/VCU_03_oATOM_CANFD_Matrix_CH_V600_202502_d824d0f9_Tx
          ComTxIPdu: ComMinimumDelayTime=0, ComTxIPduUnusedAreasDefault=0
            ComTxModeFalse
              ComTxMode: ComTxModeMode=PERIODIC, ComTxModeTimeOffset=0, ComTxModeTimePeriod=0.1
            ComTxModeTrue
              ComTxMode: ComTxModeMode=PERIODIC, ComTxModeTimeOffset=0, ComTxModeTimePeriod=0.1
        VCU_04_oATOM_CANFD_Matrix_CH_V600_202502_db6dbd42_Tx: ComIPduDirection=SEND, ComIPduGroupRef=VCU_oATOM_CANFD_Matrix_CH_V600_202502_Tx_081cfe42, ComIPduSignalGroupRef=SG_VCU_04_SigGroup_oVCU_04_oATOM_CANFD_Matrix_CH_V600_202502_4cce7c18_Tx, ComPduIdRef=EcucPduCollection/VCU_04_oATOM_CANFD_Matrix_CH_V600_202502_db6dbd42_Tx
          ComTxIPdu: ComMinimumDelayTime=0, ComTxIPduUnusedAreasDefault=0
            ComTxModeFalse
              ComTxMode: ComTxModeMode=PERIODIC, ComTxModeTimeOffset=0, ComTxModeTimePeriod=0.1
            ComTxModeTrue
              ComTxMode: ComTxModeMode=PERIODIC, ComTxModeTimeOffset=0, ComTxModeTimePeriod=0.1
        VCU_AccPedal_oATOM_CANFD_Matrix_CH_V600_202502_0d0df7a0_Tx: ComIPduDirection=SEND, ComIPduGroupRef=VCU_oATOM_CANFD_Matrix_CH_V600_202502_Tx_081cfe42, ComIPduSignalGroupRef=SG_VCU_AccPedal_SigGroup_oVCU_AccPedal_oATOM_CANFD_Matrix_CH_V600_202502_aa50ac8d_Tx, ComPduIdRef=EcucPduCollection/VCU_AccPedal_oATOM_CANFD_Matrix_CH_V600_202502_0d0df7a0_Tx
          ComTxIPdu: ComMinimumDelayTime=0, ComTxIPduUnusedAreasDefault=0
            ComTxModeFalse
              ComTxMode: ComTxModeMode=PERIODIC, ComTxModeTimeOffset=0, ComTxModeTimePeriod=0.02
            ComTxModeTrue
              ComTxMode: ComTxModeMode=PERIODIC, ComTxModeTimeOffset=0, ComTxModeTimePeriod=0.02
        VCU_BMS_oATOM_CANFD_Matrix_CH_V600_202502_1208e503_Tx: ComIPduDirection=SEND, ComIPduGroupRef=VCU_oATOM_CANFD_Matrix_CH_V600_202502_Tx_081cfe42, ComIPduSignalGroupRef=SG_VCU_BMS_SigGroup_oVCU_BMS_oATOM_CANFD_Matrix_CH_V600_202502_d27feb30_Tx, ComPduIdRef=EcucPduCollection/VCU_BMS_oATOM_CANFD_Matrix_CH_V600_202502_1208e503_Tx
          ComTxIPdu: ComMinimumDelayTime=0, ComTxIPduUnusedAreasDefault=0
            ComTxModeFalse
              ComTxMode: ComTxModeMode=PERIODIC, ComTxModeTimeOffset=0, ComTxModeTimePeriod=0.02
            ComTxModeTrue
              ComTxMode: ComTxModeMode=PERIODIC, ComTxModeTimeOffset=0, ComTxModeTimePeriod=0.02
        VCU_Chassis_01_oATOM_CANFD_Matrix_CH_V600_202502_d7fdb34f_Tx: ComIPduDirection=SEND, ComIPduGroupRef=VCU_oATOM_CANFD_Matrix_CH_V600_202502_Tx_081cfe42, ComIPduSignalGroupRef=SG_VCU_Chassis_01_SigGroup_oVCU_Chassis_01_oATOM_CANFD_Matrix_CH_V600_202502_52963860_Tx, ComPduIdRef=EcucPduCollection/VCU_Chassis_01_oATOM_CANFD_Matrix_CH_V600_202502_d7fdb34f_Tx
          ComTxIPdu: ComMinimumDelayTime=0, ComTxIPduUnusedAreasDefault=0
            ComTxModeFalse
              ComTxMode: ComTxModeMode=PERIODIC, ComTxModeTimeOffset=0, ComTxModeTimePeriod=0.02
            ComTxModeTrue
              ComTxMode: ComTxModeMode=PERIODIC, ComTxModeTimeOffset=0, ComTxModeTimePeriod=0.02
        VCU_EXV_1_oLIN00_50eec975_Tx: ComIPduDirection=SEND, ComIPduGroupRef=VCU_oLIN00_Tx_1dc75bd5, ComIPduSignalRef=TMM_EXV1_EnableRequest_oVCU_EXV_1_oLIN00_d988d266_Tx, ComIPduSignalRef=TMM_EXV1_PositionRequest_oVCU_EXV_1_oLIN00_cbd2de27_Tx, ComIPduSignalRef=TMM_EXV1_initRequest_oVCU_EXV_1_oLIN00_082350ea_Tx, ComPduIdRef=EcucPduCollection/VCU_EXV_1_oLIN00_50eec975_Tx
          ComTxIPdu: ComTxIPduUnusedAreasDefault=255
        VCU_EXV_2_oLIN00_de61ce96_Tx: ComIPduDirection=SEND, ComIPduGroupRef=VCU_oLIN00_Tx_1dc75bd5, ComIPduSignalRef=TMM_EXV2_EnableRequest_oVCU_EXV_2_oLIN00_0c106490_Tx, ComIPduSignalRef=TMM_EXV2_PositionRequest_oVCU_EXV_2_oLIN00_ce8ee7dd_Tx, ComIPduSignalRef=TMM_EXV2_initRequest_oVCU_EXV_2_oLIN00_95846e7a_Tx, ComPduIdRef=EcucPduCollection/VCU_EXV_2_oLIN00_de61ce96_Tx
          ComTxIPdu: ComTxIPduUnusedAreasDefault=255
        VCU_HMIsignals_01_oATOM_CANFD_Matrix_CH_V600_202502_f29a9fcc_Tx: ComIPduDirection=SEND, ComIPduGroupRef=VCU_oATOM_CANFD_Matrix_CH_V600_202502_Tx_081cfe42, ComIPduSignalGroupRef=SG_VCU_HMIsignals_01_SigGroup_oVCU_HMIsignals_01_oATOM_CANFD_Matrix_CH_V600_202502_c30c8d8f_Tx, ComPduIdRef=EcucPduCollection/VCU_HMIsignals_01_oATOM_CANFD_Matrix_CH_V600_202502_f29a9fcc_Tx
          ComTxIPdu: ComMinimumDelayTime=0, ComTxIPduUnusedAreasDefault=0
            ComTxModeFalse
              ComTxMode: ComTxModeMode=PERIODIC, ComTxModeTimeOffset=0, ComTxModeTimePeriod=0.2
            ComTxModeTrue
              ComTxMode: ComTxModeMode=PERIODIC, ComTxModeTimeOffset=0, ComTxModeTimePeriod=0.2
        VCU_HMIsignals_02_oATOM_CANFD_Matrix_CH_V600_202502_7949a1d5_Tx: ComIPduDirection=SEND, ComIPduGroupRef=VCU_oATOM_CANFD_Matrix_CH_V600_202502_Tx_081cfe42, ComIPduSignalGroupRef=SG_VCU_HMIsignals_02_SigGroup_oVCU_HMIsignals_02_oATOM_CANFD_Matrix_CH_V600_202502_b90a0cf2_Tx, ComPduIdRef=EcucPduCollection/VCU_HMIsignals_02_oATOM_CANFD_Matrix_CH_V600_202502_7949a1d5_Tx
          ComTxIPdu: ComMinimumDelayTime=0, ComTxIPduUnusedAreasDefault=0
            ComTxModeFalse
              ComTxMode: ComTxModeMode=PERIODIC, ComTxModeTimeOffset=0, ComTxModeTimePeriod=0.2
            ComTxModeTrue
              ComTxMode: ComTxModeMode=PERIODIC, ComTxModeTimeOffset=0, ComTxModeTimePeriod=0.2
        VCU_IBS_01_oATOM_CANFD_Matrix_CH_V600_202502_4c086bc0_Tx: ComIPduDirection=SEND, ComIPduGroupRef=VCU_oATOM_CANFD_Matrix_CH_V600_202502_Tx_081cfe42, ComIPduSignalGroupRef=SG_VCU_IBS_01_SigGroup_oVCU_IBS_01_oATOM_CANFD_Matrix_CH_V600_202502_f0f49d09_Tx, ComPduIdRef=EcucPduCollection/VCU_IBS_01_oATOM_CANFD_Matrix_CH_V600_202502_4c086bc0_Tx
          ComTxIPdu: ComMinimumDelayTime=0, ComTxIPduUnusedAreasDefault=0
            ComTxModeFalse
              ComTxMode: ComTxModeMode=PERIODIC, ComTxModeTimeOffset=0, ComTxModeTimePeriod=0.01
            ComTxModeTrue
              ComTxMode: ComTxModeMode=PERIODIC, ComTxModeTimeOffset=0, ComTxModeTimePeriod=0.01
        VCU_MCU_03_oATOM_CANFD_Matrix_CH_V600_202502_0d9d0aa9_Tx: ComIPduDirection=SEND, ComIPduGroupRef=VCU_oATOM_CANFD_Matrix_CH_V600_202502_Tx_081cfe42, ComIPduSignalGroupRef=SG_VCU_MCU_03_SigGroup_oVCU_MCU_03_oATOM_CANFD_Matrix_CH_V600_202502_c0057d9b_Tx, ComPduIdRef=EcucPduCollection/VCU_MCU_03_oATOM_CANFD_Matrix_CH_V600_202502_0d9d0aa9_Tx
          ComTxIPdu: ComMinimumDelayTime=0, ComTxIPduUnusedAreasDefault=0
            ComTxModeFalse
              ComTxMode: ComTxModeMode=PERIODIC, ComTxModeTimeOffset=0, ComTxModeTimePeriod=0.01
            ComTxModeTrue
              ComTxMode: ComTxModeMode=PERIODIC, ComTxModeTimeOffset=0, ComTxModeTimePeriod=0.01
        VCU_PlugInChrgInfo_oATOM_CANFD_Matrix_CH_V600_202502_20405e82_Tx: ComIPduDirection=SEND, ComIPduGroupRef=VCU_oATOM_CANFD_Matrix_CH_V600_202502_Tx_081cfe42, ComIPduSignalGroupRef=SG_VCU_PlugInChrgInfo_SigGroup_oVCU_PlugInChrgInfo_oATOM_CANFD_Matrix_CH_V600_202502_c285d340_Tx, ComPduIdRef=EcucPduCollection/VCU_PlugInChrgInfo_oATOM_CANFD_Matrix_CH_V600_202502_20405e82_Tx
          ComTxIPdu: ComMinimumDelayTime=0, ComTxIPduUnusedAreasDefault=0
            ComTxModeFalse
              ComTxMode: ComTxModeMode=PERIODIC, ComTxModeTimeOffset=0, ComTxModeTimePeriod=0.2
            ComTxModeTrue
              ComTxMode: ComTxModeMode=PERIODIC, ComTxModeTimeOffset=0, ComTxModeTimePeriod=0.2
        VCU_SVA_CMD_oLIN00_756d14f6_Tx: ComIPduDirection=SEND, ComIPduGroupRef=VCU_oLIN00_Tx_1dc75bd5, ComIPduSignalRef=Calibration_cmd_oVCU_SVA_CMD_oLIN00_6732180a_Tx, ComIPduSignalRef=Target_Pos_cmd_oVCU_SVA_CMD_oLIN00_b87f26ef_Tx, ComPduIdRef=EcucPduCollection/VCU_SVA_CMD_oLIN00_756d14f6_Tx
          ComTxIPdu: ComTxIPduUnusedAreasDefault=255
        VcuAdcTxG0Msg0_oTC37X_VCU_CAN01_5798df68_Tx: ComIPduDirection=SEND, ComIPduGroupRef=VCU_oTC37X_VCU_CAN01_Tx_4e6d6cda, ComIPduSignalRef=AN0_oVcuAdcTxG0Msg0_oTC37X_VCU_CAN01_66f10a00_Tx, ComIPduSignalRef=AN1_oVcuAdcTxG0Msg0_oTC37X_VCU_CAN01_42735b36_Tx, ComIPduSignalRef=AN2_oVcuAdcTxG0Msg0_oTC37X_VCU_CAN01_2ff5a86c_Tx, ComIPduSignalRef=AN3_oVcuAdcTxG0Msg0_oTC37X_VCU_CAN01_0b77f95a_Tx, ComPduIdRef=EcucPduCollection/VcuAdcTxG0Msg0_oTC37X_VCU_CAN01_5798df68_Tx
          ComTxIPdu: ComMinimumDelayTime=0, ComTxIPduUnusedAreasDefault=0
            ComTxModeFalse
              ComTxMode: ComTxModeMode=PERIODIC, ComTxModeTimeOffset=0, ComTxModeTimePeriod=0.5
            ComTxModeTrue
              ComTxMode: ComTxModeMode=PERIODIC, ComTxModeTimeOffset=0, ComTxModeTimePeriod=0.5
        VcuAdcTxG0Msg1_oTC37X_VCU_CAN01_b8ca6989_Tx: ComIPduDirection=SEND, ComIPduGroupRef=VCU_oTC37X_VCU_CAN01_Tx_4e6d6cda, ComIPduSignalRef=AN4_oVcuAdcTxG0Msg1_oTC37X_VCU_CAN01_1baaf839_Tx, ComIPduSignalRef=AN5_oVcuAdcTxG0Msg1_oTC37X_VCU_CAN01_3f28a90f_Tx, ComIPduSignalRef=AN6_oVcuAdcTxG0Msg1_oTC37X_VCU_CAN01_52ae5a55_Tx, ComIPduSignalRef=AN7_oVcuAdcTxG0Msg1_oTC37X_VCU_CAN01_762c0b63_Tx, ComPduIdRef=EcucPduCollection/VcuAdcTxG0Msg1_oTC37X_VCU_CAN01_b8ca6989_Tx
          ComTxIPdu: ComMinimumDelayTime=0, ComTxIPduUnusedAreasDefault=0
            ComTxModeFalse
              ComTxMode: ComTxModeMode=PERIODIC, ComTxModeTimeOffset=0, ComTxModeTimePeriod=0.5
            ComTxModeTrue
              ComTxMode: ComTxModeMode=PERIODIC, ComTxModeTimeOffset=0, ComTxModeTimePeriod=0.5
        VcuAdcTxG1Msg0_oTC37X_VCU_CAN01_40b0bba8_Tx: ComIPduDirection=SEND, ComIPduGroupRef=VCU_oTC37X_VCU_CAN01_Tx_4e6d6cda, ComIPduSignalRef=AN10_oVcuAdcTxG1Msg0_oTC37X_VCU_CAN01_f71f00b1_Tx, ComIPduSignalRef=AN11_oVcuAdcTxG1Msg0_oTC37X_VCU_CAN01_d39d5187_Tx, ComIPduSignalRef=AN8_oVcuAdcTxG1Msg0_oTC37X_VCU_CAN01_8ebae131_Tx, ComIPduSignalRef=AN9_oVcuAdcTxG1Msg0_oTC37X_VCU_CAN01_aa38b007_Tx, ComPduIdRef=EcucPduCollection/VcuAdcTxG1Msg0_oTC37X_VCU_CAN01_40b0bba8_Tx
          ComTxIPdu: ComMinimumDelayTime=0, ComTxIPduUnusedAreasDefault=0
            ComTxModeFalse
              ComTxMode: ComTxModeMode=PERIODIC, ComTxModeTimeOffset=0, ComTxModeTimePeriod=0.5
            ComTxModeTrue
              ComTxMode: ComTxModeMode=PERIODIC, ComTxModeTimeOffset=0, ComTxModeTimePeriod=0.5
        VcuAdcTxG1Msg1_oTC37X_VCU_CAN01_afe20d49_Tx: ComIPduDirection=SEND, ComIPduGroupRef=VCU_oTC37X_VCU_CAN01_Tx_4e6d6cda, ComIPduSignalRef=AN12_oVcuAdcTxG1Msg1_oTC37X_VCU_CAN01_5149143c_Tx, ComIPduSignalRef=AN13_oVcuAdcTxG1Msg1_oTC37X_VCU_CAN01_75cb450a_Tx, ComIPduSignalRef=AN14_oVcuAdcTxG1Msg1_oTC37X_VCU_CAN01_8a44f288_Tx, ComIPduSignalRef=AN15_oVcuAdcTxG1Msg1_oTC37X_VCU_CAN01_aec6a3be_Tx, ComPduIdRef=EcucPduCollection/VcuAdcTxG1Msg1_oTC37X_VCU_CAN01_afe20d49_Tx
          ComTxIPdu: ComMinimumDelayTime=0, ComTxIPduUnusedAreasDefault=0
            ComTxModeFalse
              ComTxMode: ComTxModeMode=PERIODIC, ComTxModeTimeOffset=0, ComTxModeTimePeriod=0.5
            ComTxModeTrue
              ComTxMode: ComTxModeMode=PERIODIC, ComTxModeTimeOffset=0, ComTxModeTimePeriod=0.5
        VcuAdcTxG2Msg0_oTC37X_VCU_CAN01_79c816e8_Tx: ComIPduDirection=SEND, ComIPduGroupRef=VCU_oTC37X_VCU_CAN01_Tx_4e6d6cda, ComIPduSignalRef=AN16_oVcuAdcTxG2Msg0_oTC37X_VCU_CAN01_156a4b45_Tx, ComIPduSignalRef=AN17_oVcuAdcTxG2Msg0_oTC37X_VCU_CAN01_31e81a73_Tx, ComIPduSignalRef=AN18_oVcuAdcTxG2Msg0_oTC37X_VCU_CAN01_31042200_Tx, ComIPduSignalRef=AN19_oVcuAdcTxG2Msg0_oTC37X_VCU_CAN01_15867336_Tx, ComPduIdRef=EcucPduCollection/VcuAdcTxG2Msg0_oTC37X_VCU_CAN01_79c816e8_Tx
          ComTxIPdu: ComMinimumDelayTime=0, ComTxIPduUnusedAreasDefault=0
            ComTxModeFalse
              ComTxMode: ComTxModeMode=PERIODIC, ComTxModeTimeOffset=0, ComTxModeTimePeriod=0.5
            ComTxModeTrue
              ComTxMode: ComTxModeMode=PERIODIC, ComTxModeTimeOffset=0, ComTxModeTimePeriod=0.5
        VcuAdcTxG2Msg1_oTC37X_VCU_CAN01_969aa009_Tx: ComIPduDirection=SEND, ComIPduGroupRef=VCU_oTC37X_VCU_CAN01_Tx_4e6d6cda, ComIPduSignalRef=AN20_oVcuAdcTxG2Msg1_oTC37X_VCU_CAN01_aae62509_Tx, ComIPduSignalRef=AN21_oVcuAdcTxG2Msg1_oTC37X_VCU_CAN01_8e64743f_Tx, ComIPduSignalRef=AN22_oVcuAdcTxG2Msg1_oTC37X_VCU_CAN01_e3e28765_Tx, ComIPduSignalRef=AN23_oVcuAdcTxG2Msg1_oTC37X_VCU_CAN01_c760d653_Tx, ComPduIdRef=EcucPduCollection/VcuAdcTxG2Msg1_oTC37X_VCU_CAN01_969aa009_Tx
          ComTxIPdu: ComMinimumDelayTime=0, ComTxIPduUnusedAreasDefault=0
            ComTxModeFalse
              ComTxMode: ComTxModeMode=PERIODIC, ComTxModeTimeOffset=0, ComTxModeTimePeriod=0.5
            ComTxModeTrue
              ComTxMode: ComTxModeMode=PERIODIC, ComTxModeTimeOffset=0, ComTxModeTimePeriod=0.5
        VcuAdcTxG3Msg0_oTC37X_VCU_CAN01_6ee07228_Tx: ComIPduDirection=SEND, ComIPduGroupRef=VCU_oTC37X_VCU_CAN01_Tx_4e6d6cda, ComIPduSignalRef=AN24_oVcuAdcTxG3Msg0_oTC37X_VCU_CAN01_c095b3f0_Tx, ComIPduSignalRef=AN25_oVcuAdcTxG3Msg0_oTC37X_VCU_CAN01_e417e2c6_Tx, ComIPduSignalRef=AN26_oVcuAdcTxG3Msg0_oTC37X_VCU_CAN01_8991119c_Tx, ComIPduSignalRef=AN27_oVcuAdcTxG3Msg0_oTC37X_VCU_CAN01_ad1340aa_Tx, ComPduIdRef=EcucPduCollection/VcuAdcTxG3Msg0_oTC37X_VCU_CAN01_6ee07228_Tx
          ComTxIPdu: ComMinimumDelayTime=0, ComTxIPduUnusedAreasDefault=0
            ComTxModeFalse
              ComTxMode: ComTxModeMode=PERIODIC, ComTxModeTimeOffset=0, ComTxModeTimePeriod=0.5
            ComTxModeTrue
              ComTxMode: ComTxModeMode=PERIODIC, ComTxModeTimeOffset=0, ComTxModeTimePeriod=0.5
        VcuAdcTxG3Msg1_oTC37X_VCU_CAN01_81b2c4c9_Tx: ComIPduDirection=SEND, ComIPduGroupRef=VCU_oTC37X_VCU_CAN01_Tx_4e6d6cda, ComIPduSignalRef=AN28_oVcuAdcTxG3Msg1_oTC37X_VCU_CAN01_42adce38_Tx, ComIPduSignalRef=AN29_oVcuAdcTxG3Msg1_oTC37X_VCU_CAN01_662f9f0e_Tx, ComIPduSignalRef=AN30_oVcuAdcTxG3Msg1_oTC37X_VCU_CAN01_72505601_Tx, ComIPduSignalRef=AN31_oVcuAdcTxG3Msg1_oTC37X_VCU_CAN01_56d20737_Tx, ComPduIdRef=EcucPduCollection/VcuAdcTxG3Msg1_oTC37X_VCU_CAN01_81b2c4c9_Tx
          ComTxIPdu: ComMinimumDelayTime=0, ComTxIPduUnusedAreasDefault=0
            ComTxModeFalse
              ComTxMode: ComTxModeMode=PERIODIC, ComTxModeTimeOffset=0, ComTxModeTimePeriod=0.5
            ComTxModeTrue
              ComTxMode: ComTxModeMode=PERIODIC, ComTxModeTimeOffset=0, ComTxModeTimePeriod=0.5
        VcuAdcTxG8Msg0_oTC37X_VCU_CAN01_eedbf968_Tx: ComIPduDirection=SEND, ComIPduGroupRef=VCU_oTC37X_VCU_CAN01_Tx_4e6d6cda, ComIPduSignalRef=AN32_oVcuAdcTxG8Msg0_oTC37X_VCU_CAN01_543dc9cc_Tx, ComIPduSignalRef=AN33_oVcuAdcTxG8Msg0_oTC37X_VCU_CAN01_70bf98fa_Tx, ComIPduSignalRef=AN34_oVcuAdcTxG8Msg0_oTC37X_VCU_CAN01_8f302f78_Tx, ComIPduSignalRef=AN35_oVcuAdcTxG8Msg0_oTC37X_VCU_CAN01_abb27e4e_Tx, ComPduIdRef=EcucPduCollection/VcuAdcTxG8Msg0_oTC37X_VCU_CAN01_eedbf968_Tx
          ComTxIPdu: ComMinimumDelayTime=0, ComTxIPduUnusedAreasDefault=0
            ComTxModeFalse
              ComTxMode: ComTxModeMode=PERIODIC, ComTxModeTimeOffset=0, ComTxModeTimePeriod=0.5
            ComTxModeTrue
              ComTxMode: ComTxModeMode=PERIODIC, ComTxModeTimeOffset=0, ComTxModeTimePeriod=0.5
        VcuAdcTxG8Msg1_oTC37X_VCU_CAN01_01894f89_Tx: ComIPduDirection=SEND, ComIPduGroupRef=VCU_oTC37X_VCU_CAN01_Tx_4e6d6cda, ComIPduSignalRef=AN36_oVcuAdcTxG8Msg1_oTC37X_VCU_CAN01_29663bf5_Tx, ComIPduSignalRef=AN37_oVcuAdcTxG8Msg1_oTC37X_VCU_CAN01_0de46ac3_Tx, ComIPduSignalRef=AN38_oVcuAdcTxG8Msg1_oTC37X_VCU_CAN01_0d0852b0_Tx, ComIPduSignalRef=AN39_oVcuAdcTxG8Msg1_oTC37X_VCU_CAN01_298a0386_Tx, ComPduIdRef=EcucPduCollection/VcuAdcTxG8Msg1_oTC37X_VCU_CAN01_01894f89_Tx
          ComTxIPdu: ComMinimumDelayTime=0, ComTxIPduUnusedAreasDefault=0
            ComTxModeFalse
              ComTxMode: ComTxModeMode=PERIODIC, ComTxModeTimeOffset=0, ComTxModeTimePeriod=0.5
            ComTxModeTrue
              ComTxMode: ComTxModeMode=PERIODIC, ComTxModeTimeOffset=0, ComTxModeTimePeriod=0.5
        VcuAdcTxG8Msg2_oTC37X_VCU_CAN01_eb0f92eb_Tx: ComIPduDirection=SEND, ComIPduGroupRef=VCU_oTC37X_VCU_CAN01_Tx_4e6d6cda, ComIPduSignalRef=AN40_oVcuAdcTxG8Msg2_oTC37X_VCU_CAN01_1ba46d98_Tx, ComIPduSignalRef=AN41_oVcuAdcTxG8Msg2_oTC37X_VCU_CAN01_3f263cae_Tx, ComIPduSignalRef=AN42_oVcuAdcTxG8Msg2_oTC37X_VCU_CAN01_52a0cff4_Tx, ComIPduSignalRef=AN43_oVcuAdcTxG8Msg2_oTC37X_VCU_CAN01_76229ec2_Tx, ComPduIdRef=EcucPduCollection/VcuAdcTxG8Msg2_oTC37X_VCU_CAN01_eb0f92eb_Tx
          ComTxIPdu: ComMinimumDelayTime=0, ComTxIPduUnusedAreasDefault=0
            ComTxModeFalse
              ComTxMode: ComTxModeMode=PERIODIC, ComTxModeTimeOffset=0, ComTxModeTimePeriod=0.5
            ComTxModeTrue
              ComTxMode: ComTxModeMode=PERIODIC, ComTxModeTimeOffset=0, ComTxModeTimePeriod=0.5
        VcuAdcTxG8Msg3_oTC37X_VCU_CAN01_045d240a_Tx: ComIPduDirection=SEND, ComIPduGroupRef=VCU_oTC37X_VCU_CAN01_Tx_4e6d6cda, ComIPduSignalRef=AN44_oVcuAdcTxG8Msg3_oTC37X_VCU_CAN01_66ff9fa1_Tx, ComIPduSignalRef=AN45_oVcuAdcTxG8Msg3_oTC37X_VCU_CAN01_427dce97_Tx, ComIPduSignalRef=AN46_oVcuAdcTxG8Msg3_oTC37X_VCU_CAN01_2ffb3dcd_Tx, ComIPduSignalRef=AN47_oVcuAdcTxG8Msg3_oTC37X_VCU_CAN01_0b796cfb_Tx, ComPduIdRef=EcucPduCollection/VcuAdcTxG8Msg3_oTC37X_VCU_CAN01_045d240a_Tx
          ComTxIPdu: ComMinimumDelayTime=0, ComTxIPduUnusedAreasDefault=0
            ComTxModeFalse
              ComTxMode: ComTxModeMode=PERIODIC, ComTxModeTimeOffset=0, ComTxModeTimePeriod=0.5
            ComTxModeTrue
              ComTxMode: ComTxModeMode=PERIODIC, ComTxModeTimeOffset=0, ComTxModeTimePeriod=0.5
        VcuCan03RxMsg1_oTC37X_VCU_CAN03_77e3a75f_Rx: ComIPduDirection=RECEIVE, ComIPduGroupRef=VCU_oTC37X_VCU_CAN03_Rx_b23e03d7, ComIPduSignalRef=VcuRxMsg3_Sig0_oVcuCan03RxMsg1_oTC37X_VCU_CAN03_ab1f8c96_Rx, ComIPduSignalRef=VcuRxMsg3_Sig1_oVcuCan03RxMsg1_oTC37X_VCU_CAN03_8f9ddda0_Rx, ComIPduSignalRef=VcuRxMsg3_Sig2_oVcuCan03RxMsg1_oTC37X_VCU_CAN03_e21b2efa_Rx, ComIPduSignalRef=VcuRxMsg3_Sig3_oVcuCan03RxMsg1_oTC37X_VCU_CAN03_c6997fcc_Rx, ComPduIdRef=EcucPduCollection/VcuCan03RxMsg1_oTC37X_VCU_CAN03_77e3a75f_Rx
        VcuCan03RxMsg2_oTC37X_VCU_CAN03_9d657a3d_Rx: ComIPduDirection=RECEIVE, ComIPduGroupRef=VCU_oTC37X_VCU_CAN03_Rx_b23e03d7, ComIPduSignalRef=VcuRxMsg4_Sig0_oVcuCan03RxMsg2_oTC37X_VCU_CAN03_735765ea_Rx, ComIPduSignalRef=VcuRxMsg4_Sig1_oVcuCan03RxMsg2_oTC37X_VCU_CAN03_57d534dc_Rx, ComIPduSignalRef=VcuRxMsg4_Sig2_oVcuCan03RxMsg2_oTC37X_VCU_CAN03_3a53c786_Rx, ComIPduSignalRef=VcuRxMsg4_Sig3_oVcuCan03RxMsg2_oTC37X_VCU_CAN03_1ed196b0_Rx, ComPduIdRef=EcucPduCollection/VcuCan03RxMsg2_oTC37X_VCU_CAN03_9d657a3d_Rx
        VcuCan03TxMsg1_oTC37X_VCU_CAN03_9a29d525_Tx: ComIPduDirection=SEND, ComIPduGroupRef=VCU_oTC37X_VCU_CAN03_Tx_e464a451, ComIPduSignalRef=VcuAdcTxMsg1_Sig0_oVcuCan03TxMsg1_oTC37X_VCU_CAN03_1782ee05_Tx, ComIPduSignalRef=VcuAdcTxMsg1_Sig1_oVcuCan03TxMsg1_oTC37X_VCU_CAN03_3300bf33_Tx, ComIPduSignalRef=VcuAdcTxMsg1_Sig2_oVcuCan03TxMsg1_oTC37X_VCU_CAN03_5e864c69_Tx, ComIPduSignalRef=VcuAdcTxMsg1_Sig3_oVcuCan03TxMsg1_oTC37X_VCU_CAN03_7a041d5f_Tx, ComPduIdRef=EcucPduCollection/VcuCan03TxMsg1_oTC37X_VCU_CAN03_9a29d525_Tx
          ComTxIPdu: ComMinimumDelayTime=0, ComTxIPduUnusedAreasDefault=0
            ComTxModeFalse
              ComTxMode: ComTxModeMode=PERIODIC, ComTxModeTimeOffset=0, ComTxModeTimePeriod=0.5
            ComTxModeTrue
              ComTxMode: ComTxModeMode=PERIODIC, ComTxModeTimeOffset=0, ComTxModeTimePeriod=0.5
        VcuCan03TxMsg2_oTC37X_VCU_CAN03_70af0847_Tx: ComIPduDirection=SEND, ComIPduGroupRef=VCU_oTC37X_VCU_CAN03_Tx_e464a451, ComIPduSignalRef=VcuAdcTxMsg2_Sig0_oVcuCan03TxMsg2_oTC37X_VCU_CAN03_2e9f2f9c_Tx, ComIPduSignalRef=VcuAdcTxMsg2_Sig1_oVcuCan03TxMsg2_oTC37X_VCU_CAN03_0a1d7eaa_Tx, ComIPduSignalRef=VcuAdcTxMsg2_Sig2_oVcuCan03TxMsg2_oTC37X_VCU_CAN03_679b8df0_Tx, ComIPduSignalRef=VcuAdcTxMsg2_Sig3_oVcuCan03TxMsg2_oTC37X_VCU_CAN03_4319dcc6_Tx, ComPduIdRef=EcucPduCollection/VcuCan03TxMsg2_oTC37X_VCU_CAN03_70af0847_Tx
          ComTxIPdu: ComMinimumDelayTime=0, ComTxIPduUnusedAreasDefault=0
            ComTxModeFalse
              ComTxMode: ComTxModeMode=PERIODIC, ComTxModeTimeOffset=0, ComTxModeTimePeriod=0.5
            ComTxModeTrue
              ComTxMode: ComTxModeMode=PERIODIC, ComTxModeTimeOffset=0, ComTxModeTimePeriod=0.5
        VcuCan12RxMsg3_oTC37X_VCU_CAN12_38853822_Rx: ComIPduDirection=RECEIVE, ComIPduGroupRef=VCU_oTC37X_VCU_CAN12_Rx_37e24d02, ComIPduSignalRef=VcuCan12RxMsg3_Sig0_oVcuCan12RxMsg3_oTC37X_VCU_CAN12_5a65a77f_Rx, ComIPduSignalRef=VcuCan12RxMsg3_Sig1_oVcuCan12RxMsg3_oTC37X_VCU_CAN12_7ee7f649_Rx, ComIPduSignalRef=VcuCan12RxMsg3_Sig2_oVcuCan12RxMsg3_oTC37X_VCU_CAN12_13610513_Rx, ComIPduSignalRef=VcuCan12RxMsg3_Sig3_oVcuCan12RxMsg3_oTC37X_VCU_CAN12_37e35425_Rx, ComPduIdRef=EcucPduCollection/VcuCan12RxMsg3_oTC37X_VCU_CAN12_38853822_Rx
        VcuCan12RxMsg4_oTC37X_VCU_CAN12_d9ab3246_Rx: ComIPduDirection=RECEIVE, ComIPduGroupRef=VCU_oTC37X_VCU_CAN12_Rx_37e24d02, ComIPduSignalRef=VcuCan12RxMsg4_Sig0_oVcuCan12RxMsg4_oTC37X_VCU_CAN12_89859905_Rx, ComIPduSignalRef=VcuCan12RxMsg4_Sig1_oVcuCan12RxMsg4_oTC37X_VCU_CAN12_ad07c833_Rx, ComIPduSignalRef=VcuCan12RxMsg4_Sig2_oVcuCan12RxMsg4_oTC37X_VCU_CAN12_c0813b69_Rx, ComIPduSignalRef=VcuCan12RxMsg4_Sig3_oVcuCan12RxMsg4_oTC37X_VCU_CAN12_e4036a5f_Rx, ComPduIdRef=EcucPduCollection/VcuCan12RxMsg4_oTC37X_VCU_CAN12_d9ab3246_Rx
        VcuCan12TxMsg1_oTC37X_VCU_CAN12_d09b21db_Tx: ComIPduDirection=SEND, ComIPduGroupRef=VCU_oTC37X_VCU_CAN12_Tx_61b8ea84, ComIPduSignalRef=VcuCan12TxMsg1_Sig0_oVcuCan12TxMsg1_oTC37X_VCU_CAN12_d3993898_Tx, ComIPduSignalRef=VcuCan12TxMsg1_Sig1_oVcuCan12TxMsg1_oTC37X_VCU_CAN12_f71b69ae_Tx, ComIPduSignalRef=VcuCan12TxMsg1_Sig2_oVcuCan12TxMsg1_oTC37X_VCU_CAN12_9a9d9af4_Tx, ComIPduSignalRef=VcuCan12TxMsg1_Sig3_oVcuCan12TxMsg1_oTC37X_VCU_CAN12_be1fcbc2_Tx, ComPduIdRef=EcucPduCollection/VcuCan12TxMsg1_oTC37X_VCU_CAN12_d09b21db_Tx
          ComTxIPdu: ComMinimumDelayTime=0, ComTxIPduUnusedAreasDefault=0
            ComTxModeFalse
              ComTxMode: ComTxModeMode=PERIODIC, ComTxModeTimeOffset=0, ComTxModeTimePeriod=0.5
            ComTxModeTrue
              ComTxMode: ComTxModeMode=PERIODIC, ComTxModeTimeOffset=0, ComTxModeTimePeriod=0.5
        VcuCan12TxMsg2_oTC37X_VCU_CAN12_3a1dfcb9_Tx: ComIPduDirection=SEND, ComIPduGroupRef=VCU_oTC37X_VCU_CAN12_Tx_61b8ea84, ComIPduSignalRef=VcuCan12TxMsg2_Sig0_oVcuCan12TxMsg2_oTC37X_VCU_CAN12_ea84f901_Tx, ComIPduSignalRef=VcuCan12TxMsg2_Sig1_oVcuCan12TxMsg2_oTC37X_VCU_CAN12_ce06a837_Tx, ComIPduSignalRef=VcuCan12TxMsg2_Sig2_oVcuCan12TxMsg2_oTC37X_VCU_CAN12_a3805b6d_Tx, ComIPduSignalRef=VcuCan12TxMsg2_Sig3_oVcuCan12TxMsg2_oTC37X_VCU_CAN12_87020a5b_Tx, ComPduIdRef=EcucPduCollection/VcuCan12TxMsg2_oTC37X_VCU_CAN12_3a1dfcb9_Tx
          ComTxIPdu: ComMinimumDelayTime=0, ComTxIPduUnusedAreasDefault=0
            ComTxModeFalse
              ComTxMode: ComTxModeMode=PERIODIC, ComTxModeTimeOffset=0, ComTxModeTimePeriod=0.5
            ComTxModeTrue
              ComTxMode: ComTxModeMode=PERIODIC, ComTxModeTimeOffset=0, ComTxModeTimePeriod=0.5
        VcuMeasurementMsg0_oTC37X_VCU_CAN01_0deb23c3_Tx: ComIPduDirection=SEND, ComIPduGroupRef=VCU_oTC37X_VCU_CAN01_Tx_4e6d6cda, ComIPduSignalRef=EXT_PWM_IN1_Duty_oVcuMeasurementMsg0_oTC37X_VCU_CAN01_92760a96_Tx, ComIPduSignalRef=EXT_PWM_IN1_Period_oVcuMeasurementMsg0_oTC37X_VCU_CAN01_c46a50e4_Tx, ComIPduSignalRef=EXT_PWM_IN2_Duty_oVcuMeasurementMsg0_oTC37X_VCU_CAN01_5b42119b_Tx, ComIPduSignalRef=EXT_PWM_IN2_Period_oVcuMeasurementMsg0_oTC37X_VCU_CAN01_fba12e71_Tx, ComIPduSignalRef=Ext_IN2_oVcuMeasurementMsg0_oTC37X_VCU_CAN01_a925e19e_Tx, ComPduIdRef=EcucPduCollection/VcuMeasurementMsg0_oTC37X_VCU_CAN01_0deb23c3_Tx
          ComTxIPdu: ComMinimumDelayTime=0, ComTxIPduUnusedAreasDefault=0
            ComTxModeFalse
              ComTxMode: ComTxModeMode=PERIODIC, ComTxModeTimeOffset=0, ComTxModeTimePeriod=0.5
            ComTxModeTrue
              ComTxMode: ComTxModeMode=PERIODIC, ComTxModeTimeOffset=0, ComTxModeTimePeriod=0.5
        VcuRxCtrlMsg0_oTC37X_VCU_CAN01_b24a2ab4_Rx: ComIPduDirection=RECEIVE, ComIPduGroupRef=VCU_oTC37X_VCU_CAN01_Rx_1837cb5c, ComIPduSignalRef=Tle888qk_Out21BriCfg_oVcuRxCtrlMsg0_oTC37X_VCU_CAN01_f4735e02_Rx, ComIPduSignalRef=Tle888qk_Out21_En_oVcuRxCtrlMsg0_oTC37X_VCU_CAN01_fce8b2a9_Rx, ComIPduSignalRef=Tle888qk_Out22BriCfg_oVcuRxCtrlMsg0_oTC37X_VCU_CAN01_27e842f9_Rx, ComIPduSignalRef=Tle888qk_Out22_En_oVcuRxCtrlMsg0_oTC37X_VCU_CAN01_9808c957_Rx, ComIPduSignalRef=Tle888qk_Out23BriCfg_oVcuRxCtrlMsg0_oTC37X_VCU_CAN01_69614950_Rx, ComIPduSignalRef=Tle888qk_Out23_En_oVcuRxCtrlMsg0_oTC37X_VCU_CAN01_0d781dc2_Rx, ComIPduSignalRef=Tle888qk_Out24BriCfg_oVcuRxCtrlMsg0_oTC37X_VCU_CAN01_5baf7d4e_Rx, ComIPduSignalRef=Tle888qk_Out24_En_oVcuRxCtrlMsg0_oTC37X_VCU_CAN01_51c83eab_Rx, ComPduIdRef=EcucPduCollection/VcuRxCtrlMsg0_oTC37X_VCU_CAN01_b24a2ab4_Rx
        VcuRxCtrlMsg1_oTC37X_VCU_CAN01_5d189c55_Rx: ComIPduDirection=RECEIVE, ComIPduGroupRef=VCU_oTC37X_VCU_CAN01_Rx_1837cb5c, ComIPduSignalRef=Bts7xx_HS1_En_oVcuRxCtrlMsg1_oTC37X_VCU_CAN01_d0692a3c_Rx, ComIPduSignalRef=Bts7xx_HS2_En_oVcuRxCtrlMsg1_oTC37X_VCU_CAN01_b48951c2_Rx, ComIPduSignalRef=Bts7xx_HS3_En_oVcuRxCtrlMsg1_oTC37X_VCU_CAN01_21f98557_Rx, ComIPduSignalRef=Bts7xx_HS4_En_oVcuRxCtrlMsg1_oTC37X_VCU_CAN01_7d49a63e_Rx, ComIPduSignalRef=Tle4252d_en_oVcuRxCtrlMsg1_oTC37X_VCU_CAN01_24c739a8_Rx, ComIPduSignalRef=Tle9201_Dir_oVcuRxCtrlMsg1_oTC37X_VCU_CAN01_4c38edaa_Rx, ComIPduSignalRef=Tle9201_Dis_oVcuRxCtrlMsg1_oTC37X_VCU_CAN01_7aca7d59_Rx, ComIPduSignalRef=Tle9201_Pwm_oVcuRxCtrlMsg1_oTC37X_VCU_CAN01_bf73fa17_Rx, ComPduIdRef=EcucPduCollection/VcuRxCtrlMsg1_oTC37X_VCU_CAN01_5d189c55_Rx
        VcuRxCtrlMsg2_oTC37X_VCU_CAN01_b79e4137_Rx: ComIPduDirection=RECEIVE, ComIPduGroupRef=VCU_oTC37X_VCU_CAN01_Rx_1837cb5c, ComIPduSignalRef=Tle888qk_Lout14_En_oVcuRxCtrlMsg2_oTC37X_VCU_CAN01_a11e1e88_Rx, ComIPduSignalRef=Tle888qk_Lout16_En_oVcuRxCtrlMsg2_oTC37X_VCU_CAN01_508eb1e3_Rx, ComIPduSignalRef=Tle888qk_Lout1_En_oVcuRxCtrlMsg2_oTC37X_VCU_CAN01_0e3571fa_Rx, ComIPduSignalRef=Tle888qk_Lout8_En_oVcuRxCtrlMsg2_oTC37X_VCU_CAN01_ebe51441_Rx, ComPduIdRef=EcucPduCollection/VcuRxCtrlMsg2_oTC37X_VCU_CAN01_b79e4137_Rx
        VcuRxMsg1_oTC37X_VCU_CAN00_78805594_Rx: ComIPduDirection=RECEIVE, ComIPduGroupRef=VCU_oTC37X_VCU_CAN00_Rx_a08bac39, ComIPduSignalRef=VcuRxMsg1_Sig0_oVcuRxMsg1_oTC37X_VCU_CAN00_13cef464_Rx, ComIPduSignalRef=VcuRxMsg1_Sig1_oVcuRxMsg1_oTC37X_VCU_CAN00_70c92d40_Rx, ComIPduSignalRef=VcuRxMsg1_Sig2_oVcuRxMsg1_oTC37X_VCU_CAN00_d5c1462c_Rx, ComIPduSignalRef=VcuRxMsg1_Sig3_oVcuRxMsg1_oTC37X_VCU_CAN00_b6c69f08_Rx, ComPduIdRef=EcucPduCollection/VcuRxMsg1_oTC37X_VCU_CAN00_78805594_Rx
        VcuRxMsg2_oTC37X_VCU_CAN00_920688f6_Rx: ComIPduDirection=RECEIVE, ComIPduGroupRef=VCU_oTC37X_VCU_CAN00_Rx_a08bac39, ComIPduSignalRef=VcuRxMsg2_Sig0_oVcuRxMsg2_oTC37X_VCU_CAN00_94ceda5c_Rx, ComIPduSignalRef=VcuRxMsg2_Sig1_oVcuRxMsg2_oTC37X_VCU_CAN00_f7c90378_Rx, ComIPduSignalRef=VcuRxMsg2_Sig2_oVcuRxMsg2_oTC37X_VCU_CAN00_52c16814_Rx, ComIPduSignalRef=VcuRxMsg2_Sig3_oVcuRxMsg2_oTC37X_VCU_CAN00_31c6b130_Rx, ComPduIdRef=EcucPduCollection/VcuRxMsg2_oTC37X_VCU_CAN00_920688f6_Rx
        VcuRxMsg3_oTC37X_VCU_CAN01_0a530e81_Rx: ComIPduDirection=RECEIVE, ComIPduGroupRef=VCU_oTC37X_VCU_CAN01_Rx_1837cb5c, ComIPduSignalRef=VcuRxMsg3_Sig0_oVcuRxMsg3_oTC37X_VCU_CAN01_28190d1d_Rx, ComIPduSignalRef=VcuRxMsg3_Sig1_oVcuRxMsg3_oTC37X_VCU_CAN01_4b1ed439_Rx, ComIPduSignalRef=VcuRxMsg3_Sig2_oVcuRxMsg3_oTC37X_VCU_CAN01_ee16bf55_Rx, ComIPduSignalRef=VcuRxMsg3_Sig3_oVcuRxMsg3_oTC37X_VCU_CAN01_8d116671_Rx, ComPduIdRef=EcucPduCollection/VcuRxMsg3_oTC37X_VCU_CAN01_0a530e81_Rx
        VcuRxMsg4_oTC37X_VCU_CAN01_eb7d04e5_Rx: ComIPduDirection=RECEIVE, ComIPduGroupRef=VCU_oTC37X_VCU_CAN01_Rx_1837cb5c, ComIPduSignalRef=VcuRxMsg4_Sig0_oVcuRxMsg4_oTC37X_VCU_CAN01_36b8b0fb_Rx, ComIPduSignalRef=VcuRxMsg4_Sig1_oVcuRxMsg4_oTC37X_VCU_CAN01_55bf69df_Rx, ComIPduSignalRef=VcuRxMsg4_Sig2_oVcuRxMsg4_oTC37X_VCU_CAN01_f0b702b3_Rx, ComIPduSignalRef=VcuRxMsg4_Sig3_oVcuRxMsg4_oTC37X_VCU_CAN01_93b0db97_Rx, ComPduIdRef=EcucPduCollection/VcuRxMsg4_oTC37X_VCU_CAN01_eb7d04e5_Rx
        VcuTxIoMsg1_oTC37X_VCU_CAN00_54884add_Tx: ComIPduDirection=SEND, ComIPduGroupRef=VCU_oTC37X_VCU_CAN00_Tx_f6d10bbf, ComIPduSignalRef=EXT1_Valid_oVcuTxIoMsg1_oTC37X_VCU_CAN00_caf787ea_Tx, ComIPduSignalRef=EXT2_Valid_oVcuTxIoMsg1_oTC37X_VCU_CAN00_9096b88a_Tx, ComIPduSignalRef=EXT_A_IN1_oVcuTxIoMsg1_oTC37X_VCU_CAN00_37348eff_Tx, ComIPduSignalRef=EXT_A_IN2_oVcuTxIoMsg1_oTC37X_VCU_CAN00_241cb78c_Tx, ComPduIdRef=EcucPduCollection/VcuTxIoMsg1_oTC37X_VCU_CAN00_54884add_Tx
          ComTxIPdu: ComMinimumDelayTime=0, ComTxIPduUnusedAreasDefault=0
            ComTxModeFalse
              ComTxMode: ComTxModeMode=PERIODIC, ComTxModeTimeOffset=0, ComTxModeTimePeriod=0.5
            ComTxModeTrue
              ComTxMode: ComTxModeMode=PERIODIC, ComTxModeTimeOffset=0, ComTxModeTimePeriod=0.5
        VcuTxIoMsg2_oTC37X_VCU_CAN00_be0e97bf_Tx: ComIPduDirection=SEND, ComIPduGroupRef=VCU_oTC37X_VCU_CAN00_Tx_f6d10bbf, ComIPduSignalRef=EXT3_Valid_oVcuTxIoMsg2_oTC37X_VCU_CAN00_fae072f7_Tx, ComIPduSignalRef=EXT4_Valid_oVcuTxIoMsg2_oTC37X_VCU_CAN00_ced21b28_Tx, ComIPduSignalRef=EXT_A_IN3_oVcuTxIoMsg2_oTC37X_VCU_CAN00_c07d823f_Tx, ComIPduSignalRef=EXT_A_IN4_oVcuTxIoMsg2_oTC37X_VCU_CAN00_e8ca1808_Tx, ComPduIdRef=EcucPduCollection/VcuTxIoMsg2_oTC37X_VCU_CAN00_be0e97bf_Tx
          ComTxIPdu: ComMinimumDelayTime=0, ComTxIPduUnusedAreasDefault=0
            ComTxModeFalse
              ComTxMode: ComTxModeMode=PERIODIC, ComTxModeTimeOffset=0, ComTxModeTimePeriod=0.5
            ComTxModeTrue
              ComTxMode: ComTxModeMode=PERIODIC, ComTxModeTimeOffset=0, ComTxModeTimePeriod=0.5
        VcuTxIoMsg3_oTC37X_VCU_CAN00_515c215e_Tx: ComIPduDirection=SEND, ComIPduGroupRef=VCU_oTC37X_VCU_CAN00_Tx_f6d10bbf, ComIPduSignalRef=EXT5_Valid_oVcuTxIoMsg3_oTC37X_VCU_CAN00_a170bad6_Tx, ComIPduSignalRef=EXT6_Valid_oVcuTxIoMsg3_oTC37X_VCU_CAN00_fb1185b6_Tx, ComIPduSignalRef=EXT_A_IN5_oVcuTxIoMsg3_oTC37X_VCU_CAN00_097f4638_Tx, ComIPduSignalRef=EXT_A_IN6_oVcuTxIoMsg3_oTC37X_VCU_CAN00_1a577f4b_Tx, ComPduIdRef=EcucPduCollection/VcuTxIoMsg3_oTC37X_VCU_CAN00_515c215e_Tx
          ComTxIPdu: ComMinimumDelayTime=0, ComTxIPduUnusedAreasDefault=0
            ComTxModeFalse
              ComTxMode: ComTxModeMode=PERIODIC, ComTxModeTimeOffset=0, ComTxModeTimePeriod=0.5
            ComTxModeTrue
              ComTxMode: ComTxModeMode=PERIODIC, ComTxModeTimeOffset=0, ComTxModeTimePeriod=0.5
        VcuTxIoMsg4_oTC37X_VCU_CAN00_b0722b3a_Tx: ComIPduDirection=SEND, ComIPduGroupRef=VCU_oTC37X_VCU_CAN00_Tx_f6d10bbf, ComIPduSignalRef=EXT7_Valid_oVcuTxIoMsg4_oTC37X_VCU_CAN00_9acf98cd_Tx, ComIPduSignalRef=EXT8_Valid_oVcuTxIoMsg4_oTC37X_VCU_CAN00_725b5c6c_Tx, ComIPduSignalRef=EXT_A_IN7_oVcuTxIoMsg4_oTC37X_VCU_CAN00_f59e9dfe_Tx, ComIPduSignalRef=EXT_A_IN8_oVcuTxIoMsg4_oTC37X_VCU_CAN00_aa164141_Tx, ComPduIdRef=EcucPduCollection/VcuTxIoMsg4_oTC37X_VCU_CAN00_b0722b3a_Tx
          ComTxIPdu: ComMinimumDelayTime=0, ComTxIPduUnusedAreasDefault=0
            ComTxModeFalse
              ComTxMode: ComTxModeMode=PERIODIC, ComTxModeTimeOffset=0, ComTxModeTimePeriod=0.5
            ComTxModeTrue
              ComTxMode: ComTxModeMode=PERIODIC, ComTxModeTimeOffset=0, ComTxModeTimePeriod=0.5
        VcuTxIoMsg5_oTC37X_VCU_CAN00_5f209ddb_Tx: ComIPduDirection=SEND, ComIPduGroupRef=VCU_oTC37X_VCU_CAN00_Tx_f6d10bbf, ComIPduSignalRef=EXT10_Valid_oVcuTxIoMsg5_oTC37X_VCU_CAN00_ba532916_Tx, ComIPduSignalRef=EXT9_Valid_oVcuTxIoMsg5_oTC37X_VCU_CAN00_1df9fd92_Tx, ComIPduSignalRef=EXT_A_IN10_oVcuTxIoMsg5_oTC37X_VCU_CAN00_83e5b725_Tx, ComIPduSignalRef=EXT_A_IN9_oVcuTxIoMsg5_oTC37X_VCU_CAN00_4ba31f71_Tx, ComPduIdRef=EcucPduCollection/VcuTxIoMsg5_oTC37X_VCU_CAN00_5f209ddb_Tx
          ComTxIPdu: ComMinimumDelayTime=0, ComTxIPduUnusedAreasDefault=0
            ComTxModeFalse
              ComTxMode: ComTxModeMode=PERIODIC, ComTxModeTimeOffset=0, ComTxModeTimePeriod=0.5
            ComTxModeTrue
              ComTxMode: ComTxModeMode=PERIODIC, ComTxModeTimeOffset=0, ComTxModeTimePeriod=0.5
        VcuTxIoMsg6_oTC37X_VCU_CAN00_b5a640b9_Tx: ComIPduDirection=SEND, ComIPduGroupRef=VCU_oTC37X_VCU_CAN00_Tx_f6d10bbf, ComIPduSignalRef=EXT11_Valid_oVcuTxIoMsg6_oTC37X_VCU_CAN00_d025e36b_Tx, ComIPduSignalRef=EXT12_Valid_oVcuTxIoMsg6_oTC37X_VCU_CAN00_8a44dc0b_Tx, ComIPduSignalRef=EXT_A_IN11_oVcuTxIoMsg6_oTC37X_VCU_CAN00_67848296_Tx, ComIPduSignalRef=EXT_A_IN12_oVcuTxIoMsg6_oTC37X_VCU_CAN00_74acbbe5_Tx, ComPduIdRef=EcucPduCollection/VcuTxIoMsg6_oTC37X_VCU_CAN00_b5a640b9_Tx
          ComTxIPdu: ComMinimumDelayTime=0, ComTxIPduUnusedAreasDefault=0
            ComTxModeFalse
              ComTxMode: ComTxModeMode=PERIODIC, ComTxModeTimeOffset=0, ComTxModeTimePeriod=0.5
            ComTxModeTrue
              ComTxMode: ComTxModeMode=PERIODIC, ComTxModeTimeOffset=0, ComTxModeTimePeriod=0.5
        VcuTxIoMsg7_oTC37X_VCU_CAN00_5af4f658_Tx: ComIPduDirection=SEND, ComIPduGroupRef=VCU_oTC37X_VCU_CAN00_Tx_f6d10bbf, ComIPduSignalRef=EXT13_Valid_oVcuTxIoMsg7_oTC37X_VCU_CAN00_e5e67df5_Tx, ComIPduSignalRef=EXT14_Valid_oVcuTxIoMsg7_oTC37X_VCU_CAN00_d1d4142a_Tx, ComIPduSignalRef=EXT_A_IN13_oVcuTxIoMsg7_oTC37X_VCU_CAN00_9519e5d5_Tx, ComIPduSignalRef=EXT_A_IN14_oVcuTxIoMsg7_oTC37X_VCU_CAN00_bdae7fe2_Tx, ComPduIdRef=EcucPduCollection/VcuTxIoMsg7_oTC37X_VCU_CAN00_5af4f658_Tx
          ComTxIPdu: ComMinimumDelayTime=0, ComTxIPduUnusedAreasDefault=0
            ComTxModeFalse
              ComTxMode: ComTxModeMode=PERIODIC, ComTxModeTimeOffset=0, ComTxModeTimePeriod=0.5
            ComTxModeTrue
              ComTxMode: ComTxModeMode=PERIODIC, ComTxModeTimeOffset=0, ComTxModeTimePeriod=0.5
        VcuTxIoMsg8_oTC37X_VCU_CAN00_ac8b5230_Tx: ComIPduDirection=SEND, ComIPduGroupRef=VCU_oTC37X_VCU_CAN00_Tx_f6d10bbf, ComIPduSignalRef=EXT15_Valid_oVcuTxIoMsg8_oTC37X_VCU_CAN00_a75ba75d_Tx, ComIPduSignalRef=EXT16_Valid_oVcuTxIoMsg8_oTC37X_VCU_CAN00_fd3a983d_Tx, ComIPduSignalRef=EXT_A_IN15_oVcuTxIoMsg8_oTC37X_VCU_CAN00_4536335b_Tx, ComIPduSignalRef=EXT_A_IN16_oVcuTxIoMsg8_oTC37X_VCU_CAN00_561e0a28_Tx, ComPduIdRef=EcucPduCollection/VcuTxIoMsg8_oTC37X_VCU_CAN00_ac8b5230_Tx
          ComTxIPdu: ComMinimumDelayTime=0, ComTxIPduUnusedAreasDefault=0
            ComTxModeFalse
              ComTxMode: ComTxModeMode=PERIODIC, ComTxModeTimeOffset=0, ComTxModeTimePeriod=0.5
            ComTxModeTrue
              ComTxMode: ComTxModeMode=PERIODIC, ComTxModeTimeOffset=0, ComTxModeTimePeriod=0.5
        VcuTxMsg1_oTC37X_VCU_CAN00_954a27ee_Tx: ComIPduDirection=SEND, ComIPduGroupRef=VCU_oTC37X_VCU_CAN00_Tx_f6d10bbf, ComIPduSignalRef=VcuTxMsg1_Sig0_oVcuTxMsg1_oTC37X_VCU_CAN00_8243b9a9_Tx, ComIPduSignalRef=VcuTxMsg1_Sig1_oVcuTxMsg1_oTC37X_VCU_CAN00_e144608d_Tx, ComIPduSignalRef=VcuTxMsg1_Sig2_oVcuTxMsg1_oTC37X_VCU_CAN00_444c0be1_Tx, ComIPduSignalRef=VcuTxMsg1_Sig3_oVcuTxMsg1_oTC37X_VCU_CAN00_274bd2c5_Tx, ComPduIdRef=EcucPduCollection/VcuTxMsg1_oTC37X_VCU_CAN00_954a27ee_Tx
          ComTxIPdu: ComMinimumDelayTime=0, ComTxIPduUnusedAreasDefault=0
            ComTxModeFalse
              ComTxMode: ComTxModeMode=PERIODIC, ComTxModeTimeOffset=0, ComTxModeTimePeriod=0.5
            ComTxModeTrue
              ComTxMode: ComTxModeMode=PERIODIC, ComTxModeTimeOffset=0, ComTxModeTimePeriod=0.5
        VcuTxMsg2_oTC37X_VCU_CAN00_7fccfa8c_Tx: ComIPduDirection=SEND, ComIPduGroupRef=VCU_oTC37X_VCU_CAN00_Tx_f6d10bbf, ComIPduSignalRef=VcuTxMsg2_Sig0_oVcuTxMsg2_oTC37X_VCU_CAN00_05439791_Tx, ComIPduSignalRef=VcuTxMsg2_Sig1_oVcuTxMsg2_oTC37X_VCU_CAN00_66444eb5_Tx, ComIPduSignalRef=VcuTxMsg2_Sig2_oVcuTxMsg2_oTC37X_VCU_CAN00_c34c25d9_Tx, ComIPduSignalRef=VcuTxMsg2_Sig3_oVcuTxMsg2_oTC37X_VCU_CAN00_a04bfcfd_Tx, ComPduIdRef=EcucPduCollection/VcuTxMsg2_oTC37X_VCU_CAN00_7fccfa8c_Tx
          ComTxIPdu: ComMinimumDelayTime=0, ComTxIPduUnusedAreasDefault=0
            ComTxModeFalse
              ComTxMode: ComTxModeMode=PERIODIC, ComTxModeTimeOffset=0, ComTxModeTimePeriod=0.5
            ComTxModeTrue
              ComTxMode: ComTxModeMode=PERIODIC, ComTxModeTimeOffset=0, ComTxModeTimePeriod=0.5
        Vcu_Lin0_RxMsg1_oLIN01_24780c64_Rx: ComIPduDirection=RECEIVE, ComIPduGroupRef=VCU_oLIN01_Rx_f3219b36, ComIPduSignalRef=Vcu_Lin0_RxMsg1_Sig0_oVcu_Lin0_RxMsg1_oLIN01_6c375668_Rx, ComIPduSignalRef=Vcu_Lin0_RxMsg1_Sig1_oVcu_Lin0_RxMsg1_oLIN01_c9bcc666_Rx, ComIPduSignalRef=Vcu_Lin0_RxMsg2_Sig2_oVcu_Lin0_RxMsg1_oLIN01_b8f0552d_Rx, ComIPduSignalRef=Vcu_Lin0_RxMsg2_Sig3_oVcu_Lin0_RxMsg1_oLIN01_1d7bc523_Rx, ComPduIdRef=EcucPduCollection/Vcu_Lin0_RxMsg1_oLIN01_24780c64_Rx
        Vcu_Lin0_RxMsg2_oLIN01_aaf70b87_Rx: ComIPduDirection=RECEIVE, ComIPduGroupRef=VCU_oLIN01_Rx_f3219b36, ComIPduSignalRef=Vcu_Lin0_RxMsg2_Sig0_oVcu_Lin0_RxMsg2_oLIN01_a6197493_Rx, ComIPduSignalRef=Vcu_Lin0_RxMsg2_Sig1_oVcu_Lin0_RxMsg2_oLIN01_0392e49d_Rx, ComIPduSignalRef=Vcu_Lin0_RxMsg2_Sig2_oVcu_Lin0_RxMsg2_oLIN01_367f52ce_Rx, ComIPduSignalRef=Vcu_Lin0_RxMsg2_Sig3_oVcu_Lin0_RxMsg2_oLIN01_93f4c2c0_Rx, ComPduIdRef=EcucPduCollection/Vcu_Lin0_RxMsg2_oLIN01_aaf70b87_Rx
        Vcu_Lin0_TxMsg1_oLIN01_849dd3b9_Tx: ComIPduDirection=SEND, ComIPduGroupRef=VCU_oLIN01_Tx_a57b3cb0, ComIPduSignalRef=Vcu_Lin0_TxMsg1_Sig0_oVcu_Lin0_TxMsg1_oLIN01_0005f3c6_Tx, ComIPduSignalRef=Vcu_Lin0_TxMsg1_Sig1_oVcu_Lin0_TxMsg1_oLIN01_a58e63c8_Tx, ComIPduSignalRef=Vcu_Lin0_TxMsg1_Sig2_oVcu_Lin0_TxMsg1_oLIN01_9063d59b_Tx, ComIPduSignalRef=Vcu_Lin0_TxMsg1_Sig3_oVcu_Lin0_TxMsg1_oLIN01_35e84595_Tx, ComPduIdRef=EcucPduCollection/Vcu_Lin0_TxMsg1_oLIN01_849dd3b9_Tx
          ComTxIPdu: ComTxIPduUnusedAreasDefault=255
        Vcu_Lin0_TxMsg2_oLIN01_0a12d45a_Tx: ComIPduDirection=SEND, ComIPduGroupRef=VCU_oLIN01_Tx_a57b3cb0, ComIPduSignalRef=Vcu_Lin0_TxMsg2_Sig0_oVcu_Lin0_TxMsg2_oLIN01_ca2bd13d_Tx, ComIPduSignalRef=Vcu_Lin0_TxMsg2_Sig1_oVcu_Lin0_TxMsg2_oLIN01_6fa04133_Tx, ComIPduSignalRef=Vcu_Lin0_TxMsg2_Sig2_oVcu_Lin0_TxMsg2_oLIN01_5a4df760_Tx, ComIPduSignalRef=Vcu_Lin0_TxMsg2_Sig3_oVcu_Lin0_TxMsg2_oLIN01_ffc6676e_Tx, ComPduIdRef=EcucPduCollection/Vcu_Lin0_TxMsg2_oLIN01_0a12d45a_Tx
          ComTxIPdu: ComTxIPduUnusedAreasDefault=255
      14 x ComIPduGroup:
        VCU_oATOM_CANFD_Matrix_CH_V600_202502_Rx_5e4659c4
        VCU_oATOM_CANFD_Matrix_CH_V600_202502_Tx_081cfe42
        VCU_oLIN00_Rx_4b9dfc53
        VCU_oLIN00_Tx_1dc75bd5
        VCU_oLIN01_Rx_f3219b36
        VCU_oLIN01_Tx_a57b3cb0
        VCU_oTC37X_VCU_CAN00_Rx_a08bac39
        VCU_oTC37X_VCU_CAN00_Tx_f6d10bbf
        VCU_oTC37X_VCU_CAN01_Rx_1837cb5c
        VCU_oTC37X_VCU_CAN01_Tx_4e6d6cda
        VCU_oTC37X_VCU_CAN03_Rx_b23e03d7
        VCU_oTC37X_VCU_CAN03_Tx_e464a451
        VCU_oTC37X_VCU_CAN12_Rx_37e24d02
        VCU_oTC37X_VCU_CAN12_Tx_61b8ea84
      250 x ComSignal, all with ComSignalEndianness=LITTLE_ENDIAN:
        AN0_oVcuAdcTxG0Msg0_oTC37X_VCU_CAN01_66f10a00_Tx: ComBitPosition=0, ComBitSize=16, ComSignalInitValue=0, ComSignalType=SINT16, ComTimeout=0, ComTransferProperty=PENDING, ComSystemTemplateSystemSignalRef=AN0
        AN10_oVcuAdcTxG1Msg0_oTC37X_VCU_CAN01_f71f00b1_Tx: ComBitPosition=32, ComBitSize=16, ComSignalInitValue=0, ComSignalType=SINT16, ComTimeout=0, ComTransferProperty=PENDING, ComSystemTemplateSystemSignalRef=AN10
        AN11_oVcuAdcTxG1Msg0_oTC37X_VCU_CAN01_d39d5187_Tx: ComBitPosition=48, ComBitSize=16, ComSignalInitValue=0, ComSignalType=SINT16, ComTimeout=0, ComTransferProperty=PENDING, ComSystemTemplateSystemSignalRef=AN11
        AN12_oVcuAdcTxG1Msg1_oTC37X_VCU_CAN01_5149143c_Tx: ComBitPosition=0, ComBitSize=16, ComSignalInitValue=0, ComSignalType=SINT16, ComTimeout=0, ComTransferProperty=PENDING, ComSystemTemplateSystemSignalRef=AN12
        AN13_oVcuAdcTxG1Msg1_oTC37X_VCU_CAN01_75cb450a_Tx: ComBitPosition=16, ComBitSize=16, ComSignalInitValue=0, ComSignalType=SINT16, ComTimeout=0, ComTransferProperty=PENDING, ComSystemTemplateSystemSignalRef=AN13
        AN14_oVcuAdcTxG1Msg1_oTC37X_VCU_CAN01_8a44f288_Tx: ComBitPosition=32, ComBitSize=16, ComSignalInitValue=0, ComSignalType=SINT16, ComTimeout=0, ComTransferProperty=PENDING, ComSystemTemplateSystemSignalRef=AN14
        AN15_oVcuAdcTxG1Msg1_oTC37X_VCU_CAN01_aec6a3be_Tx: ComBitPosition=48, ComBitSize=16, ComSignalInitValue=0, ComSignalType=SINT16, ComTimeout=0, ComTransferProperty=PENDING, ComSystemTemplateSystemSignalRef=AN15
        AN16_oVcuAdcTxG2Msg0_oTC37X_VCU_CAN01_156a4b45_Tx: ComBitPosition=0, ComBitSize=16, ComSignalInitValue=0, ComSignalType=SINT16, ComTimeout=0, ComTransferProperty=PENDING, ComSystemTemplateSystemSignalRef=AN16
        AN17_oVcuAdcTxG2Msg0_oTC37X_VCU_CAN01_31e81a73_Tx: ComBitPosition=16, ComBitSize=16, ComSignalInitValue=0, ComSignalType=SINT16, ComTimeout=0, ComTransferProperty=PENDING, ComSystemTemplateSystemSignalRef=AN17
        AN18_oVcuAdcTxG2Msg0_oTC37X_VCU_CAN01_31042200_Tx: ComBitPosition=32, ComBitSize=16, ComSignalInitValue=0, ComSignalType=SINT16, ComTimeout=0, ComTransferProperty=PENDING, ComSystemTemplateSystemSignalRef=AN18
        AN19_oVcuAdcTxG2Msg0_oTC37X_VCU_CAN01_15867336_Tx: ComBitPosition=48, ComBitSize=16, ComSignalInitValue=0, ComSignalType=SINT16, ComTimeout=0, ComTransferProperty=PENDING, ComSystemTemplateSystemSignalRef=AN19
        AN1_oVcuAdcTxG0Msg0_oTC37X_VCU_CAN01_42735b36_Tx: ComBitPosition=16, ComBitSize=16, ComSignalInitValue=0, ComSignalType=SINT16, ComTimeout=0, ComTransferProperty=PENDING, ComSystemTemplateSystemSignalRef=AN1
        AN20_oVcuAdcTxG2Msg1_oTC37X_VCU_CAN01_aae62509_Tx: ComBitPosition=0, ComBitSize=16, ComSignalInitValue=0, ComSignalType=SINT16, ComTimeout=0, ComTransferProperty=PENDING, ComSystemTemplateSystemSignalRef=AN20
        AN21_oVcuAdcTxG2Msg1_oTC37X_VCU_CAN01_8e64743f_Tx: ComBitPosition=16, ComBitSize=16, ComSignalInitValue=0, ComSignalType=SINT16, ComTimeout=0, ComTransferProperty=PENDING, ComSystemTemplateSystemSignalRef=AN21
        AN22_oVcuAdcTxG2Msg1_oTC37X_VCU_CAN01_e3e28765_Tx: ComBitPosition=32, ComBitSize=16, ComSignalInitValue=0, ComSignalType=SINT16, ComTimeout=0, ComTransferProperty=PENDING, ComSystemTemplateSystemSignalRef=AN22
        AN23_oVcuAdcTxG2Msg1_oTC37X_VCU_CAN01_c760d653_Tx: ComBitPosition=48, ComBitSize=16, ComSignalInitValue=0, ComSignalType=SINT16, ComTimeout=0, ComTransferProperty=PENDING, ComSystemTemplateSystemSignalRef=AN23
        AN24_oVcuAdcTxG3Msg0_oTC37X_VCU_CAN01_c095b3f0_Tx: ComBitPosition=0, ComBitSize=16, ComSignalInitValue=0, ComSignalType=SINT16, ComTimeout=0, ComTransferProperty=PENDING, ComSystemTemplateSystemSignalRef=AN24
        AN25_oVcuAdcTxG3Msg0_oTC37X_VCU_CAN01_e417e2c6_Tx: ComBitPosition=16, ComBitSize=16, ComSignalInitValue=0, ComSignalType=SINT16, ComTimeout=0, ComTransferProperty=PENDING, ComSystemTemplateSystemSignalRef=AN25
        AN26_oVcuAdcTxG3Msg0_oTC37X_VCU_CAN01_8991119c_Tx: ComBitPosition=32, ComBitSize=16, ComSignalInitValue=0, ComSignalType=SINT16, ComTimeout=0, ComTransferProperty=PENDING, ComSystemTemplateSystemSignalRef=AN26
        AN27_oVcuAdcTxG3Msg0_oTC37X_VCU_CAN01_ad1340aa_Tx: ComBitPosition=48, ComBitSize=16, ComSignalInitValue=0, ComSignalType=SINT16, ComTimeout=0, ComTransferProperty=PENDING, ComSystemTemplateSystemSignalRef=AN27
        AN28_oVcuAdcTxG3Msg1_oTC37X_VCU_CAN01_42adce38_Tx: ComBitPosition=0, ComBitSize=16, ComSignalInitValue=0, ComSignalType=SINT16, ComTimeout=0, ComTransferProperty=PENDING, ComSystemTemplateSystemSignalRef=AN28
        AN29_oVcuAdcTxG3Msg1_oTC37X_VCU_CAN01_662f9f0e_Tx: ComBitPosition=16, ComBitSize=16, ComSignalInitValue=0, ComSignalType=SINT16, ComTimeout=0, ComTransferProperty=PENDING, ComSystemTemplateSystemSignalRef=AN29
        AN2_oVcuAdcTxG0Msg0_oTC37X_VCU_CAN01_2ff5a86c_Tx: ComBitPosition=32, ComBitSize=16, ComSignalInitValue=0, ComSignalType=SINT16, ComTimeout=0, ComTransferProperty=PENDING, ComSystemTemplateSystemSignalRef=AN2
        AN30_oVcuAdcTxG3Msg1_oTC37X_VCU_CAN01_72505601_Tx: ComBitPosition=32, ComBitSize=16, ComSignalInitValue=0, ComSignalType=SINT16, ComTimeout=0, ComTransferProperty=PENDING, ComSystemTemplateSystemSignalRef=AN30
        AN31_oVcuAdcTxG3Msg1_oTC37X_VCU_CAN01_56d20737_Tx: ComBitPosition=48, ComBitSize=16, ComSignalInitValue=0, ComSignalType=SINT16, ComTimeout=0, ComTransferProperty=PENDING, ComSystemTemplateSystemSignalRef=AN31
        AN32_oVcuAdcTxG8Msg0_oTC37X_VCU_CAN01_543dc9cc_Tx: ComBitPosition=0, ComBitSize=16, ComSignalInitValue=0, ComSignalType=SINT16, ComTimeout=0, ComTransferProperty=PENDING, ComSystemTemplateSystemSignalRef=AN32
        AN33_oVcuAdcTxG8Msg0_oTC37X_VCU_CAN01_70bf98fa_Tx: ComBitPosition=16, ComBitSize=16, ComSignalInitValue=0, ComSignalType=SINT16, ComTimeout=0, ComTransferProperty=PENDING, ComSystemTemplateSystemSignalRef=AN33
        AN34_oVcuAdcTxG8Msg0_oTC37X_VCU_CAN01_8f302f78_Tx: ComBitPosition=32, ComBitSize=16, ComSignalInitValue=0, ComSignalType=SINT16, ComTimeout=0, ComTransferProperty=PENDING, ComSystemTemplateSystemSignalRef=AN34
        AN35_oVcuAdcTxG8Msg0_oTC37X_VCU_CAN01_abb27e4e_Tx: ComBitPosition=48, ComBitSize=16, ComSignalInitValue=0, ComSignalType=SINT16, ComTimeout=0, ComTransferProperty=PENDING, ComSystemTemplateSystemSignalRef=AN35
        AN36_oVcuAdcTxG8Msg1_oTC37X_VCU_CAN01_29663bf5_Tx: ComBitPosition=0, ComBitSize=16, ComSignalInitValue=0, ComSignalType=SINT16, ComTimeout=0, ComTransferProperty=PENDING, ComSystemTemplateSystemSignalRef=AN36
        AN37_oVcuAdcTxG8Msg1_oTC37X_VCU_CAN01_0de46ac3_Tx: ComBitPosition=16, ComBitSize=16, ComSignalInitValue=0, ComSignalType=SINT16, ComTimeout=0, ComTransferProperty=PENDING, ComSystemTemplateSystemSignalRef=AN37
        AN38_oVcuAdcTxG8Msg1_oTC37X_VCU_CAN01_0d0852b0_Tx: ComBitPosition=32, ComBitSize=16, ComSignalInitValue=0, ComSignalType=SINT16, ComTimeout=0, ComTransferProperty=PENDING, ComSystemTemplateSystemSignalRef=AN38
        AN39_oVcuAdcTxG8Msg1_oTC37X_VCU_CAN01_298a0386_Tx: ComBitPosition=48, ComBitSize=16, ComSignalInitValue=0, ComSignalType=SINT16, ComTimeout=0, ComTransferProperty=PENDING, ComSystemTemplateSystemSignalRef=AN39
        AN3_oVcuAdcTxG0Msg0_oTC37X_VCU_CAN01_0b77f95a_Tx: ComBitPosition=48, ComBitSize=16, ComSignalInitValue=0, ComSignalType=SINT16, ComTimeout=0, ComTransferProperty=PENDING, ComSystemTemplateSystemSignalRef=AN3
        AN40_oVcuAdcTxG8Msg2_oTC37X_VCU_CAN01_1ba46d98_Tx: ComBitPosition=0, ComBitSize=16, ComSignalInitValue=0, ComSignalType=SINT16, ComTimeout=0, ComTransferProperty=PENDING, ComSystemTemplateSystemSignalRef=AN40
        AN41_oVcuAdcTxG8Msg2_oTC37X_VCU_CAN01_3f263cae_Tx: ComBitPosition=16, ComBitSize=16, ComSignalInitValue=0, ComSignalType=SINT16, ComTimeout=0, ComTransferProperty=PENDING, ComSystemTemplateSystemSignalRef=AN41
        AN42_oVcuAdcTxG8Msg2_oTC37X_VCU_CAN01_52a0cff4_Tx: ComBitPosition=32, ComBitSize=16, ComSignalInitValue=0, ComSignalType=SINT16, ComTimeout=0, ComTransferProperty=PENDING, ComSystemTemplateSystemSignalRef=AN42
        AN43_oVcuAdcTxG8Msg2_oTC37X_VCU_CAN01_76229ec2_Tx: ComBitPosition=48, ComBitSize=16, ComSignalInitValue=0, ComSignalType=SINT16, ComTimeout=0, ComTransferProperty=PENDING, ComSystemTemplateSystemSignalRef=AN43
        AN44_oVcuAdcTxG8Msg3_oTC37X_VCU_CAN01_66ff9fa1_Tx: ComBitPosition=0, ComBitSize=16, ComSignalInitValue=0, ComSignalType=SINT16, ComTimeout=0, ComTransferProperty=PENDING, ComSystemTemplateSystemSignalRef=AN44
        AN45_oVcuAdcTxG8Msg3_oTC37X_VCU_CAN01_427dce97_Tx: ComBitPosition=16, ComBitSize=16, ComSignalInitValue=0, ComSignalType=SINT16, ComTimeout=0, ComTransferProperty=PENDING, ComSystemTemplateSystemSignalRef=AN45
        AN46_oVcuAdcTxG8Msg3_oTC37X_VCU_CAN01_2ffb3dcd_Tx: ComBitPosition=32, ComBitSize=16, ComSignalInitValue=0, ComSignalType=SINT16, ComTimeout=0, ComTransferProperty=PENDING, ComSystemTemplateSystemSignalRef=AN46
        AN47_oVcuAdcTxG8Msg3_oTC37X_VCU_CAN01_0b796cfb_Tx: ComBitPosition=48, ComBitSize=16, ComSignalInitValue=0, ComSignalType=SINT16, ComTimeout=0, ComTransferProperty=PENDING, ComSystemTemplateSystemSignalRef=AN47
        AN4_oVcuAdcTxG0Msg1_oTC37X_VCU_CAN01_1baaf839_Tx: ComBitPosition=0, ComBitSize=16, ComSignalInitValue=0, ComSignalType=SINT16, ComTimeout=0, ComTransferProperty=PENDING, ComSystemTemplateSystemSignalRef=AN4
        AN5_oVcuAdcTxG0Msg1_oTC37X_VCU_CAN01_3f28a90f_Tx: ComBitPosition=16, ComBitSize=16, ComSignalInitValue=0, ComSignalType=SINT16, ComTimeout=0, ComTransferProperty=PENDING, ComSystemTemplateSystemSignalRef=AN5
        AN6_oVcuAdcTxG0Msg1_oTC37X_VCU_CAN01_52ae5a55_Tx: ComBitPosition=32, ComBitSize=16, ComSignalInitValue=0, ComSignalType=SINT16, ComTimeout=0, ComTransferProperty=PENDING, ComSystemTemplateSystemSignalRef=AN6
        AN7_oVcuAdcTxG0Msg1_oTC37X_VCU_CAN01_762c0b63_Tx: ComBitPosition=48, ComBitSize=16, ComSignalInitValue=0, ComSignalType=SINT16, ComTimeout=0, ComTransferProperty=PENDING, ComSystemTemplateSystemSignalRef=AN7
        AN8_oVcuAdcTxG1Msg0_oTC37X_VCU_CAN01_8ebae131_Tx: ComBitPosition=0, ComBitSize=16, ComSignalInitValue=0, ComSignalType=SINT16, ComTimeout=0, ComTransferProperty=PENDING, ComSystemTemplateSystemSignalRef=AN8
        AN9_oVcuAdcTxG1Msg0_oTC37X_VCU_CAN01_aa38b007_Tx: ComBitPosition=16, ComBitSize=16, ComSignalInitValue=0, ComSignalType=SINT16, ComTimeout=0, ComTransferProperty=PENDING, ComSystemTemplateSystemSignalRef=AN9
        Act_Pos_sta_oSVA_VCU_STD_oLIN00_642c9ffa_Rx: ComBitPosition=8, ComBitSize=12, ComSignalInitValue=0, ComSignalType=UINT16, ComSystemTemplateSystemSignalRef=Act_Pos_sta
        Blockage_Fault_STA_oSVA_VCU_STD_oLIN00_6c89246f_Rx: ComBitPosition=2, ComBitSize=1, ComSignalInitValue=0, ComSignalType=BOOLEAN, ComSystemTemplateSystemSignalRef=Blockage_Fault_STA
        Breakage_Fault_STA_oSVA_VCU_STD_oLIN00_a3ac9cf8_Rx: ComBitPosition=3, ComBitSize=1, ComSignalInitValue=0, ComSignalType=BOOLEAN, ComSystemTemplateSystemSignalRef=Breakage_Fault_STA
        Bts7xx_HS1_En_oVcuRxCtrlMsg1_oTC37X_VCU_CAN01_d0692a3c_Rx: ComBitPosition=32, ComBitSize=8, ComSignalInitValue=0, ComSignalType=SINT8, ComTimeout=0, ComSystemTemplateSystemSignalRef=Bts7xx_HS1_En
        Bts7xx_HS2_En_oVcuRxCtrlMsg1_oTC37X_VCU_CAN01_b48951c2_Rx: ComBitPosition=40, ComBitSize=8, ComSignalInitValue=0, ComSignalType=SINT8, ComTimeout=0, ComSystemTemplateSystemSignalRef=Bts7xx_HS2_En
        Bts7xx_HS3_En_oVcuRxCtrlMsg1_oTC37X_VCU_CAN01_21f98557_Rx: ComBitPosition=48, ComBitSize=8, ComSignalInitValue=0, ComSignalType=SINT8, ComTimeout=0, ComSystemTemplateSystemSignalRef=Bts7xx_HS3_En
        Bts7xx_HS4_En_oVcuRxCtrlMsg1_oTC37X_VCU_CAN01_7d49a63e_Rx: ComBitPosition=56, ComBitSize=8, ComSignalInitValue=0, ComSignalType=SINT8, ComTimeout=0, ComSystemTemplateSystemSignalRef=Bts7xx_HS4_En
        Calibration_cmd_oVCU_SVA_CMD_oLIN00_6732180a_Tx: ComBitPosition=8, ComBitSize=1, ComSignalInitValue=0, ComSignalType=BOOLEAN, ComSystemTemplateSystemSignalRef=Calibration_cmd
        Calibration_sta_oSVA_VCU_STD_oLIN00_dcb4af08_Rx: ComBitPosition=0, ComBitSize=2, ComSignalInitValue=0, ComSignalType=UINT8, ComSystemTemplateSystemSignalRef=Calibration_sta
        ECC_PMP2_SpdSet_oPMP_Cmd_oLIN00_8cabc4b7_Tx: ComBitPosition=8, ComBitSize=8, ComSignalInitValue=0, ComSignalType=UINT8, ComSystemTemplateSystemSignalRef=ECC_PMP2_SpdSet
        ECC_PMP3_SpdSet_oPMP_Cmd_oLIN00_0d8ea190_Tx: ComBitPosition=16, ComBitSize=8, ComSignalInitValue=0, ComSignalType=UINT8, ComSystemTemplateSystemSignalRef=ECC_PMP3_SpdSet
        EDCU_EXV2_Cmd_Init_Rq_oEDCU_EXV2_oLIN00_0144aec9_Tx: ComBitPosition=24, ComBitSize=3, ComSignalInitValue=0, ComSignalType=UINT8, ComSystemTemplateSystemSignalRef=EDCU_EXV2_Cmd_Init_Rq
        EDCU_EXV2_Cmd_Move_Enbl_oEDCU_EXV2_oLIN00_d6797517_Tx: ComBitPosition=16, ComBitSize=1, ComSignalInitValue=0, ComSignalType=BOOLEAN, ComSystemTemplateSystemSignalRef=EDCU_EXV2_Cmd_Move_Enbl
        EDCU_EXV2_Cmd_Set_Rq_oEDCU_EXV2_oLIN00_66e5876a_Tx: ComBitPosition=0, ComBitSize=16, ComSignalInitValue=0, ComSignalType=UINT16, ComSystemTemplateSystemSignalRef=EDCU_EXV2_Cmd_Set_Rq
        EXT10_Valid_oVcuTxIoMsg5_oTC37X_VCU_CAN00_ba532916_Tx: ComBitPosition=48, ComBitSize=16, ComSignalInitValue=0, ComSignalType=UINT16, ComTimeout=0, ComTransferProperty=PENDING, ComSystemTemplateSystemSignalRef=EXT10_Valid
        EXT11_Valid_oVcuTxIoMsg6_oTC37X_VCU_CAN00_d025e36b_Tx: ComBitPosition=16, ComBitSize=16, ComSignalInitValue=0, ComSignalType=UINT16, ComTimeout=0, ComTransferProperty=PENDING, ComSystemTemplateSystemSignalRef=EXT11_Valid
        EXT12_Valid_oVcuTxIoMsg6_oTC37X_VCU_CAN00_8a44dc0b_Tx: ComBitPosition=48, ComBitSize=16, ComSignalInitValue=0, ComSignalType=UINT16, ComTimeout=0, ComTransferProperty=PENDING, ComSystemTemplateSystemSignalRef=EXT12_Valid
        EXT13_Valid_oVcuTxIoMsg7_oTC37X_VCU_CAN00_e5e67df5_Tx: ComBitPosition=16, ComBitSize=16, ComSignalInitValue=0, ComSignalType=UINT16, ComTimeout=0, ComTransferProperty=PENDING, ComSystemTemplateSystemSignalRef=EXT13_Valid
        EXT14_Valid_oVcuTxIoMsg7_oTC37X_VCU_CAN00_d1d4142a_Tx: ComBitPosition=48, ComBitSize=16, ComSignalInitValue=0, ComSignalType=UINT16, ComTimeout=0, ComTransferProperty=PENDING, ComSystemTemplateSystemSignalRef=EXT14_Valid
        EXT15_Valid_oVcuTxIoMsg8_oTC37X_VCU_CAN00_a75ba75d_Tx: ComBitPosition=16, ComBitSize=16, ComSignalInitValue=0, ComSignalType=UINT16, ComTimeout=0, ComTransferProperty=PENDING, ComSystemTemplateSystemSignalRef=EXT15_Valid
        EXT16_Valid_oVcuTxIoMsg8_oTC37X_VCU_CAN00_fd3a983d_Tx: ComBitPosition=48, ComBitSize=16, ComSignalInitValue=0, ComSignalType=UINT16, ComTimeout=0, ComTransferProperty=PENDING, ComSystemTemplateSystemSignalRef=EXT16_Valid
        EXT1_Valid_oVcuTxIoMsg1_oTC37X_VCU_CAN00_caf787ea_Tx: ComBitPosition=16, ComBitSize=16, ComSignalInitValue=0, ComSignalType=UINT16, ComTimeout=0, ComTransferProperty=PENDING, ComSystemTemplateSystemSignalRef=EXT1_Valid
        EXT2_Valid_oVcuTxIoMsg1_oTC37X_VCU_CAN00_9096b88a_Tx: ComBitPosition=48, ComBitSize=16, ComSignalInitValue=0, ComSignalType=UINT16, ComTimeout=0, ComTransferProperty=PENDING, ComSystemTemplateSystemSignalRef=EXT2_Valid
        EXT3_Valid_oVcuTxIoMsg2_oTC37X_VCU_CAN00_fae072f7_Tx: ComBitPosition=16, ComBitSize=16, ComSignalInitValue=0, ComSignalType=UINT16, ComTimeout=0, ComTransferProperty=PENDING, ComSystemTemplateSystemSignalRef=EXT3_Valid
        EXT4_Valid_oVcuTxIoMsg2_oTC37X_VCU_CAN00_ced21b28_Tx: ComBitPosition=48, ComBitSize=16, ComSignalInitValue=0, ComSignalType=UINT16, ComTimeout=0, ComTransferProperty=PENDING, ComSystemTemplateSystemSignalRef=EXT4_Valid
        EXT5_Valid_oVcuTxIoMsg3_oTC37X_VCU_CAN00_a170bad6_Tx: ComBitPosition=16, ComBitSize=16, ComSignalInitValue=0, ComSignalType=UINT16, ComTimeout=0, ComTransferProperty=PENDING, ComSystemTemplateSystemSignalRef=EXT5_Valid
        EXT6_Valid_oVcuTxIoMsg3_oTC37X_VCU_CAN00_fb1185b6_Tx: ComBitPosition=48, ComBitSize=16, ComSignalInitValue=0, ComSignalType=UINT16, ComTimeout=0, ComTransferProperty=PENDING, ComSystemTemplateSystemSignalRef=EXT6_Valid
        EXT7_Valid_oVcuTxIoMsg4_oTC37X_VCU_CAN00_9acf98cd_Tx: ComBitPosition=16, ComBitSize=16, ComSignalInitValue=0, ComSignalType=UINT16, ComTimeout=0, ComTransferProperty=PENDING, ComSystemTemplateSystemSignalRef=EXT7_Valid
        EXT8_Valid_oVcuTxIoMsg4_oTC37X_VCU_CAN00_725b5c6c_Tx: ComBitPosition=48, ComBitSize=16, ComSignalInitValue=0, ComSignalType=UINT16, ComTimeout=0, ComTransferProperty=PENDING, ComSystemTemplateSystemSignalRef=EXT8_Valid
        EXT9_Valid_oVcuTxIoMsg5_oTC37X_VCU_CAN00_1df9fd92_Tx: ComBitPosition=16, ComBitSize=16, ComSignalInitValue=0, ComSignalType=UINT16, ComTimeout=0, ComTransferProperty=PENDING, ComSystemTemplateSystemSignalRef=EXT9_Valid
        EXT_A_IN10_oVcuTxIoMsg5_oTC37X_VCU_CAN00_83e5b725_Tx: ComBitPosition=32, ComBitSize=16, ComSignalInitValue=0, ComSignalType=SINT16, ComTimeout=0, ComTransferProperty=PENDING, ComSystemTemplateSystemSignalRef=EXT_A_IN10
        EXT_A_IN11_oVcuTxIoMsg6_oTC37X_VCU_CAN00_67848296_Tx: ComBitPosition=0, ComBitSize=16, ComSignalInitValue=0, ComSignalType=SINT16, ComTimeout=0, ComTransferProperty=PENDING, ComSystemTemplateSystemSignalRef=EXT_A_IN11
        EXT_A_IN12_oVcuTxIoMsg6_oTC37X_VCU_CAN00_74acbbe5_Tx: ComBitPosition=32, ComBitSize=16, ComSignalInitValue=0, ComSignalType=SINT16, ComTimeout=0, ComTransferProperty=PENDING, ComSystemTemplateSystemSignalRef=EXT_A_IN12
        EXT_A_IN13_oVcuTxIoMsg7_oTC37X_VCU_CAN00_9519e5d5_Tx: ComBitPosition=0, ComBitSize=16, ComSignalInitValue=0, ComSignalType=SINT16, ComTimeout=0, ComTransferProperty=PENDING, ComSystemTemplateSystemSignalRef=EXT_A_IN13
        EXT_A_IN14_oVcuTxIoMsg7_oTC37X_VCU_CAN00_bdae7fe2_Tx: ComBitPosition=32, ComBitSize=16, ComSignalInitValue=0, ComSignalType=SINT16, ComTimeout=0, ComTransferProperty=PENDING, ComSystemTemplateSystemSignalRef=EXT_A_IN14
        EXT_A_IN15_oVcuTxIoMsg8_oTC37X_VCU_CAN00_4536335b_Tx: ComBitPosition=0, ComBitSize=16, ComSignalInitValue=0, ComSignalType=SINT16, ComTimeout=0, ComTransferProperty=PENDING, ComSystemTemplateSystemSignalRef=EXT_A_IN15
        EXT_A_IN16_oVcuTxIoMsg8_oTC37X_VCU_CAN00_561e0a28_Tx: ComBitPosition=32, ComBitSize=16, ComSignalInitValue=0, ComSignalType=SINT16, ComTimeout=0, ComTransferProperty=PENDING, ComSystemTemplateSystemSignalRef=EXT_A_IN16
        EXT_A_IN1_oVcuTxIoMsg1_oTC37X_VCU_CAN00_37348eff_Tx: ComBitPosition=0, ComBitSize=16, ComSignalInitValue=0, ComSignalType=SINT16, ComTimeout=0, ComTransferProperty=PENDING, ComSystemTemplateSystemSignalRef=EXT_A_IN1
        EXT_A_IN2_oVcuTxIoMsg1_oTC37X_VCU_CAN00_241cb78c_Tx: ComBitPosition=32, ComBitSize=16, ComSignalInitValue=0, ComSignalType=SINT16, ComTimeout=0, ComTransferProperty=PENDING, ComSystemTemplateSystemSignalRef=EXT_A_IN2
        EXT_A_IN3_oVcuTxIoMsg2_oTC37X_VCU_CAN00_c07d823f_Tx: ComBitPosition=0, ComBitSize=16, ComSignalInitValue=0, ComSignalType=SINT16, ComTimeout=0, ComTransferProperty=PENDING, ComSystemTemplateSystemSignalRef=EXT_A_IN3
        EXT_A_IN4_oVcuTxIoMsg2_oTC37X_VCU_CAN00_e8ca1808_Tx: ComBitPosition=32, ComBitSize=16, ComSignalInitValue=0, ComSignalType=SINT16, ComTimeout=0, ComTransferProperty=PENDING, ComSystemTemplateSystemSignalRef=EXT_A_IN4
        EXT_A_IN5_oVcuTxIoMsg3_oTC37X_VCU_CAN00_097f4638_Tx: ComBitPosition=0, ComBitSize=16, ComSignalInitValue=0, ComSignalType=SINT16, ComTimeout=0, ComTransferProperty=PENDING, ComSystemTemplateSystemSignalRef=EXT_A_IN5
        EXT_A_IN6_oVcuTxIoMsg3_oTC37X_VCU_CAN00_1a577f4b_Tx: ComBitPosition=32, ComBitSize=16, ComSignalInitValue=0, ComSignalType=SINT16, ComTimeout=0, ComTransferProperty=PENDING, ComSystemTemplateSystemSignalRef=EXT_A_IN6
        EXT_A_IN7_oVcuTxIoMsg4_oTC37X_VCU_CAN00_f59e9dfe_Tx: ComBitPosition=0, ComBitSize=16, ComSignalInitValue=0, ComSignalType=SINT16, ComTimeout=0, ComTransferProperty=PENDING, ComSystemTemplateSystemSignalRef=EXT_A_IN7
        EXT_A_IN8_oVcuTxIoMsg4_oTC37X_VCU_CAN00_aa164141_Tx: ComBitPosition=32, ComBitSize=16, ComSignalInitValue=0, ComSignalType=SINT16, ComTimeout=0, ComTransferProperty=PENDING, ComSystemTemplateSystemSignalRef=EXT_A_IN8
        EXT_A_IN9_oVcuTxIoMsg5_oTC37X_VCU_CAN00_4ba31f71_Tx: ComBitPosition=0, ComBitSize=16, ComSignalInitValue=0, ComSignalType=SINT16, ComTimeout=0, ComTransferProperty=PENDING, ComSystemTemplateSystemSignalRef=EXT_A_IN9
        EXT_PWM_IN1_Duty_oVcuMeasurementMsg0_oTC37X_VCU_CAN01_92760a96_Tx: ComBitPosition=16, ComBitSize=8, ComSignalInitValue=0, ComSignalType=SINT8, ComTimeout=0, ComTransferProperty=PENDING, ComSystemTemplateSystemSignalRef=EXT_PWM_IN1_Duty
        EXT_PWM_IN1_Period_oVcuMeasurementMsg0_oTC37X_VCU_CAN01_c46a50e4_Tx: ComBitPosition=0, ComBitSize=16, ComSignalInitValue=0, ComSignalType=SINT16, ComTimeout=0, ComTransferProperty=PENDING, ComSystemTemplateSystemSignalRef=EXT_PWM_IN1_Period
        EXT_PWM_IN2_Duty_oVcuMeasurementMsg0_oTC37X_VCU_CAN01_5b42119b_Tx: ComBitPosition=40, ComBitSize=8, ComSignalInitValue=0, ComSignalType=SINT8, ComTimeout=0, ComTransferProperty=PENDING, ComSystemTemplateSystemSignalRef=EXT_PWM_IN2_Duty
        EXT_PWM_IN2_Period_oVcuMeasurementMsg0_oTC37X_VCU_CAN01_fba12e71_Tx: ComBitPosition=24, ComBitSize=16, ComSignalInitValue=0, ComSignalType=SINT16, ComTimeout=0, ComTransferProperty=PENDING, ComSystemTemplateSystemSignalRef=EXT_PWM_IN2_Period
        EXV1_CurrentInitState_oEXV_1_VCU_oLIN00_beca31e2_Rx: ComBitPosition=1, ComBitSize=2, ComSignalInitValue=0, ComSignalType=UINT8, ComSystemTemplateSystemSignalRef=EXV1_CurrentInitState
        EXV1_CurrentPosition_oEXV_1_VCU_oLIN00_6daec86f_Rx: ComBitPosition=16, ComBitSize=16, ComSignalInitValue=0, ComSignalType=UINT16, ComSystemTemplateSystemSignalRef=EXV1_CurrentPosition
        EXV1_FaultState_oEXV_1_VCU_oLIN00_72ff14f0_Rx: ComBitPosition=4, ComBitSize=4, ComSignalInitValue=0, ComSignalType=UINT8, ComSystemTemplateSystemSignalRef=EXV1_FaultState
        EXV1_ResponseError_oEXV_1_VCU_oLIN00_cbce9ad1_Rx: ComBitPosition=0, ComBitSize=1, ComSignalInitValue=0, ComSignalType=BOOLEAN, ComSystemTemplateSystemSignalRef=EXV1_ResponseError
        EXV1_RunState_oEXV_1_VCU_oLIN00_f0dc555f_Rx: ComBitPosition=3, ComBitSize=1, ComSignalInitValue=0, ComSignalType=BOOLEAN, ComSystemTemplateSystemSignalRef=EXV1_RunState
        EXV1_TemperatureWarn_oEXV_1_VCU_oLIN00_a3317e4b_Rx: ComBitPosition=10, ComBitSize=2, ComSignalInitValue=0, ComSignalType=UINT8, ComSystemTemplateSystemSignalRef=EXV1_TemperatureWarn
        EXV1_VoltageState_oEXV_1_VCU_oLIN00_31bbfd77_Rx: ComBitPosition=8, ComBitSize=2, ComSignalInitValue=0, ComSignalType=UINT8, ComSystemTemplateSystemSignalRef=EXV1_VoltageState
        EXV2_CurrentInitState_oEXV_2_VCU_oLIN00_adb498ec_Rx: ComBitPosition=1, ComBitSize=2, ComSignalInitValue=0, ComSignalType=UINT8, ComSystemTemplateSystemSignalRef=EXV2_CurrentInitState
        EXV2_CurrentPosition_oEXV_2_VCU_oLIN00_91e32486_Rx: ComBitPosition=16, ComBitSize=16, ComSignalInitValue=0, ComSignalType=UINT16, ComSystemTemplateSystemSignalRef=EXV2_CurrentPosition
        EXV2_FaultState_oEXV_2_VCU_oLIN00_41c0e318_Rx: ComBitPosition=4, ComBitSize=4, ComSignalInitValue=0, ComSignalType=UINT8, ComSystemTemplateSystemSignalRef=EXV2_FaultState
        EXV2_Fault_Stat_oEXV2_Status_oLIN00_ab6350b6_Rx: ComBitPosition=8, ComBitSize=4, ComSignalInitValue=0, ComSignalType=UINT8, ComSystemTemplateSystemSignalRef=EXV2_Fault_Stat
        EXV2_OvrTemp_Warn_oEXV2_Status_oLIN00_ba77659e_Rx: ComBitPosition=14, ComBitSize=2, ComSignalInitValue=0, ComSignalType=UINT8, ComSystemTemplateSystemSignalRef=EXV2_OvrTemp_Warn
        EXV2_Pos_oEXV2_Status_oLIN00_da80603b_Rx: ComBitPosition=16, ComBitSize=16, ComSignalInitValue=0, ComSignalType=UINT16, ComSystemTemplateSystemSignalRef=EXV2_Pos
        EXV2_ResponseError_oEXV_2_VCU_oLIN00_e747f934_Rx: ComBitPosition=0, ComBitSize=1, ComSignalInitValue=0, ComSignalType=BOOLEAN, ComSystemTemplateSystemSignalRef=EXV2_ResponseError
        EXV2_RunState_oEXV_2_VCU_oLIN00_859c8088_Rx: ComBitPosition=3, ComBitSize=1, ComSignalInitValue=0, ComSignalType=BOOLEAN, ComSystemTemplateSystemSignalRef=EXV2_RunState
        EXV2_Run_Stat_oEXV2_Status_oLIN00_0e992e12_Rx: ComBitPosition=4, ComBitSize=1, ComSignalInitValue=0, ComSignalType=BOOLEAN, ComSystemTemplateSystemSignalRef=EXV2_Run_Stat
        EXV2_TemperatureWarn_oEXV_2_VCU_oLIN00_5f7c92a2_Rx: ComBitPosition=10, ComBitSize=2, ComSignalInitValue=0, ComSignalType=UINT8, ComSystemTemplateSystemSignalRef=EXV2_TemperatureWarn
        EXV2_Volt_Stat_oEXV2_Status_oLIN00_c8727eb0_Rx: ComBitPosition=12, ComBitSize=2, ComSignalInitValue=0, ComSignalType=UINT8, ComSystemTemplateSystemSignalRef=EXV2_Volt_Stat
        EXV2_VoltageState_oEXV_2_VCU_oLIN00_8f3a2738_Rx: ComBitPosition=8, ComBitSize=2, ComSignalInitValue=0, ComSignalType=UINT8, ComSystemTemplateSystemSignalRef=EXV2_VoltageState
        EXV2_curInit_Stat_oEXV2_Status_oLIN00_b0ace0f5_Rx: ComBitPosition=2, ComBitSize=2, ComSignalInitValue=0, ComSignalType=UINT8, ComSystemTemplateSystemSignalRef=EXV2_curInit_Stat
        Ext_IN2_oVcuMeasurementMsg0_oTC37X_VCU_CAN01_a925e19e_Tx: ComBitPosition=48, ComBitSize=8, ComSignalInitValue=0, ComSignalType=SINT8, ComTimeout=0, ComTransferProperty=PENDING, ComSystemTemplateSystemSignalRef=Ext_IN2
        HVCH_CurrSens_Flt_oHVCH_Rsp01_oLIN00_09f7bc74_Rx: ComBitPosition=56, ComBitSize=5, ComSignalInitValue=0, ComSignalType=UINT8, ComSystemTemplateSystemSignalRef=HVCH_CurrSens_Flt
        HVCH_DutyCycle_oHVCH_Rsp01_oLIN00_ad1e6a22_Rx: ComBitPosition=24, ComBitSize=8, ComSignalInitValue=50, ComSignalType=UINT8, ComSystemTemplateSystemSignalRef=HVCH_DutyCycle
        HVCH_ExtPwrSup_Flt_oHVCH_Rsp01_oLIN00_28926933_Rx: ComBitPosition=45, ComBitSize=1, ComSignalInitValue=0, ComSignalType=BOOLEAN, ComSystemTemplateSystemSignalRef=HVCH_ExtPwrSup_Flt
        HVCH_HV_DC_curr_oHVCH_Rsp01_oLIN00_f613e39d_Rx: ComBitPosition=0, ComBitSize=8, ComSignalInitValue=0, ComSignalType=UINT8, ComSystemTemplateSystemSignalRef=HVCH_HV_DC_curr
        HVCH_HV_Voltage_Valid_oHVCH_Rsp01_oLIN00_2914831e_Rx: ComBitPosition=40, ComBitSize=2, ComSignalInitValue=0, ComSignalType=UINT8, ComSystemTemplateSystemSignalRef=HVCH_HV_Voltage_Valid
        HVCH_HV_voltage_oHVCH_Rsp01_oLIN00_3d3da318_Rx: ComBitPosition=8, ComBitSize=8, ComSignalInitValue=0, ComSignalType=UINT8, ComSystemTemplateSystemSignalRef=HVCH_HV_voltage
        HVCH_IntelTemp_oHVCH_Rsp02_oLIN00_2b487110_Rx: ComBitPosition=0, ComBitSize=8, ComSignalInitValue=0, ComSignalType=UINT8, ComSystemTemplateSystemSignalRef=HVCH_IntelTemp
        HVCH_InternalPCBTemp_oHVCH_Rsp01_oLIN00_398b53e8_Rx: ComBitPosition=48, ComBitSize=8, ComSignalInitValue=0, ComSignalType=UINT8, ComSystemTemplateSystemSignalRef=HVCH_InternalPCBTemp
        HVCH_LIN_Flt_oHVCH_Rsp01_oLIN00_9aaa25bf_Rx: ComBitPosition=44, ComBitSize=1, ComSignalInitValue=0, ComSignalType=BOOLEAN, ComSystemTemplateSystemSignalRef=HVCH_LIN_Flt
        HVCH_MediumTemp_oHVCH_Rsp01_oLIN00_a3387de4_Rx: ComBitPosition=16, ComBitSize=8, ComSignalInitValue=0, ComSignalType=UINT8, ComSystemTemplateSystemSignalRef=HVCH_MediumTemp
        HVCH_Off_ShrtCurr_oHVCH_Rsp01_oLIN00_bf58ab45_Rx: ComBitPosition=46, ComBitSize=1, ComSignalInitValue=0, ComSignalType=BOOLEAN, ComSystemTemplateSystemSignalRef=HVCH_Off_ShrtCurr
        HVCH_RsErr_oHVCH_Rsp01_oLIN00_527b0f8f_Rx: ComBitPosition=61, ComBitSize=1, ComSignalInitValue=0, ComSignalType=BOOLEAN, ComSystemTemplateSystemSignalRef=HVCH_RsErr
        HVCH_Status_oHVCH_Rsp01_oLIN00_60afdc75_Rx: ComBitPosition=32, ComBitSize=3, ComSignalInitValue=0, ComSignalType=UINT8, ComSystemTemplateSystemSignalRef=HVCH_Status
        HVCH_TempLim_oHVCH_Rsp01_oLIN00_d22e6add_Rx: ComBitPosition=43, ComBitSize=1, ComSignalInitValue=0, ComSignalType=BOOLEAN, ComSystemTemplateSystemSignalRef=HVCH_TempLim
        HVCH_TempSens_Flt_oHVCH_Rsp01_oLIN00_66cb2c71_Rx: ComBitPosition=42, ComBitSize=1, ComSignalInitValue=0, ComSignalType=BOOLEAN, ComSystemTemplateSystemSignalRef=HVCH_TempSens_Flt
        HVCH_defectHeaterCircuits_oHVCH_Rsp01_oLIN00_61948e74_Rx: ComBitPosition=35, ComBitSize=3, ComSignalInitValue=0, ComSignalType=UINT8, ComSystemTemplateSystemSignalRef=HVCH_defectHeaterCircuits
        LIN_Resp_Error_sta_oSVA_VCU_STD_oLIN00_47f7ca93_Rx: ComBitPosition=32, ComBitSize=1, ComSignalInitValue=0, ComSignalType=BOOLEAN, ComSystemTemplateSystemSignalRef=LIN_Resp_Error_sta
        PMP2_PumpDryRunningSta_oPMP2_Sts_oLIN00_3e217a22_Rx: ComBitPosition=3, ComBitSize=1, ComSignalInitValue=0, ComSignalType=BOOLEAN, ComSystemTemplateSystemSignalRef=PMP2_PumpDryRunningSta
        PMP2_PumpInputVolt_oPMP2_Sts_oLIN00_1fa0a533_Rx: ComBitPosition=8, ComBitSize=8, ComSignalInitValue=0, ComSignalType=UINT8, ComSystemTemplateSystemSignalRef=PMP2_PumpInputVolt
        PMP2_PumpMotorSta_oPMP2_Sts_oLIN00_d6d3ab88_Rx: ComBitPosition=1, ComBitSize=2, ComSignalInitValue=0, ComSignalType=UINT8, ComSystemTemplateSystemSignalRef=PMP2_PumpMotorSta
        PMP2_PumpPowerSta_oPMP2_Sts_oLIN00_1d0f1319_Rx: ComBitPosition=4, ComBitSize=2, ComSignalInitValue=0, ComSignalType=UINT8, ComSystemTemplateSystemSignalRef=PMP2_PumpPowerSta
        PMP2_PumpTempSta_oPMP2_Sts_oLIN00_81f2fa55_Rx: ComBitPosition=6, ComBitSize=2, ComSignalInitValue=0, ComSignalType=UINT8, ComSystemTemplateSystemSignalRef=PMP2_PumpTempSta
        PMP2_RESP_ERROR_oPMP2_Sts_oLIN00_67b666eb_Rx: ComBitPosition=0, ComBitSize=1, ComSignalInitValue=0, ComSignalType=BOOLEAN, ComSystemTemplateSystemSignalRef=PMP2_RESP_ERROR
        PMP2_RealRPM_oPMP2_Sts_oLIN00_86d75572_Rx: ComBitPosition=24, ComBitSize=8, ComSignalInitValue=0, ComSignalType=UINT8, ComSystemTemplateSystemSignalRef=PMP2_RealRPM
        PMP3_PumpDryRunningSta_oPMP3_Sts_oLIN00_30f4e2d8_Rx: ComBitPosition=3, ComBitSize=1, ComSignalInitValue=0, ComSignalType=BOOLEAN, ComSystemTemplateSystemSignalRef=PMP3_PumpDryRunningSta
        PMP3_PumpInputVolt_oPMP3_Sts_oLIN00_75dfecf6_Rx: ComBitPosition=8, ComBitSize=8, ComSignalInitValue=0, ComSignalType=UINT8, ComSystemTemplateSystemSignalRef=PMP3_PumpInputVolt
        PMP3_PumpMotorSta_oPMP3_Sts_oLIN00_43910f36_Rx: ComBitPosition=1, ComBitSize=2, ComSignalInitValue=0, ComSignalType=UINT8, ComSystemTemplateSystemSignalRef=PMP3_PumpMotorSta
        PMP3_PumpPowerSta_oPMP3_Sts_oLIN00_884db7a7_Rx: ComBitPosition=4, ComBitSize=2, ComSignalInitValue=0, ComSignalType=UINT8, ComSystemTemplateSystemSignalRef=PMP3_PumpPowerSta
        PMP3_PumpTempSta_oPMP3_Sts_oLIN00_26375532_Rx: ComBitPosition=6, ComBitSize=2, ComSignalInitValue=0, ComSignalType=UINT8, ComSystemTemplateSystemSignalRef=PMP3_PumpTempSta
        PMP3_RESP_ERROR_oPMP3_Sts_oLIN00_9f14f3a0_Rx: ComBitPosition=0, ComBitSize=1, ComSignalInitValue=0, ComSignalType=BOOLEAN, ComSystemTemplateSystemSignalRef=PMP3_RESP_ERROR
        PMP3_RealRPM_oPMP3_Sts_oLIN00_fa6fbf8a_Rx: ComBitPosition=24, ComBitSize=8, ComSignalInitValue=0, ComSignalType=UINT8, ComSystemTemplateSystemSignalRef=PMP3_RealRPM
        RsErr_EXV2_oEXV2_Status_oLIN00_5c35655a_Rx: ComBitPosition=0, ComBitSize=1, ComSignalInitValue=0, ComSignalType=BOOLEAN, ComSystemTemplateSystemSignalRef=RsErr_EXV2
        TCU_HVCHMaxPowerLimit_oTCU_HVCH_Cmd_oLIN00_4bc53e0b_Tx: ComBitPosition=16, ComBitSize=8, ComSignalInitValue=0, ComSignalType=UINT8, ComSystemTemplateSystemSignalRef=TCU_HVCHMaxPowerLimit
        TCU_HVCH_On_Rq_oTCU_HVCH_Cmd_oLIN00_9f442eaf_Tx: ComBitPosition=8, ComBitSize=2, ComSignalDataInvalidValue=3, ComSignalInitValue=0, ComSignalType=UINT8, ComSystemTemplateSystemSignalRef=TCU_HVCH_On_Rq
        TCU_HVCH_TmaxLim_output_oTCU_HVCH_Cmd_oLIN00_5e45d521_Tx: ComBitPosition=24, ComBitSize=8, ComSignalInitValue=0, ComSignalType=UINT8, ComSystemTemplateSystemSignalRef=TCU_HVCH_TmaxLim_output
        TCU_HVCH_heating_rq_oTCU_HVCH_Cmd_oLIN00_5e3a32b2_Tx: ComBitPosition=0, ComBitSize=7, ComSignalInitValue=0, ComSignalType=UINT8, ComSystemTemplateSystemSignalRef=TCU_HVCH_heating_rq
        TMM_EXV1_EnableRequest_oVCU_EXV_1_oLIN00_d988d266_Tx: ComBitPosition=16, ComBitSize=1, ComSignalInitValue=0, ComSignalType=BOOLEAN, ComSystemTemplateSystemSignalRef=TMM_EXV1_EnableRequest
        TMM_EXV1_PositionRequest_oVCU_EXV_1_oLIN00_cbd2de27_Tx: ComBitPosition=0, ComBitSize=16, ComSignalInitValue=0, ComSignalType=UINT16, ComSystemTemplateSystemSignalRef=TMM_EXV1_PositionRequest
        TMM_EXV1_initRequest_oVCU_EXV_1_oLIN00_082350ea_Tx: ComBitPosition=24, ComBitSize=3, ComSignalInitValue=0, ComSignalType=UINT8, ComSystemTemplateSystemSignalRef=TMM_EXV1_initRequest
        TMM_EXV2_EnableRequest_oVCU_EXV_2_oLIN00_0c106490_Tx: ComBitPosition=16, ComBitSize=1, ComSignalInitValue=0, ComSignalType=BOOLEAN, ComSystemTemplateSystemSignalRef=TMM_EXV2_EnableRequest
        TMM_EXV2_PositionRequest_oVCU_EXV_2_oLIN00_ce8ee7dd_Tx: ComBitPosition=0, ComBitSize=16, ComSignalInitValue=0, ComSignalType=UINT16, ComSystemTemplateSystemSignalRef=TMM_EXV2_PositionRequest
        TMM_EXV2_initRequest_oVCU_EXV_2_oLIN00_95846e7a_Tx: ComBitPosition=24, ComBitSize=3, ComSignalInitValue=0, ComSignalType=UINT8, ComSystemTemplateSystemSignalRef=TMM_EXV2_initRequest
        Target_Pos_cmd_oVCU_SVA_CMD_oLIN00_b87f26ef_Tx: ComBitPosition=16, ComBitSize=12, ComSignalInitValue=0, ComSignalType=UINT16, ComSystemTemplateSystemSignalRef=Target_Pos_cmd
        Tle4252d_en_oVcuRxCtrlMsg1_oTC37X_VCU_CAN01_24c739a8_Rx: ComBitPosition=0, ComBitSize=8, ComSignalInitValue=0, ComSignalType=SINT8, ComTimeout=0, ComSystemTemplateSystemSignalRef=Tle4252d_en
        Tle888qk_Lout14_En_oVcuRxCtrlMsg2_oTC37X_VCU_CAN01_a11e1e88_Rx: ComBitPosition=16, ComBitSize=8, ComSignalInitValue=0, ComSignalType=SINT8, ComTimeout=0, ComSystemTemplateSystemSignalRef=Tle888qk_Lout14_En
        Tle888qk_Lout16_En_oVcuRxCtrlMsg2_oTC37X_VCU_CAN01_508eb1e3_Rx: ComBitPosition=24, ComBitSize=8, ComSignalInitValue=0, ComSignalType=SINT8, ComTimeout=0, ComSystemTemplateSystemSignalRef=Tle888qk_Lout16_En
        Tle888qk_Lout1_En_oVcuRxCtrlMsg2_oTC37X_VCU_CAN01_0e3571fa_Rx: ComBitPosition=0, ComBitSize=8, ComSignalInitValue=0, ComSignalType=SINT8, ComTimeout=0, ComSystemTemplateSystemSignalRef=Tle888qk_Lout1_En
        Tle888qk_Lout8_En_oVcuRxCtrlMsg2_oTC37X_VCU_CAN01_ebe51441_Rx: ComBitPosition=8, ComBitSize=8, ComSignalInitValue=0, ComSignalType=SINT8, ComTimeout=0, ComSystemTemplateSystemSignalRef=Tle888qk_Lout8_En
        Tle888qk_Out21BriCfg_oVcuRxCtrlMsg0_oTC37X_VCU_CAN01_f4735e02_Rx: ComBitPosition=32, ComBitSize=8, ComSignalInitValue=0, ComSignalType=SINT8, ComTimeout=0, ComSystemTemplateSystemSignalRef=Tle888qk_Out21BriCfg
        Tle888qk_Out21_En_oVcuRxCtrlMsg0_oTC37X_VCU_CAN01_fce8b2a9_Rx: ComBitPosition=0, ComBitSize=8, ComSignalInitValue=0, ComSignalType=SINT8, ComTimeout=0, ComSystemTemplateSystemSignalRef=Tle888qk_Out21_En
        Tle888qk_Out22BriCfg_oVcuRxCtrlMsg0_oTC37X_VCU_CAN01_27e842f9_Rx: ComBitPosition=40, ComBitSize=8, ComSignalInitValue=0, ComSignalType=SINT8, ComTimeout=0, ComSystemTemplateSystemSignalRef=Tle888qk_Out22BriCfg
        Tle888qk_Out22_En_oVcuRxCtrlMsg0_oTC37X_VCU_CAN01_9808c957_Rx: ComBitPosition=8, ComBitSize=8, ComSignalInitValue=0, ComSignalType=SINT8, ComTimeout=0, ComSystemTemplateSystemSignalRef=Tle888qk_Out22_En
        Tle888qk_Out23BriCfg_oVcuRxCtrlMsg0_oTC37X_VCU_CAN01_69614950_Rx: ComBitPosition=48, ComBitSize=8, ComSignalInitValue=0, ComSignalType=SINT8, ComTimeout=0, ComSystemTemplateSystemSignalRef=Tle888qk_Out23BriCfg
        Tle888qk_Out23_En_oVcuRxCtrlMsg0_oTC37X_VCU_CAN01_0d781dc2_Rx: ComBitPosition=16, ComBitSize=8, ComSignalInitValue=0, ComSignalType=SINT8, ComTimeout=0, ComSystemTemplateSystemSignalRef=Tle888qk_Out23_En
        Tle888qk_Out24BriCfg_oVcuRxCtrlMsg0_oTC37X_VCU_CAN01_5baf7d4e_Rx: ComBitPosition=56, ComBitSize=8, ComSignalInitValue=0, ComSignalType=SINT8, ComTimeout=0, ComSystemTemplateSystemSignalRef=Tle888qk_Out24BriCfg
        Tle888qk_Out24_En_oVcuRxCtrlMsg0_oTC37X_VCU_CAN01_51c83eab_Rx: ComBitPosition=24, ComBitSize=8, ComSignalInitValue=0, ComSignalType=SINT8, ComTimeout=0, ComSystemTemplateSystemSignalRef=Tle888qk_Out24_En
        Tle9201_Dir_oVcuRxCtrlMsg1_oTC37X_VCU_CAN01_4c38edaa_Rx: ComBitPosition=24, ComBitSize=8, ComSignalInitValue=0, ComSignalType=SINT8, ComTimeout=0, ComSystemTemplateSystemSignalRef=Tle9201_Dir
        Tle9201_Dis_oVcuRxCtrlMsg1_oTC37X_VCU_CAN01_7aca7d59_Rx: ComBitPosition=8, ComBitSize=8, ComSignalInitValue=0, ComSignalType=SINT8, ComTimeout=0, ComSystemTemplateSystemSignalRef=Tle9201_Dis
        Tle9201_Pwm_oVcuRxCtrlMsg1_oTC37X_VCU_CAN01_bf73fa17_Rx: ComBitPosition=16, ComBitSize=8, ComSignalInitValue=0, ComSignalType=SINT8, ComTimeout=0, ComSystemTemplateSystemSignalRef=Tle9201_Pwm
        VcuAdcTxMsg1_Sig0_oVcuCan03TxMsg1_oTC37X_VCU_CAN03_1782ee05_Tx: ComBitPosition=0, ComBitSize=16, ComSignalInitValue=0, ComSignalType=SINT16, ComTimeout=0, ComTransferProperty=PENDING, ComSystemTemplateSystemSignalRef=VcuAdcTxMsg1_Sig0
        VcuAdcTxMsg1_Sig1_oVcuCan03TxMsg1_oTC37X_VCU_CAN03_3300bf33_Tx: ComBitPosition=16, ComBitSize=16, ComSignalInitValue=0, ComSignalType=SINT16, ComTimeout=0, ComTransferProperty=PENDING, ComSystemTemplateSystemSignalRef=VcuAdcTxMsg1_Sig1
        VcuAdcTxMsg1_Sig2_oVcuCan03TxMsg1_oTC37X_VCU_CAN03_5e864c69_Tx: ComBitPosition=32, ComBitSize=16, ComSignalInitValue=0, ComSignalType=SINT16, ComTimeout=0, ComTransferProperty=PENDING, ComSystemTemplateSystemSignalRef=VcuAdcTxMsg1_Sig2
        VcuAdcTxMsg1_Sig3_oVcuCan03TxMsg1_oTC37X_VCU_CAN03_7a041d5f_Tx: ComBitPosition=48, ComBitSize=16, ComSignalInitValue=0, ComSignalType=SINT16, ComTimeout=0, ComTransferProperty=PENDING, ComSystemTemplateSystemSignalRef=VcuAdcTxMsg1_Sig3
        VcuAdcTxMsg2_Sig0_oVcuCan03TxMsg2_oTC37X_VCU_CAN03_2e9f2f9c_Tx: ComBitPosition=0, ComBitSize=16, ComSignalInitValue=0, ComSignalType=SINT16, ComTimeout=0, ComTransferProperty=PENDING, ComSystemTemplateSystemSignalRef=VcuAdcTxMsg2_Sig0
        VcuAdcTxMsg2_Sig1_oVcuCan03TxMsg2_oTC37X_VCU_CAN03_0a1d7eaa_Tx: ComBitPosition=16, ComBitSize=16, ComSignalInitValue=0, ComSignalType=SINT16, ComTimeout=0, ComTransferProperty=PENDING, ComSystemTemplateSystemSignalRef=VcuAdcTxMsg2_Sig1
        VcuAdcTxMsg2_Sig2_oVcuCan03TxMsg2_oTC37X_VCU_CAN03_679b8df0_Tx: ComBitPosition=32, ComBitSize=16, ComSignalInitValue=0, ComSignalType=SINT16, ComTimeout=0, ComTransferProperty=PENDING, ComSystemTemplateSystemSignalRef=VcuAdcTxMsg2_Sig2
        VcuAdcTxMsg2_Sig3_oVcuCan03TxMsg2_oTC37X_VCU_CAN03_4319dcc6_Tx: ComBitPosition=48, ComBitSize=16, ComSignalInitValue=0, ComSignalType=SINT16, ComTimeout=0, ComTransferProperty=PENDING, ComSystemTemplateSystemSignalRef=VcuAdcTxMsg2_Sig3
        VcuCan12RxMsg3_Sig0_oVcuCan12RxMsg3_oTC37X_VCU_CAN12_5a65a77f_Rx: ComBitPosition=0, ComBitSize=16, ComSignalInitValue=0, ComSignalType=SINT16, ComTimeout=0, ComSystemTemplateSystemSignalRef=VcuCan12RxMsg3_Sig0
        VcuCan12RxMsg3_Sig1_oVcuCan12RxMsg3_oTC37X_VCU_CAN12_7ee7f649_Rx: ComBitPosition=16, ComBitSize=16, ComSignalInitValue=0, ComSignalType=SINT16, ComTimeout=0, ComSystemTemplateSystemSignalRef=VcuCan12RxMsg3_Sig1
        VcuCan12RxMsg3_Sig2_oVcuCan12RxMsg3_oTC37X_VCU_CAN12_13610513_Rx: ComBitPosition=32, ComBitSize=16, ComSignalInitValue=0, ComSignalType=SINT16, ComTimeout=0, ComSystemTemplateSystemSignalRef=VcuCan12RxMsg3_Sig2
        VcuCan12RxMsg3_Sig3_oVcuCan12RxMsg3_oTC37X_VCU_CAN12_37e35425_Rx: ComBitPosition=48, ComBitSize=16, ComSignalInitValue=0, ComSignalType=SINT16, ComTimeout=0, ComSystemTemplateSystemSignalRef=VcuCan12RxMsg3_Sig3
        VcuCan12RxMsg4_Sig0_oVcuCan12RxMsg4_oTC37X_VCU_CAN12_89859905_Rx: ComBitPosition=0, ComBitSize=16, ComSignalInitValue=0, ComSignalType=SINT16, ComTimeout=0, ComSystemTemplateSystemSignalRef=VcuCan12RxMsg4_Sig0
        VcuCan12RxMsg4_Sig1_oVcuCan12RxMsg4_oTC37X_VCU_CAN12_ad07c833_Rx: ComBitPosition=16, ComBitSize=16, ComSignalInitValue=0, ComSignalType=SINT16, ComTimeout=0, ComSystemTemplateSystemSignalRef=VcuCan12RxMsg4_Sig1
        VcuCan12RxMsg4_Sig2_oVcuCan12RxMsg4_oTC37X_VCU_CAN12_c0813b69_Rx: ComBitPosition=32, ComBitSize=16, ComSignalInitValue=0, ComSignalType=SINT16, ComTimeout=0, ComSystemTemplateSystemSignalRef=VcuCan12RxMsg4_Sig2
        VcuCan12RxMsg4_Sig3_oVcuCan12RxMsg4_oTC37X_VCU_CAN12_e4036a5f_Rx: ComBitPosition=48, ComBitSize=16, ComSignalInitValue=0, ComSignalType=SINT16, ComTimeout=0, ComSystemTemplateSystemSignalRef=VcuCan12RxMsg4_Sig3
        VcuCan12TxMsg1_Sig0_oVcuCan12TxMsg1_oTC37X_VCU_CAN12_d3993898_Tx: ComBitPosition=0, ComBitSize=16, ComSignalInitValue=0, ComSignalType=SINT16, ComTimeout=0, ComTransferProperty=PENDING, ComSystemTemplateSystemSignalRef=VcuCan12TxMsg1_Sig0
        VcuCan12TxMsg1_Sig1_oVcuCan12TxMsg1_oTC37X_VCU_CAN12_f71b69ae_Tx: ComBitPosition=16, ComBitSize=16, ComSignalInitValue=0, ComSignalType=SINT16, ComTimeout=0, ComTransferProperty=PENDING, ComSystemTemplateSystemSignalRef=VcuCan12TxMsg1_Sig1
        VcuCan12TxMsg1_Sig2_oVcuCan12TxMsg1_oTC37X_VCU_CAN12_9a9d9af4_Tx: ComBitPosition=32, ComBitSize=16, ComSignalInitValue=0, ComSignalType=SINT16, ComTimeout=0, ComTransferProperty=PENDING, ComSystemTemplateSystemSignalRef=VcuCan12TxMsg1_Sig2
        VcuCan12TxMsg1_Sig3_oVcuCan12TxMsg1_oTC37X_VCU_CAN12_be1fcbc2_Tx: ComBitPosition=48, ComBitSize=16, ComSignalInitValue=0, ComSignalType=SINT16, ComTimeout=0, ComTransferProperty=PENDING, ComSystemTemplateSystemSignalRef=VcuCan12TxMsg1_Sig3
        VcuCan12TxMsg2_Sig0_oVcuCan12TxMsg2_oTC37X_VCU_CAN12_ea84f901_Tx: ComBitPosition=0, ComBitSize=16, ComSignalInitValue=0, ComSignalType=SINT16, ComTimeout=0, ComTransferProperty=PENDING, ComSystemTemplateSystemSignalRef=VcuCan12TxMsg2_Sig0
        VcuCan12TxMsg2_Sig1_oVcuCan12TxMsg2_oTC37X_VCU_CAN12_ce06a837_Tx: ComBitPosition=16, ComBitSize=16, ComSignalInitValue=0, ComSignalType=SINT16, ComTimeout=0, ComTransferProperty=PENDING, ComSystemTemplateSystemSignalRef=VcuCan12TxMsg2_Sig1
        VcuCan12TxMsg2_Sig2_oVcuCan12TxMsg2_oTC37X_VCU_CAN12_a3805b6d_Tx: ComBitPosition=32, ComBitSize=16, ComSignalInitValue=0, ComSignalType=SINT16, ComTimeout=0, ComTransferProperty=PENDING, ComSystemTemplateSystemSignalRef=VcuCan12TxMsg2_Sig2
        VcuCan12TxMsg2_Sig3_oVcuCan12TxMsg2_oTC37X_VCU_CAN12_87020a5b_Tx: ComBitPosition=48, ComBitSize=16, ComSignalInitValue=0, ComSignalType=SINT16, ComTimeout=0, ComTransferProperty=PENDING, ComSystemTemplateSystemSignalRef=VcuCan12TxMsg2_Sig3
        VcuRxMsg1_Sig0_oVcuRxMsg1_oTC37X_VCU_CAN00_13cef464_Rx: ComBitPosition=0, ComBitSize=16, ComSignalInitValue=0, ComSignalType=SINT16, ComTimeout=0, ComSystemTemplateSystemSignalRef=VcuRxMsg1_Sig0
        VcuRxMsg1_Sig1_oVcuRxMsg1_oTC37X_VCU_CAN00_70c92d40_Rx: ComBitPosition=16, ComBitSize=16, ComSignalInitValue=0, ComSignalType=SINT16, ComTimeout=0, ComSystemTemplateSystemSignalRef=VcuRxMsg1_Sig1
        VcuRxMsg1_Sig2_oVcuRxMsg1_oTC37X_VCU_CAN00_d5c1462c_Rx: ComBitPosition=32, ComBitSize=16, ComSignalInitValue=0, ComSignalType=SINT16, ComTimeout=0, ComSystemTemplateSystemSignalRef=VcuRxMsg1_Sig2
        VcuRxMsg1_Sig3_oVcuRxMsg1_oTC37X_VCU_CAN00_b6c69f08_Rx: ComBitPosition=48, ComBitSize=16, ComSignalInitValue=0, ComSignalType=SINT16, ComTimeout=0, ComSystemTemplateSystemSignalRef=VcuRxMsg1_Sig3
        VcuRxMsg2_Sig0_oVcuRxMsg2_oTC37X_VCU_CAN00_94ceda5c_Rx: ComBitPosition=0, ComBitSize=16, ComSignalInitValue=0, ComSignalType=SINT16, ComTimeout=0, ComSystemTemplateSystemSignalRef=VcuRxMsg2_Sig0
        VcuRxMsg2_Sig1_oVcuRxMsg2_oTC37X_VCU_CAN00_f7c90378_Rx: ComBitPosition=16, ComBitSize=16, ComSignalInitValue=0, ComSignalType=SINT16, ComTimeout=0, ComSystemTemplateSystemSignalRef=VcuRxMsg2_Sig1
        VcuRxMsg2_Sig2_oVcuRxMsg2_oTC37X_VCU_CAN00_52c16814_Rx: ComBitPosition=32, ComBitSize=16, ComSignalInitValue=0, ComSignalType=SINT16, ComTimeout=0, ComSystemTemplateSystemSignalRef=VcuRxMsg2_Sig2
        VcuRxMsg2_Sig3_oVcuRxMsg2_oTC37X_VCU_CAN00_31c6b130_Rx: ComBitPosition=48, ComBitSize=16, ComSignalInitValue=0, ComSignalType=SINT16, ComTimeout=0, ComSystemTemplateSystemSignalRef=VcuRxMsg2_Sig3
        VcuRxMsg3_Sig0_oVcuCan03RxMsg1_oTC37X_VCU_CAN03_ab1f8c96_Rx: ComBitPosition=0, ComBitSize=16, ComSignalInitValue=0, ComSignalType=SINT16, ComTimeout=0, ComSystemTemplateSystemSignalRef=VcuRxMsg3_Sig0
        VcuRxMsg3_Sig0_oVcuRxMsg3_oTC37X_VCU_CAN01_28190d1d_Rx: ComBitPosition=0, ComBitSize=16, ComSignalInitValue=0, ComSignalType=SINT16, ComTimeout=0, ComSystemTemplateSystemSignalRef=VcuRxMsg3_Sig0
        VcuRxMsg3_Sig1_oVcuCan03RxMsg1_oTC37X_VCU_CAN03_8f9ddda0_Rx: ComBitPosition=16, ComBitSize=16, ComSignalInitValue=0, ComSignalType=SINT16, ComTimeout=0, ComSystemTemplateSystemSignalRef=VcuRxMsg3_Sig1
        VcuRxMsg3_Sig1_oVcuRxMsg3_oTC37X_VCU_CAN01_4b1ed439_Rx: ComBitPosition=16, ComBitSize=16, ComSignalInitValue=0, ComSignalType=SINT16, ComTimeout=0, ComSystemTemplateSystemSignalRef=VcuRxMsg3_Sig1
        VcuRxMsg3_Sig2_oVcuCan03RxMsg1_oTC37X_VCU_CAN03_e21b2efa_Rx: ComBitPosition=32, ComBitSize=16, ComSignalInitValue=0, ComSignalType=SINT16, ComTimeout=0, ComSystemTemplateSystemSignalRef=VcuRxMsg3_Sig2
        VcuRxMsg3_Sig2_oVcuRxMsg3_oTC37X_VCU_CAN01_ee16bf55_Rx: ComBitPosition=32, ComBitSize=16, ComSignalInitValue=0, ComSignalType=SINT16, ComTimeout=0, ComSystemTemplateSystemSignalRef=VcuRxMsg3_Sig2
        VcuRxMsg3_Sig3_oVcuCan03RxMsg1_oTC37X_VCU_CAN03_c6997fcc_Rx: ComBitPosition=48, ComBitSize=16, ComSignalInitValue=0, ComSignalType=SINT16, ComTimeout=0, ComSystemTemplateSystemSignalRef=VcuRxMsg3_Sig3
        VcuRxMsg3_Sig3_oVcuRxMsg3_oTC37X_VCU_CAN01_8d116671_Rx: ComBitPosition=48, ComBitSize=16, ComSignalInitValue=0, ComSignalType=SINT16, ComTimeout=0, ComSystemTemplateSystemSignalRef=VcuRxMsg3_Sig3
        VcuRxMsg4_Sig0_oVcuCan03RxMsg2_oTC37X_VCU_CAN03_735765ea_Rx: ComBitPosition=0, ComBitSize=16, ComSignalInitValue=0, ComSignalType=SINT16, ComTimeout=0, ComSystemTemplateSystemSignalRef=VcuRxMsg4_Sig0
        VcuRxMsg4_Sig0_oVcuRxMsg4_oTC37X_VCU_CAN01_36b8b0fb_Rx: ComBitPosition=0, ComBitSize=16, ComSignalInitValue=0, ComSignalType=SINT16, ComTimeout=0, ComSystemTemplateSystemSignalRef=VcuRxMsg4_Sig0
        VcuRxMsg4_Sig1_oVcuCan03RxMsg2_oTC37X_VCU_CAN03_57d534dc_Rx: ComBitPosition=16, ComBitSize=16, ComSignalInitValue=0, ComSignalType=SINT16, ComTimeout=0, ComSystemTemplateSystemSignalRef=VcuRxMsg4_Sig1
        VcuRxMsg4_Sig1_oVcuRxMsg4_oTC37X_VCU_CAN01_55bf69df_Rx: ComBitPosition=16, ComBitSize=16, ComSignalInitValue=0, ComSignalType=SINT16, ComTimeout=0, ComSystemTemplateSystemSignalRef=VcuRxMsg4_Sig1
        VcuRxMsg4_Sig2_oVcuCan03RxMsg2_oTC37X_VCU_CAN03_3a53c786_Rx: ComBitPosition=32, ComBitSize=16, ComSignalInitValue=0, ComSignalType=SINT16, ComTimeout=0, ComSystemTemplateSystemSignalRef=VcuRxMsg4_Sig2
        VcuRxMsg4_Sig2_oVcuRxMsg4_oTC37X_VCU_CAN01_f0b702b3_Rx: ComBitPosition=32, ComBitSize=16, ComSignalInitValue=0, ComSignalType=SINT16, ComTimeout=0, ComSystemTemplateSystemSignalRef=VcuRxMsg4_Sig2
        VcuRxMsg4_Sig3_oVcuCan03RxMsg2_oTC37X_VCU_CAN03_1ed196b0_Rx: ComBitPosition=48, ComBitSize=16, ComSignalInitValue=0, ComSignalType=SINT16, ComTimeout=0, ComSystemTemplateSystemSignalRef=VcuRxMsg4_Sig3
        VcuRxMsg4_Sig3_oVcuRxMsg4_oTC37X_VCU_CAN01_93b0db97_Rx: ComBitPosition=48, ComBitSize=16, ComSignalInitValue=0, ComSignalType=SINT16, ComTimeout=0, ComSystemTemplateSystemSignalRef=VcuRxMsg4_Sig3
        VcuTxMsg1_Sig0_oVcuTxMsg1_oTC37X_VCU_CAN00_8243b9a9_Tx: ComBitPosition=0, ComBitSize=16, ComSignalInitValue=0, ComSignalType=SINT16, ComTimeout=0, ComTransferProperty=PENDING, ComSystemTemplateSystemSignalRef=VcuTxMsg1_Sig0
        VcuTxMsg1_Sig1_oVcuTxMsg1_oTC37X_VCU_CAN00_e144608d_Tx: ComBitPosition=16, ComBitSize=16, ComSignalInitValue=0, ComSignalType=SINT16, ComTimeout=0, ComTransferProperty=PENDING, ComSystemTemplateSystemSignalRef=VcuTxMsg1_Sig1
        VcuTxMsg1_Sig2_oVcuTxMsg1_oTC37X_VCU_CAN00_444c0be1_Tx: ComBitPosition=32, ComBitSize=16, ComSignalInitValue=0, ComSignalType=SINT16, ComTimeout=0, ComTransferProperty=PENDING, ComSystemTemplateSystemSignalRef=VcuTxMsg1_Sig2
        VcuTxMsg1_Sig3_oVcuTxMsg1_oTC37X_VCU_CAN00_274bd2c5_Tx: ComBitPosition=48, ComBitSize=16, ComSignalInitValue=0, ComSignalType=SINT16, ComTimeout=0, ComTransferProperty=PENDING, ComSystemTemplateSystemSignalRef=VcuTxMsg1_Sig3
        VcuTxMsg2_Sig0_oVcuTxMsg2_oTC37X_VCU_CAN00_05439791_Tx: ComBitPosition=0, ComBitSize=16, ComSignalInitValue=0, ComSignalType=SINT16, ComTimeout=0, ComTransferProperty=PENDING, ComSystemTemplateSystemSignalRef=VcuTxMsg2_Sig0
        VcuTxMsg2_Sig1_oVcuTxMsg2_oTC37X_VCU_CAN00_66444eb5_Tx: ComBitPosition=16, ComBitSize=16, ComSignalInitValue=0, ComSignalType=SINT16, ComTimeout=0, ComTransferProperty=PENDING, ComSystemTemplateSystemSignalRef=VcuTxMsg2_Sig1
        VcuTxMsg2_Sig2_oVcuTxMsg2_oTC37X_VCU_CAN00_c34c25d9_Tx: ComBitPosition=32, ComBitSize=16, ComSignalInitValue=0, ComSignalType=SINT16, ComTimeout=0, ComTransferProperty=PENDING, ComSystemTemplateSystemSignalRef=VcuTxMsg2_Sig2
        VcuTxMsg2_Sig3_oVcuTxMsg2_oTC37X_VCU_CAN00_a04bfcfd_Tx: ComBitPosition=48, ComBitSize=16, ComSignalInitValue=0, ComSignalType=SINT16, ComTimeout=0, ComTransferProperty=PENDING, ComSystemTemplateSystemSignalRef=VcuTxMsg2_Sig3
        Vcu_Lin0_RxMsg1_Sig0_oVcu_Lin0_RxMsg1_oLIN01_6c375668_Rx: ComBitPosition=8, ComBitSize=8, ComSignalInitValue=0, ComSignalType=UINT8, ComSystemTemplateSystemSignalRef=Vcu_Lin0_RxMsg1_Sig0
        Vcu_Lin0_RxMsg1_Sig1_oVcu_Lin0_RxMsg1_oLIN01_c9bcc666_Rx: ComBitPosition=0, ComBitSize=8, ComSignalInitValue=0, ComSignalType=UINT8, ComSystemTemplateSystemSignalRef=Vcu_Lin0_RxMsg1_Sig1
        Vcu_Lin0_RxMsg2_Sig0_oVcu_Lin0_RxMsg2_oLIN01_a6197493_Rx: ComBitPosition=0, ComBitSize=8, ComSignalInitValue=0, ComSignalType=UINT8, ComSystemTemplateSystemSignalRef=Vcu_Lin0_RxMsg2_Sig0
        Vcu_Lin0_RxMsg2_Sig1_oVcu_Lin0_RxMsg2_oLIN01_0392e49d_Rx: ComBitPosition=8, ComBitSize=8, ComSignalInitValue=0, ComSignalType=UINT8, ComSystemTemplateSystemSignalRef=Vcu_Lin0_RxMsg2_Sig1
        Vcu_Lin0_RxMsg2_Sig2_oVcu_Lin0_RxMsg1_oLIN01_b8f0552d_Rx: ComBitPosition=16, ComBitSize=8, ComSignalInitValue=0, ComSignalType=UINT8, ComSystemTemplateSystemSignalRef=Vcu_Lin0_RxMsg2_Sig2
        Vcu_Lin0_RxMsg2_Sig2_oVcu_Lin0_RxMsg2_oLIN01_367f52ce_Rx: ComBitPosition=16, ComBitSize=8, ComSignalInitValue=0, ComSignalType=UINT8, ComSystemTemplateSystemSignalRef=Vcu_Lin0_RxMsg2_Sig2
        Vcu_Lin0_RxMsg2_Sig3_oVcu_Lin0_RxMsg1_oLIN01_1d7bc523_Rx: ComBitPosition=24, ComBitSize=8, ComSignalInitValue=0, ComSignalType=UINT8, ComSystemTemplateSystemSignalRef=Vcu_Lin0_RxMsg2_Sig3
        Vcu_Lin0_RxMsg2_Sig3_oVcu_Lin0_RxMsg2_oLIN01_93f4c2c0_Rx: ComBitPosition=32, ComBitSize=8, ComSignalInitValue=0, ComSignalType=UINT8, ComSystemTemplateSystemSignalRef=Vcu_Lin0_RxMsg2_Sig3
        Vcu_Lin0_TxMsg1_Sig0_oVcu_Lin0_TxMsg1_oLIN01_0005f3c6_Tx: ComBitPosition=0, ComBitSize=8, ComSignalInitValue=0, ComSignalType=UINT8, ComSystemTemplateSystemSignalRef=Vcu_Lin0_TxMsg1_Sig0
        Vcu_Lin0_TxMsg1_Sig1_oVcu_Lin0_TxMsg1_oLIN01_a58e63c8_Tx: ComBitPosition=8, ComBitSize=8, ComSignalInitValue=0, ComSignalType=UINT8, ComSystemTemplateSystemSignalRef=Vcu_Lin0_TxMsg1_Sig1
        Vcu_Lin0_TxMsg1_Sig2_oVcu_Lin0_TxMsg1_oLIN01_9063d59b_Tx: ComBitPosition=16, ComBitSize=8, ComSignalInitValue=0, ComSignalType=UINT8, ComSystemTemplateSystemSignalRef=Vcu_Lin0_TxMsg1_Sig2
        Vcu_Lin0_TxMsg1_Sig3_oVcu_Lin0_TxMsg1_oLIN01_35e84595_Tx: ComBitPosition=24, ComBitSize=8, ComSignalInitValue=0, ComSignalType=UINT8, ComSystemTemplateSystemSignalRef=Vcu_Lin0_TxMsg1_Sig3
        Vcu_Lin0_TxMsg2_Sig0_oVcu_Lin0_TxMsg2_oLIN01_ca2bd13d_Tx: ComBitPosition=0, ComBitSize=8, ComSignalInitValue=0, ComSignalType=UINT8, ComSystemTemplateSystemSignalRef=Vcu_Lin0_TxMsg2_Sig0
        Vcu_Lin0_TxMsg2_Sig1_oVcu_Lin0_TxMsg2_oLIN01_6fa04133_Tx: ComBitPosition=8, ComBitSize=8, ComSignalInitValue=0, ComSignalType=UINT8, ComSystemTemplateSystemSignalRef=Vcu_Lin0_TxMsg2_Sig1
        Vcu_Lin0_TxMsg2_Sig2_oVcu_Lin0_TxMsg2_oLIN01_5a4df760_Tx: ComBitPosition=16, ComBitSize=8, ComSignalInitValue=0, ComSignalType=UINT8, ComSystemTemplateSystemSignalRef=Vcu_Lin0_TxMsg2_Sig2
        Vcu_Lin0_TxMsg2_Sig3_oVcu_Lin0_TxMsg2_oLIN01_ffc6676e_Tx: ComBitPosition=24, ComBitSize=8, ComSignalInitValue=0, ComSignalType=UINT8, ComSystemTemplateSystemSignalRef=Vcu_Lin0_TxMsg2_Sig3
      31 x ComSignalGroup, all with ComTransferProperty=PENDING:
        SG_ACU_01_SigGroup_oACU_01_oATOM_CANFD_Matrix_CH_V600_202502_0a16dd9e_Rx: ComSystemTemplateSignalGroupRef=SG_ACU_01_SigGroup
          4 x ComGroupSignal, all with ComSignalEndianness=BIG_ENDIAN:
            ACU_YawRateStatus_oACU_01_oATOM_CANFD_Matrix_CH_V600_202502_a5dd4854_Rx: ComBitPosition=39, ComBitSize=2, ComSignalInitValue=0, ComSignalType=UINT8, ComSystemTemplateSystemSignalRef=ACU_YawRateStatus
            ACU_YawRate_oACU_01_oATOM_CANFD_Matrix_CH_V600_202502_35ce62e9_Rx: ComBitPosition=23, ComBitSize=16, ComSignalInitValue=30000, ComSignalType=UINT16, ComSystemTemplateSystemSignalRef=ACU_YawRate
            Checksum_0F5_oACU_01_oATOM_CANFD_Matrix_CH_V600_202502_21944b83_Rx: ComBitPosition=7, ComBitSize=8, ComSignalInitValue=0, ComSignalType=UINT8, ComSystemTemplateSystemSignalRef=Checksum_0F5
            MessageCounter_0F5_oACU_01_oATOM_CANFD_Matrix_CH_V600_202502_e1f37972_Rx: ComBitPosition=11, ComBitSize=4, ComSignalInitValue=0, ComSignalType=UINT8, ComSystemTemplateSystemSignalRef=MessageCounter_0F5
        SG_ACU_02_SigGroup_oACU_02_oATOM_CANFD_Matrix_CH_V600_202502_3b90e790_Rx: ComSystemTemplateSignalGroupRef=SG_ACU_02_SigGroup
          6 x ComGroupSignal, all with ComSignalEndianness=BIG_ENDIAN:
            ACU_LatAStatus_oACU_02_oATOM_CANFD_Matrix_CH_V600_202502_5faf7139_Rx: ComBitPosition=23, ComBitSize=2, ComSignalInitValue=0, ComSignalType=UINT8, ComSystemTemplateSystemSignalRef=ACU_LatAStatus
            ACU_LatA_oACU_02_oATOM_CANFD_Matrix_CH_V600_202502_0373507d_Rx: ComBitPosition=21, ComBitSize=14, ComSignalInitValue=4905, ComSignalType=UINT16, ComSystemTemplateSystemSignalRef=ACU_LatA
            ACU_LgtAStatus_oACU_02_oATOM_CANFD_Matrix_CH_V600_202502_8eba5290_Rx: ComBitPosition=39, ComBitSize=2, ComSignalInitValue=0, ComSignalType=UINT8, ComSystemTemplateSystemSignalRef=ACU_LgtAStatus
            ACU_LgtA_oACU_02_oATOM_CANFD_Matrix_CH_V600_202502_7ce5ad57_Rx: ComBitPosition=37, ComBitSize=14, ComSignalInitValue=4905, ComSignalType=UINT16, ComSystemTemplateSystemSignalRef=ACU_LgtA
            Checksum_0F6_oACU_02_oATOM_CANFD_Matrix_CH_V600_202502_63736e97_Rx: ComBitPosition=7, ComBitSize=8, ComSignalInitValue=0, ComSignalType=UINT8, ComSystemTemplateSystemSignalRef=Checksum_0F6
            MessageCounter_0F6_oACU_02_oATOM_CANFD_Matrix_CH_V600_202502_a3145c66_Rx: ComBitPosition=11, ComBitSize=4, ComSignalInitValue=0, ComSignalType=UINT8, ComSystemTemplateSystemSignalRef=MessageCounter_0F6
        SG_ACU_info_SigGroup_oACU_info_oATOM_CANFD_Matrix_CH_V600_202502_5b63ef23_Rx: ComSystemTemplateSignalGroupRef=SG_ACU_info_SigGroup
          19 x ComGroupSignal, all with ComSignalEndianness=BIG_ENDIAN:
            ACU_CrashOutputStsValid_oACU_info_oATOM_CANFD_Matrix_CH_V600_202502_01645954_Rx: ComBitPosition=16, ComBitSize=1, ComSignalInitValue=1, ComSignalType=BOOLEAN, ComSystemTemplateSystemSignalRef=ACU_CrashOutputStsValid
            ACU_CrashOutputSts_oACU_info_oATOM_CANFD_Matrix_CH_V600_202502_8aba12b9_Rx: ComBitPosition=23, ComBitSize=5, ComSignalInitValue=0, ComSignalType=UINT8, ComSystemTemplateSystemSignalRef=ACU_CrashOutputSts
            ACU_DriverSeatBeltStsValid_oACU_info_oATOM_CANFD_Matrix_CH_V600_202502_2fcd0f16_Rx: ComBitPosition=30, ComBitSize=1, ComSignalInitValue=0, ComSignalType=BOOLEAN, ComSystemTemplateSystemSignalRef=ACU_DriverSeatBeltStsValid
            ACU_DriverSeatBeltSts_oACU_info_oATOM_CANFD_Matrix_CH_V600_202502_4a79a099_Rx: ComBitPosition=31, ComBitSize=1, ComSignalInitValue=0, ComSignalType=BOOLEAN, ComSystemTemplateSystemSignalRef=ACU_DriverSeatBeltSts
            ACU_DriverWarningLampSts_oACU_info_oATOM_CANFD_Matrix_CH_V600_202502_53dfaac4_Rx: ComBitPosition=61, ComBitSize=2, ComSignalInitValue=0, ComSignalType=UINT8, ComSystemTemplateSystemSignalRef=ACU_DriverWarningLampSts
            ACU_PassengerAirbagSts_oACU_info_oATOM_CANFD_Matrix_CH_V600_202502_4a4cb1e6_Rx: ComBitPosition=63, ComBitSize=2, ComSignalInitValue=0, ComSignalType=UINT8, ComSystemTemplateSystemSignalRef=ACU_PassengerAirbagSts
            ACU_PassengerSeatBeltStsValid_oACU_info_oATOM_CANFD_Matrix_CH_V600_202502_96ea6676_Rx: ComBitPosition=26, ComBitSize=1, ComSignalInitValue=0, ComSignalType=BOOLEAN, ComSystemTemplateSystemSignalRef=ACU_PassengerSeatBeltStsValid
            ACU_PassengerSeatBeltSts_oACU_info_oATOM_CANFD_Matrix_CH_V600_202502_2c4c3734_Rx: ComBitPosition=27, ComBitSize=1, ComSignalInitValue=0, ComSignalType=BOOLEAN, ComSystemTemplateSystemSignalRef=ACU_PassengerSeatBeltSts
            ACU_PassengerSts_oACU_info_oATOM_CANFD_Matrix_CH_V600_202502_eb52bcb8_Rx: ComBitPosition=25, ComBitSize=1, ComSignalInitValue=0, ComSignalType=BOOLEAN, ComSystemTemplateSystemSignalRef=ACU_PassengerSts
            ACU_PassengerWarningLampSts_oACU_info_oATOM_CANFD_Matrix_CH_V600_202502_eaccbc6f_Rx: ComBitPosition=59, ComBitSize=2, ComSignalInitValue=0, ComSignalType=UINT8, ComSystemTemplateSystemSignalRef=ACU_PassengerWarningLampSts
            ACU_RLSeatBeltStatusValid_oACU_info_oATOM_CANFD_Matrix_CH_V600_202502_231d8b98_Rx: ComBitPosition=38, ComBitSize=1, ComSignalInitValue=0, ComSignalType=BOOLEAN, ComSystemTemplateSystemSignalRef=ACU_RLSeatBeltStatusValid
            ACU_RRSeatBeltStatusValid_oACU_info_oATOM_CANFD_Matrix_CH_V600_202502_8ba1e757_Rx: ComBitPosition=54, ComBitSize=1, ComSignalInitValue=0, ComSignalType=BOOLEAN, ComSystemTemplateSystemSignalRef=ACU_RRSeatBeltStatusValid
            ACU_SecondLeftSeatBeltSts_oACU_info_oATOM_CANFD_Matrix_CH_V600_202502_0c298557_Rx: ComBitPosition=39, ComBitSize=1, ComSignalInitValue=0, ComSignalType=BOOLEAN, ComSystemTemplateSystemSignalRef=ACU_SecondLeftSeatBeltSts
            ACU_SecondLeftSts_oACU_info_oATOM_CANFD_Matrix_CH_V600_202502_4d0b3459_Rx: ComBitPosition=37, ComBitSize=1, ComSignalInitValue=0, ComSignalType=BOOLEAN, ComSystemTemplateSystemSignalRef=ACU_SecondLeftSts
            ACU_SecondRightSeatBeltSts_oACU_info_oATOM_CANFD_Matrix_CH_V600_202502_3170c946_Rx: ComBitPosition=55, ComBitSize=1, ComSignalInitValue=0, ComSignalType=BOOLEAN, ComSystemTemplateSystemSignalRef=ACU_SecondRightSeatBeltSts
            ACU_SecondRightSts_oACU_info_oATOM_CANFD_Matrix_CH_V600_202502_19211d8e_Rx: ComBitPosition=53, ComBitSize=1, ComSignalInitValue=0, ComSignalType=BOOLEAN, ComSystemTemplateSystemSignalRef=ACU_SecondRightSts
            ACU_WarningLampSts_oACU_info_oATOM_CANFD_Matrix_CH_V600_202502_9c596fcb_Rx: ComBitPosition=57, ComBitSize=2, ComSignalInitValue=0, ComSignalType=UINT8, ComSystemTemplateSystemSignalRef=ACU_WarningLampSts
            Checksum_097_oACU_info_oATOM_CANFD_Matrix_CH_V600_202502_591da21b_Rx: ComBitPosition=7, ComBitSize=8, ComSignalInitValue=0, ComSignalType=UINT8, ComSystemTemplateSystemSignalRef=Checksum_097
            MessageCounter_097_oACU_info_oATOM_CANFD_Matrix_CH_V600_202502_9c6de300_Rx: ComBitPosition=11, ComBitSize=4, ComSignalInitValue=0, ComSignalType=UINT8, ComSystemTemplateSystemSignalRef=MessageCounter_097
        SG_ADCU_ACC_02_SigGroup_oADCU_ACC_02_oATOM_CANFD_Matrix_CH_V600_202502_1e479296_Rx: ComSystemTemplateSignalGroupRef=SG_ADCU_ACC_02_SigGroup
          5 x ComGroupSignal, all with ComSignalEndianness=BIG_ENDIAN, ComSignalInitValue=0, ComSignalType=UINT8:
            ADCU_ACCDA_HandsOFF_Warning_oADCU_ACC_02_oATOM_CANFD_Matrix_CH_V600_202502_cdbbce90_Rx: ComBitPosition=18, ComBitSize=3, ComSystemTemplateSystemSignalRef=ADCU_ACCDA_HandsOFF_Warning
            ADCU_ACCDA_SYS_Failure_oADCU_ACC_02_oATOM_CANFD_Matrix_CH_V600_202502_0c0a67d0_Rx: ComBitPosition=23, ComBitSize=2, ComSystemTemplateSystemSignalRef=ADCU_ACCDA_SYS_Failure
            ADCU_ACC_Mode_oADCU_ACC_02_oATOM_CANFD_Matrix_CH_V600_202502_4b80afee_Rx: ComBitPosition=21, ComBitSize=3, ComSystemTemplateSystemSignalRef=ADCU_ACC_Mode
            Checksum_0E0_oADCU_ACC_02_oATOM_CANFD_Matrix_CH_V600_202502_31389c92_Rx: ComBitPosition=7, ComBitSize=8, ComSystemTemplateSystemSignalRef=Checksum_0E0
            MessageCounter_0E0_oADCU_ACC_02_oATOM_CANFD_Matrix_CH_V600_202502_982cdfbe_Rx: ComBitPosition=11, ComBitSize=4, ComSystemTemplateSystemSignalRef=MessageCounter_0E0
        SG_ADCU_AEB_01_SigGroup_oADCU_AEB_01_oATOM_CANFD_Matrix_CH_V600_202502_50a93e3a_Rx: ComSystemTemplateSignalGroupRef=SG_ADCU_AEB_01_SigGroup
          11 x ComGroupSignal, all with ComSignalEndianness=BIG_ENDIAN, ComSignalInitValue=0:
            ADCU_AEBReq_oADCU_AEB_01_oATOM_CANFD_Matrix_CH_V600_202502_cfcc0419_Rx: ComBitPosition=15, ComBitSize=1, ComSignalType=BOOLEAN, ComSystemTemplateSystemSignalRef=ADCU_AEBReq
            ADCU_AEBWarningSts_oADCU_AEB_01_oATOM_CANFD_Matrix_CH_V600_202502_ce5fed0e_Rx: ComBitPosition=50, ComBitSize=3, ComSignalType=UINT8, ComSystemTemplateSystemSignalRef=ADCU_AEBWarningSts
            ADCU_AEB_AWB_Level_oADCU_AEB_01_oATOM_CANFD_Matrix_CH_V600_202502_16b7390a_Rx: ComBitPosition=43, ComBitSize=3, ComSignalType=UINT8, ComSystemTemplateSystemSignalRef=ADCU_AEB_AWB_Level
            ADCU_AEB_AWB_Req_oADCU_AEB_01_oATOM_CANFD_Matrix_CH_V600_202502_52a850e5_Rx: ComBitPosition=54, ComBitSize=1, ComSignalType=BOOLEAN, ComSystemTemplateSystemSignalRef=ADCU_AEB_AWB_Req
            ADCU_AEB_Decel_Cmd_oADCU_AEB_01_oATOM_CANFD_Matrix_CH_V600_202502_e2026fd4_Rx: ComBitPosition=39, ComBitSize=10, ComSignalType=SINT16, ComSystemTemplateSystemSignalRef=ADCU_AEB_Decel_Cmd
            ADCU_AEB_Prefill_CMD_oADCU_AEB_01_oATOM_CANFD_Matrix_CH_V600_202502_935b0159_Rx: ComBitPosition=55, ComBitSize=1, ComSignalType=BOOLEAN, ComSystemTemplateSystemSignalRef=ADCU_AEB_Prefill_CMD
            ADCU_AEB_State_oADCU_AEB_01_oATOM_CANFD_Matrix_CH_V600_202502_040d6d85_Rx: ComBitPosition=18, ComBitSize=2, ComSignalType=UINT8, ComSystemTemplateSystemSignalRef=ADCU_AEB_State
            ADCU_AEB_Stop_Req_oADCU_AEB_01_oATOM_CANFD_Matrix_CH_V600_202502_edd96c77_Rx: ComBitPosition=53, ComBitSize=1, ComSignalType=BOOLEAN, ComSystemTemplateSystemSignalRef=ADCU_AEB_Stop_Req
            ADCU_FCW_State_oADCU_AEB_01_oATOM_CANFD_Matrix_CH_V600_202502_858628ce_Rx: ComBitPosition=20, ComBitSize=2, ComSignalType=UINT8, ComSystemTemplateSystemSignalRef=ADCU_FCW_State
            Checksum_0E2_oADCU_AEB_01_oATOM_CANFD_Matrix_CH_V600_202502_3047b966_Rx: ComBitPosition=7, ComBitSize=8, ComSignalType=UINT8, ComSystemTemplateSystemSignalRef=Checksum_0E2
            MessageCounter_0E2_oADCU_AEB_01_oATOM_CANFD_Matrix_CH_V600_202502_9953fa4a_Rx: ComBitPosition=11, ComBitSize=4, ComSignalType=UINT8, ComSystemTemplateSystemSignalRef=MessageCounter_0E2
        SG_ADCU_APS_01_SigGroup_oADCU_APS_01_oATOM_CANFD_Matrix_CH_V600_202502_c590572d_Rx: ComSystemTemplateSignalGroupRef=SG_ADCU_APS_01_SigGroup
          12 x ComGroupSignal, all with ComSignalEndianness=BIG_ENDIAN, ComSignalInitValue=0:
            ADCU_APSComfBrkReq_oADCU_APS_01_oATOM_CANFD_Matrix_CH_V600_202502_b25663d8_Rx: ComBitPosition=42, ComBitSize=2, ComSignalType=UINT8, ComSystemTemplateSystemSignalRef=ADCU_APSComfBrkReq
            ADCU_APSCrlModeReq_oADCU_APS_01_oATOM_CANFD_Matrix_CH_V600_202502_589f1c09_Rx: ComBitPosition=15, ComBitSize=2, ComSignalType=UINT8, ComSystemTemplateSystemSignalRef=ADCU_APSCrlModeReq
            ADCU_APSCrlReq_oADCU_APS_01_oATOM_CANFD_Matrix_CH_V600_202502_da787726_Rx: ComBitPosition=23, ComBitSize=2, ComSignalType=UINT8, ComSystemTemplateSystemSignalRef=ADCU_APSCrlReq
            ADCU_APSCrlTypReq_oADCU_APS_01_oATOM_CANFD_Matrix_CH_V600_202502_25dd00be_Rx: ComBitPosition=13, ComBitSize=2, ComSignalType=UINT8, ComSystemTemplateSystemSignalRef=ADCU_APSCrlTypReq
            ADCU_APSDistanceStop_oADCU_APS_01_oATOM_CANFD_Matrix_CH_V600_202502_5af9bfc0_Rx: ComBitPosition=19, ComBitSize=12, ComSignalType=UINT16, ComSystemTemplateSystemSignalRef=ADCU_APSDistanceStop
            ADCU_APSMaxSpeedReq_oADCU_APS_01_oATOM_CANFD_Matrix_CH_V600_202502_afdb21bd_Rx: ComBitPosition=47, ComBitSize=5, ComSignalType=UINT8, ComSystemTemplateSystemSignalRef=ADCU_APSMaxSpeedReq
            ADCU_APS_Stop_Req_oADCU_APS_01_oATOM_CANFD_Matrix_CH_V600_202502_cd03c7ef_Rx: ComBitPosition=33, ComBitSize=2, ComSignalType=UINT8, ComSystemTemplateSystemSignalRef=ADCU_APS_Stop_Req
            ADCU_Parking_CtrlSts_oADCU_APS_01_oATOM_CANFD_Matrix_CH_V600_202502_c95774a6_Rx: ComBitPosition=35, ComBitSize=2, ComSignalType=UINT8, ComSystemTemplateSystemSignalRef=ADCU_Parking_CtrlSts
            ADCU_Parking_Mode_oADCU_APS_01_oATOM_CANFD_Matrix_CH_V600_202502_c6e9f3f9_Rx: ComBitPosition=55, ComBitSize=4, ComSignalType=UINT8, ComSystemTemplateSystemSignalRef=ADCU_Parking_Mode
            ADCU_TargetGear_oADCU_APS_01_oATOM_CANFD_Matrix_CH_V600_202502_dbe43087_Rx: ComBitPosition=39, ComBitSize=3, ComSignalType=UINT8, ComSystemTemplateSystemSignalRef=ADCU_TargetGear
            Checksum_0E4_oADCU_APS_01_oATOM_CANFD_Matrix_CH_V600_202502_19b3517b_Rx: ComBitPosition=7, ComBitSize=8, ComSignalType=UINT8, ComSystemTemplateSystemSignalRef=Checksum_0E4
            MessageCounter_0E4_oADCU_APS_01_oATOM_CANFD_Matrix_CH_V600_202502_b0a71257_Rx: ComBitPosition=11, ComBitSize=4, ComSignalType=UINT8, ComSystemTemplateSystemSignalRef=MessageCounter_0E4
        SG_ADCU_APS_02_SigGroup_oADCU_APS_02_oATOM_CANFD_Matrix_CH_V600_202502_67bc1f98_Rx: ComSystemTemplateSignalGroupRef=SG_ADCU_APS_02_SigGroup
          ADCU_RemoteParkingMode_oADCU_APS_02_oATOM_CANFD_Matrix_CH_V600_202502_262c752a_Rx (ComGroupSignal):
            ComBitPosition = 23
            ComBitSize = 4
            ComSignalEndianness = BIG_ENDIAN
            ComSignalInitValue = 0
            ComSignalType = UINT8
            ComSystemTemplateSystemSignalRef = ADCU_RemoteParkingMode
        SG_ADCU_DA_SigGroup_oADCU_DA_oATOM_CANFD_Matrix_CH_V600_202502_4133b6dd_Rx: ComSystemTemplateSignalGroupRef=SG_ADCU_DA_SigGroup
          3 x ComGroupSignal, all with ComSignalEndianness=BIG_ENDIAN, ComSignalInitValue=0, ComSignalType=UINT8:
            ADCU_DA_Mode_oADCU_DA_oATOM_CANFD_Matrix_CH_V600_202502_98abcb34_Rx: ComBitPosition=23, ComBitSize=3, ComSystemTemplateSystemSignalRef=ADCU_DA_Mode
            Checksum_0E6_oADCU_DA_oATOM_CANFD_Matrix_CH_V600_202502_6e918845_Rx: ComBitPosition=7, ComBitSize=8, ComSystemTemplateSystemSignalRef=Checksum_0E6
            MessageCounter_0E6_oADCU_DA_oATOM_CANFD_Matrix_CH_V600_202502_a4eb2dfd_Rx: ComBitPosition=11, ComBitSize=4, ComSystemTemplateSystemSignalRef=MessageCounter_0E6
        SG_IBS_ACC_SigGroup_oIBS_ACC_oATOM_CANFD_Matrix_CH_V600_202502_c31bc8ab_Rx: ComSystemTemplateSignalGroupRef=SG_IBS_ACC_SigGroup
          12 x ComGroupSignal, all with ComSignalEndianness=BIG_ENDIAN, ComSignalInitValue=0:
            Checksum_0B8_oIBS_ACC_oATOM_CANFD_Matrix_CH_V600_202502_ea42d99c_Rx: ComBitPosition=7, ComBitSize=8, ComSignalType=UINT8, ComSystemTemplateSystemSignalRef=Checksum_0B8
            IBS_CddActive_oIBS_ACC_oATOM_CANFD_Matrix_CH_V600_202502_cd634808_Rx: ComBitPosition=45, ComBitSize=1, ComSignalType=BOOLEAN, ComSystemTemplateSystemSignalRef=IBS_CddActive
            IBS_CddAvailable_oIBS_ACC_oATOM_CANFD_Matrix_CH_V600_202502_694f6a44_Rx: ComBitPosition=47, ComBitSize=1, ComSignalType=BOOLEAN, ComSystemTemplateSystemSignalRef=IBS_CddAvailable
            IBS_CddError_oIBS_ACC_oATOM_CANFD_Matrix_CH_V600_202502_15ba1189_Rx: ComBitPosition=46, ComBitSize=1, ComSignalType=BOOLEAN, ComSystemTemplateSystemSignalRef=IBS_CddError
            IBS_VehicleStandstill_Valid_oIBS_ACC_oATOM_CANFD_Matrix_CH_V600_202502_8e482947_Rx: ComBitPosition=23, ComBitSize=1, ComSignalType=BOOLEAN, ComSystemTemplateSystemSignalRef=IBS_VehicleStandstill_Valid
            IBS_VehicleStandstill_oIBS_ACC_oATOM_CANFD_Matrix_CH_V600_202502_e5c3fb2c_Rx: ComBitPosition=44, ComBitSize=2, ComSignalType=UINT8, ComSystemTemplateSystemSignalRef=IBS_VehicleStandstill
            IBS_VlcActive_oIBS_ACC_oATOM_CANFD_Matrix_CH_V600_202502_3fa05f6d_Rx: ComBitPosition=40, ComBitSize=1, ComSignalType=BOOLEAN, ComSystemTemplateSystemSignalRef=IBS_VlcActive
            IBS_VlcAvalible_oIBS_ACC_oATOM_CANFD_Matrix_CH_V600_202502_5ec40897_Rx: ComBitPosition=42, ComBitSize=1, ComSignalType=BOOLEAN, ComSystemTemplateSystemSignalRef=IBS_VlcAvalible
            IBS_VlcError_oIBS_ACC_oATOM_CANFD_Matrix_CH_V600_202502_b4ad3ada_Rx: ComBitPosition=41, ComBitSize=1, ComSignalType=BOOLEAN, ComSystemTemplateSystemSignalRef=IBS_VlcError
            IBS_WLTorqueVLCReqValid_oIBS_ACC_oATOM_CANFD_Matrix_CH_V600_202502_d640a38d_Rx: ComBitPosition=31, ComBitSize=2, ComSignalType=UINT8, ComSystemTemplateSystemSignalRef=IBS_WLTorqueVLCReqValid
            IBS_WLTorqueVLCReq_oIBS_ACC_oATOM_CANFD_Matrix_CH_V600_202502_e5232329_Rx: ComBitPosition=55, ComBitSize=16, ComSignalType=SINT16, ComSystemTemplateSystemSignalRef=IBS_WLTorqueVLCReq
            MessageCounter_0B8_oIBS_ACC_oATOM_CANFD_Matrix_CH_V600_202502_20387c24_Rx: ComBitPosition=11, ComBitSize=4, ComSignalType=UINT8, ComSystemTemplateSystemSignalRef=MessageCounter_0B8
        SG_IBS_APS_SigGroup_oIBS_APS_oATOM_CANFD_Matrix_CH_V600_202502_91bbe9ec_Rx: ComSystemTemplateSignalGroupRef=SG_IBS_APS_SigGroup
          9 x ComGroupSignal, all with ComSignalEndianness=BIG_ENDIAN, ComSignalInitValue=0, ComSignalType=UINT8:
            Checksum_0B7_oIBS_APS_oATOM_CANFD_Matrix_CH_V600_202502_7cf1e80a_Rx: ComBitPosition=7, ComBitSize=8, ComSystemTemplateSystemSignalRef=Checksum_0B7
            IBS_APSComfortAvl_oIBS_APS_oATOM_CANFD_Matrix_CH_V600_202502_761e7ded_Rx: ComBitPosition=31, ComBitSize=2, ComSystemTemplateSystemSignalRef=IBS_APSComfortAvl
            IBS_APSCrlReqEcho_oIBS_APS_oATOM_CANFD_Matrix_CH_V600_202502_7e0dcab4_Rx: ComBitPosition=19, ComBitSize=2, ComSystemTemplateSystemSignalRef=IBS_APSCrlReqEcho
            IBS_APSEmergenyAvl_oIBS_APS_oATOM_CANFD_Matrix_CH_V600_202502_98e19592_Rx: ComBitPosition=29, ComBitSize=2, ComSystemTemplateSystemSignalRef=IBS_APSEmergenyAvl
            IBS_APSModeEcho_oIBS_APS_oATOM_CANFD_Matrix_CH_V600_202502_b13c14e1_Rx: ComBitPosition=17, ComBitSize=2, ComSystemTemplateSystemSignalRef=IBS_APSModeEcho
            IBS_APSTrqReqActive_oIBS_APS_oATOM_CANFD_Matrix_CH_V600_202502_95892cb5_Rx: ComBitPosition=27, ComBitSize=2, ComSystemTemplateSystemSignalRef=IBS_APSTrqReqActive
            IBS_APS_Avl_oIBS_APS_oATOM_CANFD_Matrix_CH_V600_202502_912b9c67_Rx: ComBitPosition=23, ComBitSize=2, ComSystemTemplateSystemSignalRef=IBS_APS_Avl
            IBS_BrakeTypEcho_oIBS_APS_oATOM_CANFD_Matrix_CH_V600_202502_efa1b54d_Rx: ComBitPosition=21, ComBitSize=2, ComSystemTemplateSystemSignalRef=IBS_BrakeTypEcho
            MessageCounter_0B7_oIBS_APS_oATOM_CANFD_Matrix_CH_V600_202502_b68b4db2_Rx: ComBitPosition=11, ComBitSize=4, ComSystemTemplateSystemSignalRef=MessageCounter_0B7
        SG_IBS_Status_01_SigGroup_oIBS_Status_01_oATOM_CANFD_Matrix_CH_V600_202502_bdf732ba_Rx: ComSystemTemplateSignalGroupRef=SG_IBS_Status_01_SigGroup
          7 x ComGroupSignal, all with ComSignalEndianness=BIG_ENDIAN:
            Checksum_0B2_oIBS_Status_01_oATOM_CANFD_Matrix_CH_V600_202502_ad2c5ce1_Rx: ComBitPosition=7, ComBitSize=8, ComSignalInitValue=0, ComSignalType=UINT8, ComSystemTemplateSystemSignalRef=Checksum_0B2
            IBS_BrakePedalStatusValid_oIBS_Status_01_oATOM_CANFD_Matrix_CH_V600_202502_ba3a564c_Rx: ComBitPosition=21, ComBitSize=1, ComSignalInitValue=1, ComSignalType=BOOLEAN, ComSystemTemplateSystemSignalRef=IBS_BrakePedalStatusValid
            IBS_BrakePedalStatus_oIBS_Status_01_oATOM_CANFD_Matrix_CH_V600_202502_c14952d9_Rx: ComBitPosition=23, ComBitSize=2, ComSignalInitValue=0, ComSignalType=UINT8, ComSystemTemplateSystemSignalRef=IBS_BrakePedalStatus
            IBS_BrakePushrodStroke_oIBS_Status_01_oATOM_CANFD_Matrix_CH_V600_202502_b9911368_Rx: ComBitPosition=55, ComBitSize=12, ComSignalInitValue=0, ComSignalType=SINT16, ComSystemTemplateSystemSignalRef=IBS_BrakePushrodStroke
            IBS_MasterCylinderPressure_oIBS_Status_01_oATOM_CANFD_Matrix_CH_V600_202502_b339468a_Rx: ComBitPosition=19, ComBitSize=12, ComSignalInitValue=0, ComSignalType=UINT16, ComSystemTemplateSystemSignalRef=IBS_MasterCylinderPressure
            IBS_PlungerPressure_oIBS_Status_01_oATOM_CANFD_Matrix_CH_V600_202502_1a29f19b_Rx: ComBitPosition=36, ComBitSize=12, ComSignalInitValue=0, ComSignalType=SINT16, ComSystemTemplateSystemSignalRef=IBS_PlungerPressure
            MessageCounter_0B2_oIBS_Status_01_oATOM_CANFD_Matrix_CH_V600_202502_7bc88e71_Rx: ComBitPosition=11, ComBitSize=4, ComSignalInitValue=0, ComSignalType=UINT8, ComSystemTemplateSystemSignalRef=MessageCounter_0B2
        SG_IBS_Status_02_SigGroup_oIBS_Status_02_oATOM_CANFD_Matrix_CH_V600_202502_8df002b0_Rx: ComSystemTemplateSignalGroupRef=SG_IBS_Status_02_SigGroup
          18 x ComGroupSignal, all with ComSignalEndianness=BIG_ENDIAN, ComSignalInitValue=0:
            Checksum_0B3_oIBS_Status_02_oATOM_CANFD_Matrix_CH_V600_202502_a2ce7b09_Rx: ComBitPosition=7, ComBitSize=8, ComSignalType=UINT8, ComSystemTemplateSystemSignalRef=Checksum_0B3
            IBS_AEBActive_oIBS_Status_02_oATOM_CANFD_Matrix_CH_V600_202502_27fddc4e_Rx: ComBitPosition=26, ComBitSize=1, ComSignalType=BOOLEAN, ComSystemTemplateSystemSignalRef=IBS_AEBActive
            IBS_AEBAvailable_oIBS_Status_02_oATOM_CANFD_Matrix_CH_V600_202502_586c329d_Rx: ComBitPosition=33, ComBitSize=1, ComSignalType=BOOLEAN, ComSystemTemplateSystemSignalRef=IBS_AEBAvailable
            IBS_AVHAvailable_oIBS_Status_02_oATOM_CANFD_Matrix_CH_V600_202502_e9505f9e_Rx: ComBitPosition=39, ComBitSize=1, ComSignalType=BOOLEAN, ComSystemTemplateSystemSignalRef=IBS_AVHAvailable
            IBS_AWBActive_oIBS_Status_02_oATOM_CANFD_Matrix_CH_V600_202502_47745887_Rx: ComBitPosition=36, ComBitSize=1, ComSignalType=BOOLEAN, ComSystemTemplateSystemSignalRef=IBS_AWBActive
            IBS_AWBAvailable_oIBS_Status_02_oATOM_CANFD_Matrix_CH_V600_202502_0d99f9f9_Rx: ComBitPosition=32, ComBitSize=1, ComSignalType=BOOLEAN, ComSystemTemplateSystemSignalRef=IBS_AWBAvailable
            IBS_BrakeLightRequest_oIBS_Status_02_oATOM_CANFD_Matrix_CH_V600_202502_a14297cf_Rx: ComBitPosition=21, ComBitSize=2, ComSignalType=UINT8, ComSystemTemplateSystemSignalRef=IBS_BrakeLightRequest
            IBS_EPBControllerSts_oIBS_Status_02_oATOM_CANFD_Matrix_CH_V600_202502_65ed44e8_Rx: ComBitPosition=47, ComBitSize=2, ComSignalType=UINT8, ComSystemTemplateSystemSignalRef=IBS_EPBControllerSts
            IBS_EPBFailureLamp_oIBS_Status_02_oATOM_CANFD_Matrix_CH_V600_202502_94ade1a4_Rx: ComBitPosition=23, ComBitSize=2, ComSignalType=UINT8, ComSystemTemplateSystemSignalRef=IBS_EPBFailureLamp
            IBS_EPBFunctionLamp_oIBS_Status_02_oATOM_CANFD_Matrix_CH_V600_202502_947116d4_Rx: ComBitPosition=35, ComBitSize=2, ComSignalType=UINT8, ComSystemTemplateSystemSignalRef=IBS_EPBFunctionLamp
            IBS_EPBworkingSts_oIBS_Status_02_oATOM_CANFD_Matrix_CH_V600_202502_fc06f35e_Rx: ComBitPosition=19, ComBitSize=3, ComSignalType=UINT8, ComSystemTemplateSystemSignalRef=IBS_EPBworkingSts
            IBS_HDCAvailable_oIBS_Status_02_oATOM_CANFD_Matrix_CH_V600_202502_deb691a6_Rx: ComBitPosition=27, ComBitSize=1, ComSignalType=BOOLEAN, ComSystemTemplateSystemSignalRef=IBS_HDCAvailable
            IBS_HHCActive_oIBS_Status_02_oATOM_CANFD_Matrix_CH_V600_202502_f453be85_Rx: ComBitPosition=25, ComBitSize=1, ComSignalType=BOOLEAN, ComSystemTemplateSystemSignalRef=IBS_HHCActive
            IBS_HHCAvailable_oIBS_Status_02_oATOM_CANFD_Matrix_CH_V600_202502_a333cc25_Rx: ComBitPosition=24, ComBitSize=1, ComSignalType=BOOLEAN, ComSystemTemplateSystemSignalRef=IBS_HHCAvailable
            IBS_HazWarnReq_oIBS_Status_02_oATOM_CANFD_Matrix_CH_V600_202502_b191eb63_Rx: ComBitPosition=38, ComBitSize=2, ComSignalType=UINT8, ComSystemTemplateSystemSignalRef=IBS_HazWarnReq
            IBS_TCSActive_oIBS_Status_02_oATOM_CANFD_Matrix_CH_V600_202502_a64ac2d8_Rx: ComBitPosition=31, ComBitSize=1, ComSignalType=BOOLEAN, ComSystemTemplateSystemSignalRef=IBS_TCSActive
            IBS_VDCActive_oIBS_Status_02_oATOM_CANFD_Matrix_CH_V600_202502_7ab0d9f3_Rx: ComBitPosition=30, ComBitSize=1, ComSignalType=BOOLEAN, ComSystemTemplateSystemSignalRef=IBS_VDCActive
            MessageCounter_0B3_oIBS_Status_02_oATOM_CANFD_Matrix_CH_V600_202502_742aa999_Rx: ComBitPosition=11, ComBitSize=4, ComSignalType=UINT8, ComSystemTemplateSystemSignalRef=MessageCounter_0B3
        SG_IBS_Status_03_SigGroup_oIBS_Status_03_oATOM_CANFD_Matrix_CH_V600_202502_2b221089_Rx: ComSystemTemplateSignalGroupRef=SG_IBS_Status_03_SigGroup
          16 x ComGroupSignal, all with ComSignalEndianness=BIG_ENDIAN, ComSignalInitValue=0:
            Checksum_0B4_oIBS_Status_03_oATOM_CANFD_Matrix_CH_V600_202502_47252d94_Rx: ComBitPosition=7, ComBitSize=8, ComSignalType=UINT8, ComSystemTemplateSystemSignalRef=Checksum_0B4
            IBS_ABPActive_oIBS_Status_03_oATOM_CANFD_Matrix_CH_V600_202502_9a3de825_Rx: ComBitPosition=32, ComBitSize=1, ComSignalType=BOOLEAN, ComSystemTemplateSystemSignalRef=IBS_ABPActive
            IBS_ABPAvailable_oIBS_Status_03_oATOM_CANFD_Matrix_CH_V600_202502_7eb6cd8c_Rx: ComBitPosition=47, ComBitSize=1, ComSignalType=BOOLEAN, ComSystemTemplateSystemSignalRef=IBS_ABPAvailable
            IBS_ABSActive_oIBS_Status_03_oATOM_CANFD_Matrix_CH_V600_202502_bc82dc5c_Rx: ComBitPosition=33, ComBitSize=1, ComSignalType=BOOLEAN, ComSystemTemplateSystemSignalRef=IBS_ABSActive
            IBS_ABSFault_oIBS_Status_03_oATOM_CANFD_Matrix_CH_V600_202502_1bd8c058_Rx: ComBitPosition=38, ComBitSize=1, ComSignalType=BOOLEAN, ComSystemTemplateSystemSignalRef=IBS_ABSFault
            IBS_DTCFault_oIBS_Status_03_oATOM_CANFD_Matrix_CH_V600_202502_632f33ac_Rx: ComBitPosition=46, ComBitSize=1, ComSignalType=BOOLEAN, ComSystemTemplateSystemSignalRef=IBS_DTCFault
            IBS_EBDActive_oIBS_Status_03_oATOM_CANFD_Matrix_CH_V600_202502_1e24a445_Rx: ComBitPosition=37, ComBitSize=1, ComSignalType=BOOLEAN, ComSystemTemplateSystemSignalRef=IBS_EBDActive
            IBS_EBDFault_oIBS_Status_03_oATOM_CANFD_Matrix_CH_V600_202502_dad1ab7b_Rx: ComBitPosition=36, ComBitSize=1, ComSignalType=BOOLEAN, ComSystemTemplateSystemSignalRef=IBS_EBDFault
            IBS_EPBTextdisplay_oIBS_Status_03_oATOM_CANFD_Matrix_CH_V600_202502_e8354645_Rx: ComBitPosition=15, ComBitSize=3, ComSignalType=UINT8, ComSystemTemplateSystemSignalRef=IBS_EPBTextdisplay
            IBS_SystemStatus_oIBS_Status_03_oATOM_CANFD_Matrix_CH_V600_202502_306130d0_Rx: ComBitPosition=26, ComBitSize=3, ComSignalType=UINT8, ComSystemTemplateSystemSignalRef=IBS_SystemStatus
            IBS_TCSFault_oIBS_Status_03_oATOM_CANFD_Matrix_CH_V600_202502_2d90687a_Rx: ComBitPosition=34, ComBitSize=1, ComSignalType=BOOLEAN, ComSystemTemplateSystemSignalRef=IBS_TCSFault
            IBS_VCU_DecelerationRequest_Available_oIBS_Status_03_oATOM_CANFD_Matrix_CH_V600_202502_227d55b1_Rx: ComBitPosition=45, ComBitSize=4, ComSignalType=UINT8, ComSystemTemplateSystemSignalRef=IBS_VCU_DecelerationRequest_Available
            IBS_VDCFault_oIBS_Status_03_oATOM_CANFD_Matrix_CH_V600_202502_01868c54_Rx: ComBitPosition=35, ComBitSize=1, ComSignalType=BOOLEAN, ComSystemTemplateSystemSignalRef=IBS_VDCFault
            IBS_VehicleSpeedValid_oIBS_Status_03_oATOM_CANFD_Matrix_CH_V600_202502_317a0a26_Rx: ComBitPosition=39, ComBitSize=1, ComSignalType=BOOLEAN, ComSystemTemplateSystemSignalRef=IBS_VehicleSpeedValid
            IBS_VehicleSpeed_oIBS_Status_03_oATOM_CANFD_Matrix_CH_V600_202502_5ce10c83_Rx: ComBitPosition=23, ComBitSize=13, ComSignalType=UINT16, ComSystemTemplateSystemSignalRef=IBS_VehicleSpeed
            MessageCounter_0B4_oIBS_Status_03_oATOM_CANFD_Matrix_CH_V600_202502_91c1ff04_Rx: ComBitPosition=11, ComBitSize=4, ComSignalType=UINT8, ComSystemTemplateSystemSignalRef=MessageCounter_0B4
        SG_IBS_Status_04_SigGroup_oIBS_Status_04_oATOM_CANFD_Matrix_CH_V600_202502_edfe62a4_Rx: ComSystemTemplateSignalGroupRef=SG_IBS_Status_04_SigGroup
          5 x ComGroupSignal, all with ComSignalEndianness=BIG_ENDIAN, ComSignalInitValue=0:
            Checksum_0BA_oIBS_Status_04_oATOM_CANFD_Matrix_CH_V600_202502_77cd2b4a_Rx: ComBitPosition=7, ComBitSize=8, ComSignalType=UINT8, ComSystemTemplateSystemSignalRef=Checksum_0BA
            IBS_CDPActive_oIBS_Status_04_oATOM_CANFD_Matrix_CH_V600_202502_5f0477e0_Rx: ComBitPosition=23, ComBitSize=1, ComSignalType=BOOLEAN, ComSystemTemplateSystemSignalRef=IBS_CDPActive
            IBS_CDPAvailable_oIBS_Status_04_oATOM_CANFD_Matrix_CH_V600_202502_551f17a8_Rx: ComBitPosition=22, ComBitSize=1, ComSignalType=BOOLEAN, ComSystemTemplateSystemSignalRef=IBS_CDPAvailable
            IBS_DTCActive_oIBS_Status_04_oATOM_CANFD_Matrix_CH_V600_202502_05637011_Rx: ComBitPosition=21, ComBitSize=1, ComSignalType=BOOLEAN, ComSystemTemplateSystemSignalRef=IBS_DTCActive
            MessageCounter_0BA_oIBS_Status_04_oATOM_CANFD_Matrix_CH_V600_202502_a129f9da_Rx: ComBitPosition=11, ComBitSize=4, ComSignalType=UINT8, ComSystemTemplateSystemSignalRef=MessageCounter_0BA
        SG_IBS_Status_06_SigGroup_oIBS_Status_06_oATOM_CANFD_Matrix_CH_V600_202502_7b2b4097_Rx: ComSystemTemplateSignalGroupRef=SG_IBS_Status_06_SigGroup
          20 x ComGroupSignal, all with ComSignalEndianness=BIG_ENDIAN:
            Checksum_0BC_oIBS_Status_06_oATOM_CANFD_Matrix_CH_V600_202502_e0933738_Rx: ComBitPosition=7, ComBitSize=8, ComSignalInitValue=0, ComSignalType=UINT8, ComSystemTemplateSystemSignalRef=Checksum_0BC
            IBS_AVHSts_oIBS_Status_06_oATOM_CANFD_Matrix_CH_V600_202502_e3018ac7_Rx: ComBitPosition=55, ComBitSize=2, ComSignalInitValue=0, ComSignalType=UINT8, ComSystemTemplateSystemSignalRef=IBS_AVHSts
            IBS_BrakeFluidWarning_oIBS_Status_06_oATOM_CANFD_Matrix_CH_V600_202502_cf3bf9da_Rx: ComBitPosition=49, ComBitSize=2, ComSignalInitValue=0, ComSignalType=UINT8, ComSystemTemplateSystemSignalRef=IBS_BrakeFluidWarning
            IBS_EPBFailureStatus_oIBS_Status_06_oATOM_CANFD_Matrix_CH_V600_202502_2591769d_Rx: ComBitPosition=63, ComBitSize=2, ComSignalInitValue=0, ComSignalType=UINT8, ComSystemTemplateSystemSignalRef=IBS_EPBFailureStatus
            IBS_ESCOffSts_oIBS_Status_06_oATOM_CANFD_Matrix_CH_V600_202502_a7e250e7_Rx: ComBitPosition=45, ComBitSize=1, ComSignalInitValue=1, ComSignalType=BOOLEAN, ComSystemTemplateSystemSignalRef=IBS_ESCOffSts
            IBS_ESClampdisplay_oIBS_Status_06_oATOM_CANFD_Matrix_CH_V600_202502_cffaf18c_Rx: ComBitPosition=53, ComBitSize=2, ComSignalInitValue=0, ComSignalType=UINT8, ComSystemTemplateSystemSignalRef=IBS_ESClampdisplay
            IBS_FactoryMode_oIBS_Status_06_oATOM_CANFD_Matrix_CH_V600_202502_1f4b8984_Rx: ComBitPosition=40, ComBitSize=1, ComSignalInitValue=0, ComSignalType=BOOLEAN, ComSystemTemplateSystemSignalRef=IBS_FactoryMode
            IBS_HBAActive_oIBS_Status_06_oATOM_CANFD_Matrix_CH_V600_202502_b3e0fd61_Rx: ComBitPosition=46, ComBitSize=1, ComSignalInitValue=0, ComSignalType=BOOLEAN, ComSystemTemplateSystemSignalRef=IBS_HBAActive
            IBS_HDCSts_oIBS_Status_06_oATOM_CANFD_Matrix_CH_V600_202502_d0313153_Rx: ComBitPosition=51, ComBitSize=2, ComSignalInitValue=0, ComSignalType=UINT8, ComSystemTemplateSystemSignalRef=IBS_HDCSts
            IBS_MaintenaceMode_oIBS_Status_06_oATOM_CANFD_Matrix_CH_V600_202502_e1932fbc_Rx: ComBitPosition=42, ComBitSize=1, ComSignalInitValue=0, ComSignalType=BOOLEAN, ComSystemTemplateSystemSignalRef=IBS_MaintenaceMode
            IBS_RWUActive_oIBS_Status_06_oATOM_CANFD_Matrix_CH_V600_202502_353ab732_Rx: ComBitPosition=44, ComBitSize=1, ComSignalInitValue=0, ComSignalType=BOOLEAN, ComSystemTemplateSystemSignalRef=IBS_RWUActive
            IBS_RWUAvailable_oIBS_Status_06_oATOM_CANFD_Matrix_CH_V600_202502_55a4e82d_Rx: ComBitPosition=43, ComBitSize=1, ComSignalInitValue=0, ComSignalType=BOOLEAN, ComSystemTemplateSystemSignalRef=IBS_RWUAvailable
            IBS_RollerbenchMode_oIBS_Status_06_oATOM_CANFD_Matrix_CH_V600_202502_7e2deccc_Rx: ComBitPosition=41, ComBitSize=1, ComSignalInitValue=0, ComSignalType=BOOLEAN, ComSystemTemplateSystemSignalRef=IBS_RollerbenchMode
            IBS_TPMS_ResetSts_oIBS_Status_06_oATOM_CANFD_Matrix_CH_V600_202502_ee7e0532_Rx: ComBitPosition=60, ComBitSize=1, ComSignalInitValue=0, ComSignalType=BOOLEAN, ComSystemTemplateSystemSignalRef=IBS_TPMS_ResetSts
            IBS_TireMonSysSts_oIBS_Status_06_oATOM_CANFD_Matrix_CH_V600_202502_91ee3722_Rx: ComBitPosition=61, ComBitSize=1, ComSignalInitValue=1, ComSignalType=BOOLEAN, ComSystemTemplateSystemSignalRef=IBS_TireMonSysSts
            IBS_TireWarnFrntLe_oIBS_Status_06_oATOM_CANFD_Matrix_CH_V600_202502_7fea0ce4_Rx: ComBitPosition=57, ComBitSize=1, ComSignalInitValue=0, ComSignalType=BOOLEAN, ComSystemTemplateSystemSignalRef=IBS_TireWarnFrntLe
            IBS_TireWarnFrntRi_oIBS_Status_06_oATOM_CANFD_Matrix_CH_V600_202502_dbb01a62_Rx: ComBitPosition=56, ComBitSize=1, ComSignalInitValue=0, ComSignalType=BOOLEAN, ComSystemTemplateSystemSignalRef=IBS_TireWarnFrntRi
            IBS_TireWarnReLe_oIBS_Status_06_oATOM_CANFD_Matrix_CH_V600_202502_6e5db930_Rx: ComBitPosition=59, ComBitSize=1, ComSignalInitValue=0, ComSignalType=BOOLEAN, ComSystemTemplateSystemSignalRef=IBS_TireWarnReLe
            IBS_TireWarnReRi_oIBS_Status_06_oATOM_CANFD_Matrix_CH_V600_202502_ca07afb6_Rx: ComBitPosition=58, ComBitSize=1, ComSignalInitValue=0, ComSignalType=BOOLEAN, ComSystemTemplateSystemSignalRef=IBS_TireWarnReRi
            MessageCounter_0BC_oIBS_Status_06_oATOM_CANFD_Matrix_CH_V600_202502_3677e5a8_Rx: ComBitPosition=11, ComBitSize=4, ComSignalInitValue=0, ComSignalType=UINT8, ComSystemTemplateSystemSignalRef=MessageCounter_0BC
        SG_IBS_Torque_SigGroup_oIBS_Torque_oATOM_CANFD_Matrix_CH_V600_202502_5a2dd5ad_Rx: ComSystemTemplateSignalGroupRef=SG_IBS_Torque_SigGroup
          9 x ComGroupSignal, all with ComSignalEndianness=BIG_ENDIAN, ComSignalInitValue=0:
            Checksum_0B9_oIBS_Torque_oATOM_CANFD_Matrix_CH_V600_202502_c0d26283_Rx: ComBitPosition=7, ComBitSize=8, ComSignalType=UINT8, ComSystemTemplateSystemSignalRef=Checksum_0B9
            IBS_RBSStatus_oIBS_Torque_oATOM_CANFD_Matrix_CH_V600_202502_dc8e16c0_Rx: ComBitPosition=13, ComBitSize=1, ComSignalType=BOOLEAN, ComSystemTemplateSystemSignalRef=IBS_RBSStatus
            IBS_TargetGearReq_oIBS_Torque_oATOM_CANFD_Matrix_CH_V600_202502_35085f4b_Rx: ComBitPosition=23, ComBitSize=3, ComSignalType=UINT8, ComSystemTemplateSystemSignalRef=IBS_TargetGearReq
            IBS_VCU_DecelerationReqActive_oIBS_Torque_oATOM_CANFD_Matrix_CH_V600_202502_5138c66a_Rx: ComBitPosition=12, ComBitSize=1, ComSignalType=BOOLEAN, ComSystemTemplateSystemSignalRef=IBS_VCU_DecelerationReqActive
            IBS_WLTorqueAPSReqValid_oIBS_Torque_oATOM_CANFD_Matrix_CH_V600_202502_406d9ee6_Rx: ComBitPosition=45, ComBitSize=2, ComSignalType=UINT8, ComSystemTemplateSystemSignalRef=IBS_WLTorqueAPSReqValid
            IBS_WLTorqueAPSReq_oIBS_Torque_oATOM_CANFD_Matrix_CH_V600_202502_1036d2a9_Rx: ComBitPosition=55, ComBitSize=16, ComSignalType=UINT16, ComSystemTemplateSystemSignalRef=IBS_WLTorqueAPSReq
            IBS_WLTorqueRBSReqValid_oIBS_Torque_oATOM_CANFD_Matrix_CH_V600_202502_0144d4d4_Rx: ComBitPosition=15, ComBitSize=2, ComSignalType=UINT8, ComSystemTemplateSystemSignalRef=IBS_WLTorqueRBSReqValid
            IBS_WLTorqueRBSReq_oIBS_Torque_oATOM_CANFD_Matrix_CH_V600_202502_dae1e9b7_Rx: ComBitPosition=31, ComBitSize=16, ComSignalType=UINT16, ComSystemTemplateSystemSignalRef=IBS_WLTorqueRBSReq
            MessageCounter_0B9_oIBS_Torque_oATOM_CANFD_Matrix_CH_V600_202502_683f1d6f_Rx: ComBitPosition=11, ComBitSize=4, ComSignalType=UINT8, ComSystemTemplateSystemSignalRef=MessageCounter_0B9
        SG_IBS_VCU_MotorControl_SigGroup_oIBS_VCU_MotorControl_oATOM_CANFD_Matrix_CH_V600_202502_9a811a5b_Rx: ComSystemTemplateSignalGroupRef=SG_IBS_VCU_MotorControl_SigGroup
          6 x ComGroupSignal, all with ComSignalEndianness=BIG_ENDIAN, ComSignalInitValue=0:
            Checksum_090_oIBS_VCU_MotorControl_oATOM_CANFD_Matrix_CH_V600_202502_b5095e35_Rx: ComBitPosition=7, ComBitSize=8, ComSignalType=UINT8, ComSystemTemplateSystemSignalRef=Checksum_090
            IBS_WLTorqueIncrReqSts_oIBS_VCU_MotorControl_oATOM_CANFD_Matrix_CH_V600_202502_f80f3ab5_Rx: ComBitPosition=14, ComBitSize=1, ComSignalType=BOOLEAN, ComSystemTemplateSystemSignalRef=IBS_WLTorqueIncrReqSts
            IBS_WLTorqueIncrReq_oIBS_VCU_MotorControl_oATOM_CANFD_Matrix_CH_V600_202502_6e9d7a41_Rx: ComBitPosition=55, ComBitSize=16, ComSignalType=UINT16, ComSystemTemplateSystemSignalRef=IBS_WLTorqueIncrReq
            IBS_WLTorqueRedReqSts_oIBS_VCU_MotorControl_oATOM_CANFD_Matrix_CH_V600_202502_2655e1fb_Rx: ComBitPosition=12, ComBitSize=1, ComSignalType=BOOLEAN, ComSystemTemplateSystemSignalRef=IBS_WLTorqueRedReqSts
            IBS_WLTorqueRedReq_oIBS_VCU_MotorControl_oATOM_CANFD_Matrix_CH_V600_202502_79bc7664_Rx: ComBitPosition=39, ComBitSize=16, ComSignalType=UINT16, ComSystemTemplateSystemSignalRef=IBS_WLTorqueRedReq
            MessageCounter_090_oIBS_VCU_MotorControl_oATOM_CANFD_Matrix_CH_V600_202502_db5c1277_Rx: ComBitPosition=11, ComBitSize=4, ComSignalType=UINT8, ComSystemTemplateSystemSignalRef=MessageCounter_090
        SG_IBS_WheelSpeed_01_SigGroup_oIBS_WheelSpeed_01_oATOM_CANFD_Matrix_CH_V600_202502_5773aa13_Rx: ComSystemTemplateSignalGroupRef=SG_IBS_WheelSpeed_01_SigGroup
          10 x ComGroupSignal, all with ComSignalEndianness=BIG_ENDIAN, ComSignalInitValue=0:
            Checksum_0B0_oIBS_WheelSpeed_01_oATOM_CANFD_Matrix_CH_V600_202502_efb220b2_Rx: ComBitPosition=7, ComBitSize=8, ComSignalType=UINT8, ComSystemTemplateSystemSignalRef=Checksum_0B0
            IBS_FLMovingDirection_oIBS_WheelSpeed_01_oATOM_CANFD_Matrix_CH_V600_202502_0e538d73_Rx: ComBitPosition=46, ComBitSize=2, ComSignalType=UINT8, ComSystemTemplateSystemSignalRef=IBS_FLMovingDirection
            IBS_FLWheelPulseCounter_oIBS_WheelSpeed_01_oATOM_CANFD_Matrix_CH_V600_202502_9718fa24_Rx: ComBitPosition=63, ComBitSize=8, ComSignalType=UINT8, ComSystemTemplateSystemSignalRef=IBS_FLWheelPulseCounter
            IBS_FLWheelSpeed_Fault_oIBS_WheelSpeed_01_oATOM_CANFD_Matrix_CH_V600_202502_19d76bef_Rx: ComBitPosition=47, ComBitSize=1, ComSignalType=BOOLEAN, ComSystemTemplateSystemSignalRef=IBS_FLWheelSpeed_Fault
            IBS_FLWheelSpeed_oIBS_WheelSpeed_01_oATOM_CANFD_Matrix_CH_V600_202502_d228a055_Rx: ComBitPosition=44, ComBitSize=13, ComSignalType=UINT16, ComSystemTemplateSystemSignalRef=IBS_FLWheelSpeed
            IBS_FRMovingDirection_oIBS_WheelSpeed_01_oATOM_CANFD_Matrix_CH_V600_202502_be7c8b57_Rx: ComBitPosition=22, ComBitSize=2, ComSignalType=UINT8, ComSystemTemplateSystemSignalRef=IBS_FRMovingDirection
            IBS_FRWheelPulseCounter_oIBS_WheelSpeed_01_oATOM_CANFD_Matrix_CH_V600_202502_8f930e98_Rx: ComBitPosition=39, ComBitSize=8, ComSignalType=UINT8, ComSystemTemplateSystemSignalRef=IBS_FRWheelPulseCounter
            IBS_FRWheelSpeed_Fault_oIBS_WheelSpeed_01_oATOM_CANFD_Matrix_CH_V600_202502_2564a038_Rx: ComBitPosition=15, ComBitSize=1, ComSignalType=BOOLEAN, ComSystemTemplateSystemSignalRef=IBS_FRWheelSpeed_Fault
            IBS_FRWheelSpeed_oIBS_WheelSpeed_01_oATOM_CANFD_Matrix_CH_V600_202502_7a94cc9a_Rx: ComBitPosition=20, ComBitSize=13, ComSignalType=UINT16, ComSystemTemplateSystemSignalRef=IBS_FRWheelSpeed
            MessageCounter_0B0_oIBS_WheelSpeed_01_oATOM_CANFD_Matrix_CH_V600_202502_895d6141_Rx: ComBitPosition=11, ComBitSize=4, ComSignalType=UINT8, ComSystemTemplateSystemSignalRef=MessageCounter_0B0
        SG_IBS_WheelSpeed_02_SigGroup_oIBS_WheelSpeed_02_oATOM_CANFD_Matrix_CH_V600_202502_2d752b6e_Rx: ComSystemTemplateSignalGroupRef=SG_IBS_WheelSpeed_02_SigGroup
          10 x ComGroupSignal, all with ComSignalEndianness=BIG_ENDIAN, ComSignalInitValue=0:
            Checksum_0B1_oIBS_WheelSpeed_02_oATOM_CANFD_Matrix_CH_V600_202502_65c4b71d_Rx: ComBitPosition=7, ComBitSize=8, ComSignalType=UINT8, ComSystemTemplateSystemSignalRef=Checksum_0B1
            IBS_RLMovingDirection_oIBS_WheelSpeed_02_oATOM_CANFD_Matrix_CH_V600_202502_ad5dc1f0_Rx: ComBitPosition=46, ComBitSize=2, ComSignalType=UINT8, ComSystemTemplateSystemSignalRef=IBS_RLMovingDirection
            IBS_RLWheelPulseCounter_oIBS_WheelSpeed_02_oATOM_CANFD_Matrix_CH_V600_202502_296e9e60_Rx: ComBitPosition=63, ComBitSize=8, ComSignalType=UINT8, ComSystemTemplateSystemSignalRef=IBS_RLWheelPulseCounter
            IBS_RLWheelSpeed_Fault_oIBS_WheelSpeed_02_oATOM_CANFD_Matrix_CH_V600_202502_82f6f2de_Rx: ComBitPosition=47, ComBitSize=1, ComSignalType=BOOLEAN, ComSystemTemplateSystemSignalRef=IBS_RLWheelSpeed_Fault
            IBS_RLWheelSpeed_oIBS_WheelSpeed_02_oATOM_CANFD_Matrix_CH_V600_202502_5459dc3a_Rx: ComBitPosition=44, ComBitSize=13, ComSignalType=UINT16, ComSystemTemplateSystemSignalRef=IBS_RLWheelSpeed
            IBS_RRMovingDirection_oIBS_WheelSpeed_02_oATOM_CANFD_Matrix_CH_V600_202502_1d72c7d4_Rx: ComBitPosition=22, ComBitSize=2, ComSignalType=UINT8, ComSystemTemplateSystemSignalRef=IBS_RRMovingDirection
            IBS_RRWheelPulseCounter_oIBS_WheelSpeed_02_oATOM_CANFD_Matrix_CH_V600_202502_31e56adc_Rx: ComBitPosition=39, ComBitSize=8, ComSignalType=UINT8, ComSystemTemplateSystemSignalRef=IBS_RRWheelPulseCounter
            IBS_RRWheelSpeed_Fault_oIBS_WheelSpeed_02_oATOM_CANFD_Matrix_CH_V600_202502_be453909_Rx: ComBitPosition=23, ComBitSize=1, ComSignalType=BOOLEAN, ComSystemTemplateSystemSignalRef=IBS_RRWheelSpeed_Fault
            IBS_RRWheelSpeed_oIBS_WheelSpeed_02_oATOM_CANFD_Matrix_CH_V600_202502_fce5b0f5_Rx: ComBitPosition=20, ComBitSize=13, ComSignalType=UINT16, ComSystemTemplateSystemSignalRef=IBS_RRWheelSpeed
            MessageCounter_0B1_oIBS_WheelSpeed_02_oATOM_CANFD_Matrix_CH_V600_202502_032bf6ee_Rx: ComBitPosition=11, ComBitSize=4, ComSignalType=UINT8, ComSystemTemplateSystemSignalRef=MessageCounter_0B1
        SG_SGW_17_SigGroup_oSGW_17_oATOM_CANFD_Matrix_CH_V600_202502_804294b2_Rx: ComSystemTemplateSignalGroupRef=SG_SGW_17_SigGroup
          SGW_BLESystemReadyReq_oSGW_17_oATOM_CANFD_Matrix_CH_V600_202502_359ce2fd_Rx (ComGroupSignal):
            ComBitPosition = 3
            ComBitSize = 2
            ComSignalEndianness = BIG_ENDIAN
            ComSignalInitValue = 0
            ComSignalType = UINT8
            ComSystemTemplateSystemSignalRef = SGW_BLESystemReadyReq
        SG_VCU_02_SigGroup_oVCU_02_oATOM_CANFD_Matrix_CH_V600_202502_2fc20804_Tx: ComSystemTemplateSignalGroupRef=SG_VCU_02_SigGroup
          5 x ComGroupSignal, all with ComSignalEndianness=BIG_ENDIAN, ComTransferProperty=PENDING:
            VCU_BS_Current_oVCU_02_oATOM_CANFD_Matrix_CH_V600_202502_55d19f8e_Tx: ComBitPosition=15, ComBitSize=14, ComSignalInitValue=0, ComSignalType=UINT16, ComSystemTemplateSystemSignalRef=VCU_BS_Current
            VCU_BS_IBSBatSOC_oVCU_02_oATOM_CANFD_Matrix_CH_V600_202502_34765b89_Tx: ComBitPosition=7, ComBitSize=8, ComSignalInitValue=80, ComSignalType=UINT8, ComSystemTemplateSystemSignalRef=VCU_BS_IBSBatSOC
            VCU_BS_IndicatorSts_oVCU_02_oATOM_CANFD_Matrix_CH_V600_202502_0d3265cb_Tx: ComBitPosition=31, ComBitSize=1, ComSignalInitValue=0, ComSignalType=BOOLEAN, ComSystemTemplateSystemSignalRef=VCU_BS_IndicatorSts
            VCU_BS_LV_Batt_oVCU_02_oATOM_CANFD_Matrix_CH_V600_202502_41d6d523_Tx: ComBitPosition=47, ComBitSize=15, ComSignalInitValue=0, ComSignalType=UINT16, ComSystemTemplateSystemSignalRef=VCU_BS_LV_Batt
            VCU_WakeUpStatus_oVCU_02_oATOM_CANFD_Matrix_CH_V600_202502_091aaa11_Tx: ComBitPosition=63, ComBitSize=8, ComSignalInitValue=0, ComSignalType=UINT8, ComSystemTemplateSystemSignalRef=VCU_WakeUpStatus
        SG_VCU_03_SigGroup_oVCU_03_oATOM_CANFD_Matrix_CH_V600_202502_8990e3c1_Tx: ComSystemTemplateSignalGroupRef=SG_VCU_03_SigGroup
          5 x ComGroupSignal, all with ComSignalEndianness=BIG_ENDIAN, ComSignalInitValue=0, ComTransferProperty=PENDING:
            VCU_BrakeCompensateStatus_oVCU_03_oATOM_CANFD_Matrix_CH_V600_202502_aada4313_Tx: ComBitPosition=27, ComBitSize=2, ComSignalType=UINT8, ComSystemTemplateSystemSignalRef=VCU_BrakeCompensateStatus
            VCU_ChargeProcessComment_oVCU_03_oATOM_CANFD_Matrix_CH_V600_202502_b076f405_Tx: ComBitPosition=25, ComBitSize=2, ComSignalType=UINT8, ComSystemTemplateSystemSignalRef=VCU_ChargeProcessComment
            VCU_DCFCCurrent_oVCU_03_oATOM_CANFD_Matrix_CH_V600_202502_54508868_Tx: ComBitPosition=23, ComBitSize=10, ComSignalType=UINT16, ComSystemTemplateSystemSignalRef=VCU_DCFCCurrent
            VCU_EnergyV2L_oVCU_03_oATOM_CANFD_Matrix_CH_V600_202502_5ef6f2f0_Tx: ComBitPosition=55, ComBitSize=12, ComSignalType=UINT16, ComSystemTemplateSystemSignalRef=VCU_EnergyV2L
            VCU_MemoryChargeFault_oVCU_03_oATOM_CANFD_Matrix_CH_V600_202502_cb765ea4_Tx: ComBitPosition=59, ComBitSize=1, ComSignalType=BOOLEAN, ComSystemTemplateSystemSignalRef=VCU_MemoryChargeFault
        SG_VCU_04_SigGroup_oVCU_04_oATOM_CANFD_Matrix_CH_V600_202502_4cce7c18_Tx: ComSystemTemplateSignalGroupRef=SG_VCU_04_SigGroup
          VCU_ForwardVmaxlimitStatus_oVCU_04_oATOM_CANFD_Matrix_CH_V600_202502_beba9b73_Tx (ComGroupSignal):
            ComBitPosition = 15
            ComBitSize = 1
            ComSignalEndianness = BIG_ENDIAN
            ComSignalInitValue = 0
            ComSignalType = BOOLEAN
            ComTransferProperty = PENDING
            ComSystemTemplateSystemSignalRef = VCU_ForwardVmaxlimitStatus
          VCU_ManuallyUnlockComment_oVCU_04_oATOM_CANFD_Matrix_CH_V600_202502_3223f100_Tx (ComGroupSignal):
            ComBitPosition = 14
            ComBitSize = 1
            ComSignalEndianness = BIG_ENDIAN
            ComSignalInitValue = 0
            ComSignalType = BOOLEAN
            ComTransferProperty = PENDING
            ComSystemTemplateSystemSignalRef = VCU_ManuallyUnlockComment
        SG_VCU_AccPedal_SigGroup_oVCU_AccPedal_oATOM_CANFD_Matrix_CH_V600_202502_aa50ac8d_Tx: ComSystemTemplateSignalGroupRef=SG_VCU_AccPedal_SigGroup
          13 x ComGroupSignal, all with ComSignalEndianness=BIG_ENDIAN, ComSignalInitValue=0, ComTransferProperty=PENDING:
            Checksum_0D2_oVCU_AccPedal_oATOM_CANFD_Matrix_CH_V600_202502_51727e14_Tx: ComBitPosition=7, ComBitSize=8, ComSignalType=UINT8, ComSystemTemplateSystemSignalRef=Checksum_0D2
            MessageCounter_0D2_oVCU_AccPedal_oATOM_CANFD_Matrix_CH_V600_202502_630306b4_Tx: ComBitPosition=11, ComBitSize=4, ComSignalType=UINT8, ComSystemTemplateSystemSignalRef=MessageCounter_0D2
            VCU_AccelerationPedalValid_oVCU_AccPedal_oATOM_CANFD_Matrix_CH_V600_202502_365d9f08_Tx: ComBitPosition=29, ComBitSize=1, ComSignalType=BOOLEAN, ComSystemTemplateSystemSignalRef=VCU_AccelerationPedalValid
            VCU_AccelerationPedal_oVCU_AccPedal_oATOM_CANFD_Matrix_CH_V600_202502_f84e7cef_Tx: ComBitPosition=23, ComBitSize=10, ComSignalType=UINT16, ComSystemTemplateSystemSignalRef=VCU_AccelerationPedal
            VCU_EPBReq_oVCU_AccPedal_oATOM_CANFD_Matrix_CH_V600_202502_4a2bfea4_Tx: ComBitPosition=14, ComBitSize=2, ComSignalType=UINT8, ComSystemTemplateSystemSignalRef=VCU_EPBReq
            VCU_Kickdown_oVCU_AccPedal_oATOM_CANFD_Matrix_CH_V600_202502_17d4134b_Tx: ComBitPosition=56, ComBitSize=1, ComSignalType=BOOLEAN, ComSystemTemplateSystemSignalRef=VCU_Kickdown
            VCU_TargetGear_oVCU_AccPedal_oATOM_CANFD_Matrix_CH_V600_202502_d928d8b4_Tx: ComBitPosition=43, ComBitSize=3, ComSignalType=UINT8, ComSystemTemplateSystemSignalRef=VCU_TargetGear
            VCU_VLCTorqueRequestActive_oVCU_AccPedal_oATOM_CANFD_Matrix_CH_V600_202502_a1329f5d_Tx: ComBitPosition=57, ComBitSize=1, ComSignalType=BOOLEAN, ComSystemTemplateSystemSignalRef=VCU_VLCTorqueRequestActive
            VCU_VLCTorqueRequestAvailable_oVCU_AccPedal_oATOM_CANFD_Matrix_CH_V600_202502_d00cfa4f_Tx: ComBitPosition=58, ComBitSize=1, ComSignalType=BOOLEAN, ComSystemTemplateSystemSignalRef=VCU_VLCTorqueRequestAvailable
            VCU_VehicleSpeedValid_oVCU_AccPedal_oATOM_CANFD_Matrix_CH_V600_202502_70135d30_Tx: ComBitPosition=15, ComBitSize=1, ComSignalType=BOOLEAN, ComSystemTemplateSystemSignalRef=VCU_VehicleSpeedValid
            VCU_VehicleSpeed_oVCU_AccPedal_oATOM_CANFD_Matrix_CH_V600_202502_da00c229_Tx: ComBitPosition=55, ComBitSize=13, ComSignalType=UINT16, ComSystemTemplateSystemSignalRef=VCU_VehicleSpeed
            VCU_VirtualACPedalValid_oVCU_AccPedal_oATOM_CANFD_Matrix_CH_V600_202502_4b161096_Tx: ComBitPosition=26, ComBitSize=1, ComSignalType=BOOLEAN, ComSystemTemplateSystemSignalRef=VCU_VirtualACPedalValid
            VCU_VirtualACPedal_oVCU_AccPedal_oATOM_CANFD_Matrix_CH_V600_202502_03ae7390_Tx: ComBitPosition=25, ComBitSize=10, ComSignalType=UINT16, ComSystemTemplateSystemSignalRef=VCU_VirtualACPedal
        SG_VCU_BMS_SigGroup_oVCU_BMS_oATOM_CANFD_Matrix_CH_V600_202502_d27feb30_Tx: ComSystemTemplateSignalGroupRef=SG_VCU_BMS_SigGroup
          13 x ComGroupSignal, all with ComSignalEndianness=BIG_ENDIAN, ComTransferProperty=PENDING:
            Checksum_0D1_oVCU_BMS_oATOM_CANFD_Matrix_CH_V600_202502_c848143c_Tx: ComBitPosition=7, ComBitSize=8, ComSignalInitValue=0, ComSignalType=UINT8, ComSystemTemplateSystemSignalRef=Checksum_0D1
            MessageCounter_0D1_oVCU_BMS_oATOM_CANFD_Matrix_CH_V600_202502_0232b184_Tx: ComBitPosition=11, ComBitSize=4, ComSignalInitValue=0, ComSignalType=UINT8, ComSystemTemplateSystemSignalRef=MessageCounter_0D1
            VCU_ActDriveMode_oVCU_BMS_oATOM_CANFD_Matrix_CH_V600_202502_c1c6ace2_Tx: ComBitPosition=37, ComBitSize=3, ComSignalInitValue=0, ComSignalType=UINT8, ComSystemTemplateSystemSignalRef=VCU_ActDriveMode
            VCU_BMSTargetThermLevel_oVCU_BMS_oATOM_CANFD_Matrix_CH_V600_202502_9ec34af1_Tx: ComBitPosition=55, ComBitSize=2, ComSignalInitValue=0, ComSignalType=UINT8, ComSystemTemplateSystemSignalRef=VCU_BMSTargetThermLevel
            VCU_BMS_Control_of_PosRelay_oVCU_BMS_oATOM_CANFD_Matrix_CH_V600_202502_cab9d256_Tx: ComBitPosition=53, ComBitSize=2, ComSignalInitValue=0, ComSignalType=UINT8, ComSystemTemplateSystemSignalRef=VCU_BMS_Control_of_PosRelay
            VCU_ChargeStatus_oVCU_BMS_oATOM_CANFD_Matrix_CH_V600_202502_17f7901d_Tx: ComBitPosition=27, ComBitSize=4, ComSignalInitValue=0, ComSignalType=UINT8, ComSystemTemplateSystemSignalRef=VCU_ChargeStatus
            VCU_DrvModSwitchWarn_oVCU_BMS_oATOM_CANFD_Matrix_CH_V600_202502_8a817be7_Tx: ComBitPosition=34, ComBitSize=3, ComSignalInitValue=0, ComSignalType=UINT8, ComSystemTemplateSystemSignalRef=VCU_DrvModSwitchWarn
            VCU_HVStatus_oVCU_BMS_oATOM_CANFD_Matrix_CH_V600_202502_aebb67ba_Tx: ComBitPosition=31, ComBitSize=4, ComSignalInitValue=0, ComSignalType=UINT8, ComSystemTemplateSystemSignalRef=VCU_HVStatus
            VCU_IsoMeasurementSwitch_oVCU_BMS_oATOM_CANFD_Matrix_CH_V600_202502_d7a76412_Tx: ComBitPosition=14, ComBitSize=1, ComSignalInitValue=1, ComSignalType=BOOLEAN, ComSystemTemplateSystemSignalRef=VCU_IsoMeasurementSwitch
            VCU_LimitLevel_oVCU_BMS_oATOM_CANFD_Matrix_CH_V600_202502_944086eb_Tx: ComBitPosition=39, ComBitSize=2, ComSignalInitValue=0, ComSignalType=UINT8, ComSystemTemplateSystemSignalRef=VCU_LimitLevel
            VCU_RegenBrakeLightReqVld_oVCU_BMS_oATOM_CANFD_Matrix_CH_V600_202502_b28083e9_Tx: ComBitPosition=41, ComBitSize=1, ComSignalInitValue=0, ComSignalType=BOOLEAN, ComSystemTemplateSystemSignalRef=VCU_RegenBrakeLightReqVld
            VCU_RegenBrakeLightRequest_oVCU_BMS_oATOM_CANFD_Matrix_CH_V600_202502_9537c5ed_Tx: ComBitPosition=40, ComBitSize=1, ComSignalInitValue=0, ComSignalType=BOOLEAN, ComSystemTemplateSystemSignalRef=VCU_RegenBrakeLightRequest
            VCU_RequestedModeBMS_oVCU_BMS_oATOM_CANFD_Matrix_CH_V600_202502_a3197c92_Tx: ComBitPosition=23, ComBitSize=3, ComSignalInitValue=0, ComSignalType=UINT8, ComSystemTemplateSystemSignalRef=VCU_RequestedModeBMS
        SG_VCU_Chassis_01_SigGroup_oVCU_Chassis_01_oATOM_CANFD_Matrix_CH_V600_202502_52963860_Tx: ComSystemTemplateSignalGroupRef=SG_VCU_Chassis_01_SigGroup
          15 x ComGroupSignal, all with ComSignalEndianness=BIG_ENDIAN, ComSignalInitValue=0, ComTransferProperty=PENDING:
            Checksum_0D3_oVCU_Chassis_01_oATOM_CANFD_Matrix_CH_V600_202502_090e4c9b_Tx: ComBitPosition=7, ComBitSize=8, ComSignalType=UINT8, ComSystemTemplateSystemSignalRef=Checksum_0D3
            MessageCounter_0D3_oVCU_Chassis_01_oATOM_CANFD_Matrix_CH_V600_202502_f9d73b0d_Tx: ComBitPosition=11, ComBitSize=4, ComSignalType=UINT8, ComSystemTemplateSystemSignalRef=MessageCounter_0D3
            VCU_ADASOverride_oVCU_Chassis_01_oATOM_CANFD_Matrix_CH_V600_202502_0c002a43_Tx: ComBitPosition=44, ComBitSize=1, ComSignalType=BOOLEAN, ComSystemTemplateSystemSignalRef=VCU_ADASOverride
            VCU_APSTorqueRequestActive_oVCU_Chassis_01_oATOM_CANFD_Matrix_CH_V600_202502_c8f21b10_Tx: ComBitPosition=43, ComBitSize=1, ComSignalType=BOOLEAN, ComSystemTemplateSystemSignalRef=VCU_APSTorqueRequestActive
            VCU_APSTorqueRequestAvailable_oVCU_Chassis_01_oATOM_CANFD_Matrix_CH_V600_202502_8298a57a_Tx: ComBitPosition=42, ComBitSize=1, ComSignalType=BOOLEAN, ComSystemTemplateSystemSignalRef=VCU_APSTorqueRequestAvailable
            VCU_BrakeCompensateWarn_oVCU_Chassis_01_oATOM_CANFD_Matrix_CH_V600_202502_8427f667_Tx: ComBitPosition=60, ComBitSize=2, ComSignalType=UINT8, ComSystemTemplateSystemSignalRef=VCU_BrakeCompensateWarn
            VCU_DecelerationReq_oVCU_Chassis_01_oATOM_CANFD_Matrix_CH_V600_202502_22f1bc0a_Tx: ComBitPosition=55, ComBitSize=8, ComSignalType=UINT8, ComSystemTemplateSystemSignalRef=VCU_DecelerationReq
            VCU_DecelerationReqactive_oVCU_Chassis_01_oATOM_CANFD_Matrix_CH_V600_202502_29147867_Tx: ComBitPosition=40, ComBitSize=1, ComSignalType=BOOLEAN, ComSystemTemplateSystemSignalRef=VCU_DecelerationReqactive
            VCU_DriverTorqueRequest_oVCU_Chassis_01_oATOM_CANFD_Matrix_CH_V600_202502_f98385dc_Tx: ComBitPosition=39, ComBitSize=11, ComSignalType=UINT16, ComSystemTemplateSystemSignalRef=VCU_DriverTorqueRequest
            VCU_EnergyManagementWarn_oVCU_Chassis_01_oATOM_CANFD_Matrix_CH_V600_202502_4b7de956_Tx: ComBitPosition=58, ComBitSize=2, ComSignalType=UINT8, ComSystemTemplateSystemSignalRef=VCU_EnergyManagementWarn
            VCU_RegStatus_oVCU_Chassis_01_oATOM_CANFD_Matrix_CH_V600_202502_6d4e3983_Tx: ComBitPosition=63, ComBitSize=3, ComSignalType=UINT8, ComSystemTemplateSystemSignalRef=VCU_RegStatus
            VCU_RegenTorqueCapValid_oVCU_Chassis_01_oATOM_CANFD_Matrix_CH_V600_202502_5eaff4d8_Tx: ComBitPosition=15, ComBitSize=1, ComSignalType=BOOLEAN, ComSystemTemplateSystemSignalRef=VCU_RegenTorqueCapValid
            VCU_RegenTorqueCap_oVCU_Chassis_01_oATOM_CANFD_Matrix_CH_V600_202502_a5a4bebf_Tx: ComBitPosition=23, ComBitSize=16, ComSignalType=UINT16, ComSystemTemplateSystemSignalRef=VCU_RegenTorqueCap
            VCU_TorqueRequestActive_oVCU_Chassis_01_oATOM_CANFD_Matrix_CH_V600_202502_24abcc5b_Tx: ComBitPosition=12, ComBitSize=1, ComSignalType=BOOLEAN, ComSystemTemplateSystemSignalRef=VCU_TorqueRequestActive
            VCU_TorqueRequestAvailable_oVCU_Chassis_01_oATOM_CANFD_Matrix_CH_V600_202502_22997d3f_Tx: ComBitPosition=13, ComBitSize=1, ComSignalType=BOOLEAN, ComSystemTemplateSystemSignalRef=VCU_TorqueRequestAvailable
        SG_VCU_HMIsignals_01_SigGroup_oVCU_HMIsignals_01_oATOM_CANFD_Matrix_CH_V600_202502_c30c8d8f_Tx: ComSystemTemplateSignalGroupRef=SG_VCU_HMIsignals_01_SigGroup
          14 x ComGroupSignal, all with ComSignalEndianness=BIG_ENDIAN, ComSignalInitValue=0, ComTransferProperty=PENDING:
            Checksum_317_oVCU_HMIsignals_01_oATOM_CANFD_Matrix_CH_V600_202502_7e8714d3_Tx: ComBitPosition=7, ComBitSize=8, ComSignalType=UINT8, ComSystemTemplateSystemSignalRef=Checksum_317
            MessageCounter_317_oVCU_HMIsignals_01_oATOM_CANFD_Matrix_CH_V600_202502_18685520_Tx: ComBitPosition=11, ComBitSize=4, ComSignalType=UINT8, ComSystemTemplateSystemSignalRef=MessageCounter_317
            VCU_CriSysFailure_oVCU_HMIsignals_01_oATOM_CANFD_Matrix_CH_V600_202502_13fa69e3_Tx: ComBitPosition=25, ComBitSize=2, ComSignalType=UINT8, ComSystemTemplateSystemSignalRef=VCU_CriSysFailure
            VCU_DCDCFail_oVCU_HMIsignals_01_oATOM_CANFD_Matrix_CH_V600_202502_8211651e_Tx: ComBitPosition=21, ComBitSize=1, ComSignalType=BOOLEAN, ComSystemTemplateSystemSignalRef=VCU_DCDCFail
            VCU_DriveMotOvrTemp_oVCU_HMIsignals_01_oATOM_CANFD_Matrix_CH_V600_202502_2b850699_Tx: ComBitPosition=22, ComBitSize=1, ComSignalType=BOOLEAN, ComSystemTemplateSystemSignalRef=VCU_DriveMotOvrTemp
            VCU_HVBatCriFail_oVCU_HMIsignals_01_oATOM_CANFD_Matrix_CH_V600_202502_05faf04f_Tx: ComBitPosition=29, ComBitSize=2, ComSignalType=UINT8, ComSystemTemplateSystemSignalRef=VCU_HVBatCriFail
            VCU_HVBatOvrTemp_oVCU_HMIsignals_01_oATOM_CANFD_Matrix_CH_V600_202502_1ab841cc_Tx: ComBitPosition=19, ComBitSize=1, ComSignalType=BOOLEAN, ComSystemTemplateSystemSignalRef=VCU_HVBatOvrTemp
            VCU_HVILError_oVCU_HMIsignals_01_oATOM_CANFD_Matrix_CH_V600_202502_f1e2e871_Tx: ComBitPosition=18, ComBitSize=1, ComSignalType=BOOLEAN, ComSystemTemplateSystemSignalRef=VCU_HVILError
            VCU_HVInsulResFault_oVCU_HMIsignals_01_oATOM_CANFD_Matrix_CH_V600_202502_e6836204_Tx: ComBitPosition=17, ComBitSize=1, ComSignalType=BOOLEAN, ComSystemTemplateSystemSignalRef=VCU_HVInsulResFault
            VCU_InvldGearSel_oVCU_HMIsignals_01_oATOM_CANFD_Matrix_CH_V600_202502_773f11d0_Tx: ComBitPosition=51, ComBitSize=4, ComSignalType=UINT8, ComSystemTemplateSystemSignalRef=VCU_InvldGearSel
            VCU_LimpHome_oVCU_HMIsignals_01_oATOM_CANFD_Matrix_CH_V600_202502_664ff33a_Tx: ComBitPosition=16, ComBitSize=1, ComSignalType=BOOLEAN, ComSystemTemplateSystemSignalRef=VCU_LimpHome
            VCU_MileagelowRemind_oVCU_HMIsignals_01_oATOM_CANFD_Matrix_CH_V600_202502_1b14b376_Tx: ComBitPosition=61, ComBitSize=1, ComSignalType=BOOLEAN, ComSystemTemplateSystemSignalRef=VCU_MileagelowRemind
            VCU_PlugStatus_oVCU_HMIsignals_01_oATOM_CANFD_Matrix_CH_V600_202502_250fa71e_Tx: ComBitPosition=55, ComBitSize=3, ComSignalType=UINT8, ComSystemTemplateSystemSignalRef=VCU_PlugStatus
            VCU_ReachLimitStd_oVCU_HMIsignals_01_oATOM_CANFD_Matrix_CH_V600_202502_5cd2e319_Tx: ComBitPosition=15, ComBitSize=1, ComSignalType=BOOLEAN, ComSystemTemplateSystemSignalRef=VCU_ReachLimitStd
        SG_VCU_HMIsignals_02_SigGroup_oVCU_HMIsignals_02_oATOM_CANFD_Matrix_CH_V600_202502_b90a0cf2_Tx: ComSystemTemplateSignalGroupRef=SG_VCU_HMIsignals_02_SigGroup
          9 x ComGroupSignal, all with ComSignalEndianness=BIG_ENDIAN, ComTransferProperty=PENDING:
            Checksum_318_oVCU_HMIsignals_02_oATOM_CANFD_Matrix_CH_V600_202502_fc013b78_Tx: ComBitPosition=7, ComBitSize=8, ComSignalInitValue=0, ComSignalType=UINT8, ComSystemTemplateSystemSignalRef=Checksum_318
            MessageCounter_318_oVCU_HMIsignals_02_oATOM_CANFD_Matrix_CH_V600_202502_9aee7a8b_Tx: ComBitPosition=11, ComBitSize=4, ComSignalInitValue=0, ComSignalType=UINT8, ComSystemTemplateSystemSignalRef=MessageCounter_318
            VCU_DischargeEndSoc_oVCU_HMIsignals_02_oATOM_CANFD_Matrix_CH_V600_202502_a47f7a1f_Tx: ComBitPosition=55, ComBitSize=8, ComSignalInitValue=50, ComSignalType=UINT8, ComSystemTemplateSystemSignalRef=VCU_DischargeEndSoc
            VCU_Display_Cur_oVCU_HMIsignals_02_oATOM_CANFD_Matrix_CH_V600_202502_629aba80_Tx: ComBitPosition=25, ComBitSize=10, ComSignalInitValue=0, ComSignalType=UINT16, ComSystemTemplateSystemSignalRef=VCU_Display_Cur
            VCU_Display_Power_oVCU_HMIsignals_02_oATOM_CANFD_Matrix_CH_V600_202502_1364d55f_Tx: ComBitPosition=23, ComBitSize=12, ComSignalInitValue=0, ComSignalType=UINT16, ComSystemTemplateSystemSignalRef=VCU_Display_Power
            VCU_ForwardVmaxAllowed_oVCU_HMIsignals_02_oATOM_CANFD_Matrix_CH_V600_202502_631e19bb_Tx: ComBitPosition=63, ComBitSize=8, ComSignalInitValue=0, ComSignalType=UINT8, ComSystemTemplateSystemSignalRef=VCU_ForwardVmaxAllowed
            VCU_MCU_FaultLampReq_oVCU_HMIsignals_02_oATOM_CANFD_Matrix_CH_V600_202502_b94ce354_Tx: ComBitPosition=15, ComBitSize=2, ComSignalInitValue=0, ComSignalType=UINT8, ComSystemTemplateSystemSignalRef=VCU_MCU_FaultLampReq
            VCU_SystemReady_oVCU_HMIsignals_02_oATOM_CANFD_Matrix_CH_V600_202502_3baa5f6f_Tx: ComBitPosition=27, ComBitSize=1, ComSignalInitValue=0, ComSignalType=BOOLEAN, ComSystemTemplateSystemSignalRef=VCU_SystemReady
            VCU_maxChargeSOC_oVCU_HMIsignals_02_oATOM_CANFD_Matrix_CH_V600_202502_b7e91aff_Tx: ComBitPosition=47, ComBitSize=8, ComSignalInitValue=255, ComSignalType=UINT8, ComSystemTemplateSystemSignalRef=VCU_maxChargeSOC
        SG_VCU_IBS_01_SigGroup_oVCU_IBS_01_oATOM_CANFD_Matrix_CH_V600_202502_f0f49d09_Tx: ComSystemTemplateSignalGroupRef=SG_VCU_IBS_01_SigGroup
          7 x ComGroupSignal, all with ComSignalEndianness=BIG_ENDIAN, ComSignalInitValue=0, ComTransferProperty=PENDING:
            Checksum_094_oVCU_IBS_01_oATOM_CANFD_Matrix_CH_V600_202502_28a707e9_Tx: ComBitPosition=7, ComBitSize=8, ComSignalType=UINT8, ComSystemTemplateSystemSignalRef=Checksum_094
            MessageCounter_094_oVCU_IBS_01_oATOM_CANFD_Matrix_CH_V600_202502_804a7805_Tx: ComBitPosition=11, ComBitSize=4, ComSignalType=UINT8, ComSystemTemplateSystemSignalRef=MessageCounter_094
            VCU_MotorActualTorqueValid_oVCU_IBS_01_oATOM_CANFD_Matrix_CH_V600_202502_2709c7ef_Tx: ComBitPosition=14, ComBitSize=1, ComSignalType=BOOLEAN, ComSystemTemplateSystemSignalRef=VCU_MotorActualTorqueValid
            VCU_MotorActualTorque_oVCU_IBS_01_oATOM_CANFD_Matrix_CH_V600_202502_90c1c989_Tx: ComBitPosition=39, ComBitSize=11, ComSignalType=UINT16, ComSystemTemplateSystemSignalRef=VCU_MotorActualTorque
            VCU_OPStandstillReq_oVCU_IBS_01_oATOM_CANFD_Matrix_CH_V600_202502_af773c24_Tx: ComBitPosition=42, ComBitSize=2, ComSignalType=UINT8, ComSystemTemplateSystemSignalRef=VCU_OPStandstillReq
            VCU_WheelTrqACTValid_oVCU_IBS_01_oATOM_CANFD_Matrix_CH_V600_202502_0e2031fb_Tx: ComBitPosition=40, ComBitSize=1, ComSignalType=BOOLEAN, ComSystemTemplateSystemSignalRef=VCU_WheelTrqACTValid
            VCU_WheelTrqACT_oVCU_IBS_01_oATOM_CANFD_Matrix_CH_V600_202502_722027bb_Tx: ComBitPosition=55, ComBitSize=16, ComSignalType=UINT16, ComSystemTemplateSystemSignalRef=VCU_WheelTrqACT
        SG_VCU_MCU_03_SigGroup_oVCU_MCU_03_oATOM_CANFD_Matrix_CH_V600_202502_c0057d9b_Tx: ComSystemTemplateSignalGroupRef=SG_VCU_MCU_03_SigGroup
          11 x ComGroupSignal, all with ComSignalEndianness=BIG_ENDIAN, ComSignalInitValue=0, ComTransferProperty=PENDING:
            Checksum_095_oVCU_MCU_03_oATOM_CANFD_Matrix_CH_V600_202502_004b6de5_Tx: ComBitPosition=7, ComBitSize=8, ComSignalType=UINT8, ComSystemTemplateSystemSignalRef=Checksum_095
            MessageCounter_095_oVCU_MCU_03_oATOM_CANFD_Matrix_CH_V600_202502_a8a61209_Tx: ComBitPosition=11, ComBitSize=4, ComSignalType=UINT8, ComSystemTemplateSystemSignalRef=MessageCounter_095
            VCU_ActualGear_oVCU_MCU_03_oATOM_CANFD_Matrix_CH_V600_202502_adcf3745_Tx: ComBitPosition=34, ComBitSize=3, ComSignalType=UINT8, ComSystemTemplateSystemSignalRef=VCU_ActualGear
            VCU_BrakepedalStatus_oVCU_MCU_03_oATOM_CANFD_Matrix_CH_V600_202502_f285ec19_Tx: ComBitPosition=47, ComBitSize=2, ComSignalType=UINT8, ComSystemTemplateSystemSignalRef=VCU_BrakepedalStatus
            VCU_KL15eOn_oVCU_MCU_03_oATOM_CANFD_Matrix_CH_V600_202502_2306d930_Tx: ComBitPosition=39, ComBitSize=1, ComSignalType=BOOLEAN, ComSystemTemplateSystemSignalRef=VCU_KL15eOn
            VCU_MCUDesiredTorque_oVCU_MCU_03_oATOM_CANFD_Matrix_CH_V600_202502_a07350bb_Tx: ComBitPosition=23, ComBitSize=11, ComSignalType=UINT16, ComSystemTemplateSystemSignalRef=VCU_MCUDesiredTorque
            VCU_MCUSurgeDamperState_oVCU_MCU_03_oATOM_CANFD_Matrix_CH_V600_202502_4b3e55ae_Tx: ComBitPosition=37, ComBitSize=2, ComSignalType=UINT8, ComSystemTemplateSystemSignalRef=VCU_MCUSurgeDamperState
            VCU_PWTErrorLevel_oVCU_MCU_03_oATOM_CANFD_Matrix_CH_V600_202502_4725a26e_Tx: ComBitPosition=15, ComBitSize=4, ComSignalType=UINT8, ComSystemTemplateSystemSignalRef=VCU_PWTErrorLevel
            VCU_RequestedModeMCU_oVCU_MCU_03_oATOM_CANFD_Matrix_CH_V600_202502_97cf52ed_Tx: ComBitPosition=43, ComBitSize=4, ComSignalType=UINT8, ComSystemTemplateSystemSignalRef=VCU_RequestedModeMCU
            VCU_TCSActive_oVCU_MCU_03_oATOM_CANFD_Matrix_CH_V600_202502_f7e15433_Tx: ComBitPosition=38, ComBitSize=1, ComSignalType=BOOLEAN, ComSystemTemplateSystemSignalRef=VCU_TCSActive
            VCU_TrqThresholdDampgCtl_oVCU_MCU_03_oATOM_CANFD_Matrix_CH_V600_202502_86f61526_Tx: ComBitPosition=55, ComBitSize=8, ComSignalType=UINT8, ComSystemTemplateSystemSignalRef=VCU_TrqThresholdDampgCtl
        SG_VCU_PlugInChrgInfo_SigGroup_oVCU_PlugInChrgInfo_oATOM_CANFD_Matrix_CH_V600_202502_c285d340_Tx: ComSystemTemplateSignalGroupRef=SG_VCU_PlugInChrgInfo_SigGroup
          4 x ComGroupSignal, all with ComSignalEndianness=BIG_ENDIAN, ComSignalInitValue=0, ComTransferProperty=PENDING:
            VCU_ChargeEndReason_oVCU_PlugInChrgInfo_oATOM_CANFD_Matrix_CH_V600_202502_86604033_Tx: ComBitPosition=36, ComBitSize=2, ComSignalType=UINT8, ComSystemTemplateSystemSignalRef=VCU_ChargeEndReason
            VCU_DischargeEndReason_oVCU_PlugInChrgInfo_oATOM_CANFD_Matrix_CH_V600_202502_a9c41ef6_Tx: ComBitPosition=34, ComBitSize=2, ComSignalType=UINT8, ComSystemTemplateSystemSignalRef=VCU_DischargeEndReason
            VCU_HVConnectFault_oVCU_PlugInChrgInfo_oATOM_CANFD_Matrix_CH_V600_202502_ad3614da_Tx: ComBitPosition=37, ComBitSize=1, ComSignalType=BOOLEAN, ComSystemTemplateSystemSignalRef=VCU_HVConnectFault
            VCU_RemainChrgTime_oVCU_PlugInChrgInfo_oATOM_CANFD_Matrix_CH_V600_202502_deed3006_Tx: ComBitPosition=7, ComBitSize=12, ComSignalType=UINT16, ComSystemTemplateSystemSignalRef=VCU_RemainChrgTime
    ComGeneral
