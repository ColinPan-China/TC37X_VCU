AUTOSAR XML (schema 00048)
package /InitialEcuC
  ecuc value collection InitialEcuC: ecuc-values=[Can, CanIf, CanNm, CanSM, CanTp, Com, ComM, Dcm, Dem, EcuC, EcuM, Lin, LinIf, LinSM, LinTp, Nm, PduR, Xcp]
  module config Can
    CanConfigSet
      CT_TC37X_VCU_CAN00_22cb8fec (CanController):
        CanControllerActivation = true
        CanControllerDefaultBaudrate = CT_TC37X_VCU_CAN00_22cb8fec/CanControllerBaudrateConfig
        CanControllerSystemRef = CT_TC37X_VCU_CAN00
        CanWakeupSourceRef = EcuMCommonConfiguration/CN_TC37X_VCU_CAN00_07b6c9c8
        CanControllerBaudrateConfig: CanControllerBaudRate=500
      CT_TC37X_VCU_CAN01_55ccbf7a (CanController):
        CanControllerActivation = true
        CanControllerDefaultBaudrate = CT_TC37X_VCU_CAN01_55ccbf7a/CanControllerBaudrateConfig
        CanControllerSystemRef = CT_TC37X_VCU_CAN01
        CanWakeupSourceRef = EcuMCommonConfiguration/CN_TC37X_VCU_CAN01_70b1f95e
        CanControllerBaudrateConfig: CanControllerBaudRate=500
      4 x CanHardwareObject, all with CanHandleType=BASIC, CanIdValue=0:
        CN_TC37X_VCU_CAN00_07b6c9c8_Tx: CanObjectType=TRANSMIT, CanControllerRef=CanConfigSet/CT_TC37X_VCU_CAN00_22cb8fec
        CN_TC37X_VCU_CAN00_c052b9c5_Rx: CanIdType=STANDARD, CanObjectType=RECEIVE, CanControllerRef=CanConfigSet/CT_TC37X_VCU_CAN00_22cb8fec
        CN_TC37X_VCU_CAN01_2f90d2fb_Rx: CanIdType=STANDARD, CanObjectType=RECEIVE, CanControllerRef=CanConfigSet/CT_TC37X_VCU_CAN01_55ccbf7a
        CN_TC37X_VCU_CAN01_70b1f95e_Tx: CanObjectType=TRANSMIT, CanControllerRef=CanConfigSet/CT_TC37X_VCU_CAN01_55ccbf7a
    CanGeneral: CanIndex=0
  module config CanIf
    CanIfCtrlDrvCfg_7d254554 (CanIfCtrlDrvCfg): CanIfCtrlDrvInitHohConfigRef=CanIfInitHohCfg, CanIfCtrlDrvNameRef=CanGeneral
      CT_TC37X_VCU_CAN00_22cb8fec (CanIfCtrlCfg): CanIfCtrlCanCtrlRef=CanConfigSet/CT_TC37X_VCU_CAN00_22cb8fec
      CT_TC37X_VCU_CAN01_55ccbf7a (CanIfCtrlCfg): CanIfCtrlCanCtrlRef=CanConfigSet/CT_TC37X_VCU_CAN01_55ccbf7a
    CanIfInitCfg
      CHNL_131d55da (CanIfBufferCfg): CanIfBufferSize=0, CanIfBufferHthRef=CanIfInitHohCfg/CN_TC37X_VCU_CAN01_70b1f95e_Tx
      CHNL_d841867f (CanIfBufferCfg): CanIfBufferSize=0, CanIfBufferHthRef=CanIfInitHohCfg/CN_TC37X_VCU_CAN00_07b6c9c8_Tx
      CanIfInitHohCfg: CanIfInitRefCfgSet=CanConfigSet
        CN_TC37X_VCU_CAN00_c052b9c5_Rx (CanIfHrhCfg): CanIfHrhCanCtrlIdRef=CanIfCtrlDrvCfg_7d254554/CT_TC37X_VCU_CAN00_22cb8fec, CanIfHrhIdSymRef=CanConfigSet/CN_TC37X_VCU_CAN00_c052b9c5_Rx
        CN_TC37X_VCU_CAN01_2f90d2fb_Rx (CanIfHrhCfg): CanIfHrhCanCtrlIdRef=CanIfCtrlDrvCfg_7d254554/CT_TC37X_VCU_CAN01_55ccbf7a, CanIfHrhIdSymRef=CanConfigSet/CN_TC37X_VCU_CAN01_2f90d2fb_Rx
        CN_TC37X_VCU_CAN00_07b6c9c8_Tx (CanIfHthCfg): CanIfHthCanCtrlIdRef=CanIfCtrlDrvCfg_7d254554/CT_TC37X_VCU_CAN00_22cb8fec, CanIfHthIdSymRef=CanConfigSet/CN_TC37X_VCU_CAN00_07b6c9c8_Tx
        CN_TC37X_VCU_CAN01_70b1f95e_Tx (CanIfHthCfg): CanIfHthCanCtrlIdRef=CanIfCtrlDrvCfg_7d254554/CT_TC37X_VCU_CAN01_55ccbf7a, CanIfHthIdSymRef=CanConfigSet/CN_TC37X_VCU_CAN01_70b1f95e_Tx
      9 x CanIfRxPduCfg, all with CanIfRxPduCanIdType=STANDARD_CAN, CanIfRxPduDlc=8:
        VCU_Rx_500h_NM_oTC37X_VCU_CAN00_2f971b6a_Rx: CanIfRxPduCanId=1280, CanIfRxPduUserRxIndicationName=CanNm_RxIndication, CanIfRxPduUserRxIndicationUL=CAN_NM, CanIfRxPduHrhIdRef=CanIfInitHohCfg/CN_TC37X_VCU_CAN00_c052b9c5_Rx, CanIfRxPduRef=VCU_Rx_500h_NM_oTC37X_VCU_CAN00_c4b96e15_Rx
        VCU_Rx_500h_NM_oTC37X_VCU_CAN01_21ea515e_Rx: CanIfRxPduCanId=1280, CanIfRxPduUserRxIndicationName=CanNm_RxIndication, CanIfRxPduUserRxIndicationUL=CAN_NM, CanIfRxPduHrhIdRef=CanIfInitHohCfg/CN_TC37X_VCU_CAN01_2f90d2fb_Rx, CanIfRxPduRef=VCU_Rx_500h_NM_oTC37X_VCU_CAN01_54a3f814_Rx
        VcuRxMsg1_oTC37X_VCU_CAN00_c149044d_Rx: CanIfRxPduCanId=512, CanIfRxPduUserRxIndicationName=PduR_CanIfRxIndication, CanIfRxPduUserRxIndicationUL=PDUR, CanIfRxPduHrhIdRef=CanIfInitHohCfg/CN_TC37X_VCU_CAN00_c052b9c5_Rx, CanIfRxPduRef=EcucPduCollection/VcuRxMsg1_oTC37X_VCU_CAN00_4589bbed_Rx
        VcuRxMsg2_oTC37X_VCU_CAN00_de1782b6_Rx: CanIfRxPduCanId=513, CanIfRxPduUserRxIndicationName=PduR_CanIfRxIndication, CanIfRxPduUserRxIndicationUL=PDUR, CanIfRxPduHrhIdRef=CanIfInitHohCfg/CN_TC37X_VCU_CAN00_c052b9c5_Rx, CanIfRxPduRef=EcucPduCollection/VcuRxMsg2_oTC37X_VCU_CAN00_8cbda0e0_Rx
        VcuRxMsg3_oTC37X_VCU_CAN01_29174725_Rx: CanIfRxPduCanId=514, CanIfRxPduUserRxIndicationName=PduR_CanIfRxIndication, CanIfRxPduUserRxIndicationUL=PDUR, CanIfRxPduHrhIdRef=CanIfInitHohCfg/CN_TC37X_VCU_CAN01_2f90d2fb_Rx, CanIfRxPduRef=EcucPduCollection/VcuRxMsg3_oTC37X_VCU_CAN01_5bb4c01a_Rx
        VcuRxMsg4_oTC37X_VCU_CAN01_1d60377a_Rx: CanIfRxPduCanId=515, CanIfRxPduUserRxIndicationName=PduR_CanIfRxIndication, CanIfRxPduUserRxIndicationUL=PDUR, CanIfRxPduHrhIdRef=CanIfInitHohCfg/CN_TC37X_VCU_CAN01_2f90d2fb_Rx, CanIfRxPduRef=EcucPduCollection/VcuRxMsg4_oTC37X_VCU_CAN01_55be06ba_Rx
        Vcu_Uds_Func_Request_Tp_oTC37X_VCU_CAN00_b229a038_Rx: CanIfRxPduCanId=1792, CanIfRxPduUserRxIndicationName=CanTp_RxIndication, CanIfRxPduUserRxIndicationType=PDUID_PDUINFOPTR, CanIfRxPduUserRxIndicationUL=CAN_TP, CanIfRxPduHrhIdRef=CanIfInitHohCfg/CN_TC37X_VCU_CAN00_c052b9c5_Rx, CanIfRxPduRef=Vcu_Uds_Func_Request_Tp_oTC37X_VCU_CAN00_3dbedef7_Rx
        Vcu_Uds_Phy_Request_Tp_oTC37X_VCU_CAN00_fc9370a6_Rx: CanIfRxPduCanId=1793, CanIfRxPduUserRxIndicationName=CanTp_RxIndication, CanIfRxPduUserRxIndicationType=PDUID_PDUINFOPTR, CanIfRxPduUserRxIndicationUL=CAN_TP, CanIfRxPduHrhIdRef=CanIfInitHohCfg/CN_TC37X_VCU_CAN00_c052b9c5_Rx, CanIfRxPduRef=Vcu_Uds_Phy_Request_Tp_oTC37X_VCU_CAN00_58c52463_Rx
        XCP_Request_oTC37X_VCU_CAN00_e22de59e_Rx: CanIfRxPduCanId=1542, CanIfRxPduUserRxIndicationName=Xcp_CanIfRxIndication, CanIfRxPduUserRxIndicationUL=XCP, CanIfRxPduHrhIdRef=CanIfInitHohCfg/CN_TC37X_VCU_CAN00_c052b9c5_Rx, CanIfRxPduRef=EcucPduCollection/XCP_Request_oTC37X_VCU_CAN00_3c25b45e_Rx
      16 x CanIfTxPduCfg, all with CanIfTxPduCanIdType=STANDARD_CAN, CanIfTxPduDlc=8:
        VCU_Tx_51Ch_NM_oTC37X_VCU_CAN00_560cc988_Tx: CanIfTxPduCanId=1308, CanIfTxPduUserTxConfirmationName=CanNm_TxConfirmation, CanIfTxPduUserTxConfirmationUL=CAN_NM, CanIfTxPduBufferRef=CanIfInitCfg/CHNL_d841867f, CanIfTxPduRef=EcucPduCollection/VCU_Tx_51Ch_NM_oTC37X_VCU_CAN00_0aa0ce62_Tx
        VCU_Tx_51Ch_NM_oTC37X_VCU_CAN01_587183bc_Tx: CanIfTxPduCanId=1308, CanIfTxPduUserTxConfirmationName=CanNm_TxConfirmation, CanIfTxPduUserTxConfirmationUL=CAN_NM, CanIfTxPduBufferRef=CanIfInitCfg/CHNL_131d55da, CanIfTxPduRef=EcucPduCollection/VCU_Tx_51Ch_NM_oTC37X_VCU_CAN01_9aba5863_Tx
        VcuAdcTxMsg1_oTC37X_VCU_CAN01_29adaf4d_Tx: CanIfTxPduCanId=258, CanIfTxPduUserTxConfirmationName=PduR_CanIfTxConfirmation, CanIfTxPduUserTxConfirmationUL=PDUR, CanIfTxPduBufferRef=CanIfInitCfg/CHNL_131d55da, CanIfTxPduRef=EcucPduCollection/VcuAdcTxMsg1_oTC37X_VCU_CAN01_6685c7bf_Tx
        VcuAdcTxMsg2_oTC37X_VCU_CAN01_fa8a8e09_Tx: CanIfTxPduCanId=259, CanIfTxPduUserTxConfirmationName=PduR_CanIfTxConfirmation, CanIfTxPduUserTxConfirmationUL=PDUR, CanIfTxPduBufferRef=CanIfInitCfg/CHNL_131d55da, CanIfTxPduRef=EcucPduCollection/VcuAdcTxMsg2_oTC37X_VCU_CAN01_afb1dcb2_Tx
        VcuTxIoMsg1_oTC37X_VCU_CAN00_644aaa1f_Tx: CanIfTxPduCanId=260, CanIfTxPduUserTxConfirmationName=PduR_CanIfTxConfirmation, CanIfTxPduUserTxConfirmationUL=PDUR, CanIfTxPduBufferRef=CanIfInitCfg/CHNL_d841867f, CanIfTxPduRef=EcucPduCollection/VcuTxIoMsg1_oTC37X_VCU_CAN00_869e33bc_Tx
        VcuTxIoMsg2_oTC37X_VCU_CAN00_0c9644c1_Tx: CanIfTxPduCanId=261, CanIfTxPduUserTxConfirmationName=PduR_CanIfTxConfirmation, CanIfTxPduUserTxConfirmationUL=PDUR, CanIfTxPduBufferRef=CanIfInitCfg/CHNL_d841867f, CanIfTxPduRef=EcucPduCollection/VcuTxIoMsg2_oTC37X_VCU_CAN00_4faa28b1_Tx
        VcuTxIoMsg3_oTC37X_VCU_CAN00_2b221e8b_Tx: CanIfTxPduCanId=262, CanIfTxPduUserTxConfirmationName=PduR_CanIfTxConfirmation, CanIfTxPduUserTxConfirmationUL=PDUR, CanIfTxPduBufferRef=CanIfInitCfg/CHNL_d841867f, CanIfTxPduRef=EcucPduCollection/VcuTxIoMsg3_oTC37X_VCU_CAN00_08b9de4a_Tx
        VcuTxIoMsg4_oTC37X_VCU_CAN00_dd2f997d_Tx: CanIfTxPduCanId=263, CanIfTxPduUserTxConfirmationName=PduR_CanIfTxConfirmation, CanIfTxPduUserTxConfirmationUL=PDUR, CanIfTxPduBufferRef=CanIfInitCfg/CHNL_d841867f, CanIfTxPduRef=EcucPduCollection/VcuTxIoMsg4_oTC37X_VCU_CAN00_06b318ea_Tx
        VcuTxIoMsg5_oTC37X_VCU_CAN00_fa9bc337_Tx: CanIfTxPduCanId=264, CanIfTxPduUserTxConfirmationName=PduR_CanIfTxConfirmation, CanIfTxPduUserTxConfirmationUL=PDUR, CanIfTxPduBufferRef=CanIfInitCfg/CHNL_d841867f, CanIfTxPduRef=EcucPduCollection/VcuTxIoMsg5_oTC37X_VCU_CAN00_41a0ee11_Tx
        VcuTxIoMsg6_oTC37X_VCU_CAN00_92472de9_Tx: CanIfTxPduCanId=265, CanIfTxPduUserTxConfirmationName=PduR_CanIfTxConfirmation, CanIfTxPduUserTxConfirmationUL=PDUR, CanIfTxPduBufferRef=CanIfInitCfg/CHNL_d841867f, CanIfTxPduRef=EcucPduCollection/VcuTxIoMsg6_oTC37X_VCU_CAN00_8894f51c_Tx
        VcuTxIoMsg7_oTC37X_VCU_CAN00_b5f377a3_Tx: CanIfTxPduCanId=266, CanIfTxPduUserTxConfirmationName=PduR_CanIfTxConfirmation, CanIfTxPduUserTxConfirmationUL=PDUR, CanIfTxPduBufferRef=CanIfInitCfg/CHNL_d841867f, CanIfTxPduRef=EcucPduCollection/VcuTxIoMsg7_oTC37X_VCU_CAN00_cf8703e7_Tx
        VcuTxIoMsg8_oTC37X_VCU_CAN00_a52d2444_Tx: CanIfTxPduCanId=267, CanIfTxPduUserTxConfirmationName=PduR_CanIfTxConfirmation, CanIfTxPduUserTxConfirmationUL=PDUR, CanIfTxPduBufferRef=CanIfInitCfg/CHNL_d841867f, CanIfTxPduRef=EcucPduCollection/VcuTxIoMsg8_oTC37X_VCU_CAN00_9481785c_Tx
        VcuTxMsg1_oTC37X_VCU_CAN00_78140f53_Tx: CanIfTxPduCanId=256, CanIfTxPduUserTxConfirmationName=PduR_CanIfTxConfirmation, CanIfTxPduUserTxConfirmationUL=PDUR, CanIfTxPduBufferRef=CanIfInitCfg/CHNL_d841867f, CanIfTxPduRef=EcucPduCollection/VcuTxMsg1_oTC37X_VCU_CAN00_c82dd125_Tx
        VcuTxMsg2_oTC37X_VCU_CAN00_674a89a8_Tx: CanIfTxPduCanId=257, CanIfTxPduUserTxConfirmationName=PduR_CanIfTxConfirmation, CanIfTxPduUserTxConfirmationUL=PDUR, CanIfTxPduBufferRef=CanIfInitCfg/CHNL_d841867f, CanIfTxPduRef=EcucPduCollection/VcuTxMsg2_oTC37X_VCU_CAN00_0119ca28_Tx
        Vcu_Uds_Response_Tp_oTC37X_VCU_CAN00_2ff8982b_Tx: CanIfTxPduCanId=1921, CanIfTxPduUserTxConfirmationName=CanTp_TxConfirmation, CanIfTxPduUserTxConfirmationUL=CAN_TP, CanIfTxPduBufferRef=CanIfInitCfg/CHNL_d841867f, CanIfTxPduRef=Vcu_Uds_Response_Tp_oTC37X_VCU_CAN00_834178f3_Tx
        XCP_Response_oTC37X_VCU_CAN00_933a9e7a_Tx: CanIfTxPduCanId=1543, CanIfTxPduUserTxConfirmationName=Xcp_CanIfTxConfirmation, CanIfTxPduUserTxConfirmationUL=XCP, CanIfTxPduBufferRef=CanIfInitCfg/CHNL_d841867f, CanIfTxPduRef=EcucPduCollection/XCP_Response_oTC37X_VCU_CAN00_34d2da2d_Tx
    CanIfPrivateCfg: CanIfPrivateSoftwareFilterType=LINEAR
    CanIfPublicCfg: CanIfPublicPnSupport=false
  module config CanNm
    CanNmGlobalConfig: CanNmPnEiraCalcEnabled=false, CanNmUserDataEnabled=true
      TC37X_VCU_CAN00_CAN_cc8c31fa (CanNmChannelConfig):
        CanNmMsgCycleOffset = 0
        CanNmMsgCycleTime = 0.5
        CanNmMsgReducedTime = 0.32
        CanNmNodeId = 28
        CanNmRepeatMessageTime = 1.5
        CanNmTimeoutTime = 2
        CanNmUserDataLength = 6
        CanNmWaitBusSleepTime = 2
        CanNmComMNetworkHandleRef = ComMConfigSet/CN_TC37X_VCU_CAN00_07b6c9c8
        VCU_Tx_51Ch_NM_oTC37X_VCU_CAN00_0aa0ce62_Tx (CanNmTxPdu): CanNmTxPduRef=EcucPduCollection/VCU_Tx_51Ch_NM_oTC37X_VCU_CAN00_0aa0ce62_Tx
      TC37X_VCU_CAN01_CAN_f1ec184a (CanNmChannelConfig):
        CanNmMsgCycleOffset = 0
        CanNmMsgCycleTime = 0.5
        CanNmMsgReducedTime = 0.32
        CanNmNodeId = 28
        CanNmRepeatMessageTime = 1.5
        CanNmTimeoutTime = 2
        CanNmUserDataLength = 6
        CanNmWaitBusSleepTime = 2
        CanNmComMNetworkHandleRef = ComMConfigSet/CN_TC37X_VCU_CAN01_70b1f95e
        VCU_Tx_51Ch_NM_oTC37X_VCU_CAN01_9aba5863_Tx (CanNmTxPdu): CanNmTxPduRef=EcucPduCollection/VCU_Tx_51Ch_NM_oTC37X_VCU_CAN01_9aba5863_Tx
  module config CanSM
    CanSMConfiguration
      CHNL_131d55da (CanSMManagerNetwork): CanSMComMNetworkHandleRef=ComMConfigSet/CN_TC37X_VCU_CAN01_70b1f95e
        CT_TC37X_VCU_CAN01_9a653c82 (CanSMController): CanSMControllerId=CanIfCtrlDrvCfg_7d254554/CT_TC37X_VCU_CAN01_55ccbf7a
      CHNL_d841867f (CanSMManagerNetwork): CanSMComMNetworkHandleRef=ComMConfigSet/CN_TC37X_VCU_CAN00_07b6c9c8
        CT_TC37X_VCU_CAN00_5fde07f6 (CanSMController): CanSMControllerId=CanIfCtrlDrvCfg_7d254554/CT_TC37X_VCU_CAN00_22cb8fec
  module config CanTp
    CanTpConfig: CanTpMainFunctionPeriod=0.005
      TPCH_1341a116 (CanTpChannel): CanTpChannelMode=CANTP_MODE_FULL_DUPLEX
        CanTpRxNSdu_fe7a15ff (CanTpRxNSdu):
          CanTpRxAddressingFormat = CANTP_STANDARD
          CanTpRxDl = 8
          CanTpRxTaType = CANTP_PHYSICAL
          CanTpRxNSduRef = EcucPduCollection/Vcu_Uds_Phy_Request_oTC37X_VCU_CAN00_16119f6f_Rx
          CanTpRxNPdu_63ec38a0 (CanTpRxNPdu): CanTpRxNPduRef=Vcu_Uds_Phy_Request_Tp_oTC37X_VCU_CAN00_58c52463_Rx
          CanTpTxFcNPdu_63ec38a0 (CanTpTxFcNPdu): CanTpTxFcNPduRef=Vcu_Uds_Response_Tp_oTC37X_VCU_CAN00_834178f3_Tx
        CanTpTxNSdu_fe7a15ff (CanTpTxNSdu):
          CanTpTxAddressingFormat = CANTP_STANDARD
          CanTpTxDl = 8
          CanTpTxTaType = CANTP_PHYSICAL
          CanTpTxNSduRef = EcucPduCollection/Vcu_Uds_Response_oTC37X_VCU_CAN00_39638a1a_Tx
          CanTpRxFcNPdu_4116ec52 (CanTpRxFcNPdu): CanTpRxFcNPduRef=Vcu_Uds_Phy_Request_Tp_oTC37X_VCU_CAN00_58c52463_Rx
          CanTpTxNPdu_4116ec52 (CanTpTxNPdu): CanTpTxNPduRef=Vcu_Uds_Response_Tp_oTC37X_VCU_CAN00_834178f3_Tx
      TPCH_d230b3ef (CanTpChannel): CanTpChannelMode=CANTP_MODE_FULL_DUPLEX
        CanTpRxNSdu_c12348c5 (CanTpRxNSdu):
          CanTpRxAddressingFormat = CANTP_STANDARD
          CanTpRxDl = 8
          CanTpRxTaType = CANTP_FUNCTIONAL
          CanTpRxNSduRef = EcucPduCollection/Vcu_Uds_Func_Request_oTC37X_VCU_CAN00_455d4346_Rx
          CanTpRxNPdu_257d590c (CanTpRxNPdu): CanTpRxNPduRef=Vcu_Uds_Func_Request_Tp_oTC37X_VCU_CAN00_3dbedef7_Rx
  module config Com
    ComConfig
      20 x ComIPdu, all with ComIPduType=NORMAL:
        VcuAdcTxMsg1_oTC37X_VCU_CAN01_fda515ee_Tx: ComIPduDirection=SEND, ComIPduGroupRef=VCU_oTC37X_VCU_CAN01_Tx_4e6d6cda, ComIPduSignalRef=VcuAdcTxMsg1_Sig0_oVcuAdcTxMsg1_oTC37X_VCU_CAN01_77707e8c_Tx, ComIPduSignalRef=VcuAdcTxMsg1_Sig1_oVcuAdcTxMsg1_oTC37X_VCU_CAN01_86aa7b26_Tx, ComIPduSignalRef=VcuAdcTxMsg1_Sig2_oVcuAdcTxMsg1_oTC37X_VCU_CAN01_4fb57399_Tx, ComIPduSignalRef=VcuAdcTxMsg1_Sig3_oVcuAdcTxMsg1_oTC37X_VCU_CAN01_be6f7633_Tx, ComPduIdRef=EcucPduCollection/VcuAdcTxMsg1_oTC37X_VCU_CAN01_fda515ee_Tx
          ComTxIPdu: ComMinimumDelayTime=0, ComTxIPduUnusedAreasDefault=0
            ComTxModeFalse
              ComTxMode: ComTxModeMode=PERIODIC, ComTxModeTimeOffset=0, ComTxModeTimePeriod=0.5
            ComTxModeTrue
              ComTxMode: ComTxModeMode=PERIODIC, ComTxModeTimeOffset=0, ComTxModeTimePeriod=0.5
        VcuAdcTxMsg2_oTC37X_VCU_CAN01_1723c88c_Tx: ComIPduDirection=SEND, ComIPduGroupRef=VCU_oTC37X_VCU_CAN01_Tx_4e6d6cda, ComIPduSignalRef=VcuAdcTxMsg2_Sig0_oVcuAdcTxMsg2_oTC37X_VCU_CAN01_c7979c8e_Tx, ComIPduSignalRef=VcuAdcTxMsg2_Sig1_oVcuAdcTxMsg2_oTC37X_VCU_CAN01_364d9924_Tx, ComIPduSignalRef=VcuAdcTxMsg2_Sig2_oVcuAdcTxMsg2_oTC37X_VCU_CAN01_ff52919b_Tx, ComIPduSignalRef=VcuAdcTxMsg2_Sig3_oVcuAdcTxMsg2_oTC37X_VCU_CAN01_0e889431_Tx, ComPduIdRef=EcucPduCollection/VcuAdcTxMsg2_oTC37X_VCU_CAN01_1723c88c_Tx
          ComTxIPdu: ComMinimumDelayTime=0, ComTxIPduUnusedAreasDefault=0
            ComTxModeFalse
              ComTxMode: ComTxModeMode=PERIODIC, ComTxModeTimeOffset=0, ComTxModeTimePeriod=0.5
            ComTxModeTrue
              ComTxMode: ComTxModeMode=PERIODIC, ComTxModeTimeOffset=0, ComTxModeTimePeriod=0.5
        VcuRxMsg1_oTC37X_VCU_CAN00_78805594_Rx: ComIPduDirection=RECEIVE, ComIPduGroupRef=VCU_oTC37X_VCU_CAN00_Rx_a08bac39, ComIPduSignalRef=VcuRxMsg1_Sig0_oVcuRxMsg1_oTC37X_VCU_CAN00_13cef464_Rx, ComIPduSignalRef=VcuRxMsg1_Sig1_oVcuRxMsg1_oTC37X_VCU_CAN00_70c92d40_Rx, ComIPduSignalRef=VcuRxMsg1_Sig2_oVcuRxMsg1_oTC37X_VCU_CAN00_d5c1462c_Rx, ComIPduSignalRef=VcuRxMsg1_Sig3_oVcuRxMsg1_oTC37X_VCU_CAN00_b6c69f08_Rx, ComPduIdRef=EcucPduCollection/VcuRxMsg1_oTC37X_VCU_CAN00_78805594_Rx
        VcuRxMsg2_oTC37X_VCU_CAN00_920688f6_Rx: ComIPduDirection=RECEIVE, ComIPduGroupRef=VCU_oTC37X_VCU_CAN00_Rx_a08bac39, ComIPduSignalRef=VcuRxMsg2_Sig0_oVcuRxMsg2_oTC37X_VCU_CAN00_94ceda5c_Rx, ComIPduSignalRef=VcuRxMsg2_Sig1_oVcuRxMsg2_oTC37X_VCU_CAN00_f7c90378_Rx, ComIPduSignalRef=VcuRxMsg2_Sig2_oVcuRxMsg2_oTC37X_VCU_CAN00_52c16814_Rx, ComIPduSignalRef=VcuRxMsg2_Sig3_oVcuRxMsg2_oTC37X_VCU_CAN00_31c6b130_Rx, ComPduIdRef=EcucPduCollection/VcuRxMsg2_oTC37X_VCU_CAN00_920688f6_Rx
        VcuRxMsg3_oTC37X_VCU_CAN01_0a530e81_Rx: ComIPduDirection=RECEIVE, ComIPduGroupRef=VCU_oTC37X_VCU_CAN01_Rx_1837cb5c, ComIPduSignalRef=VcuRxMsg3_Sig0_oVcuRxMsg3_oTC37X_VCU_CAN01_28190d1d_Rx, ComIPduSignalRef=VcuRxMsg3_Sig1_oVcuRxMsg3_oTC37X_VCU_CAN01_4b1ed439_Rx, ComIPduSignalRef=VcuRxMsg3_Sig2_oVcuRxMsg3_oTC37X_VCU_CAN01_ee16bf55_Rx, ComIPduSignalRef=VcuRxMsg3_Sig3_oVcuRxMsg3_oTC37X_VCU_CAN01_8d116671_Rx, ComPduIdRef=EcucPduCollection/VcuRxMsg3_oTC37X_VCU_CAN01_0a530e81_Rx
        VcuRxMsg4_oTC37X_VCU_CAN01_eb7d04e5_Rx: ComIPduDirection=RECEIVE, ComIPduGroupRef=VCU_oTC37X_VCU_CAN01_Rx_1837cb5c, ComIPduSignalRef=VcuRxMsg4_Sig0_oVcuRxMsg4_oTC37X_VCU_CAN01_36b8b0fb_Rx, ComIPduSignalRef=VcuRxMsg4_Sig1_oVcuRxMsg4_oTC37X_VCU_CAN01_55bf69df_Rx, ComIPduSignalRef=VcuRxMsg4_Sig2_oVcuRxMsg4_oTC37X_VCU_CAN01_f0b702b3_Rx, ComIPduSignalRef=VcuRxMsg4_Sig3_oVcuRxMsg4_oTC37X_VCU_CAN01_93b0db97_Rx, ComPduIdRef=EcucPduCollection/VcuRxMsg4_oTC37X_VCU_CAN01_eb7d04e5_Rx
        VcuTxIoMsg1_oTC37X_VCU_CAN00_54884add_Tx: ComIPduDirection=SEND, ComIPduGroupRef=VCU_oTC37X_VCU_CAN00_Tx_f6d10bbf, ComIPduSignalRef=EXT1_Valid_oVcuTxIoMsg1_oTC37X_VCU_CAN00_caf787ea_Tx, ComIPduSignalRef=EXT2_Valid_oVcuTxIoMsg1_oTC37X_VCU_CAN00_9096b88a_Tx, ComIPduSignalRef=EXT_A_IN1_oVcuTxIoMsg1_oTC37X_VCU_CAN00_37348eff_Tx, ComIPduSignalRef=EXT_A_IN2_oVcuTxIoMsg1_oTC37X_VCU_CAN00_241cb78c_Tx, ComPduIdRef=EcucPduCollection/VcuTxIoMsg1_oTC37X_VCU_CAN00_54884add_Tx
          ComTxIPdu: ComMinimumDelayTime=0, ComTxIPduUnusedAreasDefault=0
            ComTxModeFalse
              ComTxMode: ComTxModeMode=PERIODIC, ComTxModeTimeOffset=0, ComTxModeTimePeriod=0.5
            ComTxModeTrue
              ComTxMode: ComTxModeMode=PERIODIC, ComTxModeTimeOffset=0, ComTxModeTimePeriod=0.5
        VcuTxIoMsg2_oTC37X_VCU_CAN00_be0e97bf_Tx: ComIPduDirection=SEND, ComIPduGroupRef=VCU_oTC37X_VCU_CAN00_Tx_f6d10bbf, ComIPduSignalRef=EXT3_Valid_oVcuTxIoMsg2_oTC37X_VCU_CAN00_fae072f7_Tx, ComIPduSignalRef=EXT4_Valid_oVcuTxIoMsg2_oTC37X_VCU_CAN00_ced21b28_Tx, ComIPduSignalRef=EXT_A_IN3_oVcuTxIoMsg2_oTC37X_VCU_CAN00_c07d823f_Tx, ComIPduSignalRef=EXT_A_IN4_oVcuTxIoMsg2_oTC37X_VCU_CAN00_e8ca1808_Tx, ComPduIdRef=EcucPduCollection/VcuTxIoMsg2_oTC37X_VCU_CAN00_be0e97bf_Tx
          ComTxIPdu: ComMinimumDelayTime=0, ComTxIPduUnusedAreasDefault=0
            ComTxModeFalse
              ComTxMode: ComTxModeMode=PERIODIC, ComTxModeTimeOffset=0, ComTxModeTimePeriod=0.5
            ComTxModeTrue
              ComTxMode: ComTxModeMode=PERIODIC, ComTxModeTimeOffset=0, ComTxModeTimePeriod=0.5
        VcuTxIoMsg3_oTC37X_VCU_CAN00_515c215e_Tx: ComIPduDirection=SEND, ComIPduGroupRef=VCU_oTC37X_VCU_CAN00_Tx_f6d10bbf, ComIPduSignalRef=EXT5_Valid_oVcuTxIoMsg3_oTC37X_VCU_CAN00_a170bad6_Tx, ComIPduSignalRef=EXT6_Valid_oVcuTxIoMsg3_oTC37X_VCU_CAN00_fb1185b6_Tx, ComIPduSignalRef=EXT_A_IN5_oVcuTxIoMsg3_oTC37X_VCU_CAN00_097f4638_Tx, ComIPduSignalRef=EXT_A_IN6_oVcuTxIoMsg3_oTC37X_VCU_CAN00_1a577f4b_Tx, ComPduIdRef=EcucPduCollection/VcuTxIoMsg3_oTC37X_VCU_CAN00_515c215e_Tx
          ComTxIPdu: ComMinimumDelayTime=0, ComTxIPduUnusedAreasDefault=0
            ComTxModeFalse
              ComTxMode: ComTxModeMode=PERIODIC, ComTxModeTimeOffset=0, ComTxModeTimePeriod=0.5
            ComTxModeTrue
              ComTxMode: ComTxModeMode=PERIODIC, ComTxModeTimeOffset=0, ComTxModeTimePeriod=0.5
        VcuTxIoMsg4_oTC37X_VCU_CAN00_b0722b3a_Tx: ComIPduDirection=SEND, ComIPduGroupRef=VCU_oTC37X_VCU_CAN00_Tx_f6d10bbf, ComIPduSignalRef=EXT7_Valid_oVcuTxIoMsg4_oTC37X_VCU_CAN00_9acf98cd_Tx, ComIPduSignalRef=EXT8_Valid_oVcuTxIoMsg4_oTC37X_VCU_CAN00_725b5c6c_Tx, ComIPduSignalRef=EXT_A_IN7_oVcuTxIoMsg4_oTC37X_VCU_CAN00_f59e9dfe_Tx, ComIPduSignalRef=EXT_A_IN8_oVcuTxIoMsg4_oTC37X_VCU_CAN00_aa164141_Tx, ComPduIdRef=EcucPduCollection/VcuTxIoMsg4_oTC37X_VCU_CAN00_b0722b3a_Tx
          ComTxIPdu: ComMinimumDelayTime=0, ComTxIPduUnusedAreasDefault=0
            ComTxModeFalse
              ComTxMode: ComTxModeMode=PERIODIC, ComTxModeTimeOffset=0, ComTxModeTimePeriod=0.5
            ComTxModeTrue
              ComTxMode: ComTxModeMode=PERIODIC, ComTxModeTimeOffset=0, ComTxModeTimePeriod=0.5
        VcuTxIoMsg5_oTC37X_VCU_CAN00_5f209ddb_Tx: ComIPduDirection=SEND, ComIPduGroupRef=VCU_oTC37X_VCU_CAN00_Tx_f6d10bbf, ComIPduSignalRef=EXT10_Valid_oVcuTxIoMsg5_oTC37X_VCU_CAN00_ba532916_Tx, ComIPduSignalRef=EXT9_Valid_oVcuTxIoMsg5_oTC37X_VCU_CAN00_1df9fd92_Tx, ComIPduSignalRef=EXT_A_IN10_oVcuTxIoMsg5_oTC37X_VCU_CAN00_83e5b725_Tx, ComIPduSignalRef=EXT_A_IN9_oVcuTxIoMsg5_oTC37X_VCU_CAN00_4ba31f71_Tx, ComPduIdRef=EcucPduCollection/VcuTxIoMsg5_oTC37X_VCU_CAN00_5f209ddb_Tx
          ComTxIPdu: ComMinimumDelayTime=0, ComTxIPduUnusedAreasDefault=0
            ComTxModeFalse
              ComTxMode: ComTxModeMode=PERIODIC, ComTxModeTimeOffset=0, ComTxModeTimePeriod=0.5
            ComTxModeTrue
              ComTxMode: ComTxModeMode=PERIODIC, ComTxModeTimeOffset=0, ComTxModeTimePeriod=0.5
        VcuTxIoMsg6_oTC37X_VCU_CAN00_b5a640b9_Tx: ComIPduDirection=SEND, ComIPduGroupRef=VCU_oTC37X_VCU_CAN00_Tx_f6d10bbf, ComIPduSignalRef=EXT11_Valid_oVcuTxIoMsg6_oTC37X_VCU_CAN00_d025e36b_Tx, ComIPduSignalRef=EXT12_Valid_oVcuTxIoMsg6_oTC37X_VCU_CAN00_8a44dc0b_Tx, ComIPduSignalRef=EXT_A_IN11_oVcuTxIoMsg6_oTC37X_VCU_CAN00_67848296_Tx, ComIPduSignalRef=EXT_A_IN12_oVcuTxIoMsg6_oTC37X_VCU_CAN00_74acbbe5_Tx, ComPduIdRef=EcucPduCollection/VcuTxIoMsg6_oTC37X_VCU_CAN00_b5a640b9_Tx
          ComTxIPdu: ComMinimumDelayTime=0, ComTxIPduUnusedAreasDefault=0
            ComTxModeFalse
              ComTxMode: ComTxModeMode=PERIODIC, ComTxModeTimeOffset=0, ComTxModeTimePeriod=0.5
            ComTxModeTrue
              ComTxMode: ComTxModeMode=PERIODIC, ComTxModeTimeOffset=0, ComTxModeTimePeriod=0.5
        VcuTxIoMsg7_oTC37X_VCU_CAN00_5af4f658_Tx: ComIPduDirection=SEND, ComIPduGroupRef=VCU_oTC37X_VCU_CAN00_Tx_f6d10bbf, ComIPduSignalRef=EXT13_Valid_oVcuTxIoMsg7_oTC37X_VCU_CAN00_e5e67df5_Tx, ComIPduSignalRef=EXT14_Valid_oVcuTxIoMsg7_oTC37X_VCU_CAN00_d1d4142a_Tx, ComIPduSignalRef=EXT_A_IN13_oVcuTxIoMsg7_oTC37X_VCU_CAN00_9519e5d5_Tx, ComIPduSignalRef=EXT_A_IN14_oVcuTxIoMsg7_oTC37X_VCU_CAN00_bdae7fe2_Tx, ComPduIdRef=EcucPduCollection/VcuTxIoMsg7_oTC37X_VCU_CAN00_5af4f658_Tx
          ComTxIPdu: ComMinimumDelayTime=0, ComTxIPduUnusedAreasDefault=0
            ComTxModeFalse
              ComTxMode: ComTxModeMode=PERIODIC, ComTxModeTimeOffset=0, ComTxModeTimePeriod=0.5
            ComTxModeTrue
              ComTxMode: ComTxModeMode=PERIODIC, ComTxModeTimeOffset=0, ComTxModeTimePeriod=0.5
        VcuTxIoMsg8_oTC37X_VCU_CAN00_ac8b5230_Tx: ComIPduDirection=SEND, ComIPduGroupRef=VCU_oTC37X_VCU_CAN00_Tx_f6d10bbf, ComIPduSignalRef=EXT15_Valid_oVcuTxIoMsg8_oTC37X_VCU_CAN00_a75ba75d_Tx, ComIPduSignalRef=EXT16_Valid_oVcuTxIoMsg8_oTC37X_VCU_CAN00_fd3a983d_Tx, ComIPduSignalRef=EXT_A_IN15_oVcuTxIoMsg8_oTC37X_VCU_CAN00_4536335b_Tx, ComIPduSignalRef=EXT_A_IN16_oVcuTxIoMsg8_oTC37X_VCU_CAN00_561e0a28_Tx, ComPduIdRef=EcucPduCollection/VcuTxIoMsg8_oTC37X_VCU_CAN00_ac8b5230_Tx
          ComTxIPdu: ComMinimumDelayTime=0, ComTxIPduUnusedAreasDefault=0
            ComTxModeFalse
              ComTxMode: ComTxModeMode=PERIODIC, ComTxModeTimeOffset=0, ComTxModeTimePeriod=0.5
            ComTxModeTrue
              ComTxMode: ComTxModeMode=PERIODIC, ComTxModeTimeOffset=0, ComTxModeTimePeriod=0.5
        VcuTxMsg1_oTC37X_VCU_CAN00_954a27ee_Tx: ComIPduDirection=SEND, ComIPduGroupRef=VCU_oTC37X_VCU_CAN00_Tx_f6d10bbf, ComIPduSignalRef=VcuTxMsg1_Sig0_oVcuTxMsg1_oTC37X_VCU_CAN00_8243b9a9_Tx, ComIPduSignalRef=VcuTxMsg1_Sig1_oVcuTxMsg1_oTC37X_VCU_CAN00_e144608d_Tx, ComIPduSignalRef=VcuTxMsg1_Sig2_oVcuTxMsg1_oTC37X_VCU_CAN00_444c0be1_Tx, ComIPduSignalRef=VcuTxMsg1_Sig3_oVcuTxMsg1_oTC37X_VCU_CAN00_274bd2c5_Tx, ComPduIdRef=EcucPduCollection/VcuTxMsg1_oTC37X_VCU_CAN00_954a27ee_Tx
          ComTxIPdu: ComMinimumDelayTime=0, ComTxIPduUnusedAreasDefault=0
            ComTxModeFalse
              ComTxMode: ComTxModeMode=PERIODIC, ComTxModeTimeOffset=0, ComTxModeTimePeriod=0.5
            ComTxModeTrue
              ComTxMode: ComTxModeMode=PERIODIC, ComTxModeTimeOffset=0, ComTxModeTimePeriod=0.5
        VcuTxMsg2_oTC37X_VCU_CAN00_7fccfa8c_Tx: ComIPduDirection=SEND, ComIPduGroupRef=VCU_oTC37X_VCU_CAN00_Tx_f6d10bbf, ComIPduSignalRef=VcuTxMsg2_Sig0_oVcuTxMsg2_oTC37X_VCU_CAN00_05439791_Tx, ComIPduSignalRef=VcuTxMsg2_Sig1_oVcuTxMsg2_oTC37X_VCU_CAN00_66444eb5_Tx, ComIPduSignalRef=VcuTxMsg2_Sig2_oVcuTxMsg2_oTC37X_VCU_CAN00_c34c25d9_Tx, ComIPduSignalRef=VcuTxMsg2_Sig3_oVcuTxMsg2_oTC37X_VCU_CAN00_a04bfcfd_Tx, ComPduIdRef=EcucPduCollection/VcuTxMsg2_oTC37X_VCU_CAN00_7fccfa8c_Tx
          ComTxIPdu: ComMinimumDelayTime=0, ComTxIPduUnusedAreasDefault=0
            ComTxModeFalse
              ComTxMode: ComTxModeMode=PERIODIC, ComTxModeTimeOffset=0, ComTxModeTimePeriod=0.5
            ComTxModeTrue
              ComTxMode: ComTxModeMode=PERIODIC, ComTxModeTimeOffset=0, ComTxModeTimePeriod=0.5
        Vcu_Lin0_RxMsg1_oLIN00_537f3cf2_Rx: ComIPduDirection=RECEIVE, ComIPduGroupRef=VCU_oLIN00_Rx_4b9dfc53, ComIPduSignalRef=Vcu_Lin0_RxMsg1_Sig0_oVcu_Lin0_RxMsg1_oLIN00_1b3066fe_Rx, ComIPduSignalRef=Vcu_Lin0_RxMsg1_Sig1_oVcu_Lin0_RxMsg1_oLIN00_bebbf6f0_Rx, ComIPduSignalRef=Vcu_Lin0_RxMsg2_Sig2_oVcu_Lin0_RxMsg1_oLIN00_cff765bb_Rx, ComIPduSignalRef=Vcu_Lin0_RxMsg2_Sig3_oVcu_Lin0_RxMsg1_oLIN00_6a7cf5b5_Rx, ComPduIdRef=EcucPduCollection/Vcu_Lin0_RxMsg1_oLIN00_537f3cf2_Rx
        Vcu_Lin0_RxMsg2_oLIN00_ddf03b11_Rx: ComIPduDirection=RECEIVE, ComIPduGroupRef=VCU_oLIN00_Rx_4b9dfc53, ComIPduSignalRef=Vcu_Lin0_RxMsg2_Sig0_oVcu_Lin0_RxMsg2_oLIN00_d11e4405_Rx, ComIPduSignalRef=Vcu_Lin0_RxMsg2_Sig1_oVcu_Lin0_RxMsg2_oLIN00_7495d40b_Rx, ComIPduSignalRef=Vcu_Lin0_RxMsg2_Sig2_oVcu_Lin0_RxMsg2_oLIN00_41786258_Rx, ComIPduSignalRef=Vcu_Lin0_RxMsg2_Sig3_oVcu_Lin0_RxMsg2_oLIN00_e4f3f256_Rx, ComPduIdRef=EcucPduCollection/Vcu_Lin0_RxMsg2_oLIN00_ddf03b11_Rx
        Vcu_Lin0_TxMsg1_oLIN00_f39ae32f_Tx: ComIPduDirection=SEND, ComIPduGroupRef=VCU_oLIN00_Tx_1dc75bd5, ComIPduSignalRef=Vcu_Lin0_TxMsg1_Sig0_oVcu_Lin0_TxMsg1_oLIN00_7702c350_Tx, ComIPduSignalRef=Vcu_Lin0_TxMsg1_Sig1_oVcu_Lin0_TxMsg1_oLIN00_d289535e_Tx, ComIPduSignalRef=Vcu_Lin0_TxMsg1_Sig2_oVcu_Lin0_TxMsg1_oLIN00_e764e50d_Tx, ComIPduSignalRef=Vcu_Lin0_TxMsg1_Sig3_oVcu_Lin0_TxMsg1_oLIN00_42ef7503_Tx, ComPduIdRef=EcucPduCollection/Vcu_Lin0_TxMsg1_oLIN00_f39ae32f_Tx
          ComTxIPdu: ComTxIPduUnusedAreasDefault=255
        Vcu_Lin0_TxMsg2_oLIN00_7d15e4cc_Tx: ComIPduDirection=SEND, ComIPduGroupRef=VCU_oLIN00_Tx_1dc75bd5, ComIPduSignalRef=Vcu_Lin0_TxMsg2_Sig0_oVcu_Lin0_TxMsg2_oLIN00_bd2ce1ab_Tx, ComIPduSignalRef=Vcu_Lin0_TxMsg2_Sig1_oVcu_Lin0_TxMsg2_oLIN00_18a771a5_Tx, ComIPduSignalRef=Vcu_Lin0_TxMsg2_Sig2_oVcu_Lin0_TxMsg2_oLIN00_2d4ac7f6_Tx, ComIPduSignalRef=Vcu_Lin0_TxMsg2_Sig3_oVcu_Lin0_TxMsg2_oLIN00_88c157f8_Tx, ComPduIdRef=EcucPduCollection/Vcu_Lin0_TxMsg2_oLIN00_7d15e4cc_Tx
          ComTxIPdu: ComTxIPduUnusedAreasDefault=255
      6 x ComIPduGroup:
        VCU_oLIN00_Rx_4b9dfc53
        VCU_oLIN00_Tx_1dc75bd5
        VCU_oTC37X_VCU_CAN00_Rx_a08bac39
        VCU_oTC37X_VCU_CAN00_Tx_f6d10bbf
        VCU_oTC37X_VCU_CAN01_Rx_1837cb5c
        VCU_oTC37X_VCU_CAN01_Tx_4e6d6cda
      80 x ComSignal, all with ComSignalEndianness=LITTLE_ENDIAN, ComSignalInitValue=0:
        EXT10_Valid_oVcuTxIoMsg5_oTC37X_VCU_CAN00_ba532916_Tx: ComBitPosition=48, ComBitSize=16, ComSignalType=UINT16, ComTimeout=0, ComTransferProperty=PENDING, ComSystemTemplateSystemSignalRef=EXT10_Valid
        EXT11_Valid_oVcuTxIoMsg6_oTC37X_VCU_CAN00_d025e36b_Tx: ComBitPosition=16, ComBitSize=16, ComSignalType=UINT16, ComTimeout=0, ComTransferProperty=PENDING, ComSystemTemplateSystemSignalRef=EXT11_Valid
        EXT12_Valid_oVcuTxIoMsg6_oTC37X_VCU_CAN00_8a44dc0b_Tx: ComBitPosition=48, ComBitSize=16, ComSignalType=UINT16, ComTimeout=0, ComTransferProperty=PENDING, ComSystemTemplateSystemSignalRef=EXT12_Valid
        EXT13_Valid_oVcuTxIoMsg7_oTC37X_VCU_CAN00_e5e67df5_Tx: ComBitPosition=16, ComBitSize=16, ComSignalType=UINT16, ComTimeout=0, ComTransferProperty=PENDING, ComSystemTemplateSystemSignalRef=EXT13_Valid
        EXT14_Valid_oVcuTxIoMsg7_oTC37X_VCU_CAN00_d1d4142a_Tx: ComBitPosition=48, ComBitSize=16, ComSignalType=UINT16, ComTimeout=0, ComTransferProperty=PENDING, ComSystemTemplateSystemSignalRef=EXT14_Valid
        EXT15_Valid_oVcuTxIoMsg8_oTC37X_VCU_CAN00_a75ba75d_Tx: ComBitPosition=16, ComBitSize=16, ComSignalType=UINT16, ComTimeout=0, ComTransferProperty=PENDING, ComSystemTemplateSystemSignalRef=EXT15_Valid
        EXT16_Valid_oVcuTxIoMsg8_oTC37X_VCU_CAN00_fd3a983d_Tx: ComBitPosition=48, ComBitSize=16, ComSignalType=UINT16, ComTimeout=0, ComTransferProperty=PENDING, ComSystemTemplateSystemSignalRef=EXT16_Valid
        EXT1_Valid_oVcuTxIoMsg1_oTC37X_VCU_CAN00_caf787ea_Tx: ComBitPosition=16, ComBitSize=16, ComSignalType=UINT16, ComTimeout=0, ComTransferProperty=PENDING, ComSystemTemplateSystemSignalRef=EXT1_Valid
        EXT2_Valid_oVcuTxIoMsg1_oTC37X_VCU_CAN00_9096b88a_Tx: ComBitPosition=48, ComBitSize=16, ComSignalType=UINT16, ComTimeout=0, ComTransferProperty=PENDING, ComSystemTemplateSystemSignalRef=EXT2_Valid
        EXT3_Valid_oVcuTxIoMsg2_oTC37X_VCU_CAN00_fae072f7_Tx: ComBitPosition=16, ComBitSize=16, ComSignalType=UINT16, ComTimeout=0, ComTransferProperty=PENDING, ComSystemTemplateSystemSignalRef=EXT3_Valid
        EXT4_Valid_oVcuTxIoMsg2_oTC37X_VCU_CAN00_ced21b28_Tx: ComBitPosition=48, ComBitSize=16, ComSignalType=UINT16, ComTimeout=0, ComTransferProperty=PENDING, ComSystemTemplateSystemSignalRef=EXT4_Valid
        EXT5_Valid_oVcuTxIoMsg3_oTC37X_VCU_CAN00_a170bad6_Tx: ComBitPosition=16, ComBitSize=16, ComSignalType=UINT16, ComTimeout=0, ComTransferProperty=PENDING, ComSystemTemplateSystemSignalRef=EXT5_Valid
        EXT6_Valid_oVcuTxIoMsg3_oTC37X_VCU_CAN00_fb1185b6_Tx: ComBitPosition=48, ComBitSize=16, ComSignalType=UINT16, ComTimeout=0, ComTransferProperty=PENDING, ComSystemTemplateSystemSignalRef=EXT6_Valid
        EXT7_Valid_oVcuTxIoMsg4_oTC37X_VCU_CAN00_9acf98cd_Tx: ComBitPosition=16, ComBitSize=16, ComSignalType=UINT16, ComTimeout=0, ComTransferProperty=PENDING, ComSystemTemplateSystemSignalRef=EXT7_Valid
        EXT8_Valid_oVcuTxIoMsg4_oTC37X_VCU_CAN00_725b5c6c_Tx: ComBitPosition=48, ComBitSize=16, ComSignalType=UINT16, ComTimeout=0, ComTransferProperty=PENDING, ComSystemTemplateSystemSignalRef=EXT8_Valid
        EXT9_Valid_oVcuTxIoMsg5_oTC37X_VCU_CAN00_1df9fd92_Tx: ComBitPosition=16, ComBitSize=16, ComSignalType=UINT16, ComTimeout=0, ComTransferProperty=PENDING, ComSystemTemplateSystemSignalRef=EXT9_Valid
        EXT_A_IN10_oVcuTxIoMsg5_oTC37X_VCU_CAN00_83e5b725_Tx: ComBitPosition=32, ComBitSize=16, ComSignalType=SINT16, ComTimeout=0, ComTransferProperty=PENDING, ComSystemTemplateSystemSignalRef=EXT_A_IN10
        EXT_A_IN11_oVcuTxIoMsg6_oTC37X_VCU_CAN00_67848296_Tx: ComBitPosition=0, ComBitSize=16, ComSignalType=SINT16, ComTimeout=0, ComTransferProperty=PENDING, ComSystemTemplateSystemSignalRef=EXT_A_IN11
        EXT_A_IN12_oVcuTxIoMsg6_oTC37X_VCU_CAN00_74acbbe5_Tx: ComBitPosition=32, ComBitSize=16, ComSignalType=SINT16, ComTimeout=0, ComTransferProperty=PENDING, ComSystemTemplateSystemSignalRef=EXT_A_IN12
        EXT_A_IN13_oVcuTxIoMsg7_oTC37X_VCU_CAN00_9519e5d5_Tx: ComBitPosition=0, ComBitSize=16, ComSignalType=SINT16, ComTimeout=0, ComTransferProperty=PENDING, ComSystemTemplateSystemSignalRef=EXT_A_IN13
        EXT_A_IN14_oVcuTxIoMsg7_oTC37X_VCU_CAN00_bdae7fe2_Tx: ComBitPosition=32, ComBitSize=16, ComSignalType=SINT16, ComTimeout=0, ComTransferProperty=PENDING, ComSystemTemplateSystemSignalRef=EXT_A_IN14
        EXT_A_IN15_oVcuTxIoMsg8_oTC37X_VCU_CAN00_4536335b_Tx: ComBitPosition=0, ComBitSize=16, ComSignalType=SINT16, ComTimeout=0, ComTransferProperty=PENDING, ComSystemTemplateSystemSignalRef=EXT_A_IN15
        EXT_A_IN16_oVcuTxIoMsg8_oTC37X_VCU_CAN00_561e0a28_Tx: ComBitPosition=32, ComBitSize=16, ComSignalType=SINT16, ComTimeout=0, ComTransferProperty=PENDING, ComSystemTemplateSystemSignalRef=EXT_A_IN16
        EXT_A_IN1_oVcuTxIoMsg1_oTC37X_VCU_CAN00_37348eff_Tx: ComBitPosition=0, ComBitSize=16, ComSignalType=SINT16, ComTimeout=0, ComTransferProperty=PENDING, ComSystemTemplateSystemSignalRef=EXT_A_IN1
        EXT_A_IN2_oVcuTxIoMsg1_oTC37X_VCU_CAN00_241cb78c_Tx: ComBitPosition=32, ComBitSize=16, ComSignalType=SINT16, ComTimeout=0, ComTransferProperty=PENDING, ComSystemTemplateSystemSignalRef=EXT_A_IN2
        EXT_A_IN3_oVcuTxIoMsg2_oTC37X_VCU_CAN00_c07d823f_Tx: ComBitPosition=0, ComBitSize=16, ComSignalType=SINT16, ComTimeout=0, ComTransferProperty=PENDING, ComSystemTemplateSystemSignalRef=EXT_A_IN3
        EXT_A_IN4_oVcuTxIoMsg2_oTC37X_VCU_CAN00_e8ca1808_Tx: ComBitPosition=32, ComBitSize=16, ComSignalType=SINT16, ComTimeout=0, ComTransferProperty=PENDING, ComSystemTemplateSystemSignalRef=EXT_A_IN4
        EXT_A_IN5_oVcuTxIoMsg3_oTC37X_VCU_CAN00_097f4638_Tx: ComBitPosition=0, ComBitSize=16, ComSignalType=SINT16, ComTimeout=0, ComTransferProperty=PENDING, ComSystemTemplateSystemSignalRef=EXT_A_IN5
        EXT_A_IN6_oVcuTxIoMsg3_oTC37X_VCU_CAN00_1a577f4b_Tx: ComBitPosition=32, ComBitSize=16, ComSignalType=SINT16, ComTimeout=0, ComTransferProperty=PENDING, ComSystemTemplateSystemSignalRef=EXT_A_IN6
        EXT_A_IN7_oVcuTxIoMsg4_oTC37X_VCU_CAN00_f59e9dfe_Tx: ComBitPosition=0, ComBitSize=16, ComSignalType=SINT16, ComTimeout=0, ComTransferProperty=PENDING, ComSystemTemplateSystemSignalRef=EXT_A_IN7
        EXT_A_IN8_oVcuTxIoMsg4_oTC37X_VCU_CAN00_aa164141_Tx: ComBitPosition=32, ComBitSize=16, ComSignalType=SINT16, ComTimeout=0, ComTransferProperty=PENDING, ComSystemTemplateSystemSignalRef=EXT_A_IN8
        EXT_A_IN9_oVcuTxIoMsg5_oTC37X_VCU_CAN00_4ba31f71_Tx: ComBitPosition=0, ComBitSize=16, ComSignalType=SINT16, ComTimeout=0, ComTransferProperty=PENDING, ComSystemTemplateSystemSignalRef=EXT_A_IN9
        VcuAdcTxMsg1_Sig0_oVcuAdcTxMsg1_oTC37X_VCU_CAN01_77707e8c_Tx: ComBitPosition=0, ComBitSize=16, ComSignalType=SINT16, ComTimeout=0, ComTransferProperty=PENDING, ComSystemTemplateSystemSignalRef=VcuAdcTxMsg1_Sig0
        VcuAdcTxMsg1_Sig1_oVcuAdcTxMsg1_oTC37X_VCU_CAN01_86aa7b26_Tx: ComBitPosition=16, ComBitSize=16, ComSignalType=SINT16, ComTimeout=0, ComTransferProperty=PENDING, ComSystemTemplateSystemSignalRef=VcuAdcTxMsg1_Sig1
        VcuAdcTxMsg1_Sig2_oVcuAdcTxMsg1_oTC37X_VCU_CAN01_4fb57399_Tx: ComBitPosition=32, ComBitSize=16, ComSignalType=SINT16, ComTimeout=0, ComTransferProperty=PENDING, ComSystemTemplateSystemSignalRef=VcuAdcTxMsg1_Sig2
        VcuAdcTxMsg1_Sig3_oVcuAdcTxMsg1_oTC37X_VCU_CAN01_be6f7633_Tx: ComBitPosition=48, ComBitSize=16, ComSignalType=SINT16, ComTimeout=0, ComTransferProperty=PENDING, ComSystemTemplateSystemSignalRef=VcuAdcTxMsg1_Sig3
        VcuAdcTxMsg2_Sig0_oVcuAdcTxMsg2_oTC37X_VCU_CAN01_c7979c8e_Tx: ComBitPosition=0, ComBitSize=16, ComSignalType=SINT16, ComTimeout=0, ComTransferProperty=PENDING, ComSystemTemplateSystemSignalRef=VcuAdcTxMsg2_Sig0
        VcuAdcTxMsg2_Sig1_oVcuAdcTxMsg2_oTC37X_VCU_CAN01_364d9924_Tx: ComBitPosition=16, ComBitSize=16, ComSignalType=SINT16, ComTimeout=0, ComTransferProperty=PENDING, ComSystemTemplateSystemSignalRef=VcuAdcTxMsg2_Sig1
        VcuAdcTxMsg2_Sig2_oVcuAdcTxMsg2_oTC37X_VCU_CAN01_ff52919b_Tx: ComBitPosition=32, ComBitSize=16, ComSignalType=SINT16, ComTimeout=0, ComTransferProperty=PENDING, ComSystemTemplateSystemSignalRef=VcuAdcTxMsg2_Sig2
        VcuAdcTxMsg2_Sig3_oVcuAdcTxMsg2_oTC37X_VCU_CAN01_0e889431_Tx: ComBitPosition=48, ComBitSize=16, ComSignalType=SINT16, ComTimeout=0, ComTransferProperty=PENDING, ComSystemTemplateSystemSignalRef=VcuAdcTxMsg2_Sig3
        VcuRxMsg1_Sig0_oVcuRxMsg1_oTC37X_VCU_CAN00_13cef464_Rx: ComBitPosition=0, ComBitSize=16, ComSignalType=SINT16, ComTimeout=0, ComSystemTemplateSystemSignalRef=VcuRxMsg1_Sig0
        VcuRxMsg1_Sig1_oVcuRxMsg1_oTC37X_VCU_CAN00_70c92d40_Rx: ComBitPosition=16, ComBitSize=16, ComSignalType=SINT16, ComTimeout=0, ComSystemTemplateSystemSignalRef=VcuRxMsg1_Sig1
        VcuRxMsg1_Sig2_oVcuRxMsg1_oTC37X_VCU_CAN00_d5c1462c_Rx: ComBitPosition=32, ComBitSize=16, ComSignalType=SINT16, ComTimeout=0, ComSystemTemplateSystemSignalRef=VcuRxMsg1_Sig2
        VcuRxMsg1_Sig3_oVcuRxMsg1_oTC37X_VCU_CAN00_b6c69f08_Rx: ComBitPosition=48, ComBitSize=16, ComSignalType=SINT16, ComTimeout=0, ComSystemTemplateSystemSignalRef=VcuRxMsg1_Sig3
        VcuRxMsg2_Sig0_oVcuRxMsg2_oTC37X_VCU_CAN00_94ceda5c_Rx: ComBitPosition=0, ComBitSize=16, ComSignalType=SINT16, ComTimeout=0, ComSystemTemplateSystemSignalRef=VcuRxMsg2_Sig0
        VcuRxMsg2_Sig1_oVcuRxMsg2_oTC37X_VCU_CAN00_f7c90378_Rx: ComBitPosition=16, ComBitSize=16, ComSignalType=SINT16, ComTimeout=0, ComSystemTemplateSystemSignalRef=VcuRxMsg2_Sig1
        VcuRxMsg2_Sig2_oVcuRxMsg2_oTC37X_VCU_CAN00_52c16814_Rx: ComBitPosition=32, ComBitSize=16, ComSignalType=SINT16, ComTimeout=0, ComSystemTemplateSystemSignalRef=VcuRxMsg2_Sig2
        VcuRxMsg2_Sig3_oVcuRxMsg2_oTC37X_VCU_CAN00_31c6b130_Rx: ComBitPosition=48, ComBitSize=16, ComSignalType=SINT16, ComTimeout=0, ComSystemTemplateSystemSignalRef=VcuRxMsg2_Sig3
        VcuRxMsg3_Sig0_oVcuRxMsg3_oTC37X_VCU_CAN01_28190d1d_Rx: ComBitPosition=0, ComBitSize=16, ComSignalType=SINT16, ComTimeout=0, ComSystemTemplateSystemSignalRef=VcuRxMsg3_Sig0
        VcuRxMsg3_Sig1_oVcuRxMsg3_oTC37X_VCU_CAN01_4b1ed439_Rx: ComBitPosition=16, ComBitSize=16, ComSignalType=SINT16, ComTimeout=0, ComSystemTemplateSystemSignalRef=VcuRxMsg3_Sig1
        VcuRxMsg3_Sig2_oVcuRxMsg3_oTC37X_VCU_CAN01_ee16bf55_Rx: ComBitPosition=32, ComBitSize=16, ComSignalType=SINT16, ComTimeout=0, ComSystemTemplateSystemSignalRef=VcuRxMsg3_Sig2
        VcuRxMsg3_Sig3_oVcuRxMsg3_oTC37X_VCU_CAN01_8d116671_Rx: ComBitPosition=48, ComBitSize=16, ComSignalType=SINT16, ComTimeout=0, ComSystemTemplateSystemSignalRef=VcuRxMsg3_Sig3
        VcuRxMsg4_Sig0_oVcuRxMsg4_oTC37X_VCU_CAN01_36b8b0fb_Rx: ComBitPosition=0, ComBitSize=16, ComSignalType=SINT16, ComTimeout=0, ComSystemTemplateSystemSignalRef=VcuRxMsg4_Sig0
        VcuRxMsg4_Sig1_oVcuRxMsg4_oTC37X_VCU_CAN01_55bf69df_Rx: ComBitPosition=16, ComBitSize=16, ComSignalType=SINT16, ComTimeout=0, ComSystemTemplateSystemSignalRef=VcuRxMsg4_Sig1
        VcuRxMsg4_Sig2_oVcuRxMsg4_oTC37X_VCU_CAN01_f0b702b3_Rx: ComBitPosition=32, ComBitSize=16, ComSignalType=SINT16, ComTimeout=0, ComSystemTemplateSystemSignalRef=VcuRxMsg4_Sig2
        VcuRxMsg4_Sig3_oVcuRxMsg4_oTC37X_VCU_CAN01_93b0db97_Rx: ComBitPosition=48, ComBitSize=16, ComSignalType=SINT16, ComTimeout=0, ComSystemTemplateSystemSignalRef=VcuRxMsg4_Sig3
        VcuTxMsg1_Sig0_oVcuTxMsg1_oTC37X_VCU_CAN00_8243b9a9_Tx: ComBitPosition=0, ComBitSize=16, ComSignalType=SINT16, ComTimeout=0, ComTransferProperty=PENDING, ComSystemTemplateSystemSignalRef=VcuTxMsg1_Sig0
        VcuTxMsg1_Sig1_oVcuTxMsg1_oTC37X_VCU_CAN00_e144608d_Tx: ComBitPosition=16, ComBitSize=16, ComSignalType=SINT16, ComTimeout=0, ComTransferProperty=PENDING, ComSystemTemplateSystemSignalRef=VcuTxMsg1_Sig1
        VcuTxMsg1_Sig2_oVcuTxMsg1_oTC37X_VCU_CAN00_444c0be1_Tx: ComBitPosition=32, ComBitSize=16, ComSignalType=SINT16, ComTimeout=0, ComTransferProperty=PENDING, ComSystemTemplateSystemSignalRef=VcuTxMsg1_Sig2
        VcuTxMsg1_Sig3_oVcuTxMsg1_oTC37X_VCU_CAN00_274bd2c5_Tx: ComBitPosition=48, ComBitSize=16, ComSignalType=SINT16, ComTimeout=0, ComTransferProperty=PENDING, ComSystemTemplateSystemSignalRef=VcuTxMsg1_Sig3
        VcuTxMsg2_Sig0_oVcuTxMsg2_oTC37X_VCU_CAN00_05439791_Tx: ComBitPosition=0, ComBitSize=16, ComSignalType=SINT16, ComTimeout=0, ComTransferProperty=PENDING, ComSystemTemplateSystemSignalRef=VcuTxMsg2_Sig0
        VcuTxMsg2_Sig1_oVcuTxMsg2_oTC37X_VCU_CAN00_66444eb5_Tx: ComBitPosition=16, ComBitSize=16, ComSignalType=SINT16, ComTimeout=0, ComTransferProperty=PENDING, ComSystemTemplateSystemSignalRef=VcuTxMsg2_Sig1
        VcuTxMsg2_Sig2_oVcuTxMsg2_oTC37X_VCU_CAN00_c34c25d9_Tx: ComBitPosition=32, ComBitSize=16, ComSignalType=SINT16, ComTimeout=0, ComTransferProperty=PENDING, ComSystemTemplateSystemSignalRef=VcuTxMsg2_Sig2
        VcuTxMsg2_Sig3_oVcuTxMsg2_oTC37X_VCU_CAN00_a04bfcfd_Tx: ComBitPosition=48, ComBitSize=16, ComSignalType=SINT16, ComTimeout=0, ComTransferProperty=PENDING, ComSystemTemplateSystemSignalRef=VcuTxMsg2_Sig3
        Vcu_Lin0_RxMsg1_Sig0_oVcu_Lin0_RxMsg1_oLIN00_1b3066fe_Rx: ComBitPosition=8, ComBitSize=8, ComSignalType=UINT8, ComSystemTemplateSystemSignalRef=Vcu_Lin0_RxMsg1_Sig0
        Vcu_Lin0_RxMsg1_Sig1_oVcu_Lin0_RxMsg1_oLIN00_bebbf6f0_Rx: ComBitPosition=0, ComBitSize=8, ComSignalType=UINT8, ComSystemTemplateSystemSignalRef=Vcu_Lin0_RxMsg1_Sig1
        Vcu_Lin0_RxMsg2_Sig0_oVcu_Lin0_RxMsg2_oLIN00_d11e4405_Rx: ComBitPosition=0, ComBitSize=8, ComSignalType=UINT8, ComSystemTemplateSystemSignalRef=Vcu_Lin0_RxMsg2_Sig0
        Vcu_Lin0_RxMsg2_Sig1_oVcu_Lin0_RxMsg2_oLIN00_7495d40b_Rx: ComBitPosition=8, ComBitSize=8, ComSignalType=UINT8, ComSystemTemplateSystemSignalRef=Vcu_Lin0_RxMsg2_Sig1
        Vcu_Lin0_RxMsg2_Sig2_oVcu_Lin0_RxMsg1_oLIN00_cff765bb_Rx: ComBitPosition=16, ComBitSize=8, ComSignalType=UINT8, ComSystemTemplateSystemSignalRef=Vcu_Lin0_RxMsg2_Sig2
        Vcu_Lin0_RxMsg2_Sig2_oVcu_Lin0_RxMsg2_oLIN00_41786258_Rx: ComBitPosition=16, ComBitSize=8, ComSignalType=UINT8, ComSystemTemplateSystemSignalRef=Vcu_Lin0_RxMsg2_Sig2
        Vcu_Lin0_RxMsg2_Sig3_oVcu_Lin0_RxMsg1_oLIN00_6a7cf5b5_Rx: ComBitPosition=24, ComBitSize=8, ComSignalType=UINT8, ComSystemTemplateSystemSignalRef=Vcu_Lin0_RxMsg2_Sig3
        Vcu_Lin0_RxMsg2_Sig3_oVcu_Lin0_RxMsg2_oLIN00_e4f3f256_Rx: ComBitPosition=32, ComBitSize=8, ComSignalType=UINT8, ComSystemTemplateSystemSignalRef=Vcu_Lin0_RxMsg2_Sig3
        Vcu_Lin0_TxMsg1_Sig0_oVcu_Lin0_TxMsg1_oLIN00_7702c350_Tx: ComBitPosition=0, ComBitSize=8, ComSignalType=UINT8, ComSystemTemplateSystemSignalRef=Vcu_Lin0_TxMsg1_Sig0
        Vcu_Lin0_TxMsg1_Sig1_oVcu_Lin0_TxMsg1_oLIN00_d289535e_Tx: ComBitPosition=8, ComBitSize=8, ComSignalType=UINT8, ComSystemTemplateSystemSignalRef=Vcu_Lin0_TxMsg1_Sig1
        Vcu_Lin0_TxMsg1_Sig2_oVcu_Lin0_TxMsg1_oLIN00_e764e50d_Tx: ComBitPosition=16, ComBitSize=8, ComSignalType=UINT8, ComSystemTemplateSystemSignalRef=Vcu_Lin0_TxMsg1_Sig2
        Vcu_Lin0_TxMsg1_Sig3_oVcu_Lin0_TxMsg1_oLIN00_42ef7503_Tx: ComBitPosition=24, ComBitSize=8, ComSignalType=UINT8, ComSystemTemplateSystemSignalRef=Vcu_Lin0_TxMsg1_Sig3
        Vcu_Lin0_TxMsg2_Sig0_oVcu_Lin0_TxMsg2_oLIN00_bd2ce1ab_Tx: ComBitPosition=0, ComBitSize=8, ComSignalType=UINT8, ComSystemTemplateSystemSignalRef=Vcu_Lin0_TxMsg2_Sig0
        Vcu_Lin0_TxMsg2_Sig1_oVcu_Lin0_TxMsg2_oLIN00_18a771a5_Tx: ComBitPosition=8, ComBitSize=8, ComSignalType=UINT8, ComSystemTemplateSystemSignalRef=Vcu_Lin0_TxMsg2_Sig1
        Vcu_Lin0_TxMsg2_Sig2_oVcu_Lin0_TxMsg2_oLIN00_2d4ac7f6_Tx: ComBitPosition=16, ComBitSize=8, ComSignalType=UINT8, ComSystemTemplateSystemSignalRef=Vcu_Lin0_TxMsg2_Sig2
        Vcu_Lin0_TxMsg2_Sig3_oVcu_Lin0_TxMsg2_oLIN00_88c157f8_Tx: ComBitPosition=24, ComBitSize=8, ComSignalType=UINT8, ComSystemTemplateSystemSignalRef=Vcu_Lin0_TxMsg2_Sig3
    ComGeneral
  module config ComM
    ComMConfigSet: ComMPncEnabled=false
      3 x ComMChannel:
        CN_LIN00_b12a0454: ComMBusType=COMM_BUS_TYPE_LIN, ComMChannelId=2
          ComMNetworkManagement: ComMNmVariant=NONE
          CN_LIN00_8453a76d (ComMUserPerChannel): ComMUserChannel=CN_LIN00_984dfd9e
        CN_TC37X_VCU_CAN00_07b6c9c8: ComMBusType=COMM_BUS_TYPE_CAN, ComMChannelId=0
          ComMNetworkManagement: ComMNmVariant=FULL
          CN_TC37X_VCU_CAN00_cc35f66d (ComMUserPerChannel): ComMUserChannel=CN_TC37X_VCU_CAN00_b1b4f272
        CN_TC37X_VCU_CAN01_70b1f95e: ComMBusType=COMM_BUS_TYPE_CAN, ComMChannelId=1
          ComMNetworkManagement: ComMNmVariant=FULL
          CN_TC37X_VCU_CAN01_a952cd2b (ComMUserPerChannel): ComMUserChannel=CN_TC37X_VCU_CAN01_5e76994c
      3 x ComMUser:
        CN_LIN00_984dfd9e: ComMUserIdentifier=2
        CN_TC37X_VCU_CAN00_b1b4f272: ComMUserIdentifier=0
        CN_TC37X_VCU_CAN01_5e76994c: ComMUserIdentifier=1
    ComMGeneral: ComMPncIdCounting=COMM_PNC_ID_COUNT_FROM_NM_MESSAGE, ComMPncSupport=false
  module config Dcm
    DcmConfigSet  # Diagnostics Data Import
      DcmDsl
        DcmDslProtocol
          DcmDslProtocolRow_29812fbf (DcmDslProtocolRow)
            DcmDslConnection_15e709a3 (DcmDslConnection)
              DcmDslMainConnection_f109a58a (DcmDslMainConnection)
                Vcu_Uds_Func_Request_oTC37X_VCU_CAN00_21e26bac_Rx_f99a7a58 (DcmDslProtocolRx):
                  DcmDslProtocolRxAddrType = DCM_FUNCTIONAL_TYPE
                  DcmDslProtocolRxPduId = 1
                  DcmDslProtocolRxComMChannelRef = ComMConfigSet/CN_TC37X_VCU_CAN00_07b6c9c8
                  DcmDslProtocolRxPduRef = Vcu_Uds_Func_Request_oTC37X_VCU_CAN00_21e26bac_Rx
                Vcu_Uds_Phy_Request_oTC37X_VCU_CAN00_d561dcee_Rx_7ba0ca16 (DcmDslProtocolRx):
                  DcmDslProtocolRxAddrType = DCM_PHYSICAL_TYPE
                  DcmDslProtocolRxPduId = 2
                  DcmDslProtocolRxComMChannelRef = ComMConfigSet/CN_TC37X_VCU_CAN00_07b6c9c8
                  DcmDslProtocolRxPduRef = Vcu_Uds_Phy_Request_oTC37X_VCU_CAN00_d561dcee_Rx
                Vcu_Uds_Response_oTC37X_VCU_CAN00_4d111be6_Tx_666acd3e (DcmDslProtocolTx): DcmDslTxConfirmationPduId=0, DcmDslProtocolTxPduRef=EcucPduCollection/Vcu_Uds_Response_oTC37X_VCU_CAN00_4d111be6_Tx
      DcmDsp: DcmDspMaxDidToRead=5  # Diagnostics Data Import
        ComControl (DcmDspComControl)  # Diagnostics Data Import
          DspComContolAllChannel (DcmDspComControlAllChannel)  # Diagnostics Data Import
        DcmDspSession  # Diagnostics Data Import
          3 x DcmDspSessionRow, all with DcmDspSessionP2ServerMax=0.05, DcmDspSessionP2StarServerMax=5:
            Extended: DcmDspSessionLevel=3, DcmDspSessionForBoot=DCM_NO_BOOT  # Diagnostics Data Import
            Programming: DcmDspSessionLevel=2  # Diagnostics Data Import
            Default: DcmDspSessionLevel=1, DcmDspSessionForBoot=DCM_NO_BOOT  # Diagnostics Data Import
        DcmDspSecurity  # Diagnostics Data Import
          Level_3 (DcmDspSecurityRow):  # Diagnostics Data Import
            DcmDspSecurityDelayTime = 10
            DcmDspSecurityDelayTimeOnBoot = 0
            DcmDspSecurityKeySize = 2
            DcmDspSecurityLevel = 2
            DcmDspSecurityNumAttDelay = 3
            DcmDspSecuritySeedSize = 2
          UnlockedL1 (DcmDspSecurityRow):  # Diagnostics Data Import
            DcmDspSecurityDelayTime = 10
            DcmDspSecurityDelayTimeOnBoot = 0
            DcmDspSecurityKeySize = 4
            DcmDspSecurityLevel = 1
            DcmDspSecurityNumAttDelay = 3
            DcmDspSecuritySeedSize = 4
        3 x DcmDspRoutineInfo:
          RoutineInfo_Vcu_Roution_00  # Diagnostics Data Import
            DcmDspRoutineRequestResOut  # Diagnostics Data Import
              Out_New_Data_Object (DcmDspRoutineRequestResOutSignal): DcmDspRoutineSignalLength=16, DcmDspRoutineSignalType=UINT16, DcmDspRoutineSignalEndianness=BIG_ENDIAN, DcmDspRoutineSignalPos=0  # Diagnostics Data Import
            DcmDspRoutineStopOut  # Diagnostics Data Import
              Out_New_Data_Object (DcmDspRoutineStopOutSignal): DcmDspRoutineSignalLength=16, DcmDspRoutineSignalType=UINT16, DcmDspRoutineSignalEndianness=BIG_ENDIAN, DcmDspRoutineSignalPos=0  # Diagnostics Data Import
            DcmDspRoutineStopIn  # Diagnostics Data Import
              In_New_Data_Object (DcmDspRoutineStopInSignal): DcmDspRoutineSignalLength=16, DcmDspRoutineSignalType=UINT16, DcmDspRoutineSignalEndianness=BIG_ENDIAN, DcmDspRoutineSignalPos=0  # Diagnostics Data Import
            DcmDspStartRoutineOut  # Diagnostics Data Import
              Out_New_Data_Object (DcmDspStartRoutineOutSignal): DcmDspRoutineSignalLength=16, DcmDspRoutineSignalType=UINT16, DcmDspRoutineSignalEndianness=BIG_ENDIAN, DcmDspRoutineSignalPos=0  # Diagnostics Data Import
            DcmDspStartRoutineIn  # Diagnostics Data Import
              In_New_Data_Object (DcmDspStartRoutineInSignal): DcmDspRoutineSignalLength=16, DcmDspRoutineSignalType=UINT16, DcmDspRoutineSignalEndianness=BIG_ENDIAN, DcmDspRoutineSignalPos=0  # Diagnostics Data Import
            DcmDspRoutineAuthorization: DcmDspRoutineSessionRef=DcmDspSession/Programming, DcmDspRoutineSessionRef=DcmDspSession/Extended  # Diagnostics Data Import
          RoutineInfo_SampleRoutineControl_StartOnly  # Diagnostics Data Import
            DcmDspRoutineRequestResOut  # Diagnostics Data Import
              Out_Result (DcmDspRoutineRequestResOutSignal): DcmDspRoutineSignalLength=32, DcmDspRoutineSignalType=UINT32, DcmDspRoutineSignalEndianness=BIG_ENDIAN, DcmDspRoutineSignalPos=0  # Diagnostics Data Import
            DcmDspStartRoutineIn  # Diagnostics Data Import
              In_Option1 (DcmDspStartRoutineInSignal): DcmDspRoutineSignalLength=24, DcmDspRoutineSignalType=UINT8_N, DcmDspRoutineSignalEndianness=opaque, DcmDspRoutineSignalPos=0  # Diagnostics Data Import
            DcmDspRoutineAuthorization: DcmDspRoutineSessionRef=DcmDspSession/Programming, DcmDspRoutineSessionRef=DcmDspSession/Extended  # Diagnostics Data Import
          RoutineInfo_SampleRoutineControl  # Diagnostics Data Import
            DcmDspRoutineRequestResOut  # Diagnostics Data Import
              Out_Result (DcmDspRoutineRequestResOutSignal): DcmDspRoutineSignalLength=16, DcmDspRoutineSignalType=UINT16, DcmDspRoutineSignalEndianness=BIG_ENDIAN, DcmDspRoutineSignalPos=0  # Diagnostics Data Import
            DcmDspRoutineStopOut  # Diagnostics Data Import
              Out_StopState (DcmDspRoutineStopOutSignal): DcmDspRoutineSignalLength=32, DcmDspRoutineSignalType=UINT32, DcmDspRoutineSignalEndianness=BIG_ENDIAN, DcmDspRoutineSignalPos=0  # Diagnostics Data Import
            DcmDspStartRoutineOut  # Diagnostics Data Import
              Out_InitState (DcmDspStartRoutineOutSignal): DcmDspRoutineSignalLength=32, DcmDspRoutineSignalType=UINT32, DcmDspRoutineSignalEndianness=BIG_ENDIAN, DcmDspRoutineSignalPos=0  # Diagnostics Data Import
            DcmDspStartRoutineIn  # Diagnostics Data Import
              In_Option0 (DcmDspStartRoutineInSignal): DcmDspRoutineSignalLength=8, DcmDspRoutineSignalType=UINT8, DcmDspRoutineSignalPos=0  # Diagnostics Data Import
            DcmDspRoutineAuthorization: DcmDspRoutineSessionRef=DcmDspSession/Programming, DcmDspRoutineSessionRef=DcmDspSession/Extended  # Diagnostics Data Import
        3 x DcmDspRoutine, all with DcmDspRequestResultsRoutineSupported=true:
          Vcu_Roution_00: DcmDspStopRoutineSupported=true, DcmDspRoutineIdentifier=261, DcmDspRoutineInfoRef=RoutineInfo_Vcu_Roution_00  # Diagnostics Data Import
          SampleRoutineControl_StartOnly: DcmDspStopRoutineSupported=false, DcmDspRoutineIdentifier=260, DcmDspRoutineInfoRef=RoutineInfo_SampleRoutineControl_StartOnly  # Diagnostics Data Import
          SampleRoutineControl: DcmDspStopRoutineSupported=true, DcmDspRoutineIdentifier=256, DcmDspRoutineInfoRef=RoutineInfo_SampleRoutineControl  # Diagnostics Data Import
        10 x DcmDspDidInfo:
          DidInfo_SampleDynamicallyDefinedNonPeriodicDID: DcmDspDidDynamicallyDefined=true  # Diagnostics Data Import
            DcmDspDidAccess  # Diagnostics Data Import
              DcmDspDidDefine: DcmDspDDDidMaxElements=5  # Diagnostics Data Import
              DcmDspDidRead  # Diagnostics Data Import
          DidInfo_Hardware_Version  # Diagnostics Data Import
            DcmDspDidAccess  # Diagnostics Data Import
              DcmDspDidWrite  # Diagnostics Data Import
              DcmDspDidRead  # Diagnostics Data Import
          DidInfo_Vehicle_Identification  # Diagnostics Data Import
            DcmDspDidAccess  # Diagnostics Data Import
              DcmDspDidWrite  # Diagnostics Data Import
              DcmDspDidRead  # Diagnostics Data Import
          DidInfo_SerialNumber  # Diagnostics Data Import
            DcmDspDidAccess  # Diagnostics Data Import
              DcmDspDidWrite  # Diagnostics Data Import
              DcmDspDidRead  # Diagnostics Data Import
          DidInfo_EcuIdentification  # Diagnostics Data Import
            DcmDspDidAccess  # Diagnostics Data Import
              DcmDspDidWrite  # Diagnostics Data Import
              DcmDspDidRead  # Diagnostics Data Import
          DidInfo_Spare_Part_Number  # Diagnostics Data Import
            DcmDspDidAccess  # Diagnostics Data Import
              DcmDspDidWrite  # Diagnostics Data Import
              DcmDspDidRead  # Diagnostics Data Import
          DidInfo_Boot_Software  # Diagnostics Data Import
            DcmDspDidAccess  # Diagnostics Data Import
              DcmDspDidWrite  # Diagnostics Data Import
              DcmDspDidRead  # Diagnostics Data Import
          DidInfo_VCU_DID_00  # Diagnostics Data Import
            DcmDspDidAccess  # Diagnostics Data Import
              DcmDspDidWrite  # Diagnostics Data Import
              DcmDspDidRead  # Diagnostics Data Import
          DidInfo_DataDiagnosticIdentifier_DID  # Diagnostics Data Import
            DcmDspDidAccess  # Diagnostics Data Import
              DcmDspDidWrite  # Diagnostics Data Import
              DcmDspDidRead  # Diagnostics Data Import
          DidInfo_DevelopmentData  # Diagnostics Data Import
            DcmDspDidAccess  # Diagnostics Data Import
              DcmDspDidWrite  # Diagnostics Data Import
              DcmDspDidRead  # Diagnostics Data Import
        10 x DcmDspDid:
          SampleDynamicallyDefinedNonPeriodicDID: DcmDspDidIdentifier=62208, DcmDspDidInfoRef=DidInfo_SampleDynamicallyDefinedNonPeriodicDID  # Diagnostics Data Import
          Hardware_Version: DcmDspDidIdentifier=61843, DcmDspDidInfoRef=DidInfo_Hardware_Version  # Diagnostics Data Import
            Hardware_Version_Number (DcmDspDidSignal): DcmDspDidDataPos=0, DcmDspDidDataRef=Hardware_Version_Hardware_Version_Number  # Diagnostics Data Import
          Vehicle_Identification: DcmDspDidIdentifier=61840, DcmDspDidInfoRef=DidInfo_Vehicle_Identification  # Diagnostics Data Import
            VIN (DcmDspDidSignal): DcmDspDidDataPos=0, DcmDspDidDataRef=Vehicle_Identification_VIN  # Diagnostics Data Import
          SerialNumber: DcmDspDidIdentifier=61836, DcmDspDidInfoRef=DidInfo_SerialNumber  # Diagnostics Data Import
            SerialNumber (DcmDspDidSignal): DcmDspDidDataPos=0, DcmDspDidDataRef=SerialNumber_SerialNumber  # Diagnostics Data Import
          EcuIdentification: DcmDspDidIdentifier=61833, DcmDspDidInfoRef=DidInfo_EcuIdentification  # Diagnostics Data Import
            Part_Number (DcmDspDidSignal): DcmDspDidDataPos=0, DcmDspDidDataRef=EcuIdentification_Part_Number  # Diagnostics Data Import
          Spare_Part_Number: DcmDspDidIdentifier=61831, DcmDspDidInfoRef=DidInfo_Spare_Part_Number  # Diagnostics Data Import
            Spare_Part_Number (DcmDspDidSignal): DcmDspDidDataPos=0, DcmDspDidDataRef=Spare_Part_Number_Spare_Part_Number  # Diagnostics Data Import
          Boot_Software: DcmDspDidIdentifier=61824, DcmDspDidInfoRef=DidInfo_Boot_Software  # Diagnostics Data Import
            Boot_Software_Identification (DcmDspDidSignal): DcmDspDidDataPos=8, DcmDspDidDataRef=Boot_Software_Boot_Software_Identification  # Diagnostics Data Import
            NumberOfModules (DcmDspDidSignal): DcmDspDidDataPos=0, DcmDspDidDataRef=Boot_Software_NumberOfModules  # Diagnostics Data Import
          VCU_DID_00: DcmDspDidIdentifier=4132, DcmDspDidInfoRef=DidInfo_VCU_DID_00  # Diagnostics Data Import
            DataRecord (DcmDspDidSignal): DcmDspDidDataPos=0, DcmDspDidDataRef=VCU_DID_00_DataRecord  # Diagnostics Data Import
          DataDiagnosticIdentifier_DID: DcmDspDidIdentifier=257, DcmDspDidInfoRef=DidInfo_DataDiagnosticIdentifier_DID  # Diagnostics Data Import
            DataDiagnosticIdentifier (DcmDspDidSignal): DcmDspDidDataPos=0, DcmDspDidDataRef=DataDiagnosticIdentifier_DID_DataDiagnosticIdentifier  # Diagnostics Data Import
          DevelopmentData: DcmDspDidIdentifier=256, DcmDspDidInfoRef=DidInfo_DevelopmentData  # Diagnostics Data Import
            5 x DcmDspDidSignal:
              TransportLayerVersion: DcmDspDidDataPos=64, DcmDspDidDataRef=DevelopmentData_TransportLayerVersion  # Diagnostics Data Import
              DiagnosticModuleVersion: DcmDspDidDataPos=48, DcmDspDidDataRef=DevelopmentData_DiagnosticModuleVersion  # Diagnostics Data Import
              NmVersion: DcmDspDidDataPos=32, DcmDspDidDataRef=DevelopmentData_NmVersion  # Diagnostics Data Import
              CanDriverVersion: DcmDspDidDataPos=16, DcmDspDidDataRef=DevelopmentData_CanDriverVersion  # Diagnostics Data Import
              OperatingSystemVersion: DcmDspDidDataPos=0, DcmDspDidDataRef=DevelopmentData_OperatingSystemVersion  # Diagnostics Data Import
        DataInfo_Hardware_Version_Hardware_Version_Number (DcmDspDataInfo): DcmDspDataFixedLength=true  # Diagnostics Data Import
        Hardware_Version_Hardware_Version_Number (DcmDspData): DcmDspDataSize=32, DcmDspDataType=UINT32, DcmDspDataInfoRef=DataInfo_Hardware_Version_Hardware_Version_Number  # Diagnostics Data Import
        DataInfo_Vehicle_Identification_VIN (DcmDspDataInfo): DcmDspDataFixedLength=true  # Diagnostics Data Import
        Vehicle_Identification_VIN (DcmDspData): DcmDspDataSize=136, DcmDspDataType=UINT8_N, DcmDspDataInfoRef=DataInfo_Vehicle_Identification_VIN  # Diagnostics Data Import
        DataInfo_SerialNumber_SerialNumber (DcmDspDataInfo): DcmDspDataFixedLength=true  # Diagnostics Data Import
        SerialNumber_SerialNumber (DcmDspData): DcmDspDataSize=32, DcmDspDataType=UINT32, DcmDspDataInfoRef=DataInfo_SerialNumber_SerialNumber  # Diagnostics Data Import
        DataInfo_EcuIdentification_Part_Number (DcmDspDataInfo): DcmDspDataFixedLength=true  # Diagnostics Data Import
        EcuIdentification_Part_Number (DcmDspData): DcmDspDataSize=104, DcmDspDataType=UINT8_N, DcmDspDataInfoRef=DataInfo_EcuIdentification_Part_Number  # Diagnostics Data Import
        DataInfo_Spare_Part_Number_Spare_Part_Number (DcmDspDataInfo): DcmDspDataFixedLength=true  # Diagnostics Data Import
        Spare_Part_Number_Spare_Part_Number (DcmDspData): DcmDspDataSize=32, DcmDspDataType=UINT32, DcmDspDataInfoRef=DataInfo_Spare_Part_Number_Spare_Part_Number  # Diagnostics Data Import
        DataInfo_Boot_Software_Boot_Software_Identification (DcmDspDataInfo): DcmDspDataFixedLength=true  # Diagnostics Data Import
        Boot_Software_Boot_Software_Identification (DcmDspData): DcmDspDataSize=32, DcmDspDataType=UINT32, DcmDspDataInfoRef=DataInfo_Boot_Software_Boot_Software_Identification  # Diagnostics Data Import
        DataInfo_Boot_Software_NumberOfModules (DcmDspDataInfo): DcmDspDataFixedLength=true  # Diagnostics Data Import
        Boot_Software_NumberOfModules (DcmDspData): DcmDspDataSize=8, DcmDspDataType=UINT8, DcmDspDataInfoRef=DataInfo_Boot_Software_NumberOfModules  # Diagnostics Data Import
        DataInfo_VCU_DID_00_DataRecord (DcmDspDataInfo): DcmDspDataFixedLength=true  # Diagnostics Data Import
        VCU_DID_00_DataRecord (DcmDspData): DcmDspDataSize=32, DcmDspDataType=UINT32, DcmDspDataInfoRef=DataInfo_VCU_DID_00_DataRecord  # Diagnostics Data Import
        DataInfo_DataDiagnosticIdentifier_DID_DataDiagnosticIdentifier (DcmDspDataInfo): DcmDspDataFixedLength=true  # Diagnostics Data Import
        DataDiagnosticIdentifier_DID_DataDiagnosticIdentifier (DcmDspData): DcmDspDataSize=16, DcmDspDataType=UINT16, DcmDspDataInfoRef=DataInfo_DataDiagnosticIdentifier_DID_DataDiagnosticIdentifier  # Diagnostics Data Import
        DataInfo_DevelopmentData_TransportLayerVersion (DcmDspDataInfo): DcmDspDataFixedLength=true  # Diagnostics Data Import
        DevelopmentData_TransportLayerVersion (DcmDspData): DcmDspDataSize=16, DcmDspDataType=UINT16, DcmDspDataInfoRef=DataInfo_DevelopmentData_TransportLayerVersion  # Diagnostics Data Import
        DataInfo_DevelopmentData_DiagnosticModuleVersion (DcmDspDataInfo): DcmDspDataFixedLength=true  # Diagnostics Data Import
        DevelopmentData_DiagnosticModuleVersion (DcmDspData): DcmDspDataSize=16, DcmDspDataType=UINT16, DcmDspDataInfoRef=DataInfo_DevelopmentData_DiagnosticModuleVersion  # Diagnostics Data Import
        DataInfo_DevelopmentData_NmVersion (DcmDspDataInfo): DcmDspDataFixedLength=true  # Diagnostics Data Import
        DevelopmentData_NmVersion (DcmDspData): DcmDspDataSize=16, DcmDspDataType=UINT16, DcmDspDataInfoRef=DataInfo_DevelopmentData_NmVersion  # Diagnostics Data Import
        DataInfo_DevelopmentData_CanDriverVersion (DcmDspDataInfo): DcmDspDataFixedLength=true  # Diagnostics Data Import
        DevelopmentData_CanDriverVersion (DcmDspData): DcmDspDataSize=16, DcmDspDataType=UINT16, DcmDspDataInfoRef=DataInfo_DevelopmentData_CanDriverVersion  # Diagnostics Data Import
        DataInfo_DevelopmentData_OperatingSystemVersion (DcmDspDataInfo): DcmDspDataFixedLength=true  # Diagnostics Data Import
        DevelopmentData_OperatingSystemVersion (DcmDspData): DcmDspDataSize=16, DcmDspDataType=UINT16, DcmDspDataInfoRef=DataInfo_DevelopmentData_OperatingSystemVersion  # Diagnostics Data Import
      DcmDsd  # Diagnostics Data Import
        DcmDsdServiceTable  # Diagnostics Data Import
          14 x DcmDsdService:
            ControlDtcSetting: DcmDsdSidTabServiceId=133, DcmDsdSidTabSubfuncAvail=true  # Diagnostics Data Import
              Disable (DcmDsdSubService): DcmDsdSubServiceId=2  # Diagnostics Data Import
              Enable (DcmDsdSubService): DcmDsdSubServiceId=1  # Diagnostics Data Import
            TesterPresent: DcmDsdSidTabServiceId=62, DcmDsdSidTabSubfuncAvail=true  # Diagnostics Data Import
              TesterPresent (DcmDsdSubService): DcmDsdSubServiceId=0  # Diagnostics Data Import
            WriteMemoryByAddress: DcmDsdSidTabServiceId=61, DcmDsdSidTabSubfuncAvail=false  # Diagnostics Data Import
            RoutineControl: DcmDsdSidTabServiceId=49, DcmDsdSidTabSubfuncAvail=true, DcmDsdSidTabSessionLevelRef=DcmDspSession/Programming, DcmDsdSidTabSessionLevelRef=DcmDspSession/Extended  # Diagnostics Data Import
            WriteDataById: DcmDsdSidTabServiceId=46, DcmDsdSidTabSubfuncAvail=false  # Diagnostics Data Import
            DynamicallyDefineDataId: DcmDsdSidTabServiceId=44, DcmDsdSidTabSubfuncAvail=true  # Diagnostics Data Import
              3 x DcmDsdSubService:
                DynDefClr: DcmDsdSubServiceId=3  # Diagnostics Data Import
                DynDefByAddr: DcmDsdSubServiceId=2  # Diagnostics Data Import
                DynDefById: DcmDsdSubServiceId=1  # Diagnostics Data Import
            CommunicationControl: DcmDsdSidTabServiceId=40, DcmDsdSidTabSubfuncAvail=true, DcmDsdSidTabSessionLevelRef=DcmDspSession/Programming, DcmDsdSidTabSessionLevelRef=DcmDspSession/Extended  # Diagnostics Data Import
              4 x DcmDsdSubService, all with DcmDsdSubServiceSessionLevelRef=DcmDspSession/Programming, DcmDsdSubServiceSessionLevelRef=DcmDspSession/Extended:
                DisableRxAndTx: DcmDsdSubServiceId=3  # Diagnostics Data Import
                DisableRxAndEnableTx: DcmDsdSubServiceId=2  # Diagnostics Data Import
                EnableRxAndDisableTx: DcmDsdSubServiceId=1  # Diagnostics Data Import
                EnableRxAndTx: DcmDsdSubServiceId=0  # Diagnostics Data Import
            SecurityAccess: DcmDsdSidTabServiceId=39, DcmDsdSidTabSubfuncAvail=true, DcmDsdSidTabSessionLevelRef=DcmDspSession/Programming, DcmDsdSidTabSessionLevelRef=DcmDspSession/Extended  # Diagnostics Data Import
              4 x DcmDsdSubService, all with DcmDsdSubServiceSessionLevelRef=DcmDspSession/Programming, DcmDsdSubServiceSessionLevelRef=DcmDspSession/Extended:
                sendKey_Send: DcmDsdSubServiceId=4  # Diagnostics Data Import
                requestSeed_Request: DcmDsdSubServiceId=3  # Diagnostics Data Import
                KeyLevel1_Send: DcmDsdSubServiceId=2  # Diagnostics Data Import
                SeedLevel1_Request: DcmDsdSubServiceId=1  # Diagnostics Data Import
            ReadMemoryByAddress: DcmDsdSidTabServiceId=35, DcmDsdSidTabSubfuncAvail=false  # Diagnostics Data Import
            ReadDataById: DcmDsdSidTabServiceId=34, DcmDsdSidTabSubfuncAvail=false  # Diagnostics Data Import
            ReadDtcInfo: DcmDsdSidTabServiceId=25, DcmDsdSidTabSubfuncAvail=true  # Diagnostics Data Import
              12 x DcmDsdSubService:
                RDTCFDC: DcmDsdSubServiceId=20  # Diagnostics Data Import
                RMRTFDTC: DcmDsdSubServiceId=13  # Diagnostics Data Import
                RFCDTC: DcmDsdSubServiceId=12  # Diagnostics Data Import
                RSUPDTC: DcmDsdSubServiceId=10  # Diagnostics Data Import
                RSIODTC: DcmDsdSubServiceId=9  # Diagnostics Data Import
                RDTCBSMR: DcmDsdSubServiceId=8  # Diagnostics Data Import
                RNODTCBSMR: DcmDsdSubServiceId=7  # Diagnostics Data Import
                RDTCEDRBDN: DcmDsdSubServiceId=6  # Diagnostics Data Import
                RDTCSSBDTC: DcmDsdSubServiceId=4  # Diagnostics Data Import
                RDTCSSI: DcmDsdSubServiceId=3  # Diagnostics Data Import
                RDTCBSM: DcmDsdSubServiceId=2  # Diagnostics Data Import
                RNODTCBSM: DcmDsdSubServiceId=1  # Diagnostics Data Import
            ClearDiagInfo: DcmDsdSidTabServiceId=20, DcmDsdSidTabSubfuncAvail=false  # Diagnostics Data Import
            EcuReset: DcmDsdSidTabServiceId=17, DcmDsdSidTabSubfuncAvail=true  # Diagnostics Data Import
              Hard (DcmDsdSubService): DcmDsdSubServiceId=1  # Diagnostics Data Import
            DiagSessionControl: DcmDsdSidTabServiceId=16, DcmDsdSidTabSubfuncAvail=true  # Diagnostics Data Import
              3 x DcmDsdSubService:
                Extended: DcmDsdSubServiceId=3  # Diagnostics Data Import
                Programming: DcmDsdSubServiceId=2  # Diagnostics Data Import
                Default: DcmDsdSubServiceId=1  # Diagnostics Data Import
      DcmGeneral: DcmResetToFblAfterSessionFinalResponseEnabled=false  # Diagnostics Data Import
  module config Dem
    DemGeneral:  # Diagnostics Data Import
      DemAgingCycleCounterProcessing = DEM_PROCESS_AGINGCTR_INTERN
      DemDebounceCounterBasedSupport = true
      DemPTOSupport = false
      DemDtcStatusAvailabilityMask = 255
      DemTypeOfFreezeFrameRecordNumeration = DEM_FF_RECNUM_CALCULATED
      OccurrenceCounter_Occurrence_Counter (DemDataClass): DemDataElementDataSize=1, DemDataElementInternalData=DEM_OCCCTR, DemDataElementUsePort=USE_DATA_INTERNAL  # Diagnostics Data Import
      4 x DemOperationCycle:
        WarmUpCycle: DemOperationCycleType=DEM_OPCYC_WARMUP  # Diagnostics Data Import
        PowerCycle: DemOperationCycleType=DEM_OPCYC_POWER  # Diagnostics Data Import
        OBDDrivingCycle: DemOperationCycleType=DEM_OPCYC_OBD_DCY  # Diagnostics Data Import
        IgnitionCycle: DemOperationCycleType=DEM_OPCYC_IGNITION  # Diagnostics Data Import
      WarningIndicator (DemIndicator)  # Diagnostics Data Import
      OccurrenceCounter (DemExtendedDataRecordClass): DemExtendedDataRecordNumber=1, DemDataClassRef=OccurrenceCounter_Occurrence_Counter  # Diagnostics Data Import
      ExtendedDataClass_83dcefb7 (DemExtendedDataClass): DemExtendedDataRecordClassRef=OccurrenceCounter  # Diagnostics Data Import
    DemConfigSet  # Diagnostics Data Import
      DTC_0x000003 (DemEventParameter): DemEventKind=DEM_EVENT_KIND_SWC, DemDTCClassRef=DTCClass_DTC_0x000003, DemExtendedDataClassRef=ExtendedDataClass_83dcefb7  # Diagnostics Data Import
        DemEventClass:  # Diagnostics Data Import
          DemAgingAllowed = true
          DemAgingCycleCounterThreshold = 40
          DemEventDestination = DEM_DTC_ORIGIN_PRIMARY_MEMORY
          DemEventPriority = 1
          DemEventSignificance = DEM_EVENT_SIGNIFICANCE_FAULT
          DemEventFailureCycleCounterThreshold = 2
          DemAgingCycleRef = WarmUpCycle
          DemOperationCycleRef = OBDDrivingCycle
          IndicatorAttribute_WarningIndicator (DemIndicatorAttribute): DemIndicatorFailureCycleSource=DEM_FAILURE_CYCLE_EVENT, DemIndicatorHealingCycleRef=OBDDrivingCycle, DemIndicatorRef=WarningIndicator  # Diagnostics Data Import
          DemDebounceAlgorithmClass  # Diagnostics Data Import
            DemDebounceCounterBased: DemDebounceCounterDecrementStepSize=1, DemDebounceCounterIncrementStepSize=1, DemDebounceCounterJumpDown=false, DemDebounceCounterJumpUp=true  # Diagnostics Data Import
      DTCClass_DTC_0x000003 (DemDTCClass): DemDTCSeverity=DEM_DTC_SEV_NO_SEVERITY, DemUdsDTC=3  # Diagnostics Data Import
      DTC_0x000002 (DemEventParameter): DemEventKind=DEM_EVENT_KIND_SWC, DemDTCClassRef=DTCClass_DTC_0x000002, DemExtendedDataClassRef=ExtendedDataClass_83dcefb7  # Diagnostics Data Import
        DemEventClass:  # Diagnostics Data Import
          DemAgingAllowed = false
          DemAgingCycleCounterThreshold = 100
          DemEventDestination = DEM_DTC_ORIGIN_PRIMARY_MEMORY
          DemEventPriority = 2
          DemEventSignificance = DEM_EVENT_SIGNIFICANCE_FAULT
          DemEventFailureCycleCounterThreshold = 0
          DemAgingCycleRef = IgnitionCycle
          DemOperationCycleRef = PowerCycle
          IndicatorAttribute_WarningIndicator (DemIndicatorAttribute): DemIndicatorFailureCycleSource=DEM_FAILURE_CYCLE_EVENT, DemIndicatorHealingCycleRef=PowerCycle, DemIndicatorRef=WarningIndicator  # Diagnostics Data Import
          DemDebounceAlgorithmClass  # Diagnostics Data Import
            DemDebounceCounterBased: DemDebounceCounterDecrementStepSize=1, DemDebounceCounterIncrementStepSize=1, DemDebounceCounterJumpDown=false, DemDebounceCounterJumpUp=true  # Diagnostics Data Import
        DemCallbackInitMForE  # Diagnostics Data Import
      DTCClass_DTC_0x000002 (DemDTCClass): DemDTCSeverity=DEM_DTC_SEV_NO_SEVERITY, DemUdsDTC=2  # Diagnostics Data Import
  module config EcuC
    EcucPduCollection: PduIdTypeEnum=UINT8, PduLengthTypeEnum=UINT8
      63 x Pdu:
        MasterReq_GWM_oLIN00_7f4744d7_Tx: DynamicLength=true, PduLength=8
        MasterReq_GWM_oLIN00_fcc15022_Tx: DynamicLength=true, PduLength=8
        MasterReq_Tp_oLIN00_7147b638_Tx: DynamicLength=false, PduLength=8, SysTPduToFrameMappingRef=MasterReq_Tp
        MasterReq_oLIN00_3234fe1b_Tx: DynamicLength=true, PduLength=8
        MasterReq_oLIN00_4a2bb011_Tx: DynamicLength=true, PduLength=8
        SlaveResp_GWM_oLIN00_43535e69_Rx: DynamicLength=true, PduLength=8
        SlaveResp_GWM_oLIN00_87807674_Rx: DynamicLength=true, PduLength=8
        SlaveResp_Tp_oLIN00_3328eb0b_Rx: DynamicLength=false, PduLength=8, SysTPduToFrameMappingRef=SlaveResp_Tp
        VCU_Rx_500h_NM_oTC37X_VCU_CAN00_c4b96e15_Rx: DynamicLength=false, PduLength=8, SysTPduToFrameMappingRef=VCU_Rx_500h_NM
        VCU_Rx_500h_NM_oTC37X_VCU_CAN01_54a3f814_Rx: DynamicLength=false, PduLength=8, SysTPduToFrameMappingRef=VCU_Rx_500h_NM
        VCU_Tx_51Ch_NM_oTC37X_VCU_CAN00_0aa0ce62_Tx: DynamicLength=false, PduLength=8, SysTPduToFrameMappingRef=VCU_Tx_51Ch_NM
        VCU_Tx_51Ch_NM_oTC37X_VCU_CAN01_9aba5863_Tx: DynamicLength=false, PduLength=8, SysTPduToFrameMappingRef=VCU_Tx_51Ch_NM
        VcuAdcTxMsg1_oTC37X_VCU_CAN01_6685c7bf_Tx: DynamicLength=false, PduLength=8, SysTPduToFrameMappingRef=VcuAdcTxMsg1
        VcuAdcTxMsg1_oTC37X_VCU_CAN01_fda515ee_Tx: DynamicLength=false, PduLength=8
        VcuAdcTxMsg2_oTC37X_VCU_CAN01_1723c88c_Tx: DynamicLength=false, PduLength=8
        VcuAdcTxMsg2_oTC37X_VCU_CAN01_afb1dcb2_Tx: DynamicLength=false, PduLength=8, SysTPduToFrameMappingRef=VcuAdcTxMsg2
        VcuRxMsg1_oTC37X_VCU_CAN00_4589bbed_Rx: DynamicLength=false, PduLength=8, SysTPduToFrameMappingRef=VcuRxMsg1
        VcuRxMsg1_oTC37X_VCU_CAN00_78805594_Rx: DynamicLength=false, PduLength=8
        VcuRxMsg2_oTC37X_VCU_CAN00_8cbda0e0_Rx: DynamicLength=false, PduLength=8, SysTPduToFrameMappingRef=VcuRxMsg2
        VcuRxMsg2_oTC37X_VCU_CAN00_920688f6_Rx: DynamicLength=false, PduLength=8
        VcuRxMsg3_oTC37X_VCU_CAN01_0a530e81_Rx: DynamicLength=false, PduLength=8
        VcuRxMsg3_oTC37X_VCU_CAN01_5bb4c01a_Rx: DynamicLength=false, PduLength=8, SysTPduToFrameMappingRef=VcuRxMsg3
        VcuRxMsg4_oTC37X_VCU_CAN01_55be06ba_Rx: DynamicLength=false, PduLength=8, SysTPduToFrameMappingRef=VcuRxMsg4
        VcuRxMsg4_oTC37X_VCU_CAN01_eb7d04e5_Rx: DynamicLength=false, PduLength=8
        VcuTxIoMsg1_oTC37X_VCU_CAN00_54884add_Tx: DynamicLength=false, PduLength=8
        VcuTxIoMsg1_oTC37X_VCU_CAN00_869e33bc_Tx: DynamicLength=false, PduLength=8, SysTPduToFrameMappingRef=VcuTxIoMsg1
        VcuTxIoMsg2_oTC37X_VCU_CAN00_4faa28b1_Tx: DynamicLength=false, PduLength=8, SysTPduToFrameMappingRef=VcuTxIoMsg2
        VcuTxIoMsg2_oTC37X_VCU_CAN00_be0e97bf_Tx: DynamicLength=false, PduLength=8
        VcuTxIoMsg3_oTC37X_VCU_CAN00_08b9de4a_Tx: DynamicLength=false, PduLength=8, SysTPduToFrameMappingRef=VcuTxIoMsg3
        VcuTxIoMsg3_oTC37X_VCU_CAN00_515c215e_Tx: DynamicLength=false, PduLength=8
        VcuTxIoMsg4_oTC37X_VCU_CAN00_06b318ea_Tx: DynamicLength=false, PduLength=8, SysTPduToFrameMappingRef=VcuTxIoMsg4
        VcuTxIoMsg4_oTC37X_VCU_CAN00_b0722b3a_Tx: DynamicLength=false, PduLength=8
        VcuTxIoMsg5_oTC37X_VCU_CAN00_41a0ee11_Tx: DynamicLength=false, PduLength=8, SysTPduToFrameMappingRef=VcuTxIoMsg5
        VcuTxIoMsg5_oTC37X_VCU_CAN00_5f209ddb_Tx: DynamicLength=false, PduLength=8
        VcuTxIoMsg6_oTC37X_VCU_CAN00_8894f51c_Tx: DynamicLength=false, PduLength=8, SysTPduToFrameMappingRef=VcuTxIoMsg6
        VcuTxIoMsg6_oTC37X_VCU_CAN00_b5a640b9_Tx: DynamicLength=false, PduLength=8
        VcuTxIoMsg7_oTC37X_VCU_CAN00_5af4f658_Tx: DynamicLength=false, PduLength=8
        VcuTxIoMsg7_oTC37X_VCU_CAN00_cf8703e7_Tx: DynamicLength=false, PduLength=8, SysTPduToFrameMappingRef=VcuTxIoMsg7
        VcuTxIoMsg8_oTC37X_VCU_CAN00_9481785c_Tx: DynamicLength=false, PduLength=8, SysTPduToFrameMappingRef=VcuTxIoMsg8
        VcuTxIoMsg8_oTC37X_VCU_CAN00_ac8b5230_Tx: DynamicLength=false, PduLength=8
        VcuTxMsg1_oTC37X_VCU_CAN00_954a27ee_Tx: DynamicLength=false, PduLength=8
        VcuTxMsg1_oTC37X_VCU_CAN00_c82dd125_Tx: DynamicLength=false, PduLength=8, SysTPduToFrameMappingRef=VcuTxMsg1
        VcuTxMsg2_oTC37X_VCU_CAN00_0119ca28_Tx: DynamicLength=false, PduLength=8, SysTPduToFrameMappingRef=VcuTxMsg2
        VcuTxMsg2_oTC37X_VCU_CAN00_7fccfa8c_Tx: DynamicLength=false, PduLength=8
        Vcu_Lin0_RxMsg1_oLIN00_537f3cf2_Rx: DynamicLength=false, PduLength=8
        Vcu_Lin0_RxMsg1_oLIN00_def4d57f_Rx: DynamicLength=false, PduLength=8, SysTPduToFrameMappingRef=Vcu_Lin0_RxMsg1
        Vcu_Lin0_RxMsg2_oLIN00_a811ec42_Rx: DynamicLength=false, PduLength=8, SysTPduToFrameMappingRef=Vcu_Lin0_RxMsg2
        Vcu_Lin0_RxMsg2_oLIN00_ddf03b11_Rx: DynamicLength=false, PduLength=8
        Vcu_Lin0_TxMsg1_oLIN00_db48db31_Tx: DynamicLength=false, PduLength=8, SysTPduToFrameMappingRef=Vcu_Lin0_TxMsg1
        Vcu_Lin0_TxMsg1_oLIN00_f39ae32f_Tx: DynamicLength=false, PduLength=8
        Vcu_Lin0_TxMsg2_oLIN00_7d15e4cc_Tx: DynamicLength=false, PduLength=8
        Vcu_Lin0_TxMsg2_oLIN00_adade20c_Tx: DynamicLength=false, PduLength=8, SysTPduToFrameMappingRef=Vcu_Lin0_TxMsg2
        Vcu_Uds_Func_Request_Tp_oTC37X_VCU_CAN00_3dbedef7_Rx: DynamicLength=false, PduLength=8, SysTPduToFrameMappingRef=Vcu_Uds_Func_Request_Tp
        Vcu_Uds_Func_Request_oTC37X_VCU_CAN00_21e26bac_Rx: DynamicLength=true, PduLength=7
        Vcu_Uds_Func_Request_oTC37X_VCU_CAN00_455d4346_Rx: DynamicLength=true, PduLength=7
        Vcu_Uds_Phy_Request_Tp_oTC37X_VCU_CAN00_58c52463_Rx: DynamicLength=false, PduLength=8, SysTPduToFrameMappingRef=Vcu_Uds_Phy_Request_Tp
        Vcu_Uds_Phy_Request_oTC37X_VCU_CAN00_16119f6f_Rx: DynamicLength=true, PduLength=8
        Vcu_Uds_Phy_Request_oTC37X_VCU_CAN00_d561dcee_Rx: DynamicLength=true, PduLength=8
        Vcu_Uds_Response_Tp_oTC37X_VCU_CAN00_834178f3_Tx: DynamicLength=false, PduLength=8, SysTPduToFrameMappingRef=Vcu_Uds_Response_Tp
        Vcu_Uds_Response_oTC37X_VCU_CAN00_39638a1a_Tx: DynamicLength=true, PduLength=8
        Vcu_Uds_Response_oTC37X_VCU_CAN00_4d111be6_Tx: DynamicLength=true, PduLength=8
        XCP_Request_oTC37X_VCU_CAN00_3c25b45e_Rx: DynamicLength=false, PduLength=8, SysTPduToFrameMappingRef=XCP_Request
        XCP_Response_oTC37X_VCU_CAN00_34d2da2d_Tx: DynamicLength=false, PduLength=8, SysTPduToFrameMappingRef=XCP_Response
  module config EcuM
    EcuMConfiguration
      EcuMCommonConfiguration
        EcuMDriverInitListOne
        EcuMDriverRestartList
        3 x EcuMWakeupSource:
          CN_LIN00_b12a0454: EcuMWakeupSourceId=7, EcuMComMChannelRef=ComMConfigSet/CN_LIN00_b12a0454
          CN_TC37X_VCU_CAN00_07b6c9c8: EcuMWakeupSourceId=5, EcuMComMChannelRef=ComMConfigSet/CN_TC37X_VCU_CAN00_07b6c9c8
          CN_TC37X_VCU_CAN01_70b1f95e: EcuMWakeupSourceId=6, EcuMComMChannelRef=ComMConfigSet/CN_TC37X_VCU_CAN01_70b1f95e
      EcuMFlexConfiguration: EcuMFlexModuleConfigurationRef=CanConfigSet, EcuMFlexModuleConfigurationRef=LinGlobalConfig
  module config Lin
    LinGlobalConfig
      CN_LIN00_b12a0454 (LinChannel): LinChannelBaudRate=19200, LinChannelId=0, LinChannelEcuMWakeupSource=EcuMCommonConfiguration/CN_LIN00_b12a0454  # LIN00
  module config LinIf
    LinIfGeneral: LinIfJ2602ResponseToleranceSupport=false
    LinIfGlobalConfig
      CHNL_45618847 (LinIfChannel): LinIfClusterTimeBase=0.005, LinIfChannelRef=LinGlobalConfig/CN_LIN00_b12a0454, LinIfComMNetworkHandleRef=ComMConfigSet/CN_LIN00_b12a0454
        6 x LinIfFrame, all with LinIfLength=8:
          FT_MasterReq_355bc768_Tx: LinIfChecksumType=CLASSIC, LinIfFrameType=MRF, LinIfPid=60
            LinIfPduDirection
              LinIfInternalPdu
          FT_SlaveResp_9d5cbedc_Rx: LinIfChecksumType=CLASSIC, LinIfFrameType=SRF, LinIfPid=125
            LinIfPduDirection
              LinIfInternalPdu
          FT_Vcu_Lin0_RxMsg1_26d30419_Rx: LinIfChecksumType=ENHANCED, LinIfPid=32
            LinIfPduDirection
              LinIfRxPdu: LinIfRxPduRef=EcucPduCollection/Vcu_Lin0_RxMsg1_oLIN00_def4d57f_Rx
          FT_Vcu_Lin0_RxMsg2_bfda55a3_Rx: LinIfChecksumType=ENHANCED, LinIfPid=97
            LinIfPduDirection
              LinIfRxPdu: LinIfRxPduRef=EcucPduCollection/Vcu_Lin0_RxMsg2_oLIN00_a811ec42_Rx
          FT_Vcu_Lin0_TxMsg1_f08ae704_Tx: LinIfChecksumType=ENHANCED, LinIfPid=94
            LinIfPduDirection
              LinIfTxPdu_67e62ef9 (LinIfTxPdu): LinIfTxPduRef=EcucPduCollection/Vcu_Lin0_TxMsg1_oLIN00_db48db31_Tx
          FT_Vcu_Lin0_TxMsg2_6983b6be_Tx: LinIfChecksumType=ENHANCED, LinIfPid=31
            LinIfPduDirection
              LinIfTxPdu_21a51ec5 (LinIfTxPdu): LinIfTxPduRef=EcucPduCollection/Vcu_Lin0_TxMsg2_oLIN00_adade20c_Tx
        LinIfNodeType  # CT_LIN00
          CT_LIN00_7284c7d4 (LinIfMaster): LinIfJitter=0.0001
        NULLSchedule (LinIfScheduleTable): LinIfResumePosition=CONTINUE_AT_IT_POINT, LinIfRunMode=RUN_CONTINUOUS, LinIfScheduleMode=LINTP_APPLICATIVE_SCHEDULE, LinIfScheduleTableIndex=0
        Vcu_Lin0_Schedule_8fbcfe93 (LinIfScheduleTable): LinIfRunMode=RUN_CONTINUOUS, LinIfScheduleTableIndex=1, LinIfScheduleTableName=
          4 x LinIfEntry, all with LinIfDelay=0.02:
            Vcu_Lin0_Schedule_135abe7b: LinIfEntryIndex=0, LinIfFrameRef=FT_Vcu_Lin0_TxMsg1_f08ae704_Tx
            Vcu_Lin0_Schedule_168ed5f8: LinIfEntryIndex=2, LinIfFrameRef=FT_Vcu_Lin0_RxMsg1_26d30419_Rx
            Vcu_Lin0_Schedule_f9dc6319: LinIfEntryIndex=3, LinIfFrameRef=FT_Vcu_Lin0_RxMsg2_bfda55a3_Rx
            Vcu_Lin0_Schedule_fc08089a: LinIfEntryIndex=1, LinIfFrameRef=FT_Vcu_Lin0_TxMsg2_6983b6be_Tx
  module config LinSM
    LinSMConfigSet
      CHNL_45618847 (LinSMChannel): LinSMNodeType=MASTER, LinSMComMNetworkHandleRef=ComMConfigSet/CN_LIN00_b12a0454
        CHNL_45618847_32a17f26 (LinSMSchedule): LinSMScheduleIndex=0, LinSMScheduleIndexRef=NULLSchedule
        Vcu_Lin0_Schedule_8fbcfe93 (LinSMSchedule): LinSMScheduleIndex=1, LinSMScheduleIndexRef=CHNL_45618847/Vcu_Lin0_Schedule_8fbcfe93
  module config LinTp
    LinTpGeneral: LinTpFunctionalRequestsSupported=true
    LinTpGlobalConfig
      CHNL_45618847 (LinTpChannelConfig): LinTpChannelRef=LinIfGlobalConfig/CHNL_45618847
      SlaveResp_GWM_oLIN00_87807674_Rx (LinTpRxNSdu):
        LinTpDl = 8
        LinTpRxNSduNad = 82
        LinTpRxNSduChannelRef = LinIfGlobalConfig/CHNL_45618847
        LinTpRxNSduPduRef = EcucPduCollection/SlaveResp_GWM_oLIN00_43535e69_Rx
      MasterReq_GWM_oLIN00_7f4744d7_Tx (LinTpTxNSdu): LinTpTxNSduNad=82, LinTpTxNSduChannelRef=LinIfGlobalConfig/CHNL_45618847, LinTpTxNSduPduRef=EcucPduCollection/MasterReq_GWM_oLIN00_fcc15022_Tx
      MasterReq_oLIN00_4a2bb011_Tx (LinTpTxNSdu): LinTpTxNSduNad=126, LinTpTxNSduChannelRef=LinIfGlobalConfig/CHNL_45618847, LinTpTxNSduPduRef=EcucPduCollection/MasterReq_oLIN00_3234fe1b_Tx
  module config Nm
    CN_TC37X_VCU_CAN00_07b6c9c8 (NmChannelConfig): NmComMChannelRef=ComMConfigSet/CN_TC37X_VCU_CAN00_07b6c9c8
      TC37X_VCU_CAN00_CAN_cc8c31fa (NmBusType)
        NmStandardBusNmConfig: NmStandardBusType=NM_BUSNM_CANNM  # TC37X_VCU_CAN00_CAN
    CN_TC37X_VCU_CAN01_70b1f95e (NmChannelConfig): NmComMChannelRef=ComMConfigSet/CN_TC37X_VCU_CAN01_70b1f95e
      TC37X_VCU_CAN01_CAN_f1ec184a (NmBusType)
        NmStandardBusNmConfig: NmStandardBusType=NM_BUSNM_CANNM  # TC37X_VCU_CAN01_CAN
    NmGlobalConfig
      NmGlobalFeatures: NmNodeIdEnabled=true, NmUserDataEnabled=true
      NmGlobalProperties
  module config PduR
    PduRGeneral
    PduRRoutingTables
      PduRRoutingTable
        26 x PduRRoutingPath:
          MasterReq_GWM_oLIN00_7f4744d7_Tx
            MasterReq_GWM_oLIN00_fcc15022_Tx (PduRDestPdu): PduRDestPduRef=EcucPduCollection/MasterReq_GWM_oLIN00_fcc15022_Tx
            PduRSrcPdu_ab43adcb (PduRSrcPdu): PduRSrcPduRef=EcucPduCollection/MasterReq_GWM_oLIN00_7f4744d7_Tx
          MasterReq_oLIN00_4a2bb011_Tx
            MasterReq_oLIN00_3234fe1b_Tx (PduRDestPdu): PduRDestPduRef=EcucPduCollection/MasterReq_oLIN00_3234fe1b_Tx
            PduRSrcPdu_927d3065 (PduRSrcPdu): PduRSrcPduRef=EcucPduCollection/MasterReq_oLIN00_4a2bb011_Tx
          SlaveResp_GWM_oLIN00_43535e69_Rx
            SlaveResp_GWM_oLIN00_43535e69_Rx_a37de0e8_Rx (PduRDestPdu): PduRDestPduRef=EcucPduCollection/SlaveResp_GWM_oLIN00_87807674_Rx
            PduRSrcPdu_a37de0e8 (PduRSrcPdu): PduRSrcPduRef=EcucPduCollection/SlaveResp_GWM_oLIN00_43535e69_Rx
          VcuAdcTxMsg1_oTC37X_VCU_CAN01_fda515ee_Tx
            VcuAdcTxMsg1_oTC37X_VCU_CAN01_6685c7bf_Tx (PduRDestPdu): PduRDestPduRef=EcucPduCollection/VcuAdcTxMsg1_oTC37X_VCU_CAN01_6685c7bf_Tx
            PduRSrcPdu_f8c9b934 (PduRSrcPdu): PduRSrcPduRef=EcucPduCollection/VcuAdcTxMsg1_oTC37X_VCU_CAN01_fda515ee_Tx
          VcuAdcTxMsg2_oTC37X_VCU_CAN01_1723c88c_Tx
            VcuAdcTxMsg2_oTC37X_VCU_CAN01_afb1dcb2_Tx (PduRDestPdu): PduRDestPduRef=EcucPduCollection/VcuAdcTxMsg2_oTC37X_VCU_CAN01_afb1dcb2_Tx
            PduRSrcPdu_df42a212 (PduRSrcPdu): PduRSrcPduRef=EcucPduCollection/VcuAdcTxMsg2_oTC37X_VCU_CAN01_1723c88c_Tx
          VcuRxMsg1_oTC37X_VCU_CAN00_4589bbed_Rx
            VcuRxMsg1_oTC37X_VCU_CAN00_4589bbed_Rx_6711bd67_Rx (PduRDestPdu): PduRDestPduRef=EcucPduCollection/VcuRxMsg1_oTC37X_VCU_CAN00_78805594_Rx
            PduRSrcPdu_6711bd67 (PduRSrcPdu): PduRSrcPduRef=EcucPduCollection/VcuRxMsg1_oTC37X_VCU_CAN00_4589bbed_Rx
          VcuRxMsg2_oTC37X_VCU_CAN00_8cbda0e0_Rx
            VcuRxMsg2_oTC37X_VCU_CAN00_8cbda0e0_Rx_803efadc_Rx (PduRDestPdu): PduRDestPduRef=EcucPduCollection/VcuRxMsg2_oTC37X_VCU_CAN00_920688f6_Rx
            PduRSrcPdu_803efadc (PduRSrcPdu): PduRSrcPduRef=EcucPduCollection/VcuRxMsg2_oTC37X_VCU_CAN00_8cbda0e0_Rx
          VcuRxMsg3_oTC37X_VCU_CAN01_5bb4c01a_Rx
            VcuRxMsg3_oTC37X_VCU_CAN01_5bb4c01a_Rx_3905054b_Rx (PduRDestPdu): PduRDestPduRef=EcucPduCollection/VcuRxMsg3_oTC37X_VCU_CAN01_0a530e81_Rx
            PduRSrcPdu_3905054b (PduRSrcPdu): PduRSrcPduRef=EcucPduCollection/VcuRxMsg3_oTC37X_VCU_CAN01_5bb4c01a_Rx
          VcuRxMsg4_oTC37X_VCU_CAN01_55be06ba_Rx
            VcuRxMsg4_oTC37X_VCU_CAN01_55be06ba_Rx_f5b46736_Rx (PduRDestPdu): PduRDestPduRef=EcucPduCollection/VcuRxMsg4_oTC37X_VCU_CAN01_eb7d04e5_Rx
            PduRSrcPdu_f5b46736 (PduRSrcPdu): PduRSrcPduRef=EcucPduCollection/VcuRxMsg4_oTC37X_VCU_CAN01_55be06ba_Rx
          VcuTxIoMsg1_oTC37X_VCU_CAN00_54884add_Tx
            VcuTxIoMsg1_oTC37X_VCU_CAN00_869e33bc_Tx (PduRDestPdu): PduRDestPduRef=EcucPduCollection/VcuTxIoMsg1_oTC37X_VCU_CAN00_869e33bc_Tx
            PduRSrcPdu_96b222db (PduRSrcPdu): PduRSrcPduRef=EcucPduCollection/VcuTxIoMsg1_oTC37X_VCU_CAN00_54884add_Tx
          VcuTxIoMsg2_oTC37X_VCU_CAN00_be0e97bf_Tx
            VcuTxIoMsg2_oTC37X_VCU_CAN00_4faa28b1_Tx (PduRDestPdu): PduRDestPduRef=EcucPduCollection/VcuTxIoMsg2_oTC37X_VCU_CAN00_4faa28b1_Tx
            PduRSrcPdu_3ef2d11c (PduRSrcPdu): PduRSrcPduRef=EcucPduCollection/VcuTxIoMsg2_oTC37X_VCU_CAN00_be0e97bf_Tx
          VcuTxIoMsg3_oTC37X_VCU_CAN00_515c215e_Tx
            VcuTxIoMsg3_oTC37X_VCU_CAN00_08b9de4a_Tx (PduRDestPdu): PduRDestPduRef=EcucPduCollection/VcuTxIoMsg3_oTC37X_VCU_CAN00_08b9de4a_Tx
            PduRSrcPdu_23c89b9b (PduRSrcPdu): PduRSrcPduRef=EcucPduCollection/VcuTxIoMsg3_oTC37X_VCU_CAN00_515c215e_Tx
          VcuTxIoMsg4_oTC37X_VCU_CAN00_b0722b3a_Tx
            VcuTxIoMsg4_oTC37X_VCU_CAN00_06b318ea_Tx (PduRDestPdu): PduRDestPduRef=EcucPduCollection/VcuTxIoMsg4_oTC37X_VCU_CAN00_06b318ea_Tx
            PduRSrcPdu_15ef524a (PduRSrcPdu): PduRSrcPduRef=EcucPduCollection/VcuTxIoMsg4_oTC37X_VCU_CAN00_b0722b3a_Tx
          VcuTxIoMsg5_oTC37X_VCU_CAN00_5f209ddb_Tx
            VcuTxIoMsg5_oTC37X_VCU_CAN00_41a0ee11_Tx (PduRDestPdu): PduRDestPduRef=EcucPduCollection/VcuTxIoMsg5_oTC37X_VCU_CAN00_41a0ee11_Tx
            PduRSrcPdu_886ac60a (PduRSrcPdu): PduRSrcPduRef=EcucPduCollection/VcuTxIoMsg5_oTC37X_VCU_CAN00_5f209ddb_Tx
          VcuTxIoMsg6_oTC37X_VCU_CAN00_b5a640b9_Tx
            VcuTxIoMsg6_oTC37X_VCU_CAN00_8894f51c_Tx (PduRDestPdu): PduRDestPduRef=EcucPduCollection/VcuTxIoMsg6_oTC37X_VCU_CAN00_8894f51c_Tx
            PduRSrcPdu_275934e8 (PduRSrcPdu): PduRSrcPduRef=EcucPduCollection/VcuTxIoMsg6_oTC37X_VCU_CAN00_b5a640b9_Tx
          VcuTxIoMsg7_oTC37X_VCU_CAN00_5af4f658_Tx
            VcuTxIoMsg7_oTC37X_VCU_CAN00_cf8703e7_Tx (PduRDestPdu): PduRDestPduRef=EcucPduCollection/VcuTxIoMsg7_oTC37X_VCU_CAN00_cf8703e7_Tx
            PduRSrcPdu_8c9b3cfc (PduRSrcPdu): PduRSrcPduRef=EcucPduCollection/VcuTxIoMsg7_oTC37X_VCU_CAN00_5af4f658_Tx
          VcuTxIoMsg8_oTC37X_VCU_CAN00_ac8b5230_Tx
            VcuTxIoMsg8_oTC37X_VCU_CAN00_9481785c_Tx (PduRDestPdu): PduRDestPduRef=EcucPduCollection/VcuTxIoMsg8_oTC37X_VCU_CAN00_9481785c_Tx
            PduRSrcPdu_27dcf988 (PduRSrcPdu): PduRSrcPduRef=EcucPduCollection/VcuTxIoMsg8_oTC37X_VCU_CAN00_ac8b5230_Tx
          VcuTxMsg1_oTC37X_VCU_CAN00_954a27ee_Tx
            VcuTxMsg1_oTC37X_VCU_CAN00_c82dd125_Tx (PduRDestPdu): PduRDestPduRef=EcucPduCollection/VcuTxMsg1_oTC37X_VCU_CAN00_c82dd125_Tx
            PduRSrcPdu_91d52164 (PduRSrcPdu): PduRSrcPduRef=EcucPduCollection/VcuTxMsg1_oTC37X_VCU_CAN00_954a27ee_Tx
          VcuTxMsg2_oTC37X_VCU_CAN00_7fccfa8c_Tx
            VcuTxMsg2_oTC37X_VCU_CAN00_0119ca28_Tx (PduRDestPdu): PduRDestPduRef=EcucPduCollection/VcuTxMsg2_oTC37X_VCU_CAN00_0119ca28_Tx
            PduRSrcPdu_69924b1b (PduRSrcPdu): PduRSrcPduRef=EcucPduCollection/VcuTxMsg2_oTC37X_VCU_CAN00_7fccfa8c_Tx
          Vcu_Lin0_RxMsg1_oLIN00_def4d57f_Rx
            Vcu_Lin0_RxMsg1_oLIN00_def4d57f_Rx_763211c2_Rx (PduRDestPdu): PduRDestPduRef=EcucPduCollection/Vcu_Lin0_RxMsg1_oLIN00_537f3cf2_Rx
            PduRSrcPdu_763211c2 (PduRSrcPdu): PduRSrcPduRef=EcucPduCollection/Vcu_Lin0_RxMsg1_oLIN00_def4d57f_Rx
          Vcu_Lin0_RxMsg2_oLIN00_a811ec42_Rx
            Vcu_Lin0_RxMsg2_oLIN00_a811ec42_Rx_c59add12_Rx (PduRDestPdu): PduRDestPduRef=EcucPduCollection/Vcu_Lin0_RxMsg2_oLIN00_ddf03b11_Rx
            PduRSrcPdu_c59add12 (PduRSrcPdu): PduRSrcPduRef=EcucPduCollection/Vcu_Lin0_RxMsg2_oLIN00_a811ec42_Rx
          Vcu_Lin0_TxMsg1_oLIN00_f39ae32f_Tx
            Vcu_Lin0_TxMsg1_oLIN00_db48db31_Tx (PduRDestPdu): PduRDestPduRef=EcucPduCollection/Vcu_Lin0_TxMsg1_oLIN00_db48db31_Tx
            PduRSrcPdu_af3681f0 (PduRSrcPdu): PduRSrcPduRef=EcucPduCollection/Vcu_Lin0_TxMsg1_oLIN00_f39ae32f_Tx
          Vcu_Lin0_TxMsg2_oLIN00_7d15e4cc_Tx
            Vcu_Lin0_TxMsg2_oLIN00_adade20c_Tx (PduRDestPdu): PduRDestPduRef=EcucPduCollection/Vcu_Lin0_TxMsg2_oLIN00_adade20c_Tx
            PduRSrcPdu_a77b2a3a (PduRSrcPdu): PduRSrcPduRef=EcucPduCollection/Vcu_Lin0_TxMsg2_oLIN00_7d15e4cc_Tx
          Vcu_Uds_Func_Request_oTC37X_VCU_CAN00_455d4346_Rx
            Vcu_Uds_Func_Request_oTC37X_VCU_CAN00_455d4346_Rx_4bac36fb_Rx (PduRDestPdu): PduRDestPduRef=Vcu_Uds_Func_Request_oTC37X_VCU_CAN00_21e26bac_Rx
            PduRSrcPdu_4bac36fb (PduRSrcPdu): PduRSrcPduRef=EcucPduCollection/Vcu_Uds_Func_Request_oTC37X_VCU_CAN00_455d4346_Rx
          Vcu_Uds_Phy_Request_oTC37X_VCU_CAN00_16119f6f_Rx
            Vcu_Uds_Phy_Request_oTC37X_VCU_CAN00_16119f6f_Rx_925fbf89_Rx (PduRDestPdu): PduRDestPduRef=Vcu_Uds_Phy_Request_oTC37X_VCU_CAN00_d561dcee_Rx
            PduRSrcPdu_925fbf89 (PduRSrcPdu): PduRSrcPduRef=EcucPduCollection/Vcu_Uds_Phy_Request_oTC37X_VCU_CAN00_16119f6f_Rx
          Vcu_Uds_Response_oTC37X_VCU_CAN00_4d111be6_Tx
            Vcu_Uds_Response_oTC37X_VCU_CAN00_39638a1a_Tx (PduRDestPdu): PduRDestPduRef=EcucPduCollection/Vcu_Uds_Response_oTC37X_VCU_CAN00_39638a1a_Tx
            PduRSrcPdu_1a8748e9 (PduRSrcPdu): PduRSrcPduRef=EcucPduCollection/Vcu_Uds_Response_oTC37X_VCU_CAN00_4d111be6_Tx
  module config Xcp
    XcpConfig
      XCP_Request_oTC37X_VCU_CAN00_3c25b45e_Rx (XcpPdu)
        XCP_Request_oTC37X_VCU_CAN00_3c25b45e_Rx (XcpRxPdu): XcpRxPduRef=EcucPduCollection/XCP_Request_oTC37X_VCU_CAN00_3c25b45e_Rx
      XCP_Response_oTC37X_VCU_CAN00_34d2da2d_Tx (XcpPdu)
        XCP_Response_oTC37X_VCU_CAN00_34d2da2d_Tx (XcpTxPdu): XcpTxPduRef=EcucPduCollection/XCP_Response_oTC37X_VCU_CAN00_34d2da2d_Tx
    XcpGeneral
