AUTOSAR XML (schema 00049)
package /ActiveEcuC
  module config Mcu: implementation-config-variant=VARIANT-POST-BUILD-LOADABLE, module-description=Mcu_Impl
    McuGeneralConfiguration:
      McuDevErrorDetect = true
      McuMultiCoreErrorDetect = true
      McuGetRamStateApi = false
      McuInitClock = true
      McuNoPll = false
      McuPerformResetApi = false
      McuVersionInfoApi = false
      McuClearColdResetStatusApi = false
      McuGpt12SleepModeEnabled = false
      McuGtmSleepModeEnabled = false
      McuCcu60SleepModeEnabled = false
      McuCcu61SleepModeEnabled = false
      McuIfxLpmApi = false
      McuIfxTrapApi = false
      McuIfxCpuCcuconApi = false
      McuIfxDeInitApi = false
      McuClockSourceFailureNotification = false
      McuSafetyEnable = true
      McuInitCheckApi = false
      McuOscAmpRegulationEnable = false
      McuOscCapacitance{0..3}Enable = false
      McuMainOscillatorFrequency = 20
      McuSysClkFrequency = 20
      McuSystemModeCpuCore = CPU_SYSTEM_CORE0_SEL0
      McuIdleModeCpuCore = INDIVIDUAL_IDLE_CORES_SEL0
      McuStandbyEntryMode = STANDBY_ENTRY_REQ_SLEEP_SEL0
      McuOscillatorMode = EXT_CRYSTAL_CERAMIC_RES_MODE_SEL0
      McuInitDeInitApiMode = MCU_MCAL_SUPERVISOR
      McuRuntimeApiMode = MCU_MCAL_SUPERVISOR
    McuModuleConfiguration: McuClockSrcFailureNotification=DISABLED, McuNumberOfMcuModes=1, McuRamSectors=0
      McuResetSettingConf:
        McuESR0ResetConf = MCU_ESR0_NO_RESET_SEL0
        McuESR1ResetConf = MCU_ESR1_NO_RESET_SEL0
        McuSWResetConf = MCU_SW_NO_RESET_SEL0
        McuSMUResetConf = MCU_SMU_NO_RESET_SEL0
        McuSTM{0..5}ResetConf = MCU_STM{0..5}_NO_RESET_SEL0
        McuSTM{0..5}ResetOnApplResetEnable = true
      McuTrapSettingConf:
        McuCPU{0..5}ESR0TrapEnable = false
        McuCPU{0..5}ESR1TrapEnable = false
        McuCPU{0..5}Trap2Enable = false
        McuCPU{0..5}SMUTrapEnable = false
      McuEruGlobalConf: McuEruInputFilterRegVal=0
      McuClockSettingConfig: McuClockSettingId=0
        McuClockReferencePointConfig
          McuSystemPllSettingConfig:
            McuPllInputSrcSelection = OSC_CLOCK_SRC_SELECT_SEL1
            McuSystemPllPDivider = 0
            McuSystemPllNDivider = 29
            McuSystemPllK2Divider = 1
            McuSysPllK2DivStepUpChangeDelay = 10
            McuSysPllK2DivStepDownChangeDelay = 10
            McuFmPllEnable = false
            McuFMPllModAmp = 1.25
            McuClockReferencePointFrequency0 = 300000000
          McuPeripheralPllSettingConfig:
            McuPeripheralPllPDivider = 0
            McuPeripheralPllNDivider = 39
            McuPeripheralPllK2Divider = 4
            McuPerPllK2DivStepUpChangeDelay = 10
            McuPerPllK2DivStepDownChangeDelay = 10
            McuPeripheralPllK3Divider = 3
            McuPerPllK3DivStepUpChangeDelay = 10
            McuPerPllK3DivStepDownChangeDelay = 10
            McuFreqSource1ClockDivSelect = DIV_FACTOR_2_BYPASSED_SEL1
            McuPll2DivSelect = MCU_K3_DIV_FACTOR_NOT_BYPASSED_SEL0
            McuClockReferencePointFrequency1 = 160000000
            McuClockReferencePointFrequency2 = 200000000
          McuPllDistributionSettingConfig:
            McuClockDistributionInpClockSel = PLL_INPUT_CLOCK_SRC_SELECT_SEL1
            McuLowPowerDivValue = LOW_POWER_DIVIDER_DISABLE_SEL0
            McuSRIFrequency = 300000000
            McuCPU{0..2}Frequency = 300000000
            McuCPU{3..5}Frequency = 0
            McuSPBFrequency = 100000000
            McuFSIFrequency = 100000000
            McuFSI2Frequency = 300000000
            McuReferenceFrequency1 = 12500000
            McuReferenceFrequency2 = 6666667
            McuBBBFrequency = 150000000
            McuErayClkEnable = false
            McuErayFrequency = 80000000
            McuGTMFrequency = 200000000
            McuSTMFrequency = 100000000
            McuMscClockSourceSelection = MSC_CLOCK_SOURCE_DISABLED_SEL0
            McuMscFrequency = 0
            McuMCanClockSourceSelection = MCAN_CLOCK_SOURCE_DISABLED_SEL0
            McuMCanFrequency = 0
            McuAscLinFastFrequency = 0
            McuAscLinSlowClockSourceSelection = ASCLINS_CLOCK_SOURCE_DISABLED_SEL0
            McuAscLinSlowFrequency = 0
            McuQspiClockSourceSelection = QSPI_CLOCK_SOURCE_DISABLED_SEL0
            McuQspiFrequency = 100000000
            McuAdcFrequency = 160000000
            McuConvCtrlPhaseSynchConf = PHASE_SYNCH_CONST_ACTIVE_SEL0
            McuI2CFrequency = 62500000
            McuEbuClkEnable = false
            McuEbuFrequency = 0
            McuHsctFrequency = 10000000
            McuHspdmClkEnable = false
            McuHspdm160Frequency = 0
            McuHspdm320Frequency = 0
            McuAdasFrequency = 0
            McuGEthFrequency = 100000000
            McuMcanHFrequency = 100000000
          McuExternalClockOutputConfig:
            McuExtClock0Enable = false
            McuExtClockOutSel0 = FOUT_EXT_CLOCK0_SEL0
            McuExtClock1Enable = false
            McuExtClock1Inverted = false
            McuExtClockOutSel1 = FOUT_EXT_CLOCK1_SEL0
            McuFoutClockDiv = 1
          McuClockMonitorConfig:
            McuPll{0..2}ClockMonEnable = false
            McuSpbClockMonEnable = false
            McuBackupClockMonEnable = false
            McuBackupClockRangeMonEnable = false
        McuClockReferencePoint: McuClockRefSelection=MCU_USER_DEFINED_FREQUENCY, McuClockReferencePointFrequency=0
      McuModeSettingConf: McuMode=0, McuEvrcLPMOnSleepReqEnable=false
        McuStdbyModeSettingConf:
          McuStdbyModePortTriStateEnable = false
          McuStdbyModeESR0TriStateEnable = false
          McuStdbyModeWakeupFromPORST = true
          McuStdbyModePORSTFilterEnable = false
          McuStdbyModeWakeupFromEVR = false
          McuStdbyModeWakeupFromSCR = false
          McuStdbyModeClkSelection = OSC_CLOCK_100KHZ_ONLY_SEL0
          McuStdbyModeBlankingFilterDelay = DELAY_0_MS_SEL0
          McuStdbyModeRamEnable = MCU_STANDBYRAM_DISABLED_SEL0
          McuStdbyModeESR0Conf: McuStdbyModeESR0WakeupEnable=false, McuStdbyModeESR0FltEnable=false, McuStdbyModeESR0EdgeDetection=ESR0_TRIG_RISING_EDGE_SEL1
          McuStdbyModeESR1Conf: McuStdbyModeESR1WakeupEnable=false, McuStdbyModeESR1FltEnable=false, McuStdbyModeESR1EdgeDetection=ESR1_TRIG_RISING_EDGE_SEL1
          McuStdbyModePinAConf: McuStdbyModePinAWakeupEnable=false, McuStdbyModePinAFltEnable=false, McuStdbyModePinAEdgeDetection=PINA_TRIG_RISING_EDGE_SEL1
          McuStdbyModePinBConf: McuStdbyModePinBWakeupEnable=false, McuStdbyModePinBFltEnable=false, McuStdbyModePinBEdgeDetection=PINB_TRIG_RISING_EDGE_SEL1
          McuStdbyModeWakeupTimerConf:
            McuStdbyModeWakeupTimerEnable = false
            McuStdbyModeWakeupTimerValue = 16777215
            McuStdbyModeWakeupTimerClkDiv = WUT_100KHZ_NO_DIV_CLK_SEL0
            McuStdbyModeWakeupTimerMode = WUT_AUTO_RELOAD_MODE_SEL0
      McuGpt12PrescalerConf: Gpt1BlockPrescalerSel=GPT1_BLOCK_NOT_USED, Gpt2BlockPrescalerSel=GPT2_BLOCK_NOT_USED
      GtmGlobalConfiguration
        McuGtmClockManagementConf: GtmCmuGlobalClockNumerator=1, GtmCmuGlobalClockDenominator=1
          GtmFixedClockSetting: GtmCmuFixedClockEnable=true, GtmCmuFixedClockSel=CMU_GLOBAL_CLOCK_SEL0
          GtmConfigClockSetting:
            GtmCmuConfigClock0Enable = true
            GtmCmuConfigClock0Div = 0
            GtmCmuConfigClock1Enable = true
            GtmCmuConfigClock1Div = 0
            GtmCmuConfigClock2Enable = true
            GtmCmuConfigClock2Div = 0
            GtmCmuConfigClock3Enable = true
            GtmCmuConfigClock3Div = 0
            GtmCmuConfigClock4Enable = true
            GtmCmuConfigClock4Div = 0
            GtmCmuConfigClock5Enable = true
            GtmCmuConfigClock5Div = 0
            GtmCmuConfigClock6Enable = true
            GtmCmuConfigClock6Div = 0
            GtmCmuConfigClock7Enable = true
            GtmCmuConfigClock7Div = 0
          GtmExtClockSetting:
            GtmCmuExtClock0Enable = false
            GtmCmuExtClock0Numerator = 1
            GtmCmuExtClock0Denominator = 1
            GtmCmuExtClock1Enable = false
            GtmCmuExtClock1Numerator = 1
            GtmCmuExtClock1Denominator = 1
            GtmCmuExtClock2Enable = false
            GtmCmuExtClock2Numerator = 1
            GtmCmuExtClock2Denominator = 1
        6 x GtmClusterConf, all with GtmCmuClusterInputClockDividerEnable=CLS_CLK_CFG_ENABLED_WITH_DIV_SEL2:
          GtmClusterConf
            GtmClusterConfClockSetting:
              GtmClusterConfClock{0..7}Src = CMU_CONF_CLOCK{0..7}_SEL0
            GtmClusterFixedClockSetting: GtmClusterFixedClockSrc=CMU_FIXED_CLOCK0_SEL0
          GtmClusterConf_1
            GtmClusterConfClockSetting:
              GtmClusterConfClock{0..7}Src = CMU_CONF_CLOCK{0..7}_SEL0
            GtmClusterFixedClockSetting: GtmClusterFixedClockSrc=CMU_FIXED_CLOCK0_SEL0
          GtmClusterConf_2
            GtmClusterConfClockSetting:
              GtmClusterConfClock{0..7}Src = CMU_CONF_CLOCK{0..7}_SEL0
            GtmClusterFixedClockSetting: GtmClusterFixedClockSrc=CMU_FIXED_CLOCK0_SEL0
          GtmClusterConf_3
            GtmClusterConfClockSetting:
              GtmClusterConfClock{0..7}Src = CMU_CONF_CLOCK{0..7}_SEL0
            GtmClusterFixedClockSetting: GtmClusterFixedClockSrc=CMU_FIXED_CLOCK0_SEL0
          GtmClusterConf_4
            GtmClusterConfClockSetting:
              GtmClusterConfClock{0..7}Src = CMU_CONF_CLOCK{0..7}_SEL0
            GtmClusterFixedClockSetting: GtmClusterFixedClockSrc=CMU_FIXED_CLOCK0_SEL0
          GtmClusterConf_5
            GtmClusterConfClockSetting:
              GtmClusterConfClock{0..7}Src = CMU_CONF_CLOCK{0..7}_SEL0
            GtmClusterFixedClockSetting: GtmClusterFixedClockSrc=CMU_FIXED_CLOCK0_SEL0
        4 x GtmTbuChannelConf, all with GtmTbuChannelEnable=false, GtmTbuChClockSourceSelection=CMU_CLOCK0_SEL0, GtmTbuChResolutionSel=TBU_CH_LOWER_COUNT_BITS_SEL0, GtmTbuChMode=FREE_RUNNING_COUNTER_SEL0, GtmTbuChModuloCntrSel=TBU_CH1_SEL0:
          GtmTbuChannelConf
          GtmTbuChannelConf_{1..3}
        3 x GtmTomGlobalConf:
          GtmTomGlobalConf
            GtmTomGroupConf
              GtmTomActionTimeBaseUnitConf: GtmTomActionTimeBaseSelection=TOM_ACT_TB_TBU_TS0, GtmTomActionTimeBaseValue=1
            GtmTomGroupConf_1 (GtmTomGroupConf)
              GtmTomActionTimeBaseUnitConf: GtmTomActionTimeBaseSelection=TOM_ACT_TB_TBU_TS0, GtmTomActionTimeBaseValue=1
            16 x GtmTomChannelConf, all with GtmTomChResetCn0OnTriggerEnable=false, GtmTomChInternalTriggerEnable=false, GtmTimerPortPinSelect=NONE:
              GtmTomChannelConf
              GtmTomChannelConf_{1..15}
          GtmTomGlobalConf_1
            GtmTomGroupConf
              GtmTomActionTimeBaseUnitConf: GtmTomActionTimeBaseSelection=TOM_ACT_TB_TBU_TS0, GtmTomActionTimeBaseValue=1
            GtmTomGroupConf_1 (GtmTomGroupConf)
              GtmTomActionTimeBaseUnitConf: GtmTomActionTimeBaseSelection=TOM_ACT_TB_TBU_TS0, GtmTomActionTimeBaseValue=1
            16 x GtmTomChannelConf, all with GtmTomChResetCn0OnTriggerEnable=false, GtmTomChInternalTriggerEnable=false, GtmTimerPortPinSelect=NONE:
              GtmTomChannelConf
              GtmTomChannelConf_{1..15}
          GtmTomGlobalConf_2
            GtmTomGroupConf
              GtmTomActionTimeBaseUnitConf: GtmTomActionTimeBaseSelection=TOM_ACT_TB_TBU_TS0, GtmTomActionTimeBaseValue=1
            GtmTomGroupConf_1 (GtmTomGroupConf)
              GtmTomActionTimeBaseUnitConf: GtmTomActionTimeBaseSelection=TOM_ACT_TB_TBU_TS0, GtmTomActionTimeBaseValue=1
            16 x GtmTomChannelConf, all with GtmTomChResetCn0OnTriggerEnable=false, GtmTomChInternalTriggerEnable=false, GtmTimerPortPinSelect=NONE:
              GtmTomChannelConf
              GtmTomChannelConf_{1..15}
        6 x GtmAtomGlobalConf:
          GtmAtomGlobalConf
            GtmAtomGroupConf
              GtmAtomActionTimeBaseUnitConf: GtmAtomActionTimeBaseSelection=ATOM_ACT_TB_TBU_TS0, GtmAtomActionTimeBaseValue=1
            8 x GtmAtomChannelConf, all with GtmAtomChResetCn0OnTriggerEnable=false, GtmAtomChInternalTriggerEnable=false, GtmTimerPortPinSelect=NONE:
              GtmAtomChannelConf
              GtmAtomChannelConf_{1..7}
          GtmAtomGlobalConf_1
            GtmAtomGroupConf
              GtmAtomActionTimeBaseUnitConf: GtmAtomActionTimeBaseSelection=ATOM_ACT_TB_TBU_TS0, GtmAtomActionTimeBaseValue=1
            8 x GtmAtomChannelConf, all with GtmAtomChResetCn0OnTriggerEnable=false, GtmAtomChInternalTriggerEnable=false, GtmTimerPortPinSelect=NONE:
              GtmAtomChannelConf
              GtmAtomChannelConf_{1..7}
          GtmAtomGlobalConf_2
            GtmAtomGroupConf
              GtmAtomActionTimeBaseUnitConf: GtmAtomActionTimeBaseSelection=ATOM_ACT_TB_TBU_TS0, GtmAtomActionTimeBaseValue=1
            8 x GtmAtomChannelConf, all with GtmAtomChResetCn0OnTriggerEnable=false, GtmAtomChInternalTriggerEnable=false, GtmTimerPortPinSelect=NONE:
              GtmAtomChannelConf
              GtmAtomChannelConf_{1..7}
          GtmAtomGlobalConf_3
            GtmAtomGroupConf
              GtmAtomActionTimeBaseUnitConf: GtmAtomActionTimeBaseSelection=ATOM_ACT_TB_TBU_TS0, GtmAtomActionTimeBaseValue=1
            8 x GtmAtomChannelConf, all with GtmAtomChResetCn0OnTriggerEnable=false, GtmAtomChInternalTriggerEnable=false, GtmTimerPortPinSelect=NONE:
              GtmAtomChannelConf
              GtmAtomChannelConf_{1..7}
          GtmAtomGlobalConf_4
            GtmAtomGroupConf
              GtmAtomActionTimeBaseUnitConf: GtmAtomActionTimeBaseSelection=ATOM_ACT_TB_TBU_TS0, GtmAtomActionTimeBaseValue=1
            8 x GtmAtomChannelConf, all with GtmAtomChResetCn0OnTriggerEnable=false, GtmAtomChInternalTriggerEnable=false, GtmTimerPortPinSelect=NONE:
              GtmAtomChannelConf
              GtmAtomChannelConf_{1..7}
          GtmAtomGlobalConf_5
            GtmAtomGroupConf
              GtmAtomActionTimeBaseUnitConf: GtmAtomActionTimeBaseSelection=ATOM_ACT_TB_TBU_TS0, GtmAtomActionTimeBaseValue=1
            8 x GtmAtomChannelConf, all with GtmAtomChResetCn0OnTriggerEnable=false, GtmAtomChInternalTriggerEnable=false, GtmTimerPortPinSelect=NONE:
              GtmAtomChannelConf
              GtmAtomChannelConf_{1..7}
        12 x GtmTriggerForAdc, all with GtmAdcTrigger0Select=TRIG_0_NO_TRIGGER, GtmAdcTrigger1Select=TRIG_0_NO_TRIGGER, GtmAdcTrigger2Select=TRIG_0_NO_TRIGGER, GtmAdcTrigger3Select=TRIG_0_NO_TRIGGER, GtmAdcTrigger4Select=TRIG_0_NO_TRIGGER:
          GtmTriggerForAdc
          GtmTriggerForAdc_{1..11}
        6 x GtmTriggerForDsadc, all with GtmDsadcTrigger0Select=TRIG_0_NO_TRIGGER, GtmDsadcTrigger1Select=TRIG_0_NO_TRIGGER, GtmDsadcTrigger2Select=TRIG_0_NO_TRIGGER, GtmDsadcTrigger3Select=TRIG_0_NO_TRIGGER:
          GtmTriggerForDsadc
          GtmTriggerForDsadc_{1..5}
    McuHardwareResourceAllocationConf
      McuGtmAllocationConf
        6 x McuGtmTimAllocationConf:
          McuGtmTimAllocationConf
            8 x McuGtmTimChannelAllocationConf, all with McuGtmTimChannelAllocationConf=GTM_TIM_CHANNEL_NOT_USED:
              McuGtmTimChannelAllocationConf
              McuGtmTimChannelAllocationConf_{1..7}
          McuGtmTimAllocationConf_1
            8 x McuGtmTimChannelAllocationConf, all with McuGtmTimChannelAllocationConf=GTM_TIM_CHANNEL_NOT_USED:
              McuGtmTimChannelAllocationConf
              McuGtmTimChannelAllocationConf_{1..7}
          McuGtmTimAllocationConf_2
            8 x McuGtmTimChannelAllocationConf, all with McuGtmTimChannelAllocationConf=GTM_TIM_CHANNEL_NOT_USED:
              McuGtmTimChannelAllocationConf
              McuGtmTimChannelAllocationConf_{1..7}
          McuGtmTimAllocationConf_3
            8 x McuGtmTimChannelAllocationConf, all with McuGtmTimChannelAllocationConf=GTM_TIM_CHANNEL_NOT_USED:
              McuGtmTimChannelAllocationConf
              McuGtmTimChannelAllocationConf_{1..7}
          McuGtmTimAllocationConf_4
            8 x McuGtmTimChannelAllocationConf, all with McuGtmTimChannelAllocationConf=GTM_TIM_CHANNEL_NOT_USED:
              McuGtmTimChannelAllocationConf
              McuGtmTimChannelAllocationConf_{1..7}
          McuGtmTimAllocationConf_5
            8 x McuGtmTimChannelAllocationConf, all with McuGtmTimChannelAllocationConf=GTM_TIM_CHANNEL_NOT_USED:
              McuGtmTimChannelAllocationConf
              McuGtmTimChannelAllocationConf_{1..7}
        3 x McuGtmTomAllocationConf:
          McuGtmTomAllocationConf
            16 x McuGtmTomChannelAllocationConf, all with McuGtmTomChannelAllocationConf=GTM_TOM_CHANNEL_NOT_USED, McuTomChannelEventHandledByDsadc=false:
              McuGtmTomChannelAllocationConf
              McuGtmTomChannelAllocationConf_{1..15}
          McuGtmTomAllocationConf_1
            16 x McuGtmTomChannelAllocationConf, all with McuGtmTomChannelAllocationConf=GTM_TOM_CHANNEL_NOT_USED, McuTomChannelEventHandledByDsadc=false:
              McuGtmTomChannelAllocationConf
              McuGtmTomChannelAllocationConf_{1..15}
          McuGtmTomAllocationConf_2
            16 x McuGtmTomChannelAllocationConf, all with McuGtmTomChannelAllocationConf=GTM_TOM_CHANNEL_NOT_USED, McuTomChannelEventHandledByDsadc=false:
              McuGtmTomChannelAllocationConf
              McuGtmTomChannelAllocationConf_{1..15}
        6 x McuGtmAtomAllocationConf:
          McuGtmAtomAllocationConf
            8 x McuGtmAtomChannelAllocationConf, all with McuGtmAtomChannelAllocationConf=GTM_ATOM_CHANNEL_NOT_USED, McuAtomChannelEventHandledByDsadc=false:
              McuGtmAtomChannelAllocationConf
              McuGtmAtomChannelAllocationConf_{1..7}
          McuGtmAtomAllocationConf_1
            8 x McuGtmAtomChannelAllocationConf, all with McuGtmAtomChannelAllocationConf=GTM_ATOM_CHANNEL_NOT_USED, McuAtomChannelEventHandledByDsadc=false:
              McuGtmAtomChannelAllocationConf
              McuGtmAtomChannelAllocationConf_{1..7}
          McuGtmAtomAllocationConf_2
            8 x McuGtmAtomChannelAllocationConf, all with McuGtmAtomChannelAllocationConf=GTM_ATOM_CHANNEL_NOT_USED, McuAtomChannelEventHandledByDsadc=false:
              McuGtmAtomChannelAllocationConf
              McuGtmAtomChannelAllocationConf_{1..7}
          McuGtmAtomAllocationConf_3
            8 x McuGtmAtomChannelAllocationConf, all with McuGtmAtomChannelAllocationConf=GTM_ATOM_CHANNEL_NOT_USED, McuAtomChannelEventHandledByDsadc=false:
              McuGtmAtomChannelAllocationConf
              McuGtmAtomChannelAllocationConf_{1..7}
          McuGtmAtomAllocationConf_4
            8 x McuGtmAtomChannelAllocationConf, all with McuGtmAtomChannelAllocationConf=GTM_ATOM_CHANNEL_NOT_USED, McuAtomChannelEventHandledByDsadc=false:
              McuGtmAtomChannelAllocationConf
              McuGtmAtomChannelAllocationConf_{1..7}
          McuGtmAtomAllocationConf_5
            8 x McuGtmAtomChannelAllocationConf, all with McuGtmAtomChannelAllocationConf=GTM_ATOM_CHANNEL_NOT_USED, McuAtomChannelEventHandledByDsadc=false:
              McuGtmAtomChannelAllocationConf
              McuGtmAtomChannelAllocationConf_{1..7}
      12 x McuAscLinAllocationConf:
        McuAscLinAllocationConf
          McuAscLinChannelAllocationConf: McuAscLinChannelAllocationConf=ASCLIN_CH_NOT_USED
        McuAscLinAllocationConf_1
          McuAscLinChannelAllocationConf: McuAscLinChannelAllocationConf=ASCLIN_CH_NOT_USED
        McuAscLinAllocationConf_2
          McuAscLinChannelAllocationConf: McuAscLinChannelAllocationConf=ASCLIN_CH_NOT_USED
        McuAscLinAllocationConf_3
          McuAscLinChannelAllocationConf: McuAscLinChannelAllocationConf=ASCLIN_CH_NOT_USED
        McuAscLinAllocationConf_4
          McuAscLinChannelAllocationConf: McuAscLinChannelAllocationConf=ASCLIN_CH_NOT_USED
        McuAscLinAllocationConf_5
          McuAscLinChannelAllocationConf: McuAscLinChannelAllocationConf=ASCLIN_CH_NOT_USED
        McuAscLinAllocationConf_6
          McuAscLinChannelAllocationConf: McuAscLinChannelAllocationConf=ASCLIN_CH_NOT_USED
        McuAscLinAllocationConf_7
          McuAscLinChannelAllocationConf: McuAscLinChannelAllocationConf=ASCLIN_CH_NOT_USED
        McuAscLinAllocationConf_8
          McuAscLinChannelAllocationConf: McuAscLinChannelAllocationConf=ASCLIN_CH_NOT_USED
        McuAscLinAllocationConf_9
          McuAscLinChannelAllocationConf: McuAscLinChannelAllocationConf=ASCLIN_CH_NOT_USED
        McuAscLinAllocationConf_10
          McuAscLinChannelAllocationConf: McuAscLinChannelAllocationConf=ASCLIN_CH_NOT_USED
        McuAscLinAllocationConf_11
          McuAscLinChannelAllocationConf: McuAscLinChannelAllocationConf=ASCLIN_CH_NOT_USED
      McuCcu6ModuleAllocationConf: McuCcu6ModuleAllocationConf=CCU6_MODULE_NOT_USED
      McuCcu6ModuleAllocationConf_1 (McuCcu6ModuleAllocationConf): McuCcu6ModuleAllocationConf=CCU6_MODULE_NOT_USED
      5 x McuGpt12ModuleAllocationConf, all with McuGpt12TimerAllocation=GPT_TIMER_2, McuGpt12ModuleAllocationConf=GPT_TIMER_NOT_USED:
        McuGpt12ModuleAllocationConf
        McuGpt12ModuleAllocationConf_{1..4}
      McuEruAllocationConf
        8 x McuEruChannelInputLineConf, all with McuEruChannelInputLineConf=ERU_CHANNEL_INP_NOT_USED:
          McuEruChannelInputLineConf
          McuEruChannelInputLineConf_{1..7}
        8 x McuEruChannelOutputUnitConf, all with McuEruChannelOutputUnitConf=ERU_CHANNEL_OUT_NOT_USED:
          McuEruChannelOutputUnitConf
          McuEruChannelOutputUnitConf_{1..7}
      3 x McuStmAllocationConf, all with McuStmCmp0RegAllocationConf=STM_CMP0_NOT_USED, McuStmCmp1RegAllocationConf=STM_CMP1_NOT_USED:
        McuStmAllocationConf
        McuStmAllocationConf_1
        McuStmAllocationConf_2
    CommonPublishedInformation:
      ArMajorVersion = 4
      ArMinorVersion = 2
      ArPatchVersion = 2
      SwMajorVersion = 10
      SwMinorVersion = 40
      SwPatchVersion = 2
      ModuleId = 101
      VendorId = 17
      Release = _TRICORE_TC377
    McuPublishedInformation
      21 x McuResetReasonConf, all with McuResetReason=0:
        McuResetReasonConf
        McuResetReasonConf_{1..20}
