AUTOSAR XML (schema 00048)
package /Mcu
  module config Mcu: implementation-config-variant=VARIANT-POST-BUILD, module-description=Mcu_Impl
    CommonPublishedInformation:
      ArMajorVersion = 4
      ArMinorVersion = 2
      ArPatchVersion = 2
      ModuleId = 101
      Release = _TRICORE_TC377
      SwMajorVersion = 10
      SwMinorVersion = 40
      SwPatchVersion = 2
      VendorId = 17
    McuGeneralConfiguration:
      McuCcu60SleepModeEnabled = false
      McuCcu61SleepModeEnabled = false
      McuClearColdResetStatusApi = true
      McuClockSourceFailureNotification = false
      McuDevErrorDetect = true
      McuGetRamStateApi = true
      McuGpt12SleepModeEnabled = false
      McuGtmSleepModeEnabled = false
      McuIdleModeCpuCore = INDIVIDUAL_IDLE_CORES_SEL0
      McuIfxCpuCcuconApi = false
      McuIfxDeInitApi = false
      McuIfxLpmApi = true
      McuIfxTrapApi = false
      McuInitCheckApi = false
      McuInitClock = true
      McuInitDeInitApiMode = MCU_MCAL_SUPERVISOR
      McuMainOscillatorFrequency = 20
      McuMultiCoreErrorDetect = false
      McuNoPll = false
      McuOscAmpRegulationEnable = false
      McuOscCapacitance{0..3}Enable = false
      McuOscillatorMode = EXT_CRYSTAL_CERAMIC_RES_MODE_SEL0
      McuPerformResetApi = true
      McuRuntimeApiMode = MCU_MCAL_SUPERVISOR
      McuSafetyEnable = false
      McuStandbyEntryMode = STANDBY_ENTRY_REQ_SLEEP_SEL0
      McuSysClkFrequency = 20
      McuSystemModeCpuCore = CPU_SYSTEM_CORE0_SEL0
      McuVersionInfoApi = true
    McuHardwareResourceAllocationConf_0 (McuHardwareResourceAllocationConf)
      12 x McuAscLinAllocationConf:
        McuAscLinAllocationConf_0
          McuAscLinChannelAllocationConf: McuAscLinChannelAllocationConf=ASCLIN_CH_NOT_USED
        McuAscLinAllocationConf_1
          McuAscLinChannelAllocationConf: McuAscLinChannelAllocationConf=ASCLIN_CH_USED_BY_LIN_DRIVER
        McuAscLinAllocationConf_10
          McuAscLinChannelAllocationConf: McuAscLinChannelAllocationConf=ASCLIN_CH_NOT_USED
        McuAscLinAllocationConf_11
          McuAscLinChannelAllocationConf: McuAscLinChannelAllocationConf=ASCLIN_CH_NOT_USED
        McuAscLinAllocationConf_2
          McuAscLinChannelAllocationConf: McuAscLinChannelAllocationConf=ASCLIN_CH_USED_BY_LIN_DRIVER
        McuAscLinAllocationConf_3
          McuAscLinChannelAllocationConf: McuAscLinChannelAllocationConf=ASCLIN_CH_USED_BY_LIN_DRIVER
        McuAscLinAllocationConf_4
          McuAscLinChannelAllocationConf: McuAscLinChannelAllocationConf=ASCLIN_CH_USED_BY_LIN_DRIVER
        McuAscLinAllocationConf_5
          McuAscLinChannelAllocationConf: McuAscLinChannelAllocationConf=ASCLIN_CH_NOT_USED
        McuAscLinAllocationConf_6
          McuAscLinChannelAllocationConf: McuAscLinChannelAllocationConf=ASCLIN_CH_NOT_USED
        McuAscLinAllocationConf_7
          McuAscLinChannelAllocationConf: McuAscLinChannelAllocationConf=ASCLIN_CH_NOT_USED
        McuAscLinAllocationConf_8
          McuAscLinChannelAllocationConf: McuAscLinChannelAllocationConf=ASCLIN_CH_NOT_USED
        McuAscLinAllocationConf_9
          McuAscLinChannelAllocationConf: McuAscLinChannelAllocationConf=ASCLIN_CH_NOT_USED
      McuCcu6ModuleAllocationConf_0 (McuCcu6ModuleAllocationConf): McuCcu6ModuleAllocationConf=CCU6_MODULE_NOT_USED
      McuCcu6ModuleAllocationConf_1 (McuCcu6ModuleAllocationConf): McuCcu6ModuleAllocationConf=CCU6_MODULE_NOT_USED
      McuEruAllocationConf_0 (McuEruAllocationConf)
        8 x McuEruChannelInputLineConf, all with McuEruChannelInputLineConf=ERU_CHANNEL_INP_NOT_USED:
          McuEruChannelInputLineConf_{0..7}
        8 x McuEruChannelOutputUnitConf, all with McuEruChannelOutputUnitConf=ERU_CHANNEL_OUT_NOT_USED:
          McuEruChannelOutputUnitConf_{0..7}
      5 x McuGpt12ModuleAllocationConf, all with McuGpt12ModuleAllocationConf=GPT_TIMER_NOT_USED:
        McuGpt12ModuleAllocationConf_0: McuGpt12TimerAllocation=GPT_TIMER_2
        McuGpt12ModuleAllocationConf_1: McuGpt12TimerAllocation=GPT_TIMER_3
        McuGpt12ModuleAllocationConf_2: McuGpt12TimerAllocation=GPT_TIMER_4
        McuGpt12ModuleAllocationConf_3: McuGpt12TimerAllocation=GPT_TIMER_5
        McuGpt12ModuleAllocationConf_4: McuGpt12TimerAllocation=GPT_TIMER_6
      McuGtmAllocationConf_0 (McuGtmAllocationConf)
        6 x McuGtmAtomAllocationConf:
          McuGtmAtomAllocationConf_0
            8 x McuGtmAtomChannelAllocationConf, all with McuAtomChannelEventHandledByDsadc=false, McuGtmAtomChannelAllocationConf=GTM_ATOM_CHANNEL_NOT_USED:
              McuGtmAtomChannelAllocationConf_{0..7}
          McuGtmAtomAllocationConf_1
            8 x McuGtmAtomChannelAllocationConf, all with McuAtomChannelEventHandledByDsadc=false, McuGtmAtomChannelAllocationConf=GTM_ATOM_CHANNEL_NOT_USED:
              McuGtmAtomChannelAllocationConf_{0..7}
          McuGtmAtomAllocationConf_2
            8 x McuGtmAtomChannelAllocationConf, all with McuAtomChannelEventHandledByDsadc=false, McuGtmAtomChannelAllocationConf=GTM_ATOM_CHANNEL_NOT_USED:
              McuGtmAtomChannelAllocationConf_{0..7}
          McuGtmAtomAllocationConf_3
            8 x McuGtmAtomChannelAllocationConf, all with McuAtomChannelEventHandledByDsadc=false, McuGtmAtomChannelAllocationConf=GTM_ATOM_CHANNEL_NOT_USED:
              McuGtmAtomChannelAllocationConf_{0..7}
          McuGtmAtomAllocationConf_4
            8 x McuGtmAtomChannelAllocationConf, all with McuAtomChannelEventHandledByDsadc=false, McuGtmAtomChannelAllocationConf=GTM_ATOM_CHANNEL_NOT_USED:
              McuGtmAtomChannelAllocationConf_{0..7}
          McuGtmAtomAllocationConf_5
            8 x McuGtmAtomChannelAllocationConf, all with McuAtomChannelEventHandledByDsadc=false, McuGtmAtomChannelAllocationConf=GTM_ATOM_CHANNEL_NOT_USED:
              McuGtmAtomChannelAllocationConf_{0..7}
        6 x McuGtmTimAllocationConf:
          McuGtmTimAllocationConf_0
            8 x McuGtmTimChannelAllocationConf, all with McuGtmTimChannelAllocationConf=GTM_TIM_CHANNEL_NOT_USED:
              McuGtmTimChannelAllocationConf_{0..7}
          McuGtmTimAllocationConf_1
            8 x McuGtmTimChannelAllocationConf, all with McuGtmTimChannelAllocationConf=GTM_TIM_CHANNEL_NOT_USED:
              McuGtmTimChannelAllocationConf_{0..7}
          McuGtmTimAllocationConf_2
            8 x McuGtmTimChannelAllocationConf:
              McuGtmTimChannelAllocationConf_{0..3}: McuGtmTimChannelAllocationConf=GTM_TIM_CHANNEL_NOT_USED
              McuGtmTimChannelAllocationConf_4: McuGtmTimChannelAllocationConf=GTM_TIM_CHANNEL_USED_BY_ICU
              McuGtmTimChannelAllocationConf_5: McuGtmTimChannelAllocationConf=GTM_TIM_CHANNEL_NOT_USED
              McuGtmTimChannelAllocationConf_6: McuGtmTimChannelAllocationConf=GTM_TIM_CHANNEL_USED_BY_ICU
              McuGtmTimChannelAllocationConf_7: McuGtmTimChannelAllocationConf=GTM_TIM_CHANNEL_NOT_USED
          McuGtmTimAllocationConf_3
            8 x McuGtmTimChannelAllocationConf, all with McuGtmTimChannelAllocationConf=GTM_TIM_CHANNEL_NOT_USED:
              McuGtmTimChannelAllocationConf_{0..7}
          McuGtmTimAllocationConf_4
            8 x McuGtmTimChannelAllocationConf, all with McuGtmTimChannelAllocationConf=GTM_TIM_CHANNEL_NOT_USED:
              McuGtmTimChannelAllocationConf_{0..7}
          McuGtmTimAllocationConf_5
            8 x McuGtmTimChannelAllocationConf, all with McuGtmTimChannelAllocationConf=GTM_TIM_CHANNEL_NOT_USED:
              McuGtmTimChannelAllocationConf_{0..7}
        3 x McuGtmTomAllocationConf:
          McuGtmTomAllocationConf_0
            16 x McuGtmTomChannelAllocationConf, all with McuTomChannelEventHandledByDsadc=false:
              McuGtmTomChannelAllocationConf_0: McuGtmTomChannelAllocationConf=GTM_TOM_CHANNEL_NOT_USED
              McuGtmTomChannelAllocationConf_1: McuGtmTomChannelAllocationConf=GTM_TOM_CHANNEL_NOT_USED
              McuGtmTomChannelAllocationConf_{10..15}: McuGtmTomChannelAllocationConf=GTM_TOM_CHANNEL_NOT_USED
              McuGtmTomChannelAllocationConf_2: McuGtmTomChannelAllocationConf=GTM_TOM_CHANNEL_USED_BY_PWM
              McuGtmTomChannelAllocationConf_{3..9}: McuGtmTomChannelAllocationConf=GTM_TOM_CHANNEL_NOT_USED
          McuGtmTomAllocationConf_1
            16 x McuGtmTomChannelAllocationConf, all with McuTomChannelEventHandledByDsadc=false:
              McuGtmTomChannelAllocationConf_0: McuGtmTomChannelAllocationConf=GTM_TOM_CHANNEL_USED_BY_PWM
              McuGtmTomChannelAllocationConf_1: McuGtmTomChannelAllocationConf=GTM_TOM_CHANNEL_USED_BY_PWM
              McuGtmTomChannelAllocationConf_{10..15}: McuGtmTomChannelAllocationConf=GTM_TOM_CHANNEL_NOT_USED
              McuGtmTomChannelAllocationConf_2: McuGtmTomChannelAllocationConf=GTM_TOM_CHANNEL_NOT_USED
              McuGtmTomChannelAllocationConf_3: McuGtmTomChannelAllocationConf=GTM_TOM_CHANNEL_USED_BY_PWM
              McuGtmTomChannelAllocationConf_4: McuGtmTomChannelAllocationConf=GTM_TOM_CHANNEL_USED_BY_PWM
              McuGtmTomChannelAllocationConf_{5..9}: McuGtmTomChannelAllocationConf=GTM_TOM_CHANNEL_NOT_USED
          McuGtmTomAllocationConf_2
            16 x McuGtmTomChannelAllocationConf, all with McuGtmTomChannelAllocationConf=GTM_TOM_CHANNEL_NOT_USED, McuTomChannelEventHandledByDsadc=false:
              McuGtmTomChannelAllocationConf_0
              McuGtmTomChannelAllocationConf_1
              McuGtmTomChannelAllocationConf_{10..15}
              McuGtmTomChannelAllocationConf_{2..9}
      3 x McuStmAllocationConf, all with McuStmCmp0RegAllocationConf=STM_CMP0_NOT_USED, McuStmCmp1RegAllocationConf=STM_CMP1_NOT_USED:
        McuStmAllocationConf_{0..2}
    McuModuleConfiguration: McuClockSrcFailureNotification=DISABLED, McuNumberOfMcuModes=1, McuRamSectors=0
      GtmGlobalConfiguration_0 (GtmGlobalConfiguration)
        6 x GtmAtomGlobalConf:
          GtmAtomGlobalConf_0
            8 x GtmAtomChannelConf, all with GtmAtomChInternalTriggerEnable=false, GtmAtomChResetCn0OnTriggerEnable=false, GtmTimerPortPinSelect=NONE:
              GtmAtomChannelConf_{0..7}
            GtmAtomGroupConf
              GtmAtomActionTimeBaseUnitConf: GtmAtomActionTimeBaseSelection=ATOM_ACT_TB_TBU_TS0, GtmAtomActionTimeBaseValue=1
          GtmAtomGlobalConf_1
            8 x GtmAtomChannelConf, all with GtmAtomChInternalTriggerEnable=false, GtmAtomChResetCn0OnTriggerEnable=false, GtmTimerPortPinSelect=NONE:
              GtmAtomChannelConf_{0..7}
            GtmAtomGroupConf
              GtmAtomActionTimeBaseUnitConf: GtmAtomActionTimeBaseSelection=ATOM_ACT_TB_TBU_TS0, GtmAtomActionTimeBaseValue=1
          GtmAtomGlobalConf_2
            8 x GtmAtomChannelConf, all with GtmAtomChInternalTriggerEnable=false, GtmAtomChResetCn0OnTriggerEnable=false, GtmTimerPortPinSelect=NONE:
              GtmAtomChannelConf_{0..7}
            GtmAtomGroupConf
              GtmAtomActionTimeBaseUnitConf: GtmAtomActionTimeBaseSelection=ATOM_ACT_TB_TBU_TS0, GtmAtomActionTimeBaseValue=1
          GtmAtomGlobalConf_3
            8 x GtmAtomChannelConf, all with GtmAtomChInternalTriggerEnable=false, GtmAtomChResetCn0OnTriggerEnable=false, GtmTimerPortPinSelect=NONE:
              GtmAtomChannelConf_{0..7}
            GtmAtomGroupConf
              GtmAtomActionTimeBaseUnitConf: GtmAtomActionTimeBaseSelection=ATOM_ACT_TB_TBU_TS0, GtmAtomActionTimeBaseValue=1
          GtmAtomGlobalConf_4
            8 x GtmAtomChannelConf, all with GtmAtomChInternalTriggerEnable=false, GtmAtomChResetCn0OnTriggerEnable=false, GtmTimerPortPinSelect=NONE:
              GtmAtomChannelConf_{0..7}
            GtmAtomGroupConf
              GtmAtomActionTimeBaseUnitConf: GtmAtomActionTimeBaseSelection=ATOM_ACT_TB_TBU_TS0, GtmAtomActionTimeBaseValue=1
          GtmAtomGlobalConf_5
            8 x GtmAtomChannelConf, all with GtmAtomChInternalTriggerEnable=false, GtmAtomChResetCn0OnTriggerEnable=false, GtmTimerPortPinSelect=NONE:
              GtmAtomChannelConf_{0..7}
            GtmAtomGroupConf
              GtmAtomActionTimeBaseUnitConf: GtmAtomActionTimeBaseSelection=ATOM_ACT_TB_TBU_TS0, GtmAtomActionTimeBaseValue=1
        6 x GtmClusterConf, all with GtmCmuClusterInputClockDividerEnable=CLS_CLK_CFG_ENABLED_WITH_DIV_SEL2:
          GtmClusterConf_0
            GtmClusterConfClockSetting:
              GtmClusterConfClock{0..7}Src = CMU_CONF_CLOCK{0..7}_SEL0
            GtmClusterFixedClockSetting: GtmClusterFixedClockSrc=CMU_FIXED_CLOCK0_SEL0
          GtmClusterConf_1
            GtmClusterConfClockSetting:
              GtmClusterConfClock{0..7}Src = CMU_CONF_CLOCK{0..7}_SEL0
            GtmClusterFixedClockSetting: GtmClusterFixedClockSrc=CMU_FIXED_CLOCK0_SEL0
          GtmClusterConf_2
            GtmClusterConfClockSetting:
              GtmClusterConfClock{0..7}Src = CMU_CONF_CLOCK{0..7}_SEL0
            GtmClusterFixedClockSetting: GtmClusterFixedClockSrc=CMU_FIXED_CLOCK0_SEL0
          GtmClusterConf_3
            GtmClusterConfClockSetting:
              GtmClusterConfClock{0..7}Src = CMU_CONF_CLOCK{0..7}_SEL0
            GtmClusterFixedClockSetting: GtmClusterFixedClockSrc=CMU_FIXED_CLOCK0_SEL0
          GtmClusterConf_4
            GtmClusterConfClockSetting:
              GtmClusterConfClock{0..7}Src = CMU_CONF_CLOCK{0..7}_SEL0
            GtmClusterFixedClockSetting: GtmClusterFixedClockSrc=CMU_FIXED_CLOCK0_SEL0
          GtmClusterConf_5
            GtmClusterConfClockSetting:
              GtmClusterConfClock{0..7}Src = CMU_CONF_CLOCK{0..7}_SEL0
            GtmClusterFixedClockSetting: GtmClusterFixedClockSrc=CMU_FIXED_CLOCK0_SEL0
        4 x GtmTbuChannelConf, all with GtmTbuChClockSourceSelection=CMU_CLOCK0_SEL0, GtmTbuChMode=FREE_RUNNING_COUNTER_SEL0, GtmTbuChModuloCntrSel=TBU_CH1_SEL0, GtmTbuChResolutionSel=TBU_CH_LOWER_COUNT_BITS_SEL0:
          GtmTbuChannelConf_0: GtmTbuChannelEnable=true
          GtmTbuChannelConf_{1..3}: GtmTbuChannelEnable=false
        3 x GtmTomGlobalConf:
          GtmTomGlobalConf_0
            16 x GtmTomChannelConf, all with GtmTomChInternalTriggerEnable=false, GtmTomChResetCn0OnTriggerEnable=false:
              GtmTomChannelConf_0: GtmTimerPortPinSelect=TOUT34_SELE_4_PORT33_PIN12
              GtmTomChannelConf_1: GtmTimerPortPinSelect=TOUT30_SELE_4_PORT33_PIN8
              GtmTomChannelConf_{10..15}: GtmTimerPortPinSelect=NONE
              GtmTomChannelConf_2: GtmTimerPortPinSelect=TOUT5_SELE_4_PORT02_PIN5
              GtmTomChannelConf_3: GtmTimerPortPinSelect=NONE
              GtmTomChannelConf_4: GtmTimerPortPinSelect=TOUT36_SELE_4_PORT32_PIN0
              GtmTomChannelConf_5: GtmTimerPortPinSelect=TOUT121_SELG_6_PORT11_PIN4
              GtmTomChannelConf_6: GtmTimerPortPinSelect=TOUT31_SELE_4_PORT33_PIN9
              GtmTomChannelConf_7: GtmTimerPortPinSelect=TOUT119_SELG_6_PORT11_PIN0
              GtmTomChannelConf_8: GtmTimerPortPinSelect=TOUT95_SELA_0_PORT11_PIN2
              GtmTomChannelConf_9: GtmTimerPortPinSelect=NONE
            GtmTomGroupConf_0 (GtmTomGroupConf)
              GtmTomActionTimeBaseUnitConf: GtmTomActionTimeBaseSelection=TOM_ACT_TB_TBU_TS0, GtmTomActionTimeBaseValue=1
            GtmTomGroupConf_1 (GtmTomGroupConf)
              GtmTomActionTimeBaseUnitConf: GtmTomActionTimeBaseSelection=TOM_ACT_TB_TBU_TS0, GtmTomActionTimeBaseValue=1
          GtmTomGlobalConf_1
            16 x GtmTomChannelConf, all with GtmTomChInternalTriggerEnable=false, GtmTomChResetCn0OnTriggerEnable=false:
              GtmTomChannelConf_0: GtmTimerPortPinSelect=TOUT9_SELB_1_PORT00_PIN0
              GtmTomChannelConf_1: GtmTimerPortPinSelect=TOUT10_SELB_1_PORT00_PIN1
              GtmTomChannelConf_{10..15}: GtmTimerPortPinSelect=NONE
              GtmTomChannelConf_2: GtmTimerPortPinSelect=NONE
              GtmTomChannelConf_3: GtmTimerPortPinSelect=TOUT13_SELB_1_PORT00_PIN4
              GtmTomChannelConf_4: GtmTimerPortPinSelect=TOUT14_SELB_1_PORT00_PIN5
              GtmTomChannelConf_{5..9}: GtmTimerPortPinSelect=NONE
            GtmTomGroupConf_0 (GtmTomGroupConf)
              GtmTomActionTimeBaseUnitConf: GtmTomActionTimeBaseSelection=TOM_ACT_TB_TBU_TS0, GtmTomActionTimeBaseValue=1
            GtmTomGroupConf_1 (GtmTomGroupConf)
              GtmTomActionTimeBaseUnitConf: GtmTomActionTimeBaseSelection=TOM_ACT_TB_TBU_TS0, GtmTomActionTimeBaseValue=1
          GtmTomGlobalConf_2
            16 x GtmTomChannelConf, all with GtmTomChInternalTriggerEnable=false, GtmTomChResetCn0OnTriggerEnable=false:
              GtmTomChannelConf_0: GtmTimerPortPinSelect=TOUT120_SELG_6_PORT11_PIN1
              GtmTomChannelConf_1: GtmTimerPortPinSelect=NONE
              GtmTomChannelConf_{10..15}: GtmTimerPortPinSelect=NONE
              GtmTomChannelConf_{2..9}: GtmTimerPortPinSelect=NONE
            GtmTomGroupConf_0 (GtmTomGroupConf)
              GtmTomActionTimeBaseUnitConf: GtmTomActionTimeBaseSelection=TOM_ACT_TB_TBU_TS0, GtmTomActionTimeBaseValue=1
            GtmTomGroupConf_1 (GtmTomGroupConf)
              GtmTomActionTimeBaseUnitConf: GtmTomActionTimeBaseSelection=TOM_ACT_TB_TBU_TS0, GtmTomActionTimeBaseValue=1
        12 x GtmTriggerForAdc, all with GtmAdcTrigger0Select=TRIG_0_NO_TRIGGER, GtmAdcTrigger1Select=TRIG_0_NO_TRIGGER, GtmAdcTrigger2Select=TRIG_0_NO_TRIGGER, GtmAdcTrigger3Select=TRIG_0_NO_TRIGGER, GtmAdcTrigger4Select=TRIG_0_NO_TRIGGER:
          GtmTriggerForAdc_0
          GtmTriggerForAdc_1
          GtmTriggerForAdc_10
          GtmTriggerForAdc_11
          GtmTriggerForAdc_{2..9}
        6 x GtmTriggerForDsadc, all with GtmDsadcTrigger0Select=TRIG_0_NO_TRIGGER, GtmDsadcTrigger1Select=TRIG_0_NO_TRIGGER, GtmDsadcTrigger2Select=TRIG_0_NO_TRIGGER, GtmDsadcTrigger3Select=TRIG_0_NO_TRIGGER:
          GtmTriggerForDsadc_{0..5}
        McuGtmClockManagementConf: GtmCmuGlobalClockDenominator=1, GtmCmuGlobalClockNumerator=1
          GtmConfigClockSetting:
            GtmCmuConfigClock0Div = 15
            GtmCmuConfigClock0Enable = true
            GtmCmuConfigClock1Div = 0
            GtmCmuConfigClock1Enable = true
            GtmCmuConfigClock2Div = 0
            GtmCmuConfigClock2Enable = true
            GtmCmuConfigClock3Div = 0
            GtmCmuConfigClock3Enable = true
            GtmCmuConfigClock4Div = 0
            GtmCmuConfigClock4Enable = true
            GtmCmuConfigClock5Div = 0
            GtmCmuConfigClock5Enable = true
            GtmCmuConfigClock6Div = 0
            GtmCmuConfigClock6Enable = true
            GtmCmuConfigClock7Div = 0
            GtmCmuConfigClock7Enable = true
          GtmExtClockSetting:
            GtmCmuExtClock0Denominator = 1
            GtmCmuExtClock0Enable = false
            GtmCmuExtClock0Numerator = 1
            GtmCmuExtClock1Denominator = 1
            GtmCmuExtClock1Enable = false
            GtmCmuExtClock1Numerator = 1
            GtmCmuExtClock2Denominator = 1
            GtmCmuExtClock2Enable = false
            GtmCmuExtClock2Numerator = 1
          GtmFixedClockSetting: GtmCmuFixedClockEnable=true, GtmCmuFixedClockSel=CMU_GLOBAL_CLOCK_SEL0
      McuClockSettingConfig_0 (McuClockSettingConfig): McuClockSettingId=0
        4 x McuClockReferencePoint:
          McuClockReferencePoint_0: McuClockRefSelection=MCU_ASCLINFAST_FREQUENCY, McuClockReferencePointFrequency=200000000
          McuClockReferencePoint_ADC: McuClockRefSelection=MCU_ADC_FREQUENCY, McuClockReferencePointFrequency=160000000
          McuClockReferencePoint_GPT: McuClockRefSelection=MCU_GTM_FREQUENCY, McuClockReferencePointFrequency=100000000
          McuClockReferencePoint_SPI: McuClockRefSelection=MCU_QSPI_FREQUENCY, McuClockReferencePointFrequency=200000000
        McuClockReferencePointConfig
          McuClockMonitorConfig:
            McuBackupClockMonEnable = false
            McuBackupClockRangeMonEnable = false
            McuPll{0..2}ClockMonEnable = false
            McuSpbClockMonEnable = false
          McuExternalClockOutputConfig:
            McuExtClock0Enable = true
            McuExtClock1Enable = false
            McuExtClock1Inverted = false
            McuExtClockOutSel0 = TCK_EXT_CLOCK0_SEL13
            McuExtClockOutSel1 = FOUT_EXT_CLOCK1_SEL0
            McuFoutClockDiv = 1
          McuPeripheralPllSettingConfig:
            McuClockReferencePointFrequency1 = 160000000
            McuClockReferencePointFrequency2 = 200000000
            McuFreqSource1ClockDivSelect = DIV_FACTOR_2_BYPASSED_SEL1
            McuPerPllK2DivStepDownChangeDelay = 10
            McuPerPllK2DivStepUpChangeDelay = 10
            McuPerPllK3DivStepDownChangeDelay = 10
            McuPerPllK3DivStepUpChangeDelay = 10
            McuPeripheralPllK2Divider = 3
            McuPeripheralPllK3Divider = 1
            McuPeripheralPllNDivider = 31
            McuPeripheralPllPDivider = 0
            McuPll2DivSelect = MCU_K3_DIV_FACTOR_NOT_BYPASSED_SEL0
          McuPllDistributionSettingConfig:
            McuAdasFrequency = 0
            McuAdcFrequency = 160000000
            McuAscLinFastFrequency = 200000000
            McuAscLinSlowClockSourceSelection = ASCLINS_CLOCK_SOURCE_ASCLINSI_SEL1
            McuAscLinSlowFrequency = 80000000
            McuBBBFrequency = 150000000
            McuCPU{0..3}Frequency = 300000000
            McuCPU4Frequency = 0
            McuCPU5Frequency = 0
            McuClockDistributionInpClockSel = PLL_INPUT_CLOCK_SRC_SELECT_SEL1
            McuConvCtrlPhaseSynchConf = PHASE_SYNCH_CONST_ACTIVE_SEL0
            McuEbuClkEnable = false
            McuEbuFrequency = 0
            McuErayClkEnable = true
            McuErayFrequency = 80000000
            McuFSI2Frequency = 300000000
            McuFSIFrequency = 100000000
            McuGEthFrequency = 150000000
            McuGTMFrequency = 200000000
            McuHsctFrequency = 320000000
            McuHspdm160Frequency = 0
            McuHspdm320Frequency = 0
            McuHspdmClkEnable = false
            McuI2CFrequency = 100000000
            McuLowPowerDivValue = LOW_POWER_DIVIDER_DISABLE_SEL0
            McuMCanClockSourceSelection = MCAN_CLOCK_SOURCE_MCANI_SEL1
            McuMCanFrequency = 80000000
            McuMcanHFrequency = 100000000
            McuMscClockSourceSelection = MSC_CLOCK_SOURCE_DISABLED_SEL0
            McuMscFrequency = 0
            McuQspiClockSourceSelection = QSPI_CLOCK_SOURCE_SOURCE2_SEL2
            McuQspiFrequency = 200000000
            McuReferenceFrequency1 = 12500000
            McuReferenceFrequency2 = 6666667
            McuSPBFrequency = 100000000
            McuSRIFrequency = 300000000
            McuSTMFrequency = 100000000
          McuSystemPllSettingConfig:
            McuClockReferencePointFrequency0 = 300000000
            McuFMPllModAmp = 1.25
            McuFmPllEnable = false
            McuPllInputSrcSelection = OSC_CLOCK_SRC_SELECT_SEL1
            McuSysPllK2DivStepDownChangeDelay = 10
            McuSysPllK2DivStepUpChangeDelay = 10
            McuSystemPllK2Divider = 1
            McuSystemPllNDivider = 29
            McuSystemPllPDivider = 0
        McuClockReferencePoint_CAN (McuClockReferencePoint): McuClockRefSelection=MCU_MCAN_FREQUENCY, McuClockReferencePointFrequency=80000000
        McuClockReferencePoint_GTM (McuClockReferencePoint): McuClockRefSelection=MCU_GTM_FREQUENCY, McuClockReferencePointFrequency=200000000
      McuDemEventParameterRefs_0 (McuDemEventParameterRefs)
      McuEruGlobalConf: McuEruInputFilterRegVal=0
      McuGpt12PrescalerConf: Gpt1BlockPrescalerSel=GPT1_BLOCK_NOT_USED, Gpt2BlockPrescalerSel=GPT2_BLOCK_NOT_USED
      McuModeSettingConf_Standby (McuModeSettingConf): McuEvrcLPMOnSleepReqEnable=true, McuMode=2
        McuStdbyModeSettingConf:
          McuStdbyModeBlankingFilterDelay = DELAY_0_MS_SEL0
          McuStdbyModeClkSelection = OSC_CLOCK_100KHZ_ONLY_SEL0
          McuStdbyModeESR0TriStateEnable = false
          McuStdbyModePORSTFilterEnable = false
          McuStdbyModePortTriStateEnable = false
          McuStdbyModeRamEnable = MCU_STANDBYRAM_DISABLED_SEL0
          McuStdbyModeWakeupFromEVR = false
          McuStdbyModeWakeupFromPORST = true
          McuStdbyModeWakeupFromSCR = true
          McuStdbyModeESR0Conf: McuStdbyModeESR0EdgeDetection=ESR0_TRIG_RISING_EDGE_SEL1, McuStdbyModeESR0FltEnable=false, McuStdbyModeESR0WakeupEnable=false
          McuStdbyModeESR1Conf: McuStdbyModeESR1EdgeDetection=ESR1_TRIG_RISING_FALLING_EDGE_SEL3, McuStdbyModeESR1FltEnable=false, McuStdbyModeESR1WakeupEnable=false
          McuStdbyModePinAConf: McuStdbyModePinAEdgeDetection=PINA_TRIG_RISING_EDGE_SEL1, McuStdbyModePinAFltEnable=false, McuStdbyModePinAWakeupEnable=false
          McuStdbyModePinBConf: McuStdbyModePinBEdgeDetection=PINB_TRIG_FALLING_EDGE_SEL2, McuStdbyModePinBFltEnable=true, McuStdbyModePinBWakeupEnable=true
          McuStdbyModeWakeupTimerConf:
            McuStdbyModeWakeupTimerClkDiv = WUT_100KHZ_NO_DIV_CLK_SEL0
            McuStdbyModeWakeupTimerEnable = false
            McuStdbyModeWakeupTimerMode = WUT_AUTO_RELOAD_MODE_SEL0
            McuStdbyModeWakeupTimerValue = 16777215
      McuResetSettingConf:
        McuESR0ResetConf = MCU_ESR0_NO_RESET_SEL0
        McuESR1ResetConf = MCU_ESR1_NO_RESET_SEL0
        McuSMUResetConf = MCU_SMU_NO_RESET_SEL0
        McuSTM0ResetConf = MCU_STM0_NO_RESET_SEL0
        McuSTM0ResetOnApplResetEnable = true
        McuSTM1ResetConf = MCU_STM1_NO_RESET_SEL0
        McuSTM1ResetOnApplResetEnable = true
        McuSTM2ResetConf = MCU_STM2_NO_RESET_SEL0
        McuSTM2ResetOnApplResetEnable = true
        McuSTM3ResetConf = MCU_STM3_NO_RESET_SEL0
        McuSTM3ResetOnApplResetEnable = true
        McuSTM4ResetConf = MCU_STM4_NO_RESET_SEL0
        McuSTM4ResetOnApplResetEnable = true
        McuSTM5ResetConf = MCU_STM5_NO_RESET_SEL0
        McuSTM5ResetOnApplResetEnable = true
        McuSWResetConf = MCU_SW_APPLICATION_RESET_SEL2
      McuTrapSettingConf:
        McuCPU0ESR0TrapEnable = false
        McuCPU0ESR1TrapEnable = false
        McuCPU0SMUTrapEnable = false
        McuCPU0Trap2Enable = false
        McuCPU1ESR0TrapEnable = false
        McuCPU1ESR1TrapEnable = false
        McuCPU1SMUTrapEnable = false
        McuCPU1Trap2Enable = false
        McuCPU2ESR0TrapEnable = false
        McuCPU2ESR1TrapEnable = false
        McuCPU2SMUTrapEnable = false
        McuCPU2Trap2Enable = false
        McuCPU3ESR0TrapEnable = false
        McuCPU3ESR1TrapEnable = false
        McuCPU3SMUTrapEnable = false
        McuCPU3Trap2Enable = false
        McuCPU4ESR0TrapEnable = false
        McuCPU4ESR1TrapEnable = false
        McuCPU4SMUTrapEnable = false
        McuCPU4Trap2Enable = false
        McuCPU5ESR0TrapEnable = false
        McuCPU5ESR1TrapEnable = false
        McuCPU5SMUTrapEnable = false
        McuCPU5Trap2Enable = false
      McuModeSettingConf: McuMode=0, McuEvrcLPMOnSleepReqEnable=false
        McuStdbyModeSettingConf:
          McuStdbyModePortTriStateEnable = false
          McuStdbyModeESR0TriStateEnable = false
          McuStdbyModeWakeupFromPORST = true
          McuStdbyModePORSTFilterEnable = false
          McuStdbyModeWakeupFromEVR = false
          McuStdbyModeWakeupFromSCR = false
          McuStdbyModeClkSelection = OSC_CLOCK_100KHZ_ONLY_SEL0
          McuStdbyModeBlankingFilterDelay = DELAY_0_MS_SEL0
          McuStdbyModeRamEnable = MCU_STANDBYRAM_DISABLED_SEL0
          McuStdbyModeESR0Conf: McuStdbyModeESR0WakeupEnable=false, McuStdbyModeESR0FltEnable=false, McuStdbyModeESR0EdgeDetection=ESR0_TRIG_RISING_EDGE_SEL1
          McuStdbyModeESR1Conf: McuStdbyModeESR1WakeupEnable=false, McuStdbyModeESR1FltEnable=false, McuStdbyModeESR1EdgeDetection=ESR1_TRIG_RISING_EDGE_SEL1
          McuStdbyModePinAConf: McuStdbyModePinAWakeupEnable=false, McuStdbyModePinAFltEnable=false, McuStdbyModePinAEdgeDetection=PINA_TRIG_RISING_EDGE_SEL1
          McuStdbyModePinBConf: McuStdbyModePinBWakeupEnable=false, McuStdbyModePinBFltEnable=false, McuStdbyModePinBEdgeDetection=PINB_TRIG_RISING_EDGE_SEL1
          McuStdbyModeWakeupTimerConf:
            McuStdbyModeWakeupTimerEnable = false
            McuStdbyModeWakeupTimerValue = 16777215
            McuStdbyModeWakeupTimerClkDiv = WUT_100KHZ_NO_DIV_CLK_SEL0
            McuStdbyModeWakeupTimerMode = WUT_AUTO_RELOAD_MODE_SEL0
    McuPublishedInformation
      21 x McuResetReasonConf:
        MCU_CB0_RESET: McuResetReason=11
        MCU_CB1_RESET: McuResetReason=12
        MCU_CB3_RESET: McuResetReason=13
        MCU_ESR0_RESET: McuResetReason=0
        MCU_ESR1_RESET: McuResetReason=1
        MCU_EVR33_RESET: McuResetReason=15
        MCU_EVRC_RESET: McuResetReason=14
        MCU_LBIST_RESET: McuResetReason=18
        MCU_POWER_ON_RESET: McuResetReason=10
        MCU_RESET_MULTIPLE: McuResetReason=254
        MCU_RESET_UNDEFINED: McuResetReason=255
        MCU_SMU_RESET: McuResetReason=2
        MCU_STBYR_RESET: McuResetReason=17
        MCU_STM0_RESET: McuResetReason=4
        MCU_STM1_RESET: McuResetReason=5
        MCU_STM2_RESET: McuResetReason=6
        MCU_STM3_RESET: McuResetReason=7
        MCU_STM4_RESET: McuResetReason=8
        MCU_STM5_RESET: McuResetReason=9
        MCU_SUPPLY_WDOG_RESET: McuResetReason=16
        MCU_SW_RESET: McuResetReason=3
