AUTOSAR XML (schema 00048)
package /ActiveEcuC
  module config NvM: implementation-config-variant=VARIANT-PRE-COMPILE, module-description=NvM_Impl
    NvMConfigBlock (NvMBlockDescriptor):
      NvMBlockCrcType = NVM_CRC16
      NvMBlockManagementType = NVM_BLOCK_REDUNDANT
      NvMInitBlockCallback = NULL_PTR
      NvMResistantToChangedSw = true
      NvMSelectBlockForReadAll = true
      NvMSelectBlockForWriteAll = true
      NvMUseInitCallback = false
      NvMUseJobendCallback = false
      NvMSingleBlockCallback = NULL_PTR
      NvMBswMBlockStatusInformation = false
      NvMBlockUseCrc = true
      NvMBlockUseSyncMechanism = false
      NvMCalcRamBlockCrc = false
      NvMUseServicePorts = false
      NvMNvramBlockIdentifier = 1
      NvMNvBlockNum = 2
      NvMNvBlockLength = 2
      NvMRomBlockDataAddress = NULL_PTR
      NvMBlockPostReadTransformCallback = NULL_PTR
      NvMBlockPreWriteTransformCallback = NULL_PTR
      NvMBlockUseSetRamBlockStatus = true
      NvMBlockJobPriority = 127
      NvMBlockWriteProt = false
      NvMWriteBlockOnce = false
      NvMBlockUseCRCCompMechanism = false
      NvMInvokeCallbacksForReadAll = true
      NvMInvokeCallbacksForWriteAll = true
      NvMCheckLossOfRedundancy = false
      NvMTargetBlockReference
        NvMFeeRef: NvMNameOfFeeBlock=FeeBlockConfiguration_0
    NvMCommon:
      NvMDevErrorDetect = true
      NvMVersionInfoApi = false
      NvMApiConfigClass = NVM_API_CONFIG_CLASS_3
      NvMBswMMultiBlockJobStatusInformation = true
      NvMCompiledConfigId = 1
      NvMCrcNumOfBytes = 64
      NvMDatasetSelectionBits = 4
      NvMDrvModeSwitch = true
      NvMDynamicConfiguration = false
      NvMJobPrioritization = false
      NvMPollingMode = true
      NvMSetRamBlockStatusApi = true
      NvMSizeStandardJobQueue = 1
      NvMMaxNoOfWriteRetries = 1
      NvMMainFunctionPeriod = 0.01
      NvMUseBlockIdCheck = false
      NvMRepairRedundantBlocksApi = false
      NvMSafeBswChecks = false
      NvMDetectedLossOfRedundancyCallback = NULL_PTR
    NvMCommonVendorParams:
      NvMDataIntegrityIntBuffer = true
      NvMKillWriteAllApi = true
      NvMCfgCbkIncludeList = Rte_Cbk.h
      NvMCfgCbkIncludeList = Nvm_App.h
      NvMCfgCbkIncludeList = Dem.h
      NvMCfgCbkIncludeList = Dem_Cbk.h
    13 x NvMBlockDescriptor, all with NvMBlockCrcType=NVM_CRC16, NvMBlockManagementType=NVM_BLOCK_NATIVE, NvMInitBlockCallback=NULL_PTR, NvMResistantToChangedSw=true, NvMSelectBlockForReadAll=true, NvMSelectBlockForWriteAll=true, NvMUseInitCallback=false, NvMBswMBlockStatusInformation=false, NvMCalcRamBlockCrc=false, NvMBlockJobPriority=127, NvMBlockWriteProt=false, NvMNvBlockNum=1, NvMWriteBlockOnce=false, NvMBlockUseCRCCompMechanism=false, NvMBlockUseSetRamBlockStatus=true, NvMInvokeCallbacksForReadAll=true, NvMInvokeCallbacksForWriteAll=true, NvMCheckLossOfRedundancy=false:
      NvM_DEM_AdminData: NvMUseJobendCallback=false, NvMSingleBlockCallback=NULL_PTR, NvMBlockUseCrc=true, NvMBlockUseSyncMechanism=false, NvMNvBlockLength=12, NvMNvramBlockIdentifier=2, NvMUseServicePorts=false, NvMWriteRamBlockToNvCallback=NULL_PTR, NvMReadRamBlockFromNvCallback=NULL_PTR, NvMRamBlockDataAddress=Dem_Cfg_AdminData
        NvMTargetBlockReference
          NvMFeeRef: NvMNameOfFeeBlock=FeeBlockConfiguration_UserData0
      NvM_SWC_NVBlockDescriptor_UserData1: NvMUseJobendCallback=true, NvMSingleBlockCallback=Rte_NvMNotifyJobFinished_NvM_SWC_NVBlockDescriptor_UserData1, NvMBlockUseCrc=true, NvMBlockUseSyncMechanism=true, NvMNvBlockLength=10, NvMNvramBlockIdentifier=9, NvMRomBlockNum=1, NvMStaticBlockIDCheck=false, NvMWriteVerification=false, NvMReadRamBlockFromNvCallback=Rte_SetMirror_NvM_SWC_NVBlockDescriptor_UserData1, NvMWriteRamBlockToNvCallback=Rte_GetMirror_NvM_SWC_NVBlockDescriptor_UserData1, NvMUseServicePorts=false, NvMRomBlockDataAddress=Rte_NvM_SWC_NVBlockDescriptor_UserData1_ROM_NVBlockDescriptor_UserData1  # UC:Derived from NvBlockNeeds
        NvMTargetBlockReference
          NvMFeeRef: NvMNameOfFeeBlock=Fee_SWC_NVBlockDescriptor_UserData1
      NvM_SWC_NVBlockDescriptor_UserData2: NvMUseJobendCallback=true, NvMSingleBlockCallback=Rte_NvMNotifyJobFinished_NvM_SWC_NVBlockDescriptor_UserData2, NvMBlockUseCrc=true, NvMBlockUseSyncMechanism=true, NvMNvBlockLength=32, NvMNvramBlockIdentifier=10, NvMUseServicePorts=false, NvMRomBlockNum=1, NvMStaticBlockIDCheck=false, NvMWriteVerification=false, NvMReadRamBlockFromNvCallback=Rte_SetMirror_NvM_SWC_NVBlockDescriptor_UserData2, NvMWriteRamBlockToNvCallback=Rte_GetMirror_NvM_SWC_NVBlockDescriptor_UserData2, NvMRomBlockDataAddress=Rte_NvM_SWC_NVBlockDescriptor_UserData2_ROM_NVBlockDescriptor_UserData2  # UC:Derived from NvBlockNeeds
        NvMTargetBlockReference
          NvMFeeRef: NvMNameOfFeeBlock=Fee_SWC_NVBlockDescriptor_UserData2
      SWC1NvBlockNeed_UserData3: NvMUseJobendCallback=false, NvMSingleBlockCallback=NULL_PTR, NvMBlockUseCrc=true, NvMBlockUseSyncMechanism=false, NvMNvBlockLength=10, NvMNvramBlockIdentifier=11, NvMUseServicePorts=true, NvMRomBlockNum=1, NvMRamBlockDataAddress=Rte_SWC1_NvBlockNeed_UserData3_MirrorBlock, NvMRomBlockDataAddress=Rte_SWC1_NvBlockNeed_UserData3_DefaultValue, NvMStaticBlockIDCheck=false, NvMWriteVerification=false  # UC:Derived from NvBlockNeeds
        NvMTargetBlockReference
          NvMFeeRef: NvMNameOfFeeBlock=FeeSWC1NvBlockNeed_UserData3
      NvM_DEM_PrimaryEntry_0: NvMUseJobendCallback=true, NvMSingleBlockCallback=Dem_NvM_JobFinished, NvMBlockUseCrc=true, NvMBlockUseSyncMechanism=false, NvMNvBlockLength=36, NvMNvramBlockIdentifier=3, NvMUseServicePorts=false, NvMWriteRamBlockToNvCallback=NULL_PTR, NvMReadRamBlockFromNvCallback=NULL_PTR, NvMRamBlockDataAddress=Dem_Cfg_PrimaryEntry_0
        NvMTargetBlockReference
          NvMFeeRef: NvMNameOfFeeBlock=FeeBlockConfiguration_DEM_PrimaryEntry_0
      NvM_DEM_PrimaryEntry_1: NvMUseJobendCallback=true, NvMSingleBlockCallback=Dem_NvM_JobFinished, NvMBlockUseCrc=true, NvMBlockUseSyncMechanism=false, NvMNvBlockLength=36, NvMNvramBlockIdentifier=7, NvMUseServicePorts=false, NvMWriteRamBlockToNvCallback=NULL_PTR, NvMReadRamBlockFromNvCallback=NULL_PTR, NvMRamBlockDataAddress=Dem_Cfg_PrimaryEntry_1
        NvMTargetBlockReference
          NvMFeeRef: NvMNameOfFeeBlock=FeeBlockConfiguration_DEM_PrimaryEntry_1
      NvM_DEM_StatusData: NvMUseJobendCallback=false, NvMSingleBlockCallback=NULL_PTR, NvMBlockUseCrc=true, NvMBlockUseSyncMechanism=false, NvMNvBlockLength=20, NvMNvramBlockIdentifier=8, NvMUseServicePorts=false, NvMWriteRamBlockToNvCallback=NULL_PTR, NvMReadRamBlockFromNvCallback=NULL_PTR, NvMRamBlockDataAddress=Dem_Cfg_StatusData
        NvMTargetBlockReference
          NvMFeeRef: NvMNameOfFeeBlock=FeeBlockConfiguration_UserData0_003
      DIAG_SWC_NvBlockNeed_DiagDID_00: NvMUseJobendCallback=false, NvMSingleBlockCallback=NULL_PTR, NvMBlockUseCrc=true, NvMBlockUseSyncMechanism=false, NvMNvBlockLength=4, NvMNvramBlockIdentifier=12, NvMUseServicePorts=true, NvMRamBlockDataAddress=Rte_DIAG_SWC_NvBlockNeed_DiagDID_00_MirrorBlock, NvMRomBlockDataAddress=Rte_DIAG_SWC_NvBlockNeed_DiagDID_00_DefaultValue, NvMStaticBlockIDCheck=false, NvMWriteVerification=false  # UC:Derived from NvBlockNeeds
        NvMTargetBlockReference
          NvMFeeRef: NvMNameOfFeeBlock=FeeDIAG_SWC_NvBlockNeed_DiagDID_00
      DIAG_SWC_NvBlockNeed_AttemptCounter: NvMUseJobendCallback=false, NvMSingleBlockCallback=NULL_PTR, NvMBlockUseCrc=true, NvMBlockUseSyncMechanism=false, NvMNvBlockLength=1, NvMNvramBlockIdentifier=13, NvMUseServicePorts=true, NvMRomBlockNum=1, NvMRamBlockDataAddress=Rte_DIAG_SWC_NvBlockNeed_AttemptCounter_MirrorBlock, NvMRomBlockDataAddress=Rte_DIAG_SWC_NvBlockNeed_AttemptCounter_DefaultValue, NvMStaticBlockIDCheck=false, NvMWriteVerification=false  # UC:Derived from NvBlockNeeds
        NvMTargetBlockReference
          NvMFeeRef: NvMNameOfFeeBlock=FeeDIAG_SWC_NvBlockNeed_AttemptCounter
      NvM_DEM_PrimaryEntry_2: NvMUseJobendCallback=true, NvMSingleBlockCallback=Dem_NvM_JobFinished, NvMBlockUseCrc=true, NvMBlockUseSyncMechanism=false, NvMNvBlockLength=36, NvMNvramBlockIdentifier=4, NvMUseServicePorts=false, NvMWriteRamBlockToNvCallback=NULL_PTR, NvMReadRamBlockFromNvCallback=NULL_PTR, NvMRamBlockDataAddress=Dem_Cfg_PrimaryEntry_2
        NvMTargetBlockReference
          NvMFeeRef: NvMNameOfFeeBlock=FeeBlockConfiguration_DEM_PrimaryEntry_2
      NvM_DEM_PrimaryEntry_3: NvMUseJobendCallback=true, NvMSingleBlockCallback=Dem_NvM_JobFinished, NvMBlockUseCrc=true, NvMBlockUseSyncMechanism=false, NvMNvBlockLength=36, NvMNvramBlockIdentifier=5, NvMUseServicePorts=false, NvMWriteRamBlockToNvCallback=NULL_PTR, NvMReadRamBlockFromNvCallback=NULL_PTR, NvMRamBlockDataAddress=Dem_Cfg_PrimaryEntry_3
        NvMTargetBlockReference
          NvMFeeRef: NvMNameOfFeeBlock=FeeBlockConfiguration_DEM_PrimaryEntry_3
      NvM_DEM_PrimaryEntry_4: NvMUseJobendCallback=true, NvMSingleBlockCallback=Dem_NvM_JobFinished, NvMBlockUseCrc=true, NvMBlockUseSyncMechanism=false, NvMNvBlockLength=36, NvMNvramBlockIdentifier=6, NvMUseServicePorts=false, NvMWriteRamBlockToNvCallback=NULL_PTR, NvMReadRamBlockFromNvCallback=NULL_PTR, NvMRamBlockDataAddress=Dem_Cfg_PrimaryEntry_4
        NvMTargetBlockReference
          NvMFeeRef: NvMNameOfFeeBlock=FeeBlockConfiguration_DEM_PrimaryEntry_4
      DIAG_SWC_NvBlockNeed_DID_F193: NvMUseJobendCallback=false, NvMSingleBlockCallback=NULL_PTR, NvMBlockUseCrc=false, NvMBlockUseSyncMechanism=false, NvMNvBlockLength=4, NvMNvramBlockIdentifier=14, NvMUseServicePorts=true, NvMRamBlockDataAddress=Rte_DIAG_SWC_NvBlockNeed_DID_F193_MirrorBlock, NvMRomBlockDataAddress=Rte_DIAG_SWC_NvBlockNeed_DID_F193_DefaultValue, NvMStaticBlockIDCheck=false, NvMWriteVerification=false  # UC:Derived from NvBlockNeeds
        NvMTargetBlockReference
          NvMFeeRef: NvMNameOfFeeBlock=FeeDIAG_SWC_NvBlockNeed_DID_F193
