AUTOSAR XML (schema 00048)
package /ActiveEcuC
  module config NvM: implementation-config-variant=VARIANT-PRE-COMPILE, module-description=NvM_Impl
    NvMConfigBlock (NvMBlockDescriptor):
      NvMBlockCrcType = NVM_CRC16
      NvMBlockManagementType = NVM_BLOCK_REDUNDANT
      NvMInitBlockCallback = NULL_PTR
      NvMResistantToChangedSw = true
      NvMSelectBlockForReadAll = true
      NvMSelectBlockForWriteAll = true
      NvMUseInitCallback = false
      NvMUseJobendCallback = false
      NvMSingleBlockCallback = NULL_PTR
      NvMBswMBlockStatusInformation = false
      NvMBlockUseCrc = true
      NvMBlockUseSyncMechanism = false
      NvMCalcRamBlockCrc = false
      NvMUseServicePorts = false
      NvMNvramBlockIdentifier = 1
      NvMNvBlockNum = 2
      NvMNvBlockLength = 2
      NvMRomBlockDataAddress = NULL_PTR
      NvMBlockPostReadTransformCallback = NULL_PTR
      NvMBlockPreWriteTransformCallback = NULL_PTR
      NvMBlockUseSetRamBlockStatus = true
      NvMBlockJobPriority = 127
      NvMBlockWriteProt = false
      NvMWriteBlockOnce = false
      NvMBlockUseCRCCompMechanism = false
      NvMInvokeCallbacksForReadAll = true
      NvMInvokeCallbacksForWriteAll = true
      NvMCheckLossOfRedundancy = false
      NvMTargetBlockReference
        NvMFeeRef: NvMNameOfFeeBlock=FeeBlockConfiguration_0
    NvMCommon:
      NvMDevErrorDetect = true
      NvMVersionInfoApi = false
      NvMApiConfigClass = NVM_API_CONFIG_CLASS_3
      NvMBswMMultiBlockJobStatusInformation = true
      NvMCompiledConfigId = 1
      NvMCrcNumOfBytes = 64
      NvMDatasetSelectionBits = 4
      NvMDrvModeSwitch = true
      NvMDynamicConfiguration = false
      NvMJobPrioritization = false
      NvMPollingMode = true
      NvMSetRamBlockStatusApi = true
      NvMSizeStandardJobQueue = 1
      NvMMaxNoOfWriteRetries = 1
      NvMMainFunctionPeriod = 0.01
      NvMUseBlockIdCheck = false
      NvMRepairRedundantBlocksApi = false
      NvMSafeBswChecks = false
      NvMDetectedLossOfRedundancyCallback = NULL_PTR
    NvMCommonVendorParams:
      NvMDataIntegrityIntBuffer = true
      NvMKillWriteAllApi = true
      NvMCfgCbkIncludeList = Rte_Cbk.h
      NvMCfgCbkIncludeList = Nvm_App.h
      NvMCfgCbkIncludeList = Dem.h
      NvMCfgCbkIncludeList = Dem_Cbk.h
    6 x NvMBlockDescriptor, all with NvMBlockCrcType=NVM_CRC16, NvMBlockManagementType=NVM_BLOCK_NATIVE, NvMInitBlockCallback=NULL_PTR, NvMResistantToChangedSw=true, NvMSelectBlockForReadAll=true, NvMSelectBlockForWriteAll=true, NvMUseInitCallback=false, NvMBswMBlockStatusInformation=false, NvMBlockUseCrc=true, NvMBlockUseSyncMechanism=false, NvMCalcRamBlockCrc=false, NvMBlockJobPriority=127, NvMBlockWriteProt=false, NvMNvBlockNum=1, NvMWriteBlockOnce=false, NvMUseServicePorts=false, NvMBlockUseCRCCompMechanism=false, NvMBlockUseSetRamBlockStatus=true, NvMInvokeCallbacksForReadAll=true, NvMInvokeCallbacksForWriteAll=true, NvMCheckLossOfRedundancy=false, NvMWriteRamBlockToNvCallback=NULL_PTR, NvMReadRamBlockFromNvCallback=NULL_PTR:
      NvM_DEM_AdminData: NvMUseJobendCallback=false, NvMSingleBlockCallback=NULL_PTR, NvMNvBlockLength=8, NvMNvramBlockIdentifier=2, NvMRamBlockDataAddress=Dem_Cfg_AdminData
        NvMTargetBlockReference
          NvMFeeRef: NvMNameOfFeeBlock=FeeBlockConfiguration_UserData0
      NvM_DEM_PrimaryEntry_0: NvMUseJobendCallback=true, NvMSingleBlockCallback=Dem_NvM_JobFinished, NvMNvBlockLength=36, NvMNvramBlockIdentifier=3, NvMRamBlockDataAddress=Dem_Cfg_PrimaryEntry_0
        NvMTargetBlockReference
          NvMFeeRef: NvMNameOfFeeBlock=FeeBlockConfiguration_DEM_PrimaryEntry_0
      NvM_DEM_PrimaryEntry_1: NvMUseJobendCallback=true, NvMSingleBlockCallback=Dem_NvM_JobFinished, NvMNvBlockLength=36, NvMNvramBlockIdentifier=6, NvMRamBlockDataAddress=Dem_Cfg_PrimaryEntry_1
        NvMTargetBlockReference
          NvMFeeRef: NvMNameOfFeeBlock=FeeBlockConfiguration_DEM_PrimaryEntry_1
      NvM_DEM_StatusData: NvMUseJobendCallback=false, NvMSingleBlockCallback=NULL_PTR, NvMNvBlockLength=20, NvMNvramBlockIdentifier=7, NvMRamBlockDataAddress=Dem_Cfg_StatusData
        NvMTargetBlockReference
          NvMFeeRef: NvMNameOfFeeBlock=FeeBlockConfiguration_UserData0_003
      NvM_DEM_PrimaryEntry_2: NvMUseJobendCallback=true, NvMSingleBlockCallback=Dem_NvM_JobFinished, NvMNvBlockLength=36, NvMNvramBlockIdentifier=4, NvMRamBlockDataAddress=Dem_Cfg_PrimaryEntry_2
        NvMTargetBlockReference
          NvMFeeRef: NvMNameOfFeeBlock=FeeBlockConfiguration_DEM_PrimaryEntry_2
      NvM_DEM_PrimaryEntry_3: NvMUseJobendCallback=true, NvMSingleBlockCallback=Dem_NvM_JobFinished, NvMNvBlockLength=36, NvMNvramBlockIdentifier=5, NvMRamBlockDataAddress=Dem_Cfg_PrimaryEntry_3
        NvMTargetBlockReference
          NvMFeeRef: NvMNameOfFeeBlock=FeeBlockConfiguration_DEM_PrimaryEntry_3
