AUTOSAR XML (schema 00048)
package /ActiveEcuC
  module config NvM: implementation-config-variant=VARIANT-PRE-COMPILE, module-description=NvM_Impl
    NvMConfigBlock (NvMBlockDescriptor):
      NvMBlockCrcType = NVM_CRC16
      NvMBlockManagementType = NVM_BLOCK_REDUNDANT
      NvMInitBlockCallback = NULL_PTR
      NvMResistantToChangedSw = true
      NvMSelectBlockForReadAll = true
      NvMSelectBlockForWriteAll = true
      NvMUseInitCallback = false
      NvMUseJobendCallback = false
      NvMSingleBlockCallback = NULL_PTR
      NvMBswMBlockStatusInformation = false
      NvMBlockUseCrc = true
      NvMBlockUseSyncMechanism = false
      NvMCalcRamBlockCrc = false
      NvMUseServicePorts = false
      NvMNvramBlockIdentifier = 1
      NvMNvBlockNum = 2
      NvMNvBlockLength = 2
      NvMRomBlockDataAddress = NULL_PTR
      NvMBlockPostReadTransformCallback = NULL_PTR
      NvMBlockPreWriteTransformCallback = NULL_PTR
      NvMBlockUseSetRamBlockStatus = true
      NvMBlockJobPriority = 127
      NvMBlockWriteProt = false
      NvMWriteBlockOnce = false
      NvMBlockUseCRCCompMechanism = false
      NvMInvokeCallbacksForReadAll = true
      NvMInvokeCallbacksForWriteAll = true
      NvMCheckLossOfRedundancy = false
      NvMTargetBlockReference
        NvMFeeRef: NvMNameOfFeeBlock=FeeBlockConfiguration_0
    NvMCommon:
      NvMDevErrorDetect = true
      NvMVersionInfoApi = false
      NvMApiConfigClass = NVM_API_CONFIG_CLASS_3
      NvMBswMMultiBlockJobStatusInformation = false
      NvMCompiledConfigId = 1
      NvMCrcNumOfBytes = 64
      NvMDatasetSelectionBits = 4
      NvMDrvModeSwitch = true
      NvMDynamicConfiguration = false
      NvMJobPrioritization = false
      NvMPollingMode = true
      NvMSetRamBlockStatusApi = true
      NvMSizeStandardJobQueue = 1
      NvMMaxNoOfWriteRetries = 1
      NvMMainFunctionPeriod = 0.01
      NvMUseBlockIdCheck = false
      NvMRepairRedundantBlocksApi = false
      NvMSafeBswChecks = false
      NvMDetectedLossOfRedundancyCallback = NULL_PTR
    NvMCommonVendorParams: NvMDataIntegrityIntBuffer=true, NvMKillWriteAllApi=true, NvMCfgCbkIncludeList=Rte_Cbk.h
    3 x NvMBlockDescriptor, all with NvMBlockCrcType=NVM_CRC16, NvMBlockManagementType=NVM_BLOCK_NATIVE, NvMInitBlockCallback=NULL_PTR, NvMResistantToChangedSw=true, NvMSelectBlockForReadAll=true, NvMSelectBlockForWriteAll=true, NvMUseInitCallback=false, NvMBswMBlockStatusInformation=false, NvMBlockUseCrc=true, NvMCalcRamBlockCrc=false, NvMBlockJobPriority=127, NvMBlockWriteProt=false, NvMNvBlockNum=1, NvMWriteBlockOnce=false, NvMUseServicePorts=false, NvMBlockUseCRCCompMechanism=false, NvMBlockUseSetRamBlockStatus=true, NvMInvokeCallbacksForReadAll=true, NvMInvokeCallbacksForWriteAll=true, NvMCheckLossOfRedundancy=false:
      NvMBlockDescriptor_UserData0: NvMUseJobendCallback=false, NvMSingleBlockCallback=NULL_PTR, NvMBlockUseSyncMechanism=false, NvMNvBlockLength=2, NvMNvramBlockIdentifier=2, NvMWriteRamBlockToNvCallback=NULL_PTR, NvMReadRamBlockFromNvCallback=NULL_PTR, NvMRamBlockDataAddress=RamBlock_Nvm_UserData0
        NvMTargetBlockReference
          NvMFeeRef: NvMNameOfFeeBlock=FeeBlockConfiguration_UserData0
      NvM_SWC_NVBlockDescriptor_UserData1: NvMUseJobendCallback=true, NvMSingleBlockCallback=Rte_NvMNotifyJobFinished_NvM_SWC_NVBlockDescriptor_UserData1, NvMBlockUseSyncMechanism=true, NvMNvBlockLength=10, NvMNvramBlockIdentifier=3, NvMRomBlockNum=1, NvMStaticBlockIDCheck=false, NvMWriteVerification=false, NvMReadRamBlockFromNvCallback=Rte_SetMirror_NvM_SWC_NVBlockDescriptor_UserData1, NvMWriteRamBlockToNvCallback=Rte_GetMirror_NvM_SWC_NVBlockDescriptor_UserData1, NvMRomBlockDataAddress=Rte_NvM_SWC_NVBlockDescriptor_UserData1_ROM_NVBlockDescriptor_UserData1  # UC:Derived from NvBlockNeeds
        NvMTargetBlockReference
          NvMFeeRef: NvMNameOfFeeBlock=Fee_SWC_NVBlockDescriptor_UserData1
      NvM_SWC_NVBlockDescriptor_UserData2: NvMUseJobendCallback=true, NvMSingleBlockCallback=Rte_NvMNotifyJobFinished_NvM_SWC_NVBlockDescriptor_UserData2, NvMBlockUseSyncMechanism=true, NvMNvBlockLength=32, NvMNvramBlockIdentifier=4, NvMRomBlockNum=1, NvMStaticBlockIDCheck=false, NvMWriteVerification=false, NvMReadRamBlockFromNvCallback=Rte_SetMirror_NvM_SWC_NVBlockDescriptor_UserData2, NvMWriteRamBlockToNvCallback=Rte_GetMirror_NvM_SWC_NVBlockDescriptor_UserData2, NvMRomBlockDataAddress=Rte_NvM_SWC_NVBlockDescriptor_UserData2_ROM_NVBlockDescriptor_UserData2  # UC:Derived from NvBlockNeeds
        NvMTargetBlockReference
          NvMFeeRef: NvMNameOfFeeBlock=Fee_SWC_NVBlockDescriptor_UserData2
