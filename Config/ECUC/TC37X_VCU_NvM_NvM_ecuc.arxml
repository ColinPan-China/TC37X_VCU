AUTOSAR XML (schema 00048)
package /ActiveEcuC
  module config NvM: implementation-config-variant=VARIANT-PRE-COMPILE, module-description=NvM_Impl
    NvMConfigBlock (NvMBlockDescriptor):
      NvMBlockCrcType = NVM_CRC16
      NvMBlockManagementType = NVM_BLOCK_REDUNDANT
      NvMInitBlockCallback = NULL_PTR
      NvMResistantToChangedSw = true
      NvMSelectBlockForReadAll = true
      NvMSelectBlockForWriteAll = true
      NvMUseInitCallback = false
      NvMUseJobendCallback = false
      NvMSingleBlockCallback = NULL_PTR
      NvMBswMBlockStatusInformation = false
      NvMBlockUseCrc = true
      NvMBlockUseSyncMechanism = false
      NvMCalcRamBlockCrc = false
      NvMUseServicePorts = false
      NvMNvramBlockIdentifier = 1
      NvMNvBlockNum = 2
      NvMNvBlockLength = 2
      NvMRomBlockDataAddress = NULL_PTR
      NvMBlockPostReadTransformCallback = NULL_PTR
      NvMBlockPreWriteTransformCallback = NULL_PTR
      NvMBlockUseSetRamBlockStatus = true
      NvMBlockJobPriority = 127
      NvMBlockWriteProt = false
      NvMWriteBlockOnce = false
      NvMBlockUseCRCCompMechanism = false
      NvMInvokeCallbacksForReadAll = true
      NvMInvokeCallbacksForWriteAll = true
      NvMCheckLossOfRedundancy = false
      NvMTargetBlockReference
        NvMFeeRef: NvMNameOfFeeBlock=FeeBlockConfiguration_0
    NvMCommon:
      NvMDevErrorDetect = true
      NvMVersionInfoApi = false
      NvMApiConfigClass = NVM_API_CONFIG_CLASS_3
      NvMBswMMultiBlockJobStatusInformation = false
      NvMCompiledConfigId = 1
      NvMCrcNumOfBytes = 64
      NvMDatasetSelectionBits = 4
      NvMDrvModeSwitch = true
      NvMDynamicConfiguration = false
      NvMJobPrioritization = false
      NvMPollingMode = true
      NvMSetRamBlockStatusApi = true
      NvMSizeStandardJobQueue = 1
      NvMMaxNoOfWriteRetries = 1
      NvMMainFunctionPeriod = 0.01
      NvMUseBlockIdCheck = false
      NvMRepairRedundantBlocksApi = false
      NvMSafeBswChecks = false
      NvMDetectedLossOfRedundancyCallback = NULL_PTR
    NvMCommonVendorParams: NvMDataIntegrityIntBuffer=true, NvMKillWriteAllApi=true
    NvMBlockDescriptor_UserData0 (NvMBlockDescriptor):
      NvMBlockCrcType = NVM_CRC16
      NvMBlockManagementType = NVM_BLOCK_NATIVE
      NvMInitBlockCallback = NULL_PTR
      NvMResistantToChangedSw = true
      NvMSelectBlockForReadAll = true
      NvMSelectBlockForWriteAll = true
      NvMUseInitCallback = false
      NvMUseJobendCallback = false
      NvMSingleBlockCallback = NULL_PTR
      NvMBswMBlockStatusInformation = false
      NvMBlockUseCrc = true
      NvMBlockUseSyncMechanism = false
      NvMCalcRamBlockCrc = false
      NvMBlockJobPriority = 127
      NvMBlockWriteProt = false
      NvMNvBlockLength = 2
      NvMNvBlockNum = 1
      NvMNvramBlockIdentifier = 2
      NvMWriteBlockOnce = false
      NvMUseServicePorts = false
      NvMBlockUseCRCCompMechanism = false
      NvMBlockUseSetRamBlockStatus = true
      NvMInvokeCallbacksForReadAll = true
      NvMInvokeCallbacksForWriteAll = true
      NvMCheckLossOfRedundancy = false
      NvMWriteRamBlockToNvCallback = NULL_PTR
      NvMReadRamBlockFromNvCallback = NULL_PTR
      NvMRamBlockDataAddress = RamBlock_Nvm_UserData0
      NvMTargetBlockReference
        NvMFeeRef: NvMNameOfFeeBlock=FeeBlockConfiguration_UserData0
