AUTOSAR XML (schema 00048)
package /ResourceM
  module config ResourceM: implementation-config-variant=VARIANT-PRE-COMPILE
    ResourceMGeneral: ResourceMSubDerivative=TC377x
    ResourceMMcalConfig_0 (ResourceMMcalConfig): ResourceMMasterCore=CORE0
      ResourceMMcalCore_0 (ResourceMMcalCore): ResourceMCoreID=CORE0
        ResourceMAllocation_0 (ResourceMAllocation): ResourceMModuleName=STM, ResourceMResourceRef=McuStmAllocationConf_0
      ResourceMMcalCore_1 (ResourceMMcalCore): ResourceMCoreID=CORE1
