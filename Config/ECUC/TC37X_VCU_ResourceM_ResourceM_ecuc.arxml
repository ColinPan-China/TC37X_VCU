AUTOSAR XML (schema 00049)
package /ActiveEcuC
  module config ResourceM: implementation-config-variant=VARIANT-PRE-COMPILE
    ResourceMGeneral: ResourceMSubDerivative=TC377x
    ResourceMMcalConfig: ResourceMMasterCore=CORE0
      ResourceMMcalCore: ResourceMCoreID=CORE0
