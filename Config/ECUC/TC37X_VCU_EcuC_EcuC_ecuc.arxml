AUTOSAR XML (schema 00049)
package /ActiveEcuC
  module config EcuC: implementation-config-variant=VARIANT-PRE-COMPILE, module-description=EcuC_Impl
    EcucGeneral:
      DummyFunction = false
      DummyStatement = true
      StructAlignment = Auto
      ArrayAlignment = Align8Bit
      StructInArrayAlignment = Auto
      SizeOfEnum = Size32Bit
      SizeOfROMPointer = Size32Bit
      SizeOfRAMPointer = Size32Bit
      AtomicBitAccessInBitfield = false
      AtomicVariableAccess = Atomic32BitAccess
      CPUType = CPU32Bit
      SizeOfInt = Size32Bit
      ByteOrder = LITTLE_ENDIAN
      BitOrder = LSB_to_MSB
      BitFieldDataType = INT
      DummyStatementKind = None
      ConditionalGenerating = true
      EcucBswImplementationCodeType = EcuCSourceCode
      EcuCUseStdReturnTypeForRte = false
      PostbuildLoadable: AlignmentFillPattern=255, PBROMStartAddress=0, PBRAMStartAddress=0, PBROMEndAddress=0, PBRAMEndAddress=0
      BswInitialization
        17 x InitFunction:
          BswM_PreInit: Header=BswM.h, InitPhase=INIT_ONE, ConfigType=BswM_ConfigType, ConfigPtrName=BswM_Config_Ptr, ConfigPtrClass=BSWM_INIT_DATA, ModuleRef=BswM  # /ActiveEcuC/BswM PLAIN_TEXT PreInit function description of BswM in UnfilteredViewInInvariantProject (UnfilteredInvariantProjectModelView) .
          BswM_InitMemory: Header=BswM.h, InitPhase=INIT_MEMORY, ModuleRef=BswM  # /ActiveEcuC/BswM PLAIN_TEXT InitMemory function description of BswM in UnfilteredViewInInvariantProject (UnfilteredInvariantProjectModelView) .
          BswM_Init: Header=BswM.h, InitPhase=NO_INIT, ConfigType=BswM_ConfigType, ConfigPtrName=BswM_Config_Ptr, ConfigPtrClass=BSWM_INIT_DATA, ModuleRef=BswM  # /ActiveEcuC/BswM PLAIN_TEXT Init function description of BswM in UnfilteredViewInInvariantProject (UnfilteredInvariantProjectModelView) .
          EcuM_Init: Header=EcuM.h, InitPhase=NO_INIT, ConfigType=EcuM_PbConfigType, ConfigPtrName=EcuM_Config_Ptr, ConfigPtrClass=ECUM_INIT_DATA, ModuleRef=EcuM  # /ActiveEcuC/EcuM PLAIN_TEXT Init function description of EcuM in UnfilteredViewInInvariantProject (UnfilteredInvariantProjectModelView) .
          Rte_InitMemory: Header=Rte_Main.h, InitPhase=INIT_MEMORY, ModuleRef=Rte  # /ActiveEcuC/Rte PLAIN_TEXT Automatically generated by EcuCBswInitFctConfigurationService.
          Rte_StartTiming: Header=Rte_Main.h, InitPhase=NO_INIT, ModuleRef=Rte  # /ActiveEcuC/Rte PLAIN_TEXT Automatically generated by EcuCBswInitFctConfigurationService.
          SchM_Start: Header=Rte_Main.h, InitPhase=NO_INIT, ModuleRef=Rte  # /ActiveEcuC/Rte PLAIN_TEXT Automatically generated by EcuCBswInitFctConfigurationService.
          SchM_Init: Header=Rte_Main.h, InitPhase=NO_INIT, ModuleRef=Rte  # /ActiveEcuC/Rte PLAIN_TEXT Automatically generated by EcuCBswInitFctConfigurationService.
          Rte_Start: Header=Rte_Main.h, InitPhase=INIT_THREE, ModuleRef=Rte  # /ActiveEcuC/Rte PLAIN_TEXT Automatically generated by EcuCBswInitFctConfigurationService.
          SchM_StartTiming: Header=Rte_Main.h, InitPhase=NO_INIT, ModuleRef=Rte  # /ActiveEcuC/Rte PLAIN_TEXT Automatically generated by EcuCBswInitFctConfigurationService.
          Brs_Init: Header=, InitPhase=NO_INIT, ModuleRef=vBRS  # /ActiveEcuC/vBRS PLAIN_TEXT Automatically generated by EcuCBswInitFctConfigurationService.
          vLinkGen_Init: Header=vLinkGen_Lcfg.h, InitPhase=NO_INIT, ModuleRef=vLinkGen  # /ActiveEcuC/vLinkGen PLAIN_TEXT Dummy initialization of the vLinkGen
          vBaseEnv_Init: Header=, InitPhase=NO_INIT, ModuleRef=vBaseEnv  # /ActiveEcuC/vBaseEnv PLAIN_TEXT Created vBaseEnv_Init by Extended Init XML Service
          Dio_Init: Header=Dio.h, InitPhase=NO_INIT, ModuleRef=Dio  # /Dio/Dio PLAIN_TEXT Created Dio_Init by Extended Init XML Service
          Port_Init: Header=Port.h, InitPhase=INIT_ONE_EARLY, ConfigType=Port_ConfigType, ConfigPtrName=&Port_Config, ConfigPtrClass=AUTOMATIC, ModuleRef=Port  # /Port/Port PLAIN_TEXT Created Port_Init by Extended Init XML Service
          McalLib_Init: Header=McalLib.h, InitPhase=NO_INIT, ModuleRef=McalLib  # /McalLib/McalLib PLAIN_TEXT Created McalLib_Init by Extended Init XML Service
          Mcu_Init: Header=Mcu.h, InitPhase=INIT_ONE_EARLY, ConfigType=Mcu_ConfigType, ConfigPtrName=&Mcu_Config, ConfigPtrClass=AUTOMATIC, AdditionalInitCode=Mcu_InitClock(0);while (MCU_PLL_LOCKED != Mcu_GetPllStatus());Mcu_DistributePllClock();, ModuleRef=Mcu  # /Mcu/Mcu PLAIN_TEXT Created Mcu_Init by Extended Init XML Service
    EcucHardware
      EcucCoreDefinition: EcucCoreId=0
