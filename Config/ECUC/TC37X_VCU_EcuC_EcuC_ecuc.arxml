AUTOSAR XML (schema 00048)
package /ActiveEcuC
  module config EcuC: implementation-config-variant=VARIANT-PRE-COMPILE, module-description=EcuC_Impl
    EcucGeneral:
      CPUType = CPU32Bit
      SizeOfInt = Size32Bit
      ByteOrder = LITTLE_ENDIAN
      BitOrder = LSB_to_MSB
      AtomicBitAccessInBitfield = false
      AtomicVariableAccess = Atomic32BitAccess
      SizeOfEnum = Size32Bit
      SizeOfROMPointer = Size32Bit
      SizeOfRAMPointer = Size32Bit
      BitFieldDataType = INT
      StructAlignment = Auto
      ArrayAlignment = Align8Bit
      StructInArrayAlignment = Auto
      DummyFunction = false
      DummyStatement = true
      DummyStatementKind = None
      ConditionalGenerating = true
      EcucBswImplementationCodeType = EcuCSourceCode
      EcuCUseStdReturnTypeForRte = false
      PostbuildLoadable: AlignmentFillPattern=255, PBROMStartAddress=0, PBRAMStartAddress=0, PBROMEndAddress=0, PBRAMEndAddress=0
      BswInitialization
        68 x InitFunction:
          BswM_PreInit: Header=BswM.h, InitPhase=INIT_ONE, ConfigType=BswM_ConfigType, ConfigPtrName=BswM_Config_Ptr, ConfigPtrClass=BSWM_INIT_DATA, ModuleRef=BswM  # /ActiveEcuC/BswM PLAIN_TEXT PreInit function description of BswM in UnfilteredViewInInvariantProject (UnfilteredInvariantProjectModelView) .
          BswM_InitMemory: Header=BswM.h, InitPhase=INIT_MEMORY, ModuleRef=BswM  # /ActiveEcuC/BswM PLAIN_TEXT InitMemory function description of BswM in UnfilteredViewInInvariantProject (UnfilteredInvariantProjectModelView) .
          BswM_Init: Header=BswM.h, InitPhase=NO_INIT, ConfigType=BswM_ConfigType, ConfigPtrName=BswM_Config_Ptr, ConfigPtrClass=BSWM_INIT_DATA, ModuleRef=BswM  # /ActiveEcuC/BswM PLAIN_TEXT Init function description of BswM in UnfilteredViewInInvariantProject (UnfilteredInvariantProjectModelView) .
          EcuM_Init: Header=EcuM.h, InitPhase=NO_INIT, ConfigType=EcuM_PbConfigType, ConfigPtrName=EcuM_Config_Ptr, ConfigPtrClass=ECUM_INIT_DATA, ModuleRef=EcuM  # /ActiveEcuC/EcuM PLAIN_TEXT Init function description of EcuM in UnfilteredViewInInvariantProject (UnfilteredInvariantProjectModelView) .
          Rte_InitMemory: Header=Rte_Main.h, InitPhase=INIT_MEMORY, ModuleRef=Rte  # /ActiveEcuC/Rte PLAIN_TEXT Automatically generated by EcuCBswInitFctConfigurationService.
          Rte_StartTiming: Header=Rte_Main.h, InitPhase=NO_INIT, ModuleRef=Rte  # /ActiveEcuC/Rte PLAIN_TEXT Automatically generated by EcuCBswInitFctConfigurationService.
          SchM_Start: Header=Rte_Main.h, InitPhase=NO_INIT, ModuleRef=Rte  # /ActiveEcuC/Rte PLAIN_TEXT Automatically generated by EcuCBswInitFctConfigurationService.
          SchM_Init: Header=Rte_Main.h, InitPhase=NO_INIT, ModuleRef=Rte  # /ActiveEcuC/Rte PLAIN_TEXT Automatically generated by EcuCBswInitFctConfigurationService.
          Rte_Start: Header=Rte_Main.h, InitPhase=INIT_THREE, ModuleRef=Rte  # /ActiveEcuC/Rte PLAIN_TEXT Automatically generated by EcuCBswInitFctConfigurationService.
          SchM_StartTiming: Header=Rte_Main.h, InitPhase=NO_INIT, ModuleRef=Rte  # /ActiveEcuC/Rte PLAIN_TEXT Automatically generated by EcuCBswInitFctConfigurationService.
          Brs_Init: Header=, InitPhase=NO_INIT, ModuleRef=vBRS  # /ActiveEcuC/vBRS PLAIN_TEXT Automatically generated by EcuCBswInitFctConfigurationService.
          vLinkGen_Init: Header=vLinkGen_Lcfg.h, InitPhase=NO_INIT, ModuleRef=vLinkGen  # /ActiveEcuC/vLinkGen PLAIN_TEXT Dummy initialization of the vLinkGen
          vBaseEnv_Init: Header=, InitPhase=NO_INIT, ModuleRef=vBaseEnv  # /ActiveEcuC/vBaseEnv PLAIN_TEXT Created vBaseEnv_Init by Extended Init XML Service
          Dio_Init: Header=Dio.h, InitPhase=NO_INIT, ModuleRef=Dio  # /Dio/Dio PLAIN_TEXT Created Dio_Init by Extended Init XML Service
          Port_Init: Header=Port.h, InitPhase=INIT_ONE_EARLY, ConfigType=Port_ConfigType, ConfigPtrName=&Port_Config, ConfigPtrClass=AUTOMATIC, ModuleRef=Port  # /Port/Port PLAIN_TEXT Created Port_Init by Extended Init XML Service
          McalLib_Init: Header=McalLib.h, InitPhase=NO_INIT, ModuleRef=McalLib  # /McalLib/McalLib PLAIN_TEXT Created McalLib_Init by Extended Init XML Service
          Mcu_Init: Header=Mcu.h, InitPhase=INIT_ONE_EARLY, ConfigType=Mcu_ConfigType, ConfigPtrName=&Mcu_Config, ConfigPtrClass=AUTOMATIC, AdditionalInitCode=Mcu_InitClock(0);while (MCU_PLL_LOCKED != Mcu_GetPllStatus());Mcu_DistributePllClock();, ModuleRef=Mcu  # /Mcu/Mcu PLAIN_TEXT Created Mcu_Init by Extended Init XML Service
          Can_Init: Header=Can.h, InitPhase=INIT_TWO_DRV, ConfigType=Can_ConfigType, ConfigPtrName=Can_Config_Ptr, ConfigPtrClass=CAN_INIT_DATA, ModuleRef=Can  # /ActiveEcuC/Can PLAIN_TEXT Init function description of Can in UnfilteredViewInInvariantProject (UnfilteredInvariantProjectModelView) .
          Can_InitMemory: Header=Can.h, InitPhase=INIT_MEMORY, ModuleRef=Can  # /ActiveEcuC/Can PLAIN_TEXT InitMemory function description of Can in UnfilteredViewInInvariantProject (UnfilteredInvariantProjectModelView) .
          CanIf_InitMemory: Header=CanIf.h, InitPhase=INIT_MEMORY, ModuleRef=CanIf  # /ActiveEcuC/CanIf PLAIN_TEXT InitMemory function description of CanIf in UnfilteredViewInInvariantProject (UnfilteredInvariantProjectModelView) .
          CanIf_Init: Header=CanIf.h, InitPhase=INIT_TWO_IF, ConfigType=CanIf_ConfigType, ConfigPtrName=CanIf_Config_Ptr, ConfigPtrClass=CANIF_INIT_DATA, ModuleRef=CanIf  # /ActiveEcuC/CanIf PLAIN_TEXT Init function description of CanIf in UnfilteredViewInInvariantProject (UnfilteredInvariantProjectModelView) .
          CanSM_Init: Header=CanSM_EcuM.h, InitPhase=INIT_TWO_SM, ConfigType=CanSM_ConfigType, ConfigPtrName=CanSM_Config_Ptr, ConfigPtrClass=CANSM_INIT_DATA, ModuleRef=CanSM  # /ActiveEcuC/CanSM PLAIN_TEXT Init function description of CanSM in UnfilteredViewInInvariantProject (UnfilteredInvariantProjectModelView) .
          CanSM_InitMemory: Header=CanSM_EcuM.h, InitPhase=INIT_MEMORY, ModuleRef=CanSM  # /ActiveEcuC/CanSM PLAIN_TEXT InitMemory function description of CanSM in UnfilteredViewInInvariantProject (UnfilteredInvariantProjectModelView) .
          ComM_InitMemory: Header=ComM.h, InitPhase=INIT_MEMORY, ModuleRef=ComM  # /ActiveEcuC/ComM PLAIN_TEXT InitMemory function description of ComM in UnfilteredViewInInvariantProject (UnfilteredInvariantProjectModelView) .
          ComM_Init: Header=ComM.h, InitPhase=INIT_TWO_POST_NVMREADALL, ConfigType=ComM_ConfigType, ConfigPtrName=ComM_Config_Ptr, ConfigPtrClass=COMM_INIT_DATA, ModuleRef=ComM  # /ActiveEcuC/ComM PLAIN_TEXT Init function description of ComM in UnfilteredViewInInvariantProject (UnfilteredInvariantProjectModelView) .
          ComM_PreInit: Header=ComM.h, InitPhase=INIT_ONE, ConfigType=ComM_ConfigType, ConfigPtrName=ComM_Config_Ptr, ConfigPtrClass=COMM_INIT_DATA, ModuleRef=ComM  # /ActiveEcuC/ComM PLAIN_TEXT PreInit function description of ComM in UnfilteredViewInInvariantProject (UnfilteredInvariantProjectModelView) .
          ComM_PostInit: Header=ComM.h, InitPhase=INIT_THREE, ModuleRef=ComM  # /ActiveEcuC/ComM PLAIN_TEXT Post-Initialization of the ComM and its internal state machine
          Com_InitMemory: Header=Com.h, InitPhase=INIT_MEMORY, ModuleRef=Com  # /ActiveEcuC/Com PLAIN_TEXT InitMemory function description of Com in UnfilteredViewInInvariantProject (UnfilteredInvariantProjectModelView) .
          Com_Init: Header=Com.h, InitPhase=INIT_TWO_COM, ConfigType=Com_ConfigType, ConfigPtrName=Com_Config_Ptr, ConfigPtrClass=COM_INIT_DATA, ModuleRef=Com  # /ActiveEcuC/Com PLAIN_TEXT Init function description of Com in UnfilteredViewInInvariantProject (UnfilteredInvariantProjectModelView) .
          Det_Init: Header=Det.h, InitPhase=INIT_ZERO, ConfigType=Det_ConfigType, ConfigPtrName=Det_Config_Ptr, ConfigPtrClass=DET_INIT_DATA, ModuleRef=Det  # /ActiveEcuC/Det PLAIN_TEXT Init function description of Det in UnfilteredViewInInvariantProject (UnfilteredInvariantProjectModelView) .
          Det_InitMemory: Header=Det.h, InitPhase=INIT_MEMORY, ModuleRef=Det  # /ActiveEcuC/Det PLAIN_TEXT InitMemory function description of Det in UnfilteredViewInInvariantProject (UnfilteredInvariantProjectModelView) .
          PduR_PreInit: Header=PduR.h, InitPhase=INIT_ONE, ConfigType=PduR_PBConfigType, ConfigPtrName=PduR_Config_Ptr, ConfigPtrClass=PDUR_INIT_DATA, ModuleRef=PduR  # /ActiveEcuC/PduR PLAIN_TEXT PreInit function description of PduR in UnfilteredViewInInvariantProject (UnfilteredInvariantProjectModelView) .
          PduR_Init: Header=PduR.h, InitPhase=INIT_TWO_COM, ConfigType=PduR_PBConfigType, ConfigPtrName=PduR_Config_Ptr, ConfigPtrClass=PDUR_INIT_DATA, ModuleRef=PduR  # /ActiveEcuC/PduR PLAIN_TEXT Init function description of PduR in UnfilteredViewInInvariantProject (UnfilteredInvariantProjectModelView) .
          PduR_InitMemory: Header=PduR.h, InitPhase=INIT_MEMORY, ModuleRef=PduR  # /ActiveEcuC/PduR PLAIN_TEXT InitMemory function description of PduR in UnfilteredViewInInvariantProject (UnfilteredInvariantProjectModelView) .
          CanNm_Init: Header=CanNm.h, InitPhase=INIT_TWO_NM, ConfigType=CanNm_ConfigType, ConfigPtrName=CanNm_Config_Ptr, ConfigPtrClass=CANNM_INIT_DATA, ModuleRef=CanNm  # /ActiveEcuC/CanNm PLAIN_TEXT Init function description of CanNm in UnfilteredViewInInvariantProject (UnfilteredInvariantProjectModelView) .
          CanNm_InitMemory: Header=CanNm.h, InitPhase=INIT_MEMORY, ModuleRef=CanNm  # /ActiveEcuC/CanNm PLAIN_TEXT InitMemory function description of CanNm in UnfilteredViewInInvariantProject (UnfilteredInvariantProjectModelView) .
          Nm_PreInit: Header=Nm.h, InitPhase=INIT_ONE, ConfigType=Nm_ConfigType, ConfigPtrName=Nm_Config_Ptr, ConfigPtrClass=NM_INIT_DATA, ModuleRef=Nm  # /ActiveEcuC/Nm PLAIN_TEXT PreInit function description of Nm in UnfilteredViewInInvariantProject (UnfilteredInvariantProjectModelView) .
          Nm_Init: Header=Nm.h, InitPhase=INIT_TWO_NM, ConfigType=Nm_ConfigType, ConfigPtrName=Nm_Config_Ptr, ConfigPtrClass=NM_INIT_DATA, ModuleRef=Nm  # /ActiveEcuC/Nm PLAIN_TEXT Init function description of Nm in UnfilteredViewInInvariantProject (UnfilteredInvariantProjectModelView) .
          Nm_PostInit: Header=Nm.h, InitPhase=INIT_THREE, ModuleRef=Nm  # /ActiveEcuC/Nm PLAIN_TEXT Post-Initialization of the Network Management and its internal state machine
          Nm_InitMemory: Header=Nm.h, InitPhase=INIT_MEMORY, ModuleRef=Nm  # /ActiveEcuC/Nm PLAIN_TEXT InitMemory function description of Nm in UnfilteredViewInInvariantProject (UnfilteredInvariantProjectModelView) .
          Fee_Init: Header=Fee.h, InitPhase=INIT_ONE_LATE, ConfigType=Fee_ConfigType, ConfigPtrName=&Fee_Config, ConfigPtrClass=AUTOMATIC, ModuleRef=Fee  # /Fee/Fee PLAIN_TEXT Created Fee_Init by Extended Init XML Service
          Fls_17_Dmu_Init: Header=Fls_17_Dmu.h, InitPhase=INIT_ONE, ConfigType=Fls_17_Dmu_ConfigType, ConfigPtrName=&Fls_17_Dmu_Config, ConfigPtrClass=AUTOMATIC, ModuleRef=Fls  # /Fls/Fls PLAIN_TEXT Created Fls_17_Dmu_Init by Extended Init XML Service
          NvM_Init: Header=NvM.h, InitPhase=INIT_TWO_SYS, ModuleRef=NvM  # /ActiveEcuC/NvM PLAIN_TEXT Initialization of the NVRAM Manager, to make it ready for NvM_ReadAll being requested
          Xcp_InitMemory: Header=Xcp.h, InitPhase=INIT_MEMORY, ModuleRef=Xcp  # /ActiveEcuC/Xcp PLAIN_TEXT Memory Initialization function of module Xcp.
          Xcp_Init: Header=Xcp.h, InitPhase=INIT_TWO_TP, ModuleRef=Xcp  # /ActiveEcuC/Xcp PLAIN_TEXT Module Initialization function of module Xcp.
          CanXcp_Init: Header=CanXcp.h, InitPhase=INIT_TWO_TP, ConfigType=CanXcp_ConfigType, ConfigPtrName=NULL_PTR, ConfigPtrClass=CANXCP_CONST, ModuleRef=Xcp  # /ActiveEcuC/Xcp PLAIN_TEXT Module Initialization function of module CanXcp.
          CanXcp_InitMemory: Header=CanXcp.h, InitPhase=INIT_MEMORY, ModuleRef=Xcp  # /ActiveEcuC/Xcp PLAIN_TEXT Memory Initialization function of module CanXcp.
          CanTp_Init: Header=CanTp.h, InitPhase=INIT_TWO_TP, ConfigType=CanTp_ConfigType, ConfigPtrName=CanTp_Config_Ptr, ConfigPtrClass=CANTP_INIT_DATA, ModuleRef=CanTp  # /ActiveEcuC/CanTp PLAIN_TEXT Init function description of CanTp in UnfilteredViewInInvariantProject (UnfilteredInvariantProjectModelView) .
          CanTp_InitMemory: Header=CanTp.h, InitPhase=INIT_MEMORY, ModuleRef=CanTp  # /ActiveEcuC/CanTp PLAIN_TEXT InitMemory function description of CanTp in UnfilteredViewInInvariantProject (UnfilteredInvariantProjectModelView) .
          Dcm_Init: Header=Dcm.h, InitPhase=INIT_TWO_POST_NVMREADALL, ConfigType=Dcm_ConfigType, ConfigPtrName=NULL_PTR, ConfigPtrClass=DCM_CONST, ModuleRef=Dcm  # /ActiveEcuC/Dcm PLAIN_TEXT Dcm_Init function description
          Dcm_InitMemory: Header=Dcm.h, InitPhase=INIT_MEMORY, ModuleRef=Dcm  # /ActiveEcuC/Dcm PLAIN_TEXT Dcm_InitMemory function description
          Dem_PreInit: Header=Dem.h, InitPhase=INIT_ZERO, ConfigType=Dem_ConfigType, ConfigPtrName=Dem_Config_Ptr, ConfigPtrClass=DEM_INIT_DATA, ModuleRef=Dem  # /ActiveEcuC/Dem PLAIN_TEXT PreInit function description of Dem in UnfilteredViewInInvariantProject (UnfilteredInvariantProjectModelView) .
          Dem_InitMemory: Header=Dem.h, InitPhase=INIT_MEMORY, ModuleRef=Dem  # /ActiveEcuC/Dem PLAIN_TEXT InitMemory function description of Dem in UnfilteredViewInInvariantProject (UnfilteredInvariantProjectModelView) .
          Dem_Init: Header=Dem.h, InitPhase=INIT_TWO_POST_NVMREADALL, ConfigType=Dem_ConfigType, ConfigPtrName=Dem_Config_Ptr, ConfigPtrClass=DEM_INIT_DATA, ModuleRef=Dem  # /ActiveEcuC/Dem PLAIN_TEXT Init function description of Dem in UnfilteredViewInInvariantProject (UnfilteredInvariantProjectModelView) .
          Adc_Init: Header=Adc.h, InitPhase=INIT_ONE_LATE, ConfigType=Adc_ConfigType, ConfigPtrName=&Adc_Config, ConfigPtrClass=AUTOMATIC, ModuleRef=Adc  # /Adc/Adc PLAIN_TEXT Created Adc_Init by Extended Init XML Service
          LinIf_Init: Header=LinIf.h, InitPhase=INIT_TWO_IF, ConfigType=LinIf_ConfigType, ConfigPtrName=LinIf_Config_Ptr, ConfigPtrClass=LINIF_INIT_DATA, ModuleRef=LinIf  # /ActiveEcuC/LinIf PLAIN_TEXT Init function description of LinIf in UnfilteredViewInInvariantProject (UnfilteredInvariantProjectModelView) .
          LinIf_InitMemory: Header=LinIf.h, InitPhase=INIT_MEMORY, ModuleRef=LinIf  # /ActiveEcuC/LinIf PLAIN_TEXT InitMemory function description of LinIf in UnfilteredViewInInvariantProject (UnfilteredInvariantProjectModelView) .
          LinSM_Init: Header=LinSM.h, InitPhase=INIT_TWO_SM, ConfigType=LinSM_ConfigType, ConfigPtrName=LinSM_Config_Ptr, ConfigPtrClass=LINSM_INIT_DATA, ModuleRef=LinSM  # /ActiveEcuC/LinSM PLAIN_TEXT Init function description of LinSM in UnfilteredViewInInvariantProject (UnfilteredInvariantProjectModelView) .
          LinSM_InitMemory: Header=LinSM.h, InitPhase=INIT_MEMORY, ModuleRef=LinSM  # /ActiveEcuC/LinSM PLAIN_TEXT InitMemory function description of LinSM in UnfilteredViewInInvariantProject (UnfilteredInvariantProjectModelView) .
          LinTrcv_30_Tle7259_InitMemory: Header=LinTrcv_30_Tle7259.h, InitPhase=INIT_MEMORY, ModuleRef=LinTrcv  # /ActiveEcuC/LinTrcv PLAIN_TEXT InitMemory function description of LinTrcv_30_Tle7259 in UnfilteredViewInInvariantProject (UnfilteredInvariantProjectModelView) .
          LinTrcv_30_Tle7259_Init: Header=LinTrcv_30_Tle7259.h, InitPhase=INIT_TWO_TRCV, ConfigType=LinTrcv_30_Tle7259_ConfigType, ConfigPtrName=LinTrcv_30_Tle7259_Config_Ptr, ConfigPtrClass=LINTRCV_30_TLE7259_INIT_DATA, ModuleRef=LinTrcv  # /ActiveEcuC/LinTrcv PLAIN_TEXT Init function description of LinTrcv_30_Tle7259 in UnfilteredViewInInvariantProject (UnfilteredInvariantProjectModelView) .
          Lin_Init: Header=Lin.h, InitPhase=INIT_ONE, ConfigPtrName=Lin_Config_Ptr, ConfigType=Lin_17_AscLin_ConfigType, ConfigPtrClass=1, ModuleRef=Lin
          Spi_Init: Header=Spi.h, InitPhase=INIT_ONE, ConfigType=Spi_ConfigType, ConfigPtrName=&Spi_Config, ConfigPtrClass=AUTOMATIC, ModuleRef=Spi  # /Spi/Spi PLAIN_TEXT Created Spi_Init by Extended Init XML Service
          Dma_Init: Header=Dma.h, InitPhase=INIT_ONE, ConfigType=Dma_ConfigType, ConfigPtrName=&Dma_Config, ConfigPtrClass=AUTOMATIC, ModuleRef=Dma  # /Dma/Dma PLAIN_TEXT Created Dma_Init by Extended Init XML Service
          Irq_Init: Header=Irq.h, InitPhase=NO_INIT, ModuleRef=Irq  # /Irq/Irq PLAIN_TEXT Created Irq_Init by Extended Init XML Service
          Pwm_17_GtmCcu6_Init: Header=Pwm_17_GtmCcu6.h, InitPhase=INIT_ONE, ConfigType=Pwm_17_GtmCcu6_ConfigType, ConfigPtrName=&Pwm_17_GtmCcu6_Config, ConfigPtrClass=AUTOMATIC, ModuleRef=Pwm  # /Pwm/Pwm PLAIN_TEXT Created Pwm_17_GtmCcu6_Init by Extended Init XML Service
          Icu_17_TimerIp_Init: Header=Icu_17_TimerIp.h, InitPhase=INIT_ONE_LATE, ConfigType=Icu_17_TimerIp_ConfigType, ConfigPtrName=&Icu_17_TimerIp_Config, ConfigPtrClass=AUTOMATIC, ModuleRef=Icu  # /Icu/Icu PLAIN_TEXT Created Icu_17_TimerIp_Init by Extended Init XML Service
          IoHwAb_Init: Header=IoHwAb.h, InitPhase=INIT_TWO_POST_NVMREADALL, ModuleRef=IoHwAb  # /ActiveEcuC/IoHwAb PLAIN_TEXT Initialization of IO Hardware Abstraction Module
    EcucHardware
      EcucCoreDefinition: EcucCoreId=0
    EcucPduCollection: PduIdTypeEnum=UINT8, PduLengthTypeEnum=UINT16
      251 x Pdu, all with J1939Requestable=false:
        VcuRxMsg2_oTC37X_VCU_CAN00_920688f6_Rx: DynamicLength=false, PduLength=8
        VcuRxMsg2_oTC37X_VCU_CAN00_8cbda0e0_Rx: DynamicLength=false, PduLength=8, SysTPduToFrameMappingRef=VcuRxMsg2
        VcuTxMsg2_oTC37X_VCU_CAN00_7fccfa8c_Tx: DynamicLength=false, PduLength=8
        VcuTxMsg1_oTC37X_VCU_CAN00_954a27ee_Tx: DynamicLength=false, PduLength=8
        VcuRxMsg1_oTC37X_VCU_CAN00_4589bbed_Rx: DynamicLength=false, PduLength=8, SysTPduToFrameMappingRef=VcuRxMsg1
        VcuRxMsg1_oTC37X_VCU_CAN00_78805594_Rx: DynamicLength=false, PduLength=8
        VCU_Tx_51Ch_NM_oTC37X_VCU_CAN00_0aa0ce62_Tx: DynamicLength=false, PduLength=8, SysTPduToFrameMappingRef=VCU_Tx_51Ch_NM
        VcuTxMsg1_oTC37X_VCU_CAN00_c82dd125_Tx: DynamicLength=false, PduLength=8, SysTPduToFrameMappingRef=VcuTxMsg1
        VcuTxMsg2_oTC37X_VCU_CAN00_0119ca28_Tx: DynamicLength=false, PduLength=8, SysTPduToFrameMappingRef=VcuTxMsg2
        VCU_Rx_500h_NM_oTC37X_VCU_CAN00_c4b96e15_Rx: DynamicLength=false, PduLength=8, SysTPduToFrameMappingRef=VCU_Rx_500h_NM
        XCP_Request_oTC37X_VCU_CAN00_3c25b45e_Rx: DynamicLength=false, PduLength=8, SysTPduToFrameMappingRef=XCP_Request
        XCP_Response_oTC37X_VCU_CAN00_34d2da2d_Tx: DynamicLength=false, PduLength=8, SysTPduToFrameMappingRef=XCP_Response
        Vcu_Uds_Phy_Request_oTC37X_VCU_CAN00_d561dcee_Rx: DynamicLength=true, PduLength=8
        Vcu_Uds_Phy_Request_oTC37X_VCU_CAN00_16119f6f_Rx: DynamicLength=true, PduLength=8
        Vcu_Uds_Phy_Request_Tp_oTC37X_VCU_CAN00_58c52463_Rx: DynamicLength=false, PduLength=8, SysTPduToFrameMappingRef=Vcu_Uds_Phy_Request_Tp
        Vcu_Uds_Func_Request_Tp_oTC37X_VCU_CAN00_3dbedef7_Rx: DynamicLength=false, PduLength=8, SysTPduToFrameMappingRef=Vcu_Uds_Func_Request_Tp
        Vcu_Uds_Func_Request_oTC37X_VCU_CAN00_21e26bac_Rx: DynamicLength=true, PduLength=7
        Vcu_Uds_Func_Request_oTC37X_VCU_CAN00_455d4346_Rx: DynamicLength=true, PduLength=7
        Vcu_Uds_Response_oTC37X_VCU_CAN00_4d111be6_Tx: DynamicLength=true, PduLength=8
        Vcu_Uds_Response_oTC37X_VCU_CAN00_39638a1a_Tx: DynamicLength=true, PduLength=8
        Vcu_Uds_Response_Tp_oTC37X_VCU_CAN00_834178f3_Tx: DynamicLength=false, PduLength=8, SysTPduToFrameMappingRef=Vcu_Uds_Response_Tp
        VCU_Rx_500h_NM_oTC37X_VCU_CAN01_54a3f814_Rx: DynamicLength=false, PduLength=8, SysTPduToFrameMappingRef=VCU_Rx_500h_NM
        VCU_Tx_51Ch_NM_oTC37X_VCU_CAN01_9aba5863_Tx: DynamicLength=false, PduLength=8, SysTPduToFrameMappingRef=VCU_Tx_51Ch_NM
        VcuRxMsg3_oTC37X_VCU_CAN01_0a530e81_Rx: DynamicLength=false, PduLength=8
        VcuRxMsg3_oTC37X_VCU_CAN01_5bb4c01a_Rx: DynamicLength=false, PduLength=8, SysTPduToFrameMappingRef=VcuRxMsg3
        VcuRxMsg4_oTC37X_VCU_CAN01_eb7d04e5_Rx: DynamicLength=false, PduLength=8
        VcuRxMsg4_oTC37X_VCU_CAN01_55be06ba_Rx: DynamicLength=false, PduLength=8, SysTPduToFrameMappingRef=VcuRxMsg4
        MasterReq_Tp_oLIN00_7147b638_Tx: DynamicLength=false, PduLength=8, SysTPduToFrameMappingRef=MasterReq_Tp
        SlaveResp_Tp_oLIN00_3328eb0b_Rx: DynamicLength=false, PduLength=8, SysTPduToFrameMappingRef=SlaveResp_Tp
        MasterReq_oLIN00_4a2bb011_Tx: DynamicLength=true, PduLength=8
        MasterReq_oLIN00_3234fe1b_Tx: DynamicLength=true, PduLength=8
        VcuTxIoMsg2_oTC37X_VCU_CAN00_be0e97bf_Tx: DynamicLength=false, PduLength=8
        VcuTxIoMsg1_oTC37X_VCU_CAN00_54884add_Tx: DynamicLength=false, PduLength=8
        VcuTxIoMsg2_oTC37X_VCU_CAN00_4faa28b1_Tx: DynamicLength=false, PduLength=8, SysTPduToFrameMappingRef=VcuTxIoMsg2
        VcuTxIoMsg1_oTC37X_VCU_CAN00_869e33bc_Tx: DynamicLength=false, PduLength=8, SysTPduToFrameMappingRef=VcuTxIoMsg1
        VcuTxIoMsg4_oTC37X_VCU_CAN00_06b318ea_Tx: DynamicLength=false, PduLength=8, SysTPduToFrameMappingRef=VcuTxIoMsg4
        VcuTxIoMsg3_oTC37X_VCU_CAN00_515c215e_Tx: DynamicLength=false, PduLength=8
        VcuTxIoMsg5_oTC37X_VCU_CAN00_41a0ee11_Tx: DynamicLength=false, PduLength=8, SysTPduToFrameMappingRef=VcuTxIoMsg5
        VcuTxIoMsg8_oTC37X_VCU_CAN00_ac8b5230_Tx: DynamicLength=false, PduLength=8
        VcuTxIoMsg6_oTC37X_VCU_CAN00_b5a640b9_Tx: DynamicLength=false, PduLength=8
        VcuTxIoMsg5_oTC37X_VCU_CAN00_5f209ddb_Tx: DynamicLength=false, PduLength=8
        VcuTxIoMsg3_oTC37X_VCU_CAN00_08b9de4a_Tx: DynamicLength=false, PduLength=8, SysTPduToFrameMappingRef=VcuTxIoMsg3
        VcuTxIoMsg7_oTC37X_VCU_CAN00_cf8703e7_Tx: DynamicLength=false, PduLength=8, SysTPduToFrameMappingRef=VcuTxIoMsg7
        VcuTxIoMsg8_oTC37X_VCU_CAN00_9481785c_Tx: DynamicLength=false, PduLength=8, SysTPduToFrameMappingRef=VcuTxIoMsg8
        VcuTxIoMsg7_oTC37X_VCU_CAN00_5af4f658_Tx: DynamicLength=false, PduLength=8
        VcuTxIoMsg6_oTC37X_VCU_CAN00_8894f51c_Tx: DynamicLength=false, PduLength=8, SysTPduToFrameMappingRef=VcuTxIoMsg6
        VcuTxIoMsg4_oTC37X_VCU_CAN00_b0722b3a_Tx: DynamicLength=false, PduLength=8
        VCU_EXV_1_oLIN00_58a890ac_Tx: DynamicLength=false, PduLength=8, SysTPduToFrameMappingRef=VCU_EXV_1
        SlaveResp_SVA_oLIN00_e91156ea_Rx: DynamicLength=true, PduLength=8
        VCU_SVA_CMD_oLIN00_756d14f6_Tx: DynamicLength=false, PduLength=8
        VCU_EXV_2_oLIN00_de61ce96_Tx: DynamicLength=false, PduLength=8
        TCU_HVCH_Cmd_oLIN00_385d5651_Tx: DynamicLength=false, PduLength=4
        VCU_SVA_CMD_oLIN00_89e2bb7b_Tx: DynamicLength=false, PduLength=8, SysTPduToFrameMappingRef=VCU_SVA_CMD
        SlaveResp_ERV_oLIN00_e833ce7b_Rx: DynamicLength=true, PduLength=8
        PMP2_Sts_oLIN00_cab90b6b_Rx: DynamicLength=false, PduLength=8
        SlaveResp_EXV_2_oLIN00_4f1edefd_Rx: DynamicLength=true, PduLength=8
        HVCH_Rsp02_oLIN00_286c390c_Rx: DynamicLength=false, PduLength=8
        MasterReq_SVA_oLIN00_deabba25_Tx: DynamicLength=true, PduLength=8
        SlaveResp_PMP_1_oLIN00_64423b06_Rx: DynamicLength=true, PduLength=8
        SlaveResp_HVCH_oLIN00_43b1b673_Rx: DynamicLength=true, PduLength=8
        HVCH_Rsp02_oLIN00_a3ea669e_Rx: DynamicLength=false, PduLength=8, SysTPduToFrameMappingRef=HVCH_Rsp02
        EXV_1_VCU_oLIN00_366267d6_Rx: DynamicLength=false, PduLength=8, SysTPduToFrameMappingRef=EXV_1_VCU
        VCU_EXV_2_oLIN00_2e4da991_Tx: DynamicLength=false, PduLength=8, SysTPduToFrameMappingRef=VCU_EXV_2
        SVA_VCU_STD_oLIN00_4f0795ef_Rx: DynamicLength=false, PduLength=8, SysTPduToFrameMappingRef=SVA_VCU_STD
        MasterReq_PMP_1_oLIN00_90773f5d_Tx: DynamicLength=true, PduLength=8
        SlaveResp_EXV_1_oLIN00_1f09933d_Rx: DynamicLength=true, PduLength=8
        MasterReq_SVA_oLIN00_11d66449_Tx: DynamicLength=true, PduLength=8
        PMP3_Sts_oLIN00_511c4704_Rx: DynamicLength=false, PduLength=8
        EXV_2_VCU_oLIN00_1e4a3daf_Rx: DynamicLength=false, PduLength=8
        MasterReq_EXV_1_oLIN00_52f4d550_Tx: DynamicLength=true, PduLength=8
        SlaveResp_EXV_1_oLIN00_39fbe7c0_Rx: DynamicLength=true, PduLength=8
        SVA_VCU_STD_oLIN00_4526aa1c_Rx: DynamicLength=false, PduLength=8
        VCU_EXV_1_oLIN00_50eec975_Tx: DynamicLength=false, PduLength=8
        MasterReq_HVCH_oLIN00_0c968313_Tx: DynamicLength=true, PduLength=8
        MasterReq_ERV_oLIN00_10f4fcd8_Tx: DynamicLength=true, PduLength=8
        SlaveResp_PMP_2_oLIN00_12a7023b_Rx: DynamicLength=true, PduLength=8
        MasterReq_EXV_1_oLIN00_cdcee39b_Tx: DynamicLength=true, PduLength=8
        MasterReq_PMP_2_oLIN00_e6920660_Tx: DynamicLength=true, PduLength=8
        SlaveResp_HVCH_oLIN00_93d59ea5_Rx: DynamicLength=true, PduLength=8
        MasterReq_HVCH_oLIN00_726494b3_Tx: DynamicLength=true, PduLength=8
        SlaveResp_PMP_1_oLIN00_590d111f_Rx: DynamicLength=true, PduLength=8
        EDCU_EXV2_oLIN00_1f8750a5_Tx: DynamicLength=false, PduLength=8
        EXV_1_VCU_oLIN00_69d4ef5f_Rx: DynamicLength=false, PduLength=8
        EXV_2_VCU_oLIN00_85f64a15_Rx: DynamicLength=false, PduLength=8, SysTPduToFrameMappingRef=EXV_2_VCU
        MasterReq_PMP_2_oLIN00_9a7f5091_Tx: DynamicLength=true, PduLength=8
        HVCH_Rsp01_oLIN00_a6e33eef_Rx: DynamicLength=false, PduLength=8
        EXV2_Status_oLIN00_d5e93929_Rx: DynamicLength=false, PduLength=8
        TCU_HVCH_Cmd_oLIN00_ddc31229_Tx: DynamicLength=false, PduLength=4, SysTPduToFrameMappingRef=TCU_HVCH_Cmd
        PMP_Cmd_oLIN00_3912b28b_Tx: DynamicLength=false, PduLength=8
        MasterReq_EXV_2_oLIN00_dc7bd2b3_Tx: DynamicLength=true, PduLength=8
        HVCH_Rsp01_oLIN00_d50f5fa3_Rx: DynamicLength=false, PduLength=8, SysTPduToFrameMappingRef=HVCH_Rsp01
        SlaveResp_PMP_2_oLIN00_d78216fc_Rx: DynamicLength=true, PduLength=8
        PMP3_Sts_oLIN00_4e808b3d_Rx: DynamicLength=false, PduLength=8, SysTPduToFrameMappingRef=PMP3_Sts
        SlaveResp_EXV_2_oLIN00_918694de_Rx: DynamicLength=true, PduLength=8
        PMP2_Sts_oLIN00_200c907c_Rx: DynamicLength=false, PduLength=8, SysTPduToFrameMappingRef=PMP2_Sts
        SlaveResp_SVA_oLIN00_6139b46e_Rx: DynamicLength=true, PduLength=8
        EDCU_EXV2_oLIN00_18b050dc_Tx: DynamicLength=false, PduLength=8, SysTPduToFrameMappingRef=EDCU_EXV2
        EXV2_Status_oLIN00_7fcf9f75_Rx: DynamicLength=false, PduLength=8, SysTPduToFrameMappingRef=EXV2_Status
        PMP_Cmd_oLIN00_6d889c97_Tx: DynamicLength=false, PduLength=8, SysTPduToFrameMappingRef=PMP_Cmd
        MasterReq_ERV_oLIN00_f3aa7150_Tx: DynamicLength=true, PduLength=8
        MasterReq_EXV_2_oLIN00_bb2bdaa6_Tx: DynamicLength=true, PduLength=8
        SlaveResp_ERV_oLIN00_4c387f1b_Rx: DynamicLength=true, PduLength=8
        MasterReq_PMP_1_oLIN00_14f05772_Tx: DynamicLength=true, PduLength=8
        VcuCan12TxMsg1_oTC37X_VCU_CAN12_2c92f390_Tx: DynamicLength=false, PduLength=8, SysTPduToFrameMappingRef=VcuCan12TxMsg1
        VcuCan12RxMsg4_oTC37X_VCU_CAN12_211bb20e_Rx: DynamicLength=false, PduLength=8, SysTPduToFrameMappingRef=VcuCan12RxMsg4
        VCU_Tx_51Ch_NM_oTC37X_VCU_CAN12_8673ce21_Tx: DynamicLength=false, PduLength=8, SysTPduToFrameMappingRef=VCU_Tx_51Ch_NM
        VcuCan12RxMsg3_oTC37X_VCU_CAN12_38853822_Rx: DynamicLength=false, PduLength=8
        VcuCan12RxMsg3_oTC37X_VCU_CAN12_2f1174ae_Rx: DynamicLength=false, PduLength=8, SysTPduToFrameMappingRef=VcuCan12RxMsg3
        VcuCan12TxMsg2_oTC37X_VCU_CAN12_3a1dfcb9_Tx: DynamicLength=false, PduLength=8
        VcuCan12TxMsg1_oTC37X_VCU_CAN12_d09b21db_Tx: DynamicLength=false, PduLength=8
        VCU_Rx_500h_NM_oTC37X_VCU_CAN12_486a6e56_Rx: DynamicLength=false, PduLength=8, SysTPduToFrameMappingRef=VCU_Rx_500h_NM
        VcuCan12RxMsg4_oTC37X_VCU_CAN12_d9ab3246_Rx: DynamicLength=false, PduLength=8
        VcuCan12TxMsg2_oTC37X_VCU_CAN12_e5a6e89d_Tx: DynamicLength=false, PduLength=8, SysTPduToFrameMappingRef=VcuCan12TxMsg2
        VCU_Rx_500h_NM_oTC37X_VCU_CAN03_afe7d257_Rx: DynamicLength=false, PduLength=8, SysTPduToFrameMappingRef=VCU_Rx_500h_NM
        VcuCan03TxMsg2_oTC37X_VCU_CAN03_70af0847_Tx: DynamicLength=false, PduLength=8
        VcuCan03TxMsg2_oTC37X_VCU_CAN03_0942627e_Tx: DynamicLength=false, PduLength=8, SysTPduToFrameMappingRef=VcuCan03TxMsg2
        VcuCan03RxMsg1_oTC37X_VCU_CAN03_77e3a75f_Rx: DynamicLength=false, PduLength=8
        VcuCan03TxMsg1_oTC37X_VCU_CAN03_9a29d525_Tx: DynamicLength=false, PduLength=8
        VcuCan03RxMsg1_oTC37X_VCU_CAN03_4dd213bb_Rx: DynamicLength=false, PduLength=8, SysTPduToFrameMappingRef=VcuCan03RxMsg1
        VcuCan03RxMsg2_oTC37X_VCU_CAN03_84e608b6_Rx: DynamicLength=false, PduLength=8, SysTPduToFrameMappingRef=VcuCan03RxMsg2
        VCU_Tx_51Ch_NM_oTC37X_VCU_CAN03_61fe7220_Tx: DynamicLength=false, PduLength=8, SysTPduToFrameMappingRef=VCU_Tx_51Ch_NM
        VcuCan03RxMsg2_oTC37X_VCU_CAN03_9d657a3d_Rx: DynamicLength=false, PduLength=8
        VcuCan03TxMsg1_oTC37X_VCU_CAN03_c0767973_Tx: DynamicLength=false, PduLength=8, SysTPduToFrameMappingRef=VcuCan03TxMsg1
        MasterReq_oLIN01_eb5b5f1c_Tx: DynamicLength=true, PduLength=8
        MasterReq_oLIN01_3d2c8087_Tx: DynamicLength=true, PduLength=8
        Vcu_Lin0_TxMsg2_oLIN01_0a12d45a_Tx: DynamicLength=false, PduLength=8
        MasterReq_Tp_oLIN01_a828173f_Tx: DynamicLength=false, PduLength=8, SysTPduToFrameMappingRef=MasterReq_Tp
        Vcu_Lin0_TxMsg1_oLIN01_02277a36_Tx: DynamicLength=false, PduLength=8, SysTPduToFrameMappingRef=Vcu_Lin0_TxMsg1
        MasterReq_GWM_oLIN01_08407441_Tx: DynamicLength=true, PduLength=8
        Vcu_Lin0_RxMsg2_oLIN01_aaf70b87_Rx: DynamicLength=false, PduLength=8
        SlaveResp_GWM_oLIN01_9a3cff6e_Rx: DynamicLength=true, PduLength=8
        MasterReq_GWM_oLIN01_25aef125_Tx: DynamicLength=true, PduLength=8
        Vcu_Lin0_RxMsg1_oLIN01_079b7478_Rx: DynamicLength=false, PduLength=8, SysTPduToFrameMappingRef=Vcu_Lin0_RxMsg1
        SlaveResp_Tp_oLIN01_ea474a0c_Rx: DynamicLength=false, PduLength=8, SysTPduToFrameMappingRef=SlaveResp_Tp
        Vcu_Lin0_TxMsg2_oLIN01_74c2430b_Tx: DynamicLength=false, PduLength=8, SysTPduToFrameMappingRef=Vcu_Lin0_TxMsg2
        Vcu_Lin0_TxMsg1_oLIN01_849dd3b9_Tx: DynamicLength=false, PduLength=8
        Vcu_Lin0_RxMsg1_oLIN01_24780c64_Rx: DynamicLength=false, PduLength=8
        Vcu_Lin0_RxMsg2_oLIN01_717e4d45_Rx: DynamicLength=false, PduLength=8, SysTPduToFrameMappingRef=Vcu_Lin0_RxMsg2
        SlaveResp_GWM_oLIN01_f08746e2_Rx: DynamicLength=true, PduLength=8
        IBS_Status_06_oATOM_CANFD_Matrix_CH_V600_202502_b3201aef_Rx: DynamicLength=false, PduLength=8
        VCU_HMIsignals_02_oATOM_CANFD_Matrix_CH_V600_202502_343b3975_Tx: DynamicLength=false, PduLength=8, SysTPduToFrameMappingRef=VCU_HMIsignals_02
        IBS_WheelSpeed_02_oATOM_CANFD_Matrix_CH_V600_202502_97968df7_Rx: DynamicLength=false, PduLength=8
        VCU_HMIsignals_01_oATOM_CANFD_Matrix_CH_V600_202502_f29a9fcc_Tx: DynamicLength=false, PduLength=8
        ADCU_ACC_02_oATOM_CANFD_Matrix_CH_V600_202502_09e0da82_Rx: DynamicLength=false, PduLength=8
        IBS_WheelSpeed_01_oATOM_CANFD_Matrix_CH_V600_202502_1c45b3ee_Rx: DynamicLength=false, PduLength=8
        VCU_MCU_03_oATOM_CANFD_Matrix_CH_V600_202502_0d9d0aa9_Tx: DynamicLength=false, PduLength=8
        SGW_17_oATOM_CANFD_Matrix_CH_V600_202502_3a9eb4a2_Rx: DynamicLength=false, PduLength=8, SysTPduToFrameMappingRef=SGW_17
        ACU_info_oATOM_CANFD_Matrix_CH_V600_202502_c3757d77_Rx: DynamicLength=false, PduLength=8
        VCU_3966faea_Rx: PduLength=8, SysTPduToFrameMappingRef=NM_CGW
        IBS_Status_02_oATOM_CANFD_Matrix_CH_V600_202502_35bef38d_Rx: DynamicLength=false, PduLength=8, SysTPduToFrameMappingRef=IBS_Status_02
        ACU_01_oATOM_CANFD_Matrix_CH_V600_202502_92b30981_Rx: DynamicLength=false, PduLength=8
        VCU_HMIsignals_02_oATOM_CANFD_Matrix_CH_V600_202502_7949a1d5_Tx: DynamicLength=false, PduLength=8
        VCU_PlugInChrgInfo_oATOM_CANFD_Matrix_CH_V600_202502_20405e82_Tx: DynamicLength=false, PduLength=8
        ADCU_AEB_01_oATOM_CANFD_Matrix_CH_V600_202502_73fc26ce_Rx: DynamicLength=false, PduLength=8
        VCU_02_oATOM_CANFD_Matrix_CH_V600_202502_17bac731_Tx: DynamicLength=false, PduLength=8
        ADCU_ACC_02_oATOM_CANFD_Matrix_CH_V600_202502_9c78bb9f_Rx: DynamicLength=false, PduLength=8, SysTPduToFrameMappingRef=ADCU_ACC_02
        ADCU_APS_01_oATOM_CANFD_Matrix_CH_V600_202502_c0dbb601_Rx: DynamicLength=false, PduLength=8, SysTPduToFrameMappingRef=ADCU_APS_01
        IBS_ACC_oATOM_CANFD_Matrix_CH_V600_202502_205c1446_Rx: DynamicLength=false, PduLength=8, SysTPduToFrameMappingRef=IBS_ACC
        IBS_Status_04_oATOM_CANFD_Matrix_CH_V600_202502_dc4e3b12_Rx: DynamicLength=false, PduLength=8, SysTPduToFrameMappingRef=IBS_Status_04
        VCU_MCU_03_oATOM_CANFD_Matrix_CH_V600_202502_9c2fbb06_Tx: DynamicLength=false, PduLength=8, SysTPduToFrameMappingRef=VCU_MCU_03
        IBS_Status_04_oATOM_CANFD_Matrix_CH_V600_202502_f76d333e_Rx: DynamicLength=false, PduLength=8
        VCU_IBS_01_oATOM_CANFD_Matrix_CH_V600_202502_4c086bc0_Tx: DynamicLength=false, PduLength=8
        IBS_Status_02_oATOM_CANFD_Matrix_CH_V600_202502_3bba494d_Rx: DynamicLength=false, PduLength=8
        VCU_Chassis_01_oATOM_CANFD_Matrix_CH_V600_202502_d7fdb34f_Tx: DynamicLength=false, PduLength=8
        VCU_02_oATOM_CANFD_Matrix_CH_V600_202502_b9b0de03_Tx: DynamicLength=false, PduLength=8, SysTPduToFrameMappingRef=VCU_02
        ADCU_APS_02_oATOM_CANFD_Matrix_CH_V600_202502_599b516e_Rx: DynamicLength=false, PduLength=8, SysTPduToFrameMappingRef=ADCU_APS_02
        VCU_IBS_01_oATOM_CANFD_Matrix_CH_V600_202502_72f519e8_Tx: DynamicLength=false, PduLength=8, SysTPduToFrameMappingRef=VCU_IBS_01
        IBS_Torque_oATOM_CANFD_Matrix_CH_V600_202502_e4106cfa_Rx: DynamicLength=false, PduLength=8
        ADCU_DA_oATOM_CANFD_Matrix_CH_V600_202502_8a75132b_Rx: DynamicLength=false, PduLength=8, SysTPduToFrameMappingRef=ADCU_DA
        ACU_info_oATOM_CANFD_Matrix_CH_V600_202502_83006605_Rx: DynamicLength=false, PduLength=8, SysTPduToFrameMappingRef=ACU_info
        VCU_BMS_oATOM_CANFD_Matrix_CH_V600_202502_1208e503_Tx: DynamicLength=false, PduLength=8
        VCU_HMIsignals_01_oATOM_CANFD_Matrix_CH_V600_202502_ad7bde1a_Tx: DynamicLength=false, PduLength=8, SysTPduToFrameMappingRef=VCU_HMIsignals_01
        IBS_Status_03_oATOM_CANFD_Matrix_CH_V600_202502_f451ac97_Rx: DynamicLength=false, PduLength=8, SysTPduToFrameMappingRef=IBS_Status_03
        VCU_04_oATOM_CANFD_Matrix_CH_V600_202502_db6dbd42_Tx: DynamicLength=false, PduLength=8
        VCU_04_oATOM_CANFD_Matrix_CH_V600_202502_5040169c_Tx: DynamicLength=false, PduLength=8, SysTPduToFrameMappingRef=VCU_04
        VCU_PlugInChrgInfo_oATOM_CANFD_Matrix_CH_V600_202502_f8a23add_Tx: DynamicLength=false, PduLength=8, SysTPduToFrameMappingRef=VCU_PlugInChrgInfo
        ACU_02_oATOM_CANFD_Matrix_CH_V600_202502_19603798_Rx: DynamicLength=false, PduLength=8
        VCU_AccPedal_oATOM_CANFD_Matrix_CH_V600_202502_0d0df7a0_Tx: DynamicLength=false, PduLength=8
        IBS_APS_oATOM_CANFD_Matrix_CH_V600_202502_8feeb71a_Rx: DynamicLength=false, PduLength=8, SysTPduToFrameMappingRef=IBS_APS
        IBS_APS_oATOM_CANFD_Matrix_CH_V600_202502_25d77553_Rx: DynamicLength=false, PduLength=8
        VCU_03_oATOM_CANFD_Matrix_CH_V600_202502_d824d0f9_Tx: DynamicLength=false, PduLength=8
        ADCU_APS_02_oATOM_CANFD_Matrix_CH_V600_202502_5c7f9a02_Rx: DynamicLength=false, PduLength=8
        IBS_Status_01_oATOM_CANFD_Matrix_CH_V600_202502_b0697754_Rx: DynamicLength=false, PduLength=8
        SGW_17_oATOM_CANFD_Matrix_CH_V600_202502_9b3e5336_Rx: DynamicLength=false, PduLength=8
        VCU_03_oATOM_CANFD_Matrix_CH_V600_202502_785f8119_Tx: DynamicLength=false, PduLength=8, SysTPduToFrameMappingRef=VCU_03
        VCU_AccPedal_oATOM_CANFD_Matrix_CH_V600_202502_3cf928f4_Tx: DynamicLength=false, PduLength=8, SysTPduToFrameMappingRef=VCU_AccPedal
        VCU_BMS_oATOM_CANFD_Matrix_CH_V600_202502_8dd4382b_Tx: DynamicLength=false, PduLength=8, SysTPduToFrameMappingRef=VCU_BMS
        IBS_WheelSpeed_01_oATOM_CANFD_Matrix_CH_V600_202502_cdf72100_Rx: DynamicLength=false, PduLength=8, SysTPduToFrameMappingRef=IBS_WheelSpeed_01
        ADCU_AEB_01_oATOM_CANFD_Matrix_CH_V600_202502_aeea498e_Rx: DynamicLength=false, PduLength=8, SysTPduToFrameMappingRef=ADCU_AEB_01
        ADCU_APS_01_oATOM_CANFD_Matrix_CH_V600_202502_d7aca41b_Rx: DynamicLength=false, PduLength=8
        IBS_VCU_MotorControl_oATOM_CANFD_Matrix_CH_V600_202502_d229d0d9_Rx: DynamicLength=false, PduLength=8
        IBS_Status_01_oATOM_CANFD_Matrix_CH_V600_202502_acfe14e2_Rx: DynamicLength=false, PduLength=8, SysTPduToFrameMappingRef=IBS_Status_01
        IBS_Status_03_oATOM_CANFD_Matrix_CH_V600_202502_f4245e85_Rx: DynamicLength=false, PduLength=8
        NM_VCU_oATOM_CANFD_Matrix_CH_V600_202502_7321f2c3_Tx: DynamicLength=false, PduLength=8, SysTPduToFrameMappingRef=NM_VCU
        ADCU_DA_oATOM_CANFD_Matrix_CH_V600_202502_c19ff818_Rx: DynamicLength=false, PduLength=8
        IBS_ACC_oATOM_CANFD_Matrix_CH_V600_202502_ef8c28ba_Rx: DynamicLength=false, PduLength=8
        IBS_WheelSpeed_02_oATOM_CANFD_Matrix_CH_V600_202502_54b7c66f_Rx: DynamicLength=false, PduLength=8, SysTPduToFrameMappingRef=IBS_WheelSpeed_02
        IBS_Status_06_oATOM_CANFD_Matrix_CH_V600_202502_84e18367_Rx: DynamicLength=false, PduLength=8, SysTPduToFrameMappingRef=IBS_Status_06
        ACU_01_oATOM_CANFD_Matrix_CH_V600_202502_1343b9ef_Rx: DynamicLength=false, PduLength=8, SysTPduToFrameMappingRef=ACU_01
        IBS_VCU_MotorControl_oATOM_CANFD_Matrix_CH_V600_202502_df4c437b_Rx: DynamicLength=false, PduLength=8, SysTPduToFrameMappingRef=IBS_VCU_MotorControl
        VCU_Chassis_01_oATOM_CANFD_Matrix_CH_V600_202502_e79830d3_Tx: DynamicLength=false, PduLength=8, SysTPduToFrameMappingRef=VCU_Chassis_01
        IBS_Torque_oATOM_CANFD_Matrix_CH_V600_202502_94259583_Rx: DynamicLength=false, PduLength=8, SysTPduToFrameMappingRef=IBS_Torque
        ACU_02_oATOM_CANFD_Matrix_CH_V600_202502_8a035e80_Rx: DynamicLength=false, PduLength=8, SysTPduToFrameMappingRef=ACU_02
        VcuAdcTxG2Msg1_oTC37X_VCU_CAN01_969aa009_Tx: DynamicLength=false, PduLength=8
        VcuAdcTxG2Msg1_oTC37X_VCU_CAN01_9da63bcc_Tx: DynamicLength=false, PduLength=8, SysTPduToFrameMappingRef=VcuAdcTxG2Msg1
        VcuAdcTxG1Msg0_oTC37X_VCU_CAN01_40b0bba8_Tx: DynamicLength=false, PduLength=8
        VcuAdcTxG3Msg0_oTC37X_VCU_CAN01_b3ccc652_Tx: DynamicLength=false, PduLength=8, SysTPduToFrameMappingRef=VcuAdcTxG3Msg0
        VcuAdcTxG0Msg0_oTC37X_VCU_CAN01_0847dbfd_Tx: DynamicLength=false, PduLength=8, SysTPduToFrameMappingRef=VcuAdcTxG0Msg0
        VcuAdcTxG0Msg0_oTC37X_VCU_CAN01_5798df68_Tx: DynamicLength=false, PduLength=8
        VcuAdcTxG1Msg0_oTC37X_VCU_CAN01_613ed098_Tx: DynamicLength=false, PduLength=8, SysTPduToFrameMappingRef=VcuAdcTxG1Msg0
        VcuAdcTxG3Msg1_oTC37X_VCU_CAN01_81b2c4c9_Tx: DynamicLength=false, PduLength=8
        VcuAdcTxG0Msg1_oTC37X_VCU_CAN01_b8ca6989_Tx: DynamicLength=false, PduLength=8
        VcuAdcTxG3Msg0_oTC37X_VCU_CAN01_6ee07228_Tx: DynamicLength=false, PduLength=8
        VcuAdcTxG2Msg0_oTC37X_VCU_CAN01_79c816e8_Tx: DynamicLength=false, PduLength=8
        VcuAdcTxG3Msg1_oTC37X_VCU_CAN01_f4df30a9_Tx: DynamicLength=false, PduLength=8, SysTPduToFrameMappingRef=VcuAdcTxG3Msg1
        VcuAdcTxG8Msg3_oTC37X_VCU_CAN01_045d240a_Tx: DynamicLength=false, PduLength=8
        VcuAdcTxG1Msg1_oTC37X_VCU_CAN01_afe20d49_Tx: DynamicLength=false, PduLength=8
        VcuAdcTxG1Msg1_oTC37X_VCU_CAN01_262d2663_Tx: DynamicLength=false, PduLength=8, SysTPduToFrameMappingRef=VcuAdcTxG1Msg1
        VcuAdcTxG8Msg0_oTC37X_VCU_CAN01_eedbf968_Tx: DynamicLength=false, PduLength=8
        VcuAdcTxG2Msg0_oTC37X_VCU_CAN01_dab5cd37_Tx: DynamicLength=false, PduLength=8, SysTPduToFrameMappingRef=VcuAdcTxG2Msg0
        VcuAdcTxG0Msg1_oTC37X_VCU_CAN01_4f542d06_Tx: DynamicLength=false, PduLength=8, SysTPduToFrameMappingRef=VcuAdcTxG0Msg1
        VcuAdcTxG8Msg2_oTC37X_VCU_CAN01_eb0f92eb_Tx: DynamicLength=false, PduLength=8
        VcuAdcTxG8Msg0_oTC37X_VCU_CAN01_f56d8c57_Tx: DynamicLength=false, PduLength=8, SysTPduToFrameMappingRef=VcuAdcTxG8Msg0
        VcuAdcTxG8Msg1_oTC37X_VCU_CAN01_01894f89_Tx: DynamicLength=false, PduLength=8
        VcuAdcTxG8Msg1_oTC37X_VCU_CAN01_b27e7aac_Tx: DynamicLength=false, PduLength=8, SysTPduToFrameMappingRef=VcuAdcTxG8Msg1
        VcuAdcTxG8Msg2_oTC37X_VCU_CAN01_7b4a61a1_Tx: DynamicLength=false, PduLength=8, SysTPduToFrameMappingRef=VcuAdcTxG8Msg2
        VcuAdcTxG8Msg3_oTC37X_VCU_CAN01_3c59975a_Tx: DynamicLength=false, PduLength=8, SysTPduToFrameMappingRef=VcuAdcTxG8Msg3
        VcuRxCtrlMsg0_oTC37X_VCU_CAN01_b24a2ab4_Rx: DynamicLength=false, PduLength=8
        VcuRxCtrlMsg0_oTC37X_VCU_CAN01_3715838b_Rx: DynamicLength=false, PduLength=8, SysTPduToFrameMappingRef=VcuRxCtrlMsg0
        VcuRxCtrlMsg1_oTC37X_VCU_CAN01_5d189c55_Rx: DynamicLength=false, PduLength=8
        VcuRxCtrlMsg1_oTC37X_VCU_CAN01_70067570_Rx: DynamicLength=false, PduLength=8, SysTPduToFrameMappingRef=VcuRxCtrlMsg1
        VcuMeasurementMsg0_oTC37X_VCU_CAN01_d96481d0_Tx: DynamicLength=false, PduLength=8, SysTPduToFrameMappingRef=VcuMeasurementMsg0
        VcuRxCtrlMsg2_oTC37X_VCU_CAN01_b9326e7d_Rx: DynamicLength=false, PduLength=8, SysTPduToFrameMappingRef=VcuRxCtrlMsg2
        VcuRxCtrlMsg2_oTC37X_VCU_CAN01_b79e4137_Rx: DynamicLength=false, PduLength=8
        VcuMeasurementMsg0_oTC37X_VCU_CAN01_0deb23c3_Tx: DynamicLength=false, PduLength=8
        MasterReq_Tp_oLIN02_18e9f277_Tx: DynamicLength=false, PduLength=8, SysTPduToFrameMappingRef=MasterReq_Tp
        Vcu_Lin3_TxMsg2_oLIN02_8266ef99_Tx: DynamicLength=false, PduLength=8
        MasterReq_GWM_oLIN02_956f146d_Tx: DynamicLength=true, PduLength=8
        SlaveResp_GWM_oLIN02_698e1758_Rx: DynamicLength=true, PduLength=8
        MasterReq_oLIN02_5b9aba54_Tx: DynamicLength=true, PduLength=8
        Vcu_Lin3_TxMsg2_oLIN02_80a2835b_Tx: DynamicLength=false, PduLength=8, SysTPduToFrameMappingRef=Vcu_Lin3_TxMsg2
        Vcu_Lin3_TxMsg1_oLIN02_0ce9e87a_Tx: DynamicLength=false, PduLength=8
        Vcu_Lin3_RxMsg1_oLIN02_f3fbb428_Rx: DynamicLength=false, PduLength=8, SysTPduToFrameMappingRef=Vcu_Lin3_RxMsg1
        Vcu_Lin3_RxMsg1_oLIN02_ac0c37a7_Rx: DynamicLength=false, PduLength=8
        Vcu_Lin3_RxMsg2_oLIN02_22833044_Rx: DynamicLength=false, PduLength=8
        SlaveResp_Tp_oLIN02_5a86af44_Rx: DynamicLength=false, PduLength=8, SysTPduToFrameMappingRef=SlaveResp_Tp
        Vcu_Lin3_RxMsg2_oLIN02_851e8d15_Rx: DynamicLength=false, PduLength=8, SysTPduToFrameMappingRef=Vcu_Lin3_RxMsg2
        Vcu_Lin3_TxMsg1_oLIN02_f647ba66_Tx: DynamicLength=false, PduLength=8, SysTPduToFrameMappingRef=Vcu_Lin3_TxMsg1
        MasterReq_GWM_oLIN02_914925fb_Tx: DynamicLength=true, PduLength=8
        MasterReq_oLIN02_a425d13d_Tx: DynamicLength=true, PduLength=8
        SlaveResp_GWM_oLIN02_2afd1a26_Rx: DynamicLength=true, PduLength=8
