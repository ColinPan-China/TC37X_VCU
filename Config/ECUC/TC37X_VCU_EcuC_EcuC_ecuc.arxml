AUTOSAR XML (schema 00048)
package /ActiveEcuC
  module config EcuC: implementation-config-variant=VARIANT-PRE-COMPILE, module-description=EcuC_Impl
    EcucGeneral:
      CPUType = CPU32Bit
      SizeOfInt = Size32Bit
      ByteOrder = LITTLE_ENDIAN
      BitOrder = LSB_to_MSB
      AtomicBitAccessInBitfield = false
      AtomicVariableAccess = Atomic32BitAccess
      SizeOfEnum = Size32Bit
      SizeOfROMPointer = Size32Bit
      SizeOfRAMPointer = Size32Bit
      BitFieldDataType = INT
      StructAlignment = Auto
      ArrayAlignment = Align8Bit
      StructInArrayAlignment = Auto
      DummyFunction = false
      DummyStatement = true
      DummyStatementKind = None
      ConditionalGenerating = true
      EcucBswImplementationCodeType = EcuCSourceCode
      EcuCUseStdReturnTypeForRte = false
      PostbuildLoadable: AlignmentFillPattern=255, PBROMStartAddress=0, PBRAMStartAddress=0, PBROMEndAddress=0, PBRAMEndAddress=0
      BswInitialization
        65 x InitFunction:
          BswM_PreInit: Header=BswM.h, InitPhase=INIT_ONE, ConfigType=BswM_ConfigType, ConfigPtrName=BswM_Config_Ptr, ConfigPtrClass=BSWM_INIT_DATA, ModuleRef=BswM  # /ActiveEcuC/BswM PLAIN_TEXT PreInit function description of BswM in UnfilteredViewInInvariantProject (UnfilteredInvariantProjectModelView) .
          BswM_InitMemory: Header=BswM.h, InitPhase=INIT_MEMORY, ModuleRef=BswM  # /ActiveEcuC/BswM PLAIN_TEXT InitMemory function description of BswM in UnfilteredViewInInvariantProject (UnfilteredInvariantProjectModelView) .
          BswM_Init: Header=BswM.h, InitPhase=NO_INIT, ConfigType=BswM_ConfigType, ConfigPtrName=BswM_Config_Ptr, ConfigPtrClass=BSWM_INIT_DATA, ModuleRef=BswM  # /ActiveEcuC/BswM PLAIN_TEXT Init function description of BswM in UnfilteredViewInInvariantProject (UnfilteredInvariantProjectModelView) .
          EcuM_Init: Header=EcuM.h, InitPhase=NO_INIT, ConfigType=EcuM_PbConfigType, ConfigPtrName=EcuM_Config_Ptr, ConfigPtrClass=ECUM_INIT_DATA, ModuleRef=EcuM  # /ActiveEcuC/EcuM PLAIN_TEXT Init function description of EcuM in UnfilteredViewInInvariantProject (UnfilteredInvariantProjectModelView) .
          Rte_InitMemory: Header=Rte_Main.h, InitPhase=INIT_MEMORY, ModuleRef=Rte  # /ActiveEcuC/Rte PLAIN_TEXT Automatically generated by EcuCBswInitFctConfigurationService.
          Rte_StartTiming: Header=Rte_Main.h, InitPhase=NO_INIT, ModuleRef=Rte  # /ActiveEcuC/Rte PLAIN_TEXT Automatically generated by EcuCBswInitFctConfigurationService.
          SchM_Start: Header=Rte_Main.h, InitPhase=NO_INIT, ModuleRef=Rte  # /ActiveEcuC/Rte PLAIN_TEXT Automatically generated by EcuCBswInitFctConfigurationService.
          SchM_Init: Header=Rte_Main.h, InitPhase=NO_INIT, ModuleRef=Rte  # /ActiveEcuC/Rte PLAIN_TEXT Automatically generated by EcuCBswInitFctConfigurationService.
          Rte_Start: Header=Rte_Main.h, InitPhase=INIT_THREE, ModuleRef=Rte  # /ActiveEcuC/Rte PLAIN_TEXT Automatically generated by EcuCBswInitFctConfigurationService.
          SchM_StartTiming: Header=Rte_Main.h, InitPhase=NO_INIT, ModuleRef=Rte  # /ActiveEcuC/Rte PLAIN_TEXT Automatically generated by EcuCBswInitFctConfigurationService.
          Brs_Init: Header=, InitPhase=NO_INIT, ModuleRef=vBRS  # /ActiveEcuC/vBRS PLAIN_TEXT Automatically generated by EcuCBswInitFctConfigurationService.
          vLinkGen_Init: Header=vLinkGen_Lcfg.h, InitPhase=NO_INIT, ModuleRef=vLinkGen  # /ActiveEcuC/vLinkGen PLAIN_TEXT Dummy initialization of the vLinkGen
          vBaseEnv_Init: Header=, InitPhase=NO_INIT, ModuleRef=vBaseEnv  # /ActiveEcuC/vBaseEnv PLAIN_TEXT Created vBaseEnv_Init by Extended Init XML Service
          Dio_Init: Header=Dio.h, InitPhase=NO_INIT, ModuleRef=Dio  # /Dio/Dio PLAIN_TEXT Created Dio_Init by Extended Init XML Service
          Port_Init: Header=Port.h, InitPhase=INIT_ONE_EARLY, ConfigType=Port_ConfigType, ConfigPtrName=&Port_Config, ConfigPtrClass=AUTOMATIC, ModuleRef=Port  # /Port/Port PLAIN_TEXT Created Port_Init by Extended Init XML Service
          McalLib_Init: Header=McalLib.h, InitPhase=NO_INIT, ModuleRef=McalLib  # /McalLib/McalLib PLAIN_TEXT Created McalLib_Init by Extended Init XML Service
          Mcu_Init: Header=Mcu.h, InitPhase=INIT_ONE_EARLY, ConfigType=Mcu_ConfigType, ConfigPtrName=&Mcu_Config, ConfigPtrClass=AUTOMATIC, AdditionalInitCode=Mcu_InitClock(0);while (MCU_PLL_LOCKED != Mcu_GetPllStatus());Mcu_DistributePllClock();, ModuleRef=Mcu  # /Mcu/Mcu PLAIN_TEXT Created Mcu_Init by Extended Init XML Service
          Can_Init: Header=Can.h, InitPhase=INIT_TWO_DRV, ConfigType=Can_ConfigType, ConfigPtrName=Can_Config_Ptr, ConfigPtrClass=CAN_INIT_DATA, ModuleRef=Can  # /ActiveEcuC/Can PLAIN_TEXT Init function description of Can in UnfilteredViewInInvariantProject (UnfilteredInvariantProjectModelView) .
          Can_InitMemory: Header=Can.h, InitPhase=INIT_MEMORY, ModuleRef=Can  # /ActiveEcuC/Can PLAIN_TEXT InitMemory function description of Can in UnfilteredViewInInvariantProject (UnfilteredInvariantProjectModelView) .
          CanIf_InitMemory: Header=CanIf.h, InitPhase=INIT_MEMORY, ModuleRef=CanIf  # /ActiveEcuC/CanIf PLAIN_TEXT InitMemory function description of CanIf in UnfilteredViewInInvariantProject (UnfilteredInvariantProjectModelView) .
          CanIf_Init: Header=CanIf.h, InitPhase=INIT_TWO_IF, ConfigType=CanIf_ConfigType, ConfigPtrName=CanIf_Config_Ptr, ConfigPtrClass=CANIF_INIT_DATA, ModuleRef=CanIf  # /ActiveEcuC/CanIf PLAIN_TEXT Init function description of CanIf in UnfilteredViewInInvariantProject (UnfilteredInvariantProjectModelView) .
          CanSM_Init: Header=CanSM_EcuM.h, InitPhase=INIT_TWO_SM, ConfigType=CanSM_ConfigType, ConfigPtrName=CanSM_Config_Ptr, ConfigPtrClass=CANSM_INIT_DATA, ModuleRef=CanSM  # /ActiveEcuC/CanSM PLAIN_TEXT Init function description of CanSM in UnfilteredViewInInvariantProject (UnfilteredInvariantProjectModelView) .
          CanSM_InitMemory: Header=CanSM_EcuM.h, InitPhase=INIT_MEMORY, ModuleRef=CanSM  # /ActiveEcuC/CanSM PLAIN_TEXT InitMemory function description of CanSM in UnfilteredViewInInvariantProject (UnfilteredInvariantProjectModelView) .
          ComM_InitMemory: Header=ComM.h, InitPhase=INIT_MEMORY, ModuleRef=ComM  # /ActiveEcuC/ComM PLAIN_TEXT InitMemory function description of ComM in UnfilteredViewInInvariantProject (UnfilteredInvariantProjectModelView) .
          ComM_Init: Header=ComM.h, InitPhase=INIT_TWO_POST_NVMREADALL, ConfigType=ComM_ConfigType, ConfigPtrName=ComM_Config_Ptr, ConfigPtrClass=COMM_INIT_DATA, ModuleRef=ComM  # /ActiveEcuC/ComM PLAIN_TEXT Init function description of ComM in UnfilteredViewInInvariantProject (UnfilteredInvariantProjectModelView) .
          ComM_PreInit: Header=ComM.h, InitPhase=INIT_ONE, ConfigType=ComM_ConfigType, ConfigPtrName=ComM_Config_Ptr, ConfigPtrClass=COMM_INIT_DATA, ModuleRef=ComM  # /ActiveEcuC/ComM PLAIN_TEXT PreInit function description of ComM in UnfilteredViewInInvariantProject (UnfilteredInvariantProjectModelView) .
          ComM_PostInit: Header=ComM.h, InitPhase=INIT_THREE, ModuleRef=ComM  # /ActiveEcuC/ComM PLAIN_TEXT Post-Initialization of the ComM and its internal state machine
          Com_InitMemory: Header=Com.h, InitPhase=INIT_MEMORY, ModuleRef=Com  # /ActiveEcuC/Com PLAIN_TEXT InitMemory function description of Com in UnfilteredViewInInvariantProject (UnfilteredInvariantProjectModelView) .
          Com_Init: Header=Com.h, InitPhase=INIT_TWO_COM, ConfigType=Com_ConfigType, ConfigPtrName=Com_Config_Ptr, ConfigPtrClass=COM_INIT_DATA, ModuleRef=Com  # /ActiveEcuC/Com PLAIN_TEXT Init function description of Com in UnfilteredViewInInvariantProject (UnfilteredInvariantProjectModelView) .
          Det_Init: Header=Det.h, InitPhase=INIT_ZERO, ConfigType=Det_ConfigType, ConfigPtrName=Det_Config_Ptr, ConfigPtrClass=DET_INIT_DATA, ModuleRef=Det  # /ActiveEcuC/Det PLAIN_TEXT Init function description of Det in UnfilteredViewInInvariantProject (UnfilteredInvariantProjectModelView) .
          Det_InitMemory: Header=Det.h, InitPhase=INIT_MEMORY, ModuleRef=Det  # /ActiveEcuC/Det PLAIN_TEXT InitMemory function description of Det in UnfilteredViewInInvariantProject (UnfilteredInvariantProjectModelView) .
          PduR_PreInit: Header=PduR.h, InitPhase=INIT_ONE, ConfigType=PduR_PBConfigType, ConfigPtrName=PduR_Config_Ptr, ConfigPtrClass=PDUR_INIT_DATA, ModuleRef=PduR  # /ActiveEcuC/PduR PLAIN_TEXT PreInit function description of PduR in UnfilteredViewInInvariantProject (UnfilteredInvariantProjectModelView) .
          PduR_Init: Header=PduR.h, InitPhase=INIT_TWO_COM, ConfigType=PduR_PBConfigType, ConfigPtrName=PduR_Config_Ptr, ConfigPtrClass=PDUR_INIT_DATA, ModuleRef=PduR  # /ActiveEcuC/PduR PLAIN_TEXT Init function description of PduR in UnfilteredViewInInvariantProject (UnfilteredInvariantProjectModelView) .
          PduR_InitMemory: Header=PduR.h, InitPhase=INIT_MEMORY, ModuleRef=PduR  # /ActiveEcuC/PduR PLAIN_TEXT InitMemory function description of PduR in UnfilteredViewInInvariantProject (UnfilteredInvariantProjectModelView) .
          CanNm_Init: Header=CanNm.h, InitPhase=INIT_TWO_NM, ConfigType=CanNm_ConfigType, ConfigPtrName=CanNm_Config_Ptr, ConfigPtrClass=CANNM_INIT_DATA, ModuleRef=CanNm  # /ActiveEcuC/CanNm PLAIN_TEXT Init function description of CanNm in UnfilteredViewInInvariantProject (UnfilteredInvariantProjectModelView) .
          CanNm_InitMemory: Header=CanNm.h, InitPhase=INIT_MEMORY, ModuleRef=CanNm  # /ActiveEcuC/CanNm PLAIN_TEXT InitMemory function description of CanNm in UnfilteredViewInInvariantProject (UnfilteredInvariantProjectModelView) .
          Nm_PreInit: Header=Nm.h, InitPhase=INIT_ONE, ConfigType=Nm_ConfigType, ConfigPtrName=Nm_Config_Ptr, ConfigPtrClass=NM_INIT_DATA, ModuleRef=Nm  # /ActiveEcuC/Nm PLAIN_TEXT PreInit function description of Nm in UnfilteredViewInInvariantProject (UnfilteredInvariantProjectModelView) .
          Nm_Init: Header=Nm.h, InitPhase=INIT_TWO_NM, ConfigType=Nm_ConfigType, ConfigPtrName=Nm_Config_Ptr, ConfigPtrClass=NM_INIT_DATA, ModuleRef=Nm  # /ActiveEcuC/Nm PLAIN_TEXT Init function description of Nm in UnfilteredViewInInvariantProject (UnfilteredInvariantProjectModelView) .
          Nm_PostInit: Header=Nm.h, InitPhase=INIT_THREE, ModuleRef=Nm  # /ActiveEcuC/Nm PLAIN_TEXT Post-Initialization of the Network Management and its internal state machine
          Nm_InitMemory: Header=Nm.h, InitPhase=INIT_MEMORY, ModuleRef=Nm  # /ActiveEcuC/Nm PLAIN_TEXT InitMemory function description of Nm in UnfilteredViewInInvariantProject (UnfilteredInvariantProjectModelView) .
          Fee_Init: Header=Fee.h, InitPhase=INIT_ONE_LATE, ConfigType=Fee_ConfigType, ConfigPtrName=&Fee_Config, ConfigPtrClass=AUTOMATIC, ModuleRef=Fee  # /Fee/Fee PLAIN_TEXT Created Fee_Init by Extended Init XML Service
          Fls_17_Dmu_Init: Header=Fls_17_Dmu.h, InitPhase=INIT_ONE, ConfigType=Fls_17_Dmu_ConfigType, ConfigPtrName=&Fls_17_Dmu_Config, ConfigPtrClass=AUTOMATIC, ModuleRef=Fls  # /Fls/Fls PLAIN_TEXT Created Fls_17_Dmu_Init by Extended Init XML Service
          NvM_Init: Header=NvM.h, InitPhase=INIT_TWO_SYS, ModuleRef=NvM  # /ActiveEcuC/NvM PLAIN_TEXT Initialization of the NVRAM Manager, to make it ready for NvM_ReadAll being requested
          Xcp_InitMemory: Header=Xcp.h, InitPhase=INIT_MEMORY, ModuleRef=Xcp  # /ActiveEcuC/Xcp PLAIN_TEXT Memory Initialization function of module Xcp.
          Xcp_Init: Header=Xcp.h, InitPhase=INIT_TWO_TP, ModuleRef=Xcp  # /ActiveEcuC/Xcp PLAIN_TEXT Module Initialization function of module Xcp.
          CanXcp_Init: Header=CanXcp.h, InitPhase=INIT_TWO_TP, ConfigType=CanXcp_ConfigType, ConfigPtrName=NULL_PTR, ConfigPtrClass=CANXCP_CONST, ModuleRef=Xcp  # /ActiveEcuC/Xcp PLAIN_TEXT Module Initialization function of module CanXcp.
          CanXcp_InitMemory: Header=CanXcp.h, InitPhase=INIT_MEMORY, ModuleRef=Xcp  # /ActiveEcuC/Xcp PLAIN_TEXT Memory Initialization function of module CanXcp.
          CanTp_Init: Header=CanTp.h, InitPhase=INIT_TWO_TP, ConfigType=CanTp_ConfigType, ConfigPtrName=CanTp_Config_Ptr, ConfigPtrClass=CANTP_INIT_DATA, ModuleRef=CanTp  # /ActiveEcuC/CanTp PLAIN_TEXT Init function description of CanTp in UnfilteredViewInInvariantProject (UnfilteredInvariantProjectModelView) .
          CanTp_InitMemory: Header=CanTp.h, InitPhase=INIT_MEMORY, ModuleRef=CanTp  # /ActiveEcuC/CanTp PLAIN_TEXT InitMemory function description of CanTp in UnfilteredViewInInvariantProject (UnfilteredInvariantProjectModelView) .
          Dcm_Init: Header=Dcm.h, InitPhase=INIT_TWO_POST_NVMREADALL, ConfigType=Dcm_ConfigType, ConfigPtrName=NULL_PTR, ConfigPtrClass=DCM_CONST, ModuleRef=Dcm  # /ActiveEcuC/Dcm PLAIN_TEXT Dcm_Init function description
          Dcm_InitMemory: Header=Dcm.h, InitPhase=INIT_MEMORY, ModuleRef=Dcm  # /ActiveEcuC/Dcm PLAIN_TEXT Dcm_InitMemory function description
          Dem_PreInit: Header=Dem.h, InitPhase=INIT_ZERO, ConfigType=Dem_ConfigType, ConfigPtrName=Dem_Config_Ptr, ConfigPtrClass=DEM_INIT_DATA, ModuleRef=Dem  # /ActiveEcuC/Dem PLAIN_TEXT PreInit function description of Dem in UnfilteredViewInInvariantProject (UnfilteredInvariantProjectModelView) .
          Dem_InitMemory: Header=Dem.h, InitPhase=INIT_MEMORY, ModuleRef=Dem  # /ActiveEcuC/Dem PLAIN_TEXT InitMemory function description of Dem in UnfilteredViewInInvariantProject (UnfilteredInvariantProjectModelView) .
          Dem_Init: Header=Dem.h, InitPhase=INIT_TWO_POST_NVMREADALL, ConfigType=Dem_ConfigType, ConfigPtrName=Dem_Config_Ptr, ConfigPtrClass=DEM_INIT_DATA, ModuleRef=Dem  # /ActiveEcuC/Dem PLAIN_TEXT Init function description of Dem in UnfilteredViewInInvariantProject (UnfilteredInvariantProjectModelView) .
          Adc_Init: Header=Adc.h, InitPhase=INIT_ONE_LATE, ConfigType=Adc_ConfigType, ConfigPtrName=&Adc_Config, ConfigPtrClass=AUTOMATIC, ModuleRef=Adc  # /Adc/Adc PLAIN_TEXT Created Adc_Init by Extended Init XML Service
          LinIf_Init: Header=LinIf.h, InitPhase=INIT_TWO_IF, ConfigType=LinIf_ConfigType, ConfigPtrName=LinIf_Config_Ptr, ConfigPtrClass=LINIF_INIT_DATA, ModuleRef=LinIf  # /ActiveEcuC/LinIf PLAIN_TEXT Init function description of LinIf in UnfilteredViewInInvariantProject (UnfilteredInvariantProjectModelView) .
          LinIf_InitMemory: Header=LinIf.h, InitPhase=INIT_MEMORY, ModuleRef=LinIf  # /ActiveEcuC/LinIf PLAIN_TEXT InitMemory function description of LinIf in UnfilteredViewInInvariantProject (UnfilteredInvariantProjectModelView) .
          LinSM_Init: Header=LinSM.h, InitPhase=INIT_TWO_SM, ConfigType=LinSM_ConfigType, ConfigPtrName=LinSM_Config_Ptr, ConfigPtrClass=LINSM_INIT_DATA, ModuleRef=LinSM  # /ActiveEcuC/LinSM PLAIN_TEXT Init function description of LinSM in UnfilteredViewInInvariantProject (UnfilteredInvariantProjectModelView) .
          LinSM_InitMemory: Header=LinSM.h, InitPhase=INIT_MEMORY, ModuleRef=LinSM  # /ActiveEcuC/LinSM PLAIN_TEXT InitMemory function description of LinSM in UnfilteredViewInInvariantProject (UnfilteredInvariantProjectModelView) .
          LinTrcv_30_Tle7259_InitMemory: Header=LinTrcv_30_Tle7259.h, InitPhase=INIT_MEMORY, ModuleRef=LinTrcv  # /ActiveEcuC/LinTrcv PLAIN_TEXT InitMemory function description of LinTrcv_30_Tle7259 in UnfilteredViewInInvariantProject (UnfilteredInvariantProjectModelView) .
          LinTrcv_30_Tle7259_Init: Header=LinTrcv_30_Tle7259.h, InitPhase=INIT_TWO_TRCV, ConfigType=LinTrcv_30_Tle7259_ConfigType, ConfigPtrName=LinTrcv_30_Tle7259_Config_Ptr, ConfigPtrClass=LINTRCV_30_TLE7259_INIT_DATA, ModuleRef=LinTrcv  # /ActiveEcuC/LinTrcv PLAIN_TEXT Init function description of LinTrcv_30_Tle7259 in UnfilteredViewInInvariantProject (UnfilteredInvariantProjectModelView) .
          Lin_Init: Header=Lin.h, InitPhase=INIT_ONE, ConfigPtrName=Lin_Config_Ptr, ConfigType=Lin_17_AscLin_ConfigType, ConfigPtrClass=1, ModuleRef=Lin
          Spi_Init: Header=Spi.h, InitPhase=INIT_ONE, ConfigType=Spi_ConfigType, ConfigPtrName=&Spi_Config, ConfigPtrClass=AUTOMATIC, ModuleRef=Spi  # /Spi/Spi PLAIN_TEXT Created Spi_Init by Extended Init XML Service
          Dma_Init: Header=Dma.h, InitPhase=INIT_ONE, ConfigType=Dma_ConfigType, ConfigPtrName=&Dma_Config, ConfigPtrClass=AUTOMATIC, ModuleRef=Dma  # /Dma/Dma PLAIN_TEXT Created Dma_Init by Extended Init XML Service
          Irq_Init: Header=Irq.h, InitPhase=NO_INIT, ModuleRef=Irq  # /Irq/Irq PLAIN_TEXT Created Irq_Init by Extended Init XML Service
    EcucHardware
      EcucCoreDefinition: EcucCoreId=0
    EcucPduCollection: PduIdTypeEnum=UINT8, PduLengthTypeEnum=UINT16
      63 x Pdu, all with J1939Requestable=false:
        VcuRxMsg2_oTC37X_VCU_CAN00_920688f6_Rx: DynamicLength=false, PduLength=8
        VcuRxMsg2_oTC37X_VCU_CAN00_8cbda0e0_Rx: DynamicLength=false, PduLength=8, SysTPduToFrameMappingRef=VcuRxMsg2
        VcuTxMsg2_oTC37X_VCU_CAN00_7fccfa8c_Tx: DynamicLength=false, PduLength=8
        VcuTxMsg1_oTC37X_VCU_CAN00_954a27ee_Tx: DynamicLength=false, PduLength=8
        VcuRxMsg1_oTC37X_VCU_CAN00_4589bbed_Rx: DynamicLength=false, PduLength=8, SysTPduToFrameMappingRef=VcuRxMsg1
        VcuRxMsg1_oTC37X_VCU_CAN00_78805594_Rx: DynamicLength=false, PduLength=8
        VCU_Tx_51Ch_NM_oTC37X_VCU_CAN00_0aa0ce62_Tx: DynamicLength=false, PduLength=8, SysTPduToFrameMappingRef=VCU_Tx_51Ch_NM
        VcuTxMsg1_oTC37X_VCU_CAN00_c82dd125_Tx: DynamicLength=false, PduLength=8, SysTPduToFrameMappingRef=VcuTxMsg1
        VcuTxMsg2_oTC37X_VCU_CAN00_0119ca28_Tx: DynamicLength=false, PduLength=8, SysTPduToFrameMappingRef=VcuTxMsg2
        VCU_Rx_500h_NM_oTC37X_VCU_CAN00_c4b96e15_Rx: DynamicLength=false, PduLength=8, SysTPduToFrameMappingRef=VCU_Rx_500h_NM
        XCP_Request_oTC37X_VCU_CAN00_3c25b45e_Rx: DynamicLength=false, PduLength=8, SysTPduToFrameMappingRef=XCP_Request
        XCP_Response_oTC37X_VCU_CAN00_34d2da2d_Tx: DynamicLength=false, PduLength=8, SysTPduToFrameMappingRef=XCP_Response
        Vcu_Uds_Phy_Request_oTC37X_VCU_CAN00_d561dcee_Rx: DynamicLength=true, PduLength=8
        Vcu_Uds_Phy_Request_oTC37X_VCU_CAN00_16119f6f_Rx: DynamicLength=true, PduLength=8
        Vcu_Uds_Phy_Request_Tp_oTC37X_VCU_CAN00_58c52463_Rx: DynamicLength=false, PduLength=8, SysTPduToFrameMappingRef=Vcu_Uds_Phy_Request_Tp
        Vcu_Uds_Func_Request_Tp_oTC37X_VCU_CAN00_3dbedef7_Rx: DynamicLength=false, PduLength=8, SysTPduToFrameMappingRef=Vcu_Uds_Func_Request_Tp
        Vcu_Uds_Func_Request_oTC37X_VCU_CAN00_21e26bac_Rx: DynamicLength=true, PduLength=7
        Vcu_Uds_Func_Request_oTC37X_VCU_CAN00_455d4346_Rx: DynamicLength=true, PduLength=7
        Vcu_Uds_Response_oTC37X_VCU_CAN00_4d111be6_Tx: DynamicLength=true, PduLength=8
        Vcu_Uds_Response_oTC37X_VCU_CAN00_39638a1a_Tx: DynamicLength=true, PduLength=8
        Vcu_Uds_Response_Tp_oTC37X_VCU_CAN00_834178f3_Tx: DynamicLength=false, PduLength=8, SysTPduToFrameMappingRef=Vcu_Uds_Response_Tp
        VCU_Rx_500h_NM_oTC37X_VCU_CAN01_54a3f814_Rx: DynamicLength=false, PduLength=8, SysTPduToFrameMappingRef=VCU_Rx_500h_NM
        VCU_Tx_51Ch_NM_oTC37X_VCU_CAN01_9aba5863_Tx: DynamicLength=false, PduLength=8, SysTPduToFrameMappingRef=VCU_Tx_51Ch_NM
        VcuRxMsg3_oTC37X_VCU_CAN01_0a530e81_Rx: DynamicLength=false, PduLength=8
        VcuAdcTxMsg1_oTC37X_VCU_CAN01_fda515ee_Tx: DynamicLength=false, PduLength=8
        VcuAdcTxMsg2_oTC37X_VCU_CAN01_1723c88c_Tx: DynamicLength=false, PduLength=8
        VcuRxMsg3_oTC37X_VCU_CAN01_5bb4c01a_Rx: DynamicLength=false, PduLength=8, SysTPduToFrameMappingRef=VcuRxMsg3
        VcuRxMsg4_oTC37X_VCU_CAN01_eb7d04e5_Rx: DynamicLength=false, PduLength=8
        VcuRxMsg4_oTC37X_VCU_CAN01_55be06ba_Rx: DynamicLength=false, PduLength=8, SysTPduToFrameMappingRef=VcuRxMsg4
        VcuAdcTxMsg2_oTC37X_VCU_CAN01_afb1dcb2_Tx: DynamicLength=false, PduLength=8, SysTPduToFrameMappingRef=VcuAdcTxMsg2
        VcuAdcTxMsg1_oTC37X_VCU_CAN01_6685c7bf_Tx: DynamicLength=false, PduLength=8, SysTPduToFrameMappingRef=VcuAdcTxMsg1
        MasterReq_Tp_oLIN00_7147b638_Tx: DynamicLength=false, PduLength=8, SysTPduToFrameMappingRef=MasterReq_Tp
        Vcu_Lin0_TxMsg1_oLIN00_db48db31_Tx: DynamicLength=false, PduLength=8, SysTPduToFrameMappingRef=Vcu_Lin0_TxMsg1
        SlaveResp_Tp_oLIN00_3328eb0b_Rx: DynamicLength=false, PduLength=8, SysTPduToFrameMappingRef=SlaveResp_Tp
        MasterReq_GWM_oLIN00_7f4744d7_Tx: DynamicLength=true, PduLength=8
        SlaveResp_GWM_oLIN00_43535e69_Rx: DynamicLength=true, PduLength=8
        Vcu_Lin0_RxMsg1_oLIN00_537f3cf2_Rx: DynamicLength=false, PduLength=8
        MasterReq_GWM_oLIN00_fcc15022_Tx: DynamicLength=true, PduLength=8
        Vcu_Lin0_TxMsg2_oLIN00_adade20c_Tx: DynamicLength=false, PduLength=8, SysTPduToFrameMappingRef=Vcu_Lin0_TxMsg2
        MasterReq_oLIN00_4a2bb011_Tx: DynamicLength=true, PduLength=8
        Vcu_Lin0_RxMsg2_oLIN00_a811ec42_Rx: DynamicLength=false, PduLength=8, SysTPduToFrameMappingRef=Vcu_Lin0_RxMsg2
        Vcu_Lin0_RxMsg2_oLIN00_ddf03b11_Rx: DynamicLength=false, PduLength=8
        MasterReq_oLIN00_3234fe1b_Tx: DynamicLength=true, PduLength=8
        SlaveResp_GWM_oLIN00_87807674_Rx: DynamicLength=true, PduLength=8
        Vcu_Lin0_TxMsg1_oLIN00_f39ae32f_Tx: DynamicLength=false, PduLength=8
        Vcu_Lin0_RxMsg1_oLIN00_def4d57f_Rx: DynamicLength=false, PduLength=8, SysTPduToFrameMappingRef=Vcu_Lin0_RxMsg1
        Vcu_Lin0_TxMsg2_oLIN00_7d15e4cc_Tx: DynamicLength=false, PduLength=8
        VcuTxIoMsg2_oTC37X_VCU_CAN00_be0e97bf_Tx: DynamicLength=false, PduLength=8
        VcuTxIoMsg1_oTC37X_VCU_CAN00_54884add_Tx: DynamicLength=false, PduLength=8
        VcuTxIoMsg2_oTC37X_VCU_CAN00_4faa28b1_Tx: DynamicLength=false, PduLength=8, SysTPduToFrameMappingRef=VcuTxIoMsg2
        VcuTxIoMsg1_oTC37X_VCU_CAN00_869e33bc_Tx: DynamicLength=false, PduLength=8, SysTPduToFrameMappingRef=VcuTxIoMsg1
        VcuTxIoMsg4_oTC37X_VCU_CAN00_06b318ea_Tx: DynamicLength=false, PduLength=8, SysTPduToFrameMappingRef=VcuTxIoMsg4
        VcuTxIoMsg3_oTC37X_VCU_CAN00_515c215e_Tx: DynamicLength=false, PduLength=8
        VcuTxIoMsg5_oTC37X_VCU_CAN00_41a0ee11_Tx: DynamicLength=false, PduLength=8, SysTPduToFrameMappingRef=VcuTxIoMsg5
        VcuTxIoMsg8_oTC37X_VCU_CAN00_ac8b5230_Tx: DynamicLength=false, PduLength=8
        VcuTxIoMsg6_oTC37X_VCU_CAN00_b5a640b9_Tx: DynamicLength=false, PduLength=8
        VcuTxIoMsg5_oTC37X_VCU_CAN00_5f209ddb_Tx: DynamicLength=false, PduLength=8
        VcuTxIoMsg3_oTC37X_VCU_CAN00_08b9de4a_Tx: DynamicLength=false, PduLength=8, SysTPduToFrameMappingRef=VcuTxIoMsg3
        VcuTxIoMsg7_oTC37X_VCU_CAN00_cf8703e7_Tx: DynamicLength=false, PduLength=8, SysTPduToFrameMappingRef=VcuTxIoMsg7
        VcuTxIoMsg8_oTC37X_VCU_CAN00_9481785c_Tx: DynamicLength=false, PduLength=8, SysTPduToFrameMappingRef=VcuTxIoMsg8
        VcuTxIoMsg7_oTC37X_VCU_CAN00_5af4f658_Tx: DynamicLength=false, PduLength=8
        VcuTxIoMsg6_oTC37X_VCU_CAN00_8894f51c_Tx: DynamicLength=false, PduLength=8, SysTPduToFrameMappingRef=VcuTxIoMsg6
        VcuTxIoMsg4_oTC37X_VCU_CAN00_b0722b3a_Tx: DynamicLength=false, PduLength=8
