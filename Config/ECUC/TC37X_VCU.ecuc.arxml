AUTOSAR XML (schema 00049)
package /ActiveEcuC
  ecuc value collection ActiveEcuC: ecu-extract=SYSTEM, ecuc-values=[vLinkGen, Mcu, vBRS, BswM, EcuM, McalLib, ResourceM, Rte, Os, EcuC, vSet, MemMap, vBaseEnv]
