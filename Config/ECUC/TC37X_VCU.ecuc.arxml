AUTOSAR XML (schema 00049)
package /ActiveEcuC
  ecuc value collection ActiveEcuC: ecu-extract=SYSTEM, ecuc-values=[vLinkGen, vBRS, BswM, EcuM, Rte, Os, EcuC, vSet, MemMap, vBaseEnv, Dio, Port, ResourceM, McalLib, Mcu]
