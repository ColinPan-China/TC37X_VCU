AUTOSAR XML (schema 00048)
package /ActiveEcuC
  ecuc value collection ActiveEcuC: ecu-extract=SYSTEM
    ecuc-values:
      vLinkGen
      vBRS
      BswM
      EcuM
      Rte
      Os
      EcuC
      vSet
      MemMap
      vBaseEnv
      Port
      ResourceM
      McalLib
      Mcu
      PduR
      CanIf
      Can
      Det
      Com
      ComM
      CanSM
      CanNm
      Nm
      Fls
      Fee
      MemIf
      NvM
      Xcp
      Dio
      CanTp
      Dcm
      Dem
      Lin
      LinSM
      LinIf
      LinTrcv
      Dma
      Irq
      Spi
      Adc
      Pwm
      E2EPW
      Crc
      Eth
      EthTrcv
      EthIf
      EthSM
