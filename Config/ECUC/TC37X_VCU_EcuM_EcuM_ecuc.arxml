AUTOSAR XML (schema 00048)
package /ActiveEcuC
  module config EcuM: implementation-config-variant=VARIANT-PRE-COMPILE, module-description=EcuM_Impl
    EcuMFlexGeneral: EcuMAlarmClockPresent=false, EcuMResetLoopDetection=false, EcuMEnableDefBehaviour=false
    EcuMGeneral:
      EcuMDevErrorDetect = false
      EcuMIncludeDem = true
      EcuMIncludeDet = true
      EcuMMainFunctionPeriod = 0.01
      EcuMVersionInfoApi = false
      EcuMDeferredBswMNotification = false
      EcuMSlaveCoreHandling = true
      EcuMEnableFixBehavior = false
      EcuMNonChannelWakeupInRun = false
      EcuMSchMStartInitialization = true
      EcuMSafeBswChecks = false
      EcuMBswCoreId = 0
      EcuMGeneration: EcuMOutOfBoundsWriteSanitizer=false, EcuMOutOfBoundsReadSanitizer=false, EcuMInterfacesForDeactivatedData=false
    EcuMConfiguration
      EcuMCommonConfiguration:
        EcuMConfigConsistencyHash = 12612161837475178388
        EcuMDefaultAppMode = OSDEFAULTAPPMODE
        EcuMOSResource = OsResource_Core{0..2}
        5 x EcuMWakeupSource, all with EcuMValidationTimeout=0, EcuMCheckWakeupTimeout=0, EcuMWakeupSourcePolling=false:
          ECUM_WKSOURCE_POWER: EcuMWakeupSourceId=0
          ECUM_WKSOURCE_RESET: EcuMWakeupSourceId=1
          ECUM_WKSOURCE_INTERNAL_RESET: EcuMWakeupSourceId=2
          ECUM_WKSOURCE_INTERNAL_WDG: EcuMWakeupSourceId=3
          ECUM_WKSOURCE_EXTERNAL_WDG: EcuMWakeupSourceId=4
        EcuMDefaultShutdownTarget: EcuMDefaultState=EcuMStateOff
        EcuMDriverInitListZero
          BswM_InitMemory (EcuMDriverInitItem): index=0, EcuMModuleID=BswM, EcuMModuleService=BswM_InitMemory, EcuMModuleHeader=BswM.h
          Rte_InitMemory (EcuMDriverInitItem): index=1, EcuMModuleID=Rte, EcuMModuleService=Rte_InitMemory, EcuMModuleHeader=Rte_Main.h
        EcuMDriverInitListOne
          9 x EcuMDriverInitItem:
            Port_Init: index=0, EcuMModuleID=Port, EcuMModuleService=Port_Init, EcuMModuleHeader=Port.h
            Mcu_Init: index=1, EcuMModuleID=Mcu, EcuMModuleService=Mcu_Init, EcuMModuleHeader=Mcu.h
            Mcu_Init_AdditionalCode: index=2, EcuMModuleID=Code, EcuMAdditionalInitCode=Mcu_InitClock(0);while (MCU_PLL_LOCKED != Mcu_GetPllStatus());Mcu_DistributePllClock();, EcuMModuleHeader=Mcu.h
            BswM_PreInit: index=3, EcuMModuleID=BswM, EcuMModuleService=BswM_PreInit, EcuMModuleHeader=BswM.h
            Fls_17_Dmu_Init: index=4, EcuMModuleID=Fls, EcuMModuleService=Fls_17_Dmu_Init, EcuMModuleHeader=Fls_17_Dmu.h
            Adc_Init: index=5, EcuMModuleID=Adc, EcuMModuleService=Adc_Init, EcuMModuleHeader=Adc.h
            Dma_Init: index=6, EcuMModuleID=Dma, EcuMModuleService=Dma_Init, EcuMModuleHeader=Dma.h
            Spi_Init: index=7, EcuMModuleID=Spi, EcuMModuleService=Spi_Init, EcuMModuleHeader=Spi.h
            Pwm_17_GtmCcu6_Init: index=8, EcuMModuleID=Pwm, EcuMModuleService=Pwm_17_GtmCcu6_Init, EcuMModuleHeader=Pwm_17_GtmCcu6.h
        EcuMDriverRestartList
        8 x EcuMWakeupSource:
          CN_TC37X_VCU_CAN01_70b1f95e: EcuMWakeupSourceId=8, EcuMWakeupSourcePolling=false, EcuMComMChannelRef=CN_TC37X_VCU_CAN01_70b1f95e
          CN_ATOM_CANFD_Matrix_CH_V600_202502_a4d436ac: EcuMWakeupSourceId=5, EcuMWakeupSourcePolling=false, EcuMCheckWakeupTimeout=2, EcuMValidationTimeout=2, EcuMComMChannelRef=CN_ATOM_CANFD_Matrix_CH_V600_202502_a4d436ac
          CN_ATOM_CAN_Matrix_PT_V600_20250211_9b894f3d: EcuMWakeupSourceId=6, EcuMWakeupSourcePolling=true, EcuMCheckWakeupTimeout=2, EcuMValidationTimeout=2, EcuMComMChannelRef=CN_ATOM_CAN_Matrix_PT_V600_20250211_9b894f3d
          CN_ATOM_CAN_XCP_f42a46d4: EcuMWakeupSourceId=7, EcuMWakeupSourcePolling=true, EcuMComMChannelRef=CN_ATOM_CAN_XCP_f42a46d4
          CN_J1939_bms_dea99804: EcuMWakeupSourceId=9, EcuMWakeupSourcePolling=false, EcuMComMChannelRef=CN_J1939_bms_dea99804
          CN_ATOM_HWLIN1_64cfd50f: EcuMWakeupSourceId=10, EcuMWakeupSourcePolling=false, EcuMComMChannelRef=CN_ATOM_HWLIN1_64cfd50f
          CN_ATOM_HWLIN4_14a52180: EcuMWakeupSourceId=12, EcuMWakeupSourcePolling=false, EcuMComMChannelRef=CN_ATOM_HWLIN4_14a52180
          CN_ATOM_HWLIN3_8ac1b423: EcuMWakeupSourceId=11, EcuMWakeupSourcePolling=false, EcuMComMChannelRef=CN_ATOM_HWLIN3_8ac1b423
      EcuMFlexConfiguration:
        EcuMFlexModuleConfigurationRef = CanConfigSet
        EcuMFlexModuleConfigurationRef = LinGlobalConfig
        EcuMNormalMcuModeRef = McuModeSettingConf_Standby
        EcuMPartitionRef = EcucPartition_OsCore{0..2}
        3 x EcuMResetMode:
          ECUM_RESET_MCU: EcuMResetModeId=0
          ECUM_RESET_WDG: EcuMResetModeId=1
          ECUM_RESET_IO: EcuMResetModeId=2
        4 x EcuMShutdownCause:
          ECUM_CAUSE_UNKNOWN: EcuMShutdownCauseId=0
          ECUM_CAUSE_ECU_STATE: EcuMShutdownCauseId=1
          ECUM_CAUSE_WDGM: EcuMShutdownCauseId=2
          ECUM_CAUSE_DCM: EcuMShutdownCauseId=3
        ECUM_RESET_WAKEUP (EcuMResetMode): EcuMResetModeId=3
