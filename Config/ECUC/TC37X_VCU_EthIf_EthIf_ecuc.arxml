AUTOSAR XML (schema 00048)
package /ActiveEcuC
  module config EthIf: implementation-config-variant=VARIANT-PRE-COMPILE, module-description=EthIf_Impl
    EthIfConfigSet
      EthIfFrameOwnerConfig: EthIfFrameType=0, EthIfOwner=0
      EthIfRxIndicationConfig: EthIfRxIndicationFunction=Msn_RxIndication, EthIfFrameOwnerConfigRef=EthIfFrameOwnerConfig
      EthIfTrcvLinkStateChgConfig: EthIfTrcvLinkStateChgFunction=EthSM_TrcvLinkStateChg
      EthIfTxConfirmationConfig: EthIfTxConfirmationFunction=Msn_TxConfirmation, EthIfFrameOwnerConfigRef=EthIfFrameOwnerConfig
      EthIfController:
        EthIfCtrlIdx = 0
        EthIfEnableVLAN = false
        EthIfVlanId = 0
        EthIfCtrlMtu = 1500
        EthIfEnableLaxLinkAggregation = false
        EthIfPhysControllerRef = EthCtrlConfig
        EthIfTransceiverRef = EthTrcvConfig
      EthIfBufFilterConfig
    EthIfGeneral:
      EthIfDevErrorDetect = true
      EthIfEnableRxInterrupt = true
      EthIfEnableTxInterrupt = true
      EthIfMaxTrcvsTotal = 1
      EthIfMaxTxBufsTotal = 2
      EthIfTrcvLinkStateChgMainReload = 5
      EthIfVersionInfoApi = false
      EthIfVersionInfoApiMacro = false
      EthIfEnableMainFunctionState = true
      EthIfMainFunctionPeriod = 0.005
      EthIfMainFunctionRxTimeout = 0.005
      EthIfRxIndicationIterations = 5
      EthIfUpdatePhysAddrFilter = true
      EthIfEnableZeroCopyExtensions = false
      EthIfMaxExtTxBufsTotal = 0
      EthIfGlobalTimeSupport = false
      EthIfEnableHeaderAccessApi = false
      EthIfWakeupSupport = false
      EthIfSwitchManagementSupport = false
      EthIfSafeBswChecks = false
      EthIfEnableSignalQualityApi = false
      EthIfGetAndResetMeasurementDataApi = false
      EthIfEnableSecurityEventReporting = false
      EthIfPublicCddHeaderFile = RTL8211FI.h
