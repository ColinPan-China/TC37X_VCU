AUTOSAR XML (schema 00048)
package /ActiveEcuC
  module config LinIf: implementation-config-variant=VARIANT-PRE-COMPILE, module-description=LinIf_Impl
    LinIfGeneral:
      LinIfJ2602ResponseToleranceSupport = false
      LinIfCancelTransmitSupported = false
      LinIfDevErrorDetect = true
      LinIfMultipleDriversSupported = false
      LinIfMultipleTrcvDriverSupported = false
      LinIfNcOptionalRequestSupported = true
      LinIfTpSupported = false
      LinIfTrcvDriverSupported = true
      LinIfVersionInfoApi = false
      LinIfEvtFrameSupported = false
      LinIfSporadicFrameSupported = false
      LinIfRuntimeMeasurementSupport = false
      LinIfSafeBswChecks = false
      LinIfBusMirroringSupported = false
    LinIfGlobalConfig: LinIfTimeBase=0.005
      3 x LinIfChannel, all with LinIfClusterTimeBase=0.005, LinIfGotoSleepConfirmationUL=LIN_SM, LinIfStartupState=SLEEP, LinIfWakeupConfirmationUL=LIN_SM, LinIfWakeupDelay=0.1, LinIfWakeupDelayExternal=0.1, LinIfBusIdleTimeoutPeriod=4, LinIfWakeupConfirmationTimeoutPeriod=2, LinIfScheduleRequestConfirmationUL=LIN_SM, LinIfScheduleChangeNextTimeBase=false:
        CHNL_45618847: LinIfChannelId=2, LinIfChannelRef=CN_LIN00_b12a0454, LinIfComMNetworkHandleRef=CN_LIN00_b12a0454
          FT_MasterReq_355bc768_Tx (LinIfFrame): LinIfChecksumType=CLASSIC, LinIfFrameType=MRF, LinIfLength=8, LinIfPid=60
            LinIfPduDirection
              LinIfInternalPdu
          FT_SlaveResp_9d5cbedc_Rx (LinIfFrame): LinIfChecksumType=CLASSIC, LinIfFrameType=SRF, LinIfLength=8, LinIfPid=125
            LinIfPduDirection
              LinIfInternalPdu
          LinIfNodeType  # CT_LIN00
            CT_LIN00_7284c7d4 (LinIfMaster): LinIfJitter=0.0001, LinIfLoadBalancingOffset=0
          LinIfTransceiverDrvConfig: LinIfTrcvIdRef=LinTrcvChannel
          11 x LinIfFrame, all with LinIfChecksumType=ENHANCED, LinIfFrameType=UNCONDITIONAL:
            FT_PMP3_Sts_f45e64cb_Rx: LinIfLength=8, LinIfPid=231
              LinIfPduDirection
                LinIfRxPdu: LinIfUserRxIndicationUL=PDUR, LinIfRxPduRef=PMP3_Sts_oLIN00_4e808b3d_Rx
            FT_VCU_EXV_2_a2a0816d_Tx: LinIfLength=8, LinIfPid=180
              LinIfPduDirection
                LinIfTxPdu_814bac9f (LinIfTxPdu): LinIfTxPduId=8, LinIfUserTxUL=PDUR, LinIfTxPduRef=VCU_EXV_2_oLIN00_2e4da991_Tx
            FT_VCU_EXV_1_3ba9d0d7_Tx: LinIfLength=8, LinIfPid=31
              LinIfPduDirection
                LinIfTxPdu_66470162 (LinIfTxPdu): LinIfTxPduId=7, LinIfUserTxUL=PDUR, LinIfTxPduRef=VCU_EXV_1_oLIN00_58a890ac_Tx
            FT_PMP_Cmd_bd05f3f5_Tx: LinIfLength=8, LinIfPid=100
              LinIfPduDirection
                LinIfTxPdu_c5fc6a36 (LinIfTxPdu): LinIfTxPduId=5, LinIfUserTxUL=PDUR, LinIfTxPduRef=PMP_Cmd_oLIN00_6d889c97_Tx
            FT_TCU_HVCH_Cmd_ccc60f64_Tx: LinIfLength=4, LinIfPid=85
              LinIfPduDirection
                LinIfTxPdu_d8f856fb (LinIfTxPdu): LinIfTxPduId=6, LinIfUserTxUL=PDUR, LinIfTxPduRef=TCU_HVCH_Cmd_oLIN00_ddc31229_Tx
            FT_VCU_SVA_CMD_86a423b3_Tx: LinIfLength=8, LinIfPid=80
              LinIfPduDirection
                LinIfTxPdu_d60e946c (LinIfTxPdu): LinIfTxPduId=9, LinIfUserTxUL=PDUR, LinIfTxPduRef=VCU_SVA_CMD_oLIN00_89e2bb7b_Tx
            FT_EXV_2_VCU_c45065f9_Rx: LinIfLength=8, LinIfPid=245
              LinIfPduDirection
                LinIfRxPdu: LinIfUserRxIndicationUL=PDUR, LinIfRxPduRef=EXV_2_VCU_oLIN00_85f64a15_Rx
            FT_EXV_1_VCU_83f01f29_Rx: LinIfLength=8, LinIfPid=173
              LinIfPduDirection
                LinIfRxPdu: LinIfUserRxIndicationUL=PDUR, LinIfRxPduRef=EXV_1_VCU_oLIN00_366267d6_Rx
            FT_HVCH_Rsp02_90df2aef_Rx: LinIfLength=8, LinIfPid=151
              LinIfPduDirection
                LinIfRxPdu: LinIfUserRxIndicationUL=PDUR, LinIfRxPduRef=HVCH_Rsp02_oLIN00_a3ea669e_Rx
            FT_EXV2_Status_7cc3db8b_Rx: LinIfLength=8, LinIfPid=146
              LinIfPduDirection
                LinIfRxPdu: LinIfUserRxIndicationUL=PDUR, LinIfRxPduRef=EXV2_Status_oLIN00_7fcf9f75_Rx
            FT_HVCH_Rsp01_09d67b55_Rx: LinIfLength=8, LinIfPid=214
              LinIfPduDirection
                LinIfRxPdu: LinIfUserRxIndicationUL=PDUR, LinIfRxPduRef=HVCH_Rsp01_oLIN00_d50f5fa3_Rx
          TCU_LIN_Schedule_740f8639 (LinIfScheduleTable):
            LinIfRunMode = RUN_CONTINUOUS
            LinIfScheduleTableIndex = 1
            LinIfScheduleTableName = 
            LinIfResumePosition = START_FROM_BEGINNING
            LinIfScheduleMode = LINTP_APPLICATIVE_SCHEDULE
            14 x LinIfEntry:
              TCU_LIN_Schedule_0b3bc331: LinIfDelay=0.01, LinIfEntryIndex=6, LinIfFrameRef=FT_PMP_Cmd_bd05f3f5_Tx
              TCU_LIN_Schedule_efc1a2d6: LinIfDelay=0.1, LinIfEntryIndex=3, LinIfFrameRef=FT_EXV_1_VCU_83f01f29_Rx
              TCU_LIN_Schedule_0e83c94d: LinIfDelay=0.02, LinIfEntryIndex=13, LinIfFrameRef=FT_HVCH_Rsp02_90df2aef_Rx
              TCU_LIN_Schedule_e405142f: LinIfDelay=0.015, LinIfEntryIndex=10, LinIfFrameRef=FT_SVA_VCU_STD_d43d5185_Rx
              TCU_LIN_Schedule_00931437: LinIfDelay=0.1, LinIfEntryIndex=2, LinIfFrameRef=FT_VCU_EXV_1_3ba9d0d7_Tx
              TCU_LIN_Schedule_0eefa8b2: LinIfDelay=0.1, LinIfEntryIndex=4, LinIfFrameRef=FT_VCU_EXV_2_a2a0816d_Tx
              TCU_LIN_Schedule_05477fb4: LinIfDelay=0.01, LinIfEntryIndex=0, LinIfFrameRef=FT_EDCU_EXV2_cbc2ea70_Tx
              TCU_LIN_Schedule_fd446759: LinIfDelay=0.015, LinIfEntryIndex=9, LinIfFrameRef=FT_VCU_SVA_CMD_86a423b3_Tx
              TCU_LIN_Schedule_0b57a2ce: LinIfDelay=0.02, LinIfEntryIndex=11, LinIfFrameRef=FT_TCU_HVCH_Cmd_ccc60f64_Tx
              TCU_LIN_Schedule_e1d17fac: LinIfDelay=0.02, LinIfEntryIndex=12, LinIfFrameRef=FT_HVCH_Rsp01_09d67b55_Rx
              TCU_LIN_Schedule_e46975d0: LinIfDelay=0.01, LinIfEntryIndex=7, LinIfFrameRef=FT_PMP2_Sts_c93e4d7b_Rx
              TCU_LIN_Schedule_e1bd1e53: LinIfDelay=0.1, LinIfEntryIndex=5, LinIfFrameRef=FT_EXV_2_VCU_c45065f9_Rx
              TCU_LIN_Schedule_ea15c955: LinIfDelay=0.01, LinIfEntryIndex=1, LinIfFrameRef=FT_EXV2_Status_7cc3db8b_Rx
              TCU_LIN_Schedule_1216d1b8: LinIfDelay=0.01, LinIfEntryIndex=8, LinIfFrameRef=FT_PMP3_Sts_f45e64cb_Rx
          3 x LinIfFrame, all with LinIfChecksumType=ENHANCED, LinIfLength=8, LinIfFrameType=UNCONDITIONAL:
            FT_PMP2_Sts_c93e4d7b_Rx: LinIfPid=166
              LinIfPduDirection
                LinIfRxPdu: LinIfUserRxIndicationUL=PDUR, LinIfRxPduRef=PMP2_Sts_oLIN00_200c907c_Rx
            FT_SVA_VCU_STD_d43d5185_Rx: LinIfPid=17
              LinIfPduDirection
                LinIfRxPdu: LinIfUserRxIndicationUL=PDUR, LinIfRxPduRef=SVA_VCU_STD_oLIN00_4f0795ef_Rx
            FT_EDCU_EXV2_cbc2ea70_Tx: LinIfPid=226
              LinIfPduDirection
                LinIfTxPdu_51fe7a72 (LinIfTxPdu): LinIfTxPduId=4, LinIfUserTxUL=PDUR, LinIfTxPduRef=EDCU_EXV2_oLIN00_18b050dc_Tx
          NULLSchedule_CHNL_45618847 (LinIfScheduleTable): LinIfResumePosition=CONTINUE_AT_IT_POINT, LinIfRunMode=RUN_CONTINUOUS, LinIfScheduleMode=LINTP_APPLICATIVE_SCHEDULE, LinIfScheduleTableIndex=0
        CHNL_8e3d5be2: LinIfChannelId=0, LinIfChannelRef=CN_LIN01_c62d34c2, LinIfComMNetworkHandleRef=CN_LIN01_c62d34c2
          3 x LinIfFrame, all with LinIfLength=8:
            FT_Vcu_Lin0_RxMsg1_83589417_Rx: LinIfChecksumType=ENHANCED, LinIfPid=32, LinIfFrameType=UNCONDITIONAL
              LinIfPduDirection
                LinIfRxPdu: LinIfUserRxIndicationUL=PDUR, LinIfRxPduRef=Vcu_Lin0_RxMsg1_oLIN01_079b7478_Rx
            FT_Vcu_Lin0_RxMsg2_1a51c5ad_Rx: LinIfChecksumType=ENHANCED, LinIfPid=97, LinIfFrameType=UNCONDITIONAL
              LinIfPduDirection
                LinIfRxPdu: LinIfUserRxIndicationUL=PDUR, LinIfRxPduRef=Vcu_Lin0_RxMsg2_oLIN01_717e4d45_Rx
            FT_MasterReq_e2b94730_Tx: LinIfChecksumType=CLASSIC, LinIfFrameType=MRF, LinIfPid=60
              LinIfPduDirection
                LinIfInternalPdu
          Vcu_Lin0_Schedule_0e999bb4 (LinIfScheduleTable):
            LinIfRunMode = RUN_CONTINUOUS
            LinIfScheduleTableIndex = 1
            LinIfScheduleTableName = 
            LinIfResumePosition = START_FROM_BEGINNING
            LinIfScheduleMode = LINTP_APPLICATIVE_SCHEDULE
            4 x LinIfEntry, all with LinIfDelay=0.02:
              Vcu_Lin0_Schedule_519d2303: LinIfEntryIndex=2, LinIfFrameRef=FT_Vcu_Lin0_RxMsg1_83589417_Rx
              Vcu_Lin0_Schedule_bb1bfe61: LinIfEntryIndex=1, LinIfFrameRef=FT_Vcu_Lin0_TxMsg2_cc0826b0_Tx
              Vcu_Lin0_Schedule_54494880: LinIfEntryIndex=0, LinIfFrameRef=FT_Vcu_Lin0_TxMsg1_5501770a_Tx
              Vcu_Lin0_Schedule_becf95e2: LinIfEntryIndex=3, LinIfFrameRef=FT_Vcu_Lin0_RxMsg2_1a51c5ad_Rx
          FT_Vcu_Lin0_TxMsg2_cc0826b0_Tx (LinIfFrame): LinIfChecksumType=ENHANCED, LinIfLength=8, LinIfPid=31, LinIfFrameType=UNCONDITIONAL
            LinIfPduDirection
              LinIfTxPdu_87e9e0e9 (LinIfTxPdu): LinIfTxPduId=1, LinIfUserTxUL=PDUR, LinIfTxPduRef=Vcu_Lin0_TxMsg2_oLIN01_74c2430b_Tx
          FT_Vcu_Lin0_TxMsg1_5501770a_Tx (LinIfFrame): LinIfChecksumType=ENHANCED, LinIfLength=8, LinIfPid=94, LinIfFrameType=UNCONDITIONAL
            LinIfPduDirection
              LinIfTxPdu_76dd5725 (LinIfTxPdu): LinIfTxPduId=0, LinIfUserTxUL=PDUR, LinIfTxPduRef=Vcu_Lin0_TxMsg1_oLIN01_02277a36_Tx
          LinIfNodeType  # CT_LIN01
            CT_LIN01_0583f742 (LinIfMaster): LinIfJitter=0.0001, LinIfLoadBalancingOffset=0
          NULLSchedule (LinIfScheduleTable): LinIfResumePosition=CONTINUE_AT_IT_POINT, LinIfRunMode=RUN_CONTINUOUS, LinIfScheduleMode=LINTP_APPLICATIVE_SCHEDULE, LinIfScheduleTableIndex=0
          FT_SlaveResp_4abe3e84_Rx (LinIfFrame): LinIfChecksumType=CLASSIC, LinIfFrameType=SRF, LinIfLength=8, LinIfPid=125
            LinIfPduDirection
              LinIfInternalPdu
        CHNL_08a9294c: LinIfChannelId=1, LinIfChannelRef=CN_LIN02_5f246578, LinIfComMNetworkHandleRef=CN_LIN02_5f246578
          FT_Vcu_Lin3_TxMsg1_ee63c6ba_Tx (LinIfFrame): LinIfChecksumType=ENHANCED, LinIfLength=8, LinIfPid=94, LinIfFrameType=UNCONDITIONAL
            LinIfPduDirection
              LinIfTxPdu_49b2f4e6 (LinIfTxPdu): LinIfTxPduId=2, LinIfUserTxUL=PDUR, LinIfTxPduRef=Vcu_Lin3_TxMsg1_oLIN02_f647ba66_Tx
          FT_Vcu_Lin3_TxMsg2_776a9700_Tx (LinIfFrame): LinIfChecksumType=ENHANCED, LinIfLength=8, LinIfPid=31, LinIfFrameType=UNCONDITIONAL
            LinIfPduDirection
              LinIfTxPdu_21a8fa18 (LinIfTxPdu): LinIfTxPduId=3, LinIfUserTxUL=PDUR, LinIfTxPduRef=Vcu_Lin3_TxMsg2_oLIN02_80a2835b_Tx
          NULLSchedule_CHNL_08a9294c (LinIfScheduleTable): LinIfResumePosition=CONTINUE_AT_IT_POINT, LinIfRunMode=RUN_CONTINUOUS, LinIfScheduleMode=LINTP_APPLICATIVE_SCHEDULE, LinIfScheduleTableIndex=0
          FT_Vcu_Lin3_RxMsg2_a133741d_Rx (LinIfFrame): LinIfChecksumType=ENHANCED, LinIfLength=8, LinIfPid=97, LinIfFrameType=UNCONDITIONAL
            LinIfPduDirection
              LinIfRxPdu: LinIfUserRxIndicationUL=PDUR, LinIfRxPduRef=Vcu_Lin3_RxMsg2_oLIN02_851e8d15_Rx
          FT_Vcu_Lin3_RxMsg1_383a25a7_Rx (LinIfFrame): LinIfChecksumType=ENHANCED, LinIfLength=8, LinIfPid=32, LinIfFrameType=UNCONDITIONAL
            LinIfPduDirection
              LinIfRxPdu: LinIfUserRxIndicationUL=PDUR, LinIfRxPduRef=Vcu_Lin3_RxMsg1_oLIN02_f3fbb428_Rx
          LinIfNodeType  # CT_LIN02
            CT_LIN02_9c8aa6f8 (LinIfMaster): LinIfJitter=0.0001, LinIfLoadBalancingOffset=0
          Vcu_Lin3_Schedule_bdb0899f (LinIfScheduleTable):
            LinIfRunMode = RUN_CONTINUOUS
            LinIfScheduleTableIndex = 1
            LinIfScheduleTableName = 
            LinIfResumePosition = START_FROM_BEGINNING
            LinIfScheduleMode = LINTP_APPLICATIVE_SCHEDULE
            4 x LinIfEntry, all with LinIfDelay=0.02:
              Vcu_Lin3_Schedule_d7278e00: LinIfEntryIndex=1, LinIfFrameRef=FT_Vcu_Lin3_TxMsg2_776a9700_Tx
              Vcu_Lin3_Schedule_387538e1: LinIfEntryIndex=0, LinIfFrameRef=FT_Vcu_Lin3_TxMsg1_ee63c6ba_Tx
              Vcu_Lin3_Schedule_3da15362: LinIfEntryIndex=2, LinIfFrameRef=FT_Vcu_Lin3_RxMsg1_383a25a7_Rx
              Vcu_Lin3_Schedule_d2f3e583: LinIfEntryIndex=3, LinIfFrameRef=FT_Vcu_Lin3_RxMsg2_a133741d_Rx
          FT_MasterReq_41efc199_Tx (LinIfFrame): LinIfChecksumType=CLASSIC, LinIfFrameType=MRF, LinIfLength=8, LinIfPid=60
            LinIfPduDirection
              LinIfInternalPdu
          FT_SlaveResp_e9e8b82d_Rx (LinIfFrame): LinIfChecksumType=CLASSIC, LinIfFrameType=SRF, LinIfLength=8, LinIfPid=125
            LinIfPduDirection
              LinIfInternalPdu
