AUTOSAR XML (schema 00048)
package /ActiveEcuC
  module config LinIf: implementation-config-variant=VARIANT-PRE-COMPILE, module-description=LinIf_Impl
    LinIfGeneral:
      LinIfJ2602ResponseToleranceSupport = false
      LinIfCancelTransmitSupported = false
      LinIfDevErrorDetect = true
      LinIfMultipleDriversSupported = false
      LinIfMultipleTrcvDriverSupported = false
      LinIfNcOptionalRequestSupported = true
      LinIfTpSupported = false
      LinIfTrcvDriverSupported = true
      LinIfVersionInfoApi = false
      LinIfEvtFrameSupported = false
      LinIfSporadicFrameSupported = false
      LinIfRuntimeMeasurementSupport = false
      LinIfSafeBswChecks = false
      LinIfBusMirroringSupported = false
    LinIfGlobalConfig: LinIfTimeBase=0.005
      CHNL_45618847 (LinIfChannel):
        LinIfClusterTimeBase = 0.005
        LinIfChannelId = 0
        LinIfGotoSleepConfirmationUL = LIN_SM
        LinIfStartupState = SLEEP
        LinIfWakeupConfirmationUL = LIN_SM
        LinIfWakeupDelay = 0.1
        LinIfWakeupDelayExternal = 0.1
        LinIfBusIdleTimeoutPeriod = 4
        LinIfWakeupConfirmationTimeoutPeriod = 2
        LinIfScheduleRequestConfirmationUL = LIN_SM
        LinIfScheduleChangeNextTimeBase = false
        LinIfChannelRef = CN_LIN00_b12a0454
        LinIfComMNetworkHandleRef = CN_LIN00_b12a0454
        FT_MasterReq_355bc768_Tx (LinIfFrame): LinIfChecksumType=CLASSIC, LinIfFrameType=MRF, LinIfLength=8, LinIfPid=60
          LinIfPduDirection
            LinIfInternalPdu
        Vcu_Lin0_Schedule_8fbcfe93 (LinIfScheduleTable):
          LinIfRunMode = RUN_CONTINUOUS
          LinIfScheduleTableIndex = 1
          LinIfScheduleTableName = 
          LinIfResumePosition = START_FROM_BEGINNING
          LinIfScheduleMode = LINTP_APPLICATIVE_SCHEDULE
          4 x LinIfEntry, all with LinIfDelay=0.02:
            Vcu_Lin0_Schedule_f9dc6319: LinIfEntryIndex=3, LinIfFrameRef=FT_Vcu_Lin0_RxMsg2_bfda55a3_Rx
            Vcu_Lin0_Schedule_fc08089a: LinIfEntryIndex=1, LinIfFrameRef=FT_Vcu_Lin0_TxMsg2_6983b6be_Tx
            Vcu_Lin0_Schedule_135abe7b: LinIfEntryIndex=0, LinIfFrameRef=FT_Vcu_Lin0_TxMsg1_f08ae704_Tx
            Vcu_Lin0_Schedule_168ed5f8: LinIfEntryIndex=2, LinIfFrameRef=FT_Vcu_Lin0_RxMsg1_26d30419_Rx
        5 x LinIfFrame, all with LinIfLength=8:
          FT_Vcu_Lin0_RxMsg1_26d30419_Rx: LinIfChecksumType=ENHANCED, LinIfPid=32, LinIfFrameType=UNCONDITIONAL
            LinIfPduDirection
              LinIfRxPdu: LinIfUserRxIndicationUL=PDUR, LinIfRxPduRef=Vcu_Lin0_RxMsg1_oLIN00_def4d57f_Rx
          FT_Vcu_Lin0_TxMsg1_f08ae704_Tx: LinIfChecksumType=ENHANCED, LinIfPid=94, LinIfFrameType=UNCONDITIONAL
            LinIfPduDirection
              LinIfTxPdu_67e62ef9 (LinIfTxPdu): LinIfTxPduId=0, LinIfUserTxUL=PDUR, LinIfTxPduRef=Vcu_Lin0_TxMsg1_oLIN00_db48db31_Tx
          FT_Vcu_Lin0_TxMsg2_6983b6be_Tx: LinIfChecksumType=ENHANCED, LinIfPid=31, LinIfFrameType=UNCONDITIONAL
            LinIfPduDirection
              LinIfTxPdu_21a51ec5 (LinIfTxPdu): LinIfTxPduId=1, LinIfUserTxUL=PDUR, LinIfTxPduRef=Vcu_Lin0_TxMsg2_oLIN00_adade20c_Tx
          FT_SlaveResp_9d5cbedc_Rx: LinIfChecksumType=CLASSIC, LinIfFrameType=SRF, LinIfPid=125
            LinIfPduDirection
              LinIfInternalPdu
          FT_Vcu_Lin0_RxMsg2_bfda55a3_Rx: LinIfChecksumType=ENHANCED, LinIfPid=97, LinIfFrameType=UNCONDITIONAL
            LinIfPduDirection
              LinIfRxPdu: LinIfUserRxIndicationUL=PDUR, LinIfRxPduRef=Vcu_Lin0_RxMsg2_oLIN00_a811ec42_Rx
        LinIfNodeType  # CT_LIN00
          CT_LIN00_7284c7d4 (LinIfMaster): LinIfJitter=0.0001, LinIfLoadBalancingOffset=0
        NULLSchedule (LinIfScheduleTable): LinIfResumePosition=CONTINUE_AT_IT_POINT, LinIfRunMode=RUN_CONTINUOUS, LinIfScheduleMode=LINTP_APPLICATIVE_SCHEDULE, LinIfScheduleTableIndex=0
        LinIfTransceiverDrvConfig: LinIfTrcvIdRef=LinTrcvChannel
