AUTOSAR XML (schema 00048)
package /ActiveEcuC
  module config LinIf: implementation-config-variant=VARIANT-PRE-COMPILE, module-description=LinIf_Impl
    LinIfGeneral:
      LinIfJ2602ResponseToleranceSupport = false
      LinIfCancelTransmitSupported = false
      LinIfDevErrorDetect = true
      LinIfMultipleDriversSupported = false
      LinIfMultipleTrcvDriverSupported = false
      LinIfNcOptionalRequestSupported = true
      LinIfTpSupported = false
      LinIfTrcvDriverSupported = true
      LinIfVersionInfoApi = false
      LinIfEvtFrameSupported = false
      LinIfSporadicFrameSupported = false
      LinIfRuntimeMeasurementSupport = false
      LinIfSafeBswChecks = false
      LinIfBusMirroringSupported = false
    LinIfGlobalConfig: LinIfTimeBase=0.005
      3 x LinIfChannel, all with LinIfClusterTimeBase=0.005, LinIfGotoSleepConfirmationUL=LIN_SM, LinIfStartupState=SLEEP, LinIfWakeupConfirmationUL=LIN_SM, LinIfWakeupDelay=0.1, LinIfWakeupDelayExternal=0.1, LinIfBusIdleTimeoutPeriod=4, LinIfWakeupConfirmationTimeoutPeriod=2, LinIfScheduleRequestConfirmationUL=LIN_SM, LinIfScheduleChangeNextTimeBase=false:
        CHNL_a1e6ddd5: LinIfChannelId=0, LinIfChannelRef=CN_ATOM_HWLIN1_64cfd50f, LinIfComMNetworkHandleRef=CN_ATOM_HWLIN1_64cfd50f
          FT_VCU_BS_01_030651ac_Tx (LinIfFrame): LinIfChecksumType=ENHANCED, LinIfLength=8, LinIfPid=57, LinIfFrameType=UNCONDITIONAL
            LinIfPduDirection
              LinIfTxPdu_68cd4531 (LinIfTxPdu): LinIfTxPduId=1, LinIfUserTxUL=PDUR, LinIfTxPduRef=VCU_BS_01_oATOM_HWLIN1_bc28519d_Tx
          FT_FRC_01_f7bde5d6_Rx (LinIfFrame): LinIfChecksumType=ENHANCED, LinIfLength=8, LinIfPid=43, LinIfFrameType=UNCONDITIONAL
            LinIfPduDirection
              LinIfRxPdu: LinIfUserRxIndicationUL=PDUR, LinIfRxPduRef=FRC_01_oATOM_HWLIN1_94cce030_Rx
          NULLSchedule_CHNL_a1e6ddd5 (LinIfScheduleTable): LinIfResumePosition=CONTINUE_AT_IT_POINT, LinIfRunMode=RUN_CONTINUOUS, LinIfScheduleMode=LINTP_APPLICATIVE_SCHEDULE, LinIfScheduleTableIndex=0
          FT_SlaveResp_2d662851_Rx (LinIfFrame): LinIfChecksumType=CLASSIC, LinIfFrameType=SRF, LinIfLength=8, LinIfPid=125
            LinIfPduDirection
              LinIfInternalPdu
          DiagResponseSchedule_f0e03ba7 (LinIfScheduleTable):
            LinIfRunMode = RUN_CONTINUOUS
            LinIfScheduleTableIndex = 2
            LinIfScheduleTableName = 
            LinIfResumePosition = START_FROM_BEGINNING
            LinIfScheduleMode = LINTP_APPLICATIVE_SCHEDULE
            DiagResponseSchedule_b16b497a (LinIfEntry): LinIfDelay=0.015, LinIfEntryIndex=0, LinIfFrameRef=FT_SlaveResp_2d662851_Rx
          FT_MasterReq_856151e5_Tx (LinIfFrame): LinIfChecksumType=CLASSIC, LinIfFrameType=MRF, LinIfLength=8, LinIfPid=60
            LinIfPduDirection
              LinIfInternalPdu
          VCU_LIN_Schedule_fbca640b (LinIfScheduleTable):
            LinIfRunMode = RUN_CONTINUOUS
            LinIfScheduleTableIndex = 3
            LinIfScheduleTableName = 
            LinIfResumePosition = START_FROM_BEGINNING
            LinIfScheduleMode = LINTP_APPLICATIVE_SCHEDULE
            6 x LinIfEntry:
              VCU_LIN_Schedule_26600fb6: LinIfDelay=0.01, LinIfEntryIndex=1, LinIfFrameRef=FT_BS_02_84b37676_Rx
              VCU_LIN_Schedule_2dc8d8b0: LinIfDelay=0.08, LinIfEntryIndex=5, LinIfFrameRef=FT_FRC_01_f7bde5d6_Rx
              VCU_LIN_Schedule_c29a6e51: LinIfDelay=0.01, LinIfEntryIndex=4, LinIfFrameRef=FT_VCU_01_dc99513c_Tx
              VCU_LIN_Schedule_23b46435: LinIfDelay=0.01, LinIfEntryIndex=3, LinIfFrameRef=FT_VCU_BS_01_030651ac_Tx
              VCU_LIN_Schedule_c932b957: LinIfDelay=0.01, LinIfEntryIndex=0, LinIfFrameRef=FT_BS_01_1dba27cc_Rx
              VCU_LIN_Schedule_cce6d2d4: LinIfDelay=0.01, LinIfEntryIndex=2, LinIfFrameRef=FT_BS_03_f3b446e0_Rx
          FT_VCU_01_dc99513c_Tx (LinIfFrame): LinIfChecksumType=ENHANCED, LinIfLength=8, LinIfPid=37, LinIfFrameType=UNCONDITIONAL
            LinIfPduDirection
              LinIfTxPdu_bbec5200 (LinIfTxPdu): LinIfTxPduId=0, LinIfUserTxUL=PDUR, LinIfTxPduRef=VCU_01_oATOM_HWLIN1_3376b4d2_Tx
          DiagRequestSchedule_72b11ad9 (LinIfScheduleTable):
            LinIfRunMode = RUN_CONTINUOUS
            LinIfScheduleTableIndex = 1
            LinIfScheduleTableName = 
            LinIfResumePosition = START_FROM_BEGINNING
            LinIfScheduleMode = LINTP_APPLICATIVE_SCHEDULE
            DiagRequestSchedule_f9200f56 (LinIfEntry): LinIfDelay=0.015, LinIfEntryIndex=0, LinIfFrameRef=FT_MasterReq_856151e5_Tx
          3 x LinIfFrame, all with LinIfChecksumType=ENHANCED, LinIfLength=8, LinIfFrameType=UNCONDITIONAL:
            FT_BS_03_f3b446e0_Rx: LinIfPid=118
              LinIfPduDirection
                LinIfRxPdu: LinIfUserRxIndicationUL=PDUR, LinIfRxPduRef=BS_03_oATOM_HWLIN1_d8082808_Rx
            FT_BS_01_1dba27cc_Rx: LinIfPid=180
              LinIfPduDirection
                LinIfRxPdu: LinIfUserRxIndicationUL=PDUR, LinIfRxPduRef=BS_01_oATOM_HWLIN1_9c4501d9_Rx
            FT_BS_02_84b37676_Rx: LinIfPid=245
              LinIfPduDirection
                LinIfRxPdu: LinIfUserRxIndicationUL=PDUR, LinIfRxPduRef=BS_02_oATOM_HWLIN1_17963fc0_Rx
          LinIfNodeType  # CT_ATOM_HWLIN1
            CT_ATOM_HWLIN1_ea9715f3 (LinIfMaster): LinIfJitter=0.0001, LinIfLoadBalancingOffset=0
          LinIfTransceiverDrvConfig: LinIfTrcvIdRef=LinTrcvChannel_HWLIN1
        CHNL_f12b4c66: LinIfChannelId=2, LinIfChannelRef=CN_ATOM_HWLIN4_14a52180, LinIfComMNetworkHandleRef=CN_ATOM_HWLIN4_14a52180
          Vcu_Lin0_Schedule_7bfb014e (LinIfScheduleTable):
            LinIfRunMode = RUN_CONTINUOUS
            LinIfScheduleTableIndex = 1
            LinIfScheduleTableName = 
            LinIfResumePosition = START_FROM_BEGINNING
            LinIfScheduleMode = LINTP_APPLICATIVE_SCHEDULE
            4 x LinIfEntry, all with LinIfDelay=0.02:
              Vcu_Lin0_Schedule_5efc97c1: LinIfEntryIndex=2, LinIfFrameRef=FT_Vcu_Lin0_RxMsg1_de45ed8f_Rx
              Vcu_Lin0_Schedule_5b28fc42: LinIfEntryIndex=0, LinIfFrameRef=FT_Vcu_Lin0_TxMsg1_081c0e92_Tx
              Vcu_Lin0_Schedule_b1ae2120: LinIfEntryIndex=3, LinIfFrameRef=FT_Vcu_Lin0_RxMsg2_474cbc35_Rx
              Vcu_Lin0_Schedule_b47a4aa3: LinIfEntryIndex=1, LinIfFrameRef=FT_Vcu_Lin0_TxMsg2_91155f28_Tx
          6 x LinIfFrame, all with LinIfLength=8:
            FT_Vcu_Lin0_TxMsg1_081c0e92_Tx: LinIfChecksumType=ENHANCED, LinIfPid=94, LinIfFrameType=UNCONDITIONAL
              LinIfPduDirection
                LinIfTxPdu_7fea8aa6 (LinIfTxPdu): LinIfTxPduId=4, LinIfUserTxUL=PDUR, LinIfTxPduRef=Vcu_Lin0_TxMsg1_oATOM_HWLIN4_7afddfb2_Tx
            FT_Vcu_Lin0_TxMsg2_91155f28_Tx: LinIfChecksumType=ENHANCED, LinIfPid=31, LinIfFrameType=UNCONDITIONAL
              LinIfPduDirection
                LinIfTxPdu_1b32bd0a (LinIfTxPdu): LinIfTxPduId=5, LinIfUserTxUL=PDUR, LinIfTxPduRef=Vcu_Lin0_TxMsg2_oATOM_HWLIN4_f12ee1ab_Tx
            FT_MasterReq_bbebdc5f_Tx: LinIfChecksumType=CLASSIC, LinIfFrameType=MRF, LinIfPid=60
              LinIfPduDirection
                LinIfInternalPdu
            FT_Vcu_Lin0_RxMsg1_de45ed8f_Rx: LinIfChecksumType=ENHANCED, LinIfPid=32, LinIfFrameType=UNCONDITIONAL
              LinIfPduDirection
                LinIfRxPdu: LinIfUserRxIndicationUL=PDUR, LinIfRxPduRef=Vcu_Lin0_RxMsg1_oATOM_HWLIN4_2f84bea2_Rx
            FT_Vcu_Lin0_RxMsg2_474cbc35_Rx: LinIfChecksumType=ENHANCED, LinIfPid=97, LinIfFrameType=UNCONDITIONAL
              LinIfPduDirection
                LinIfRxPdu: LinIfUserRxIndicationUL=PDUR, LinIfRxPduRef=Vcu_Lin0_RxMsg2_oATOM_HWLIN4_a45780bb_Rx
            FT_SlaveResp_13eca5eb_Rx: LinIfChecksumType=CLASSIC, LinIfFrameType=SRF, LinIfPid=125
              LinIfPduDirection
                LinIfInternalPdu
          LinIfNodeType  # CT_ATOM_HWLIN4
            CT_ATOM_HWLIN4_9afde17c (LinIfMaster): LinIfJitter=0.0001, LinIfLoadBalancingOffset=0
          NULLSchedule (LinIfScheduleTable): LinIfResumePosition=CONTINUE_AT_IT_POINT, LinIfRunMode=RUN_CONTINUOUS, LinIfScheduleMode=LINTP_APPLICATIVE_SCHEDULE, LinIfScheduleTableIndex=0
        CHNL_ec2e7cde: LinIfChannelId=1, LinIfChannelRef=CN_ATOM_HWLIN3_8ac1b423, LinIfComMNetworkHandleRef=CN_ATOM_HWLIN3_8ac1b423
          FT_SlaveResp_59d22ea0_Rx (LinIfFrame): LinIfChecksumType=CLASSIC, LinIfFrameType=SRF, LinIfLength=8, LinIfPid=125
            LinIfPduDirection
              LinIfInternalPdu
          NULLSchedule_CHNL_ec2e7cde (LinIfScheduleTable): LinIfResumePosition=CONTINUE_AT_IT_POINT, LinIfRunMode=RUN_CONTINUOUS, LinIfScheduleMode=LINTP_APPLICATIVE_SCHEDULE, LinIfScheduleTableIndex=0
          3 x LinIfFrame, all with LinIfLength=8:
            FT_Vcu_Lin3_TxMsg2_d1caa463_Tx: LinIfChecksumType=ENHANCED, LinIfPid=31, LinIfFrameType=UNCONDITIONAL
              LinIfPduDirection
                LinIfTxPdu_1259c3aa (LinIfTxPdu): LinIfTxPduId=3, LinIfUserTxUL=PDUR, LinIfTxPduRef=Vcu_Lin3_TxMsg2_oATOM_HWLIN3_32a8c13b_Tx
            FT_MasterReq_f1d55714_Tx: LinIfChecksumType=CLASSIC, LinIfFrameType=MRF, LinIfPid=60
              LinIfPduDirection
                LinIfInternalPdu
            FT_Vcu_Lin3_RxMsg1_9e9a16c4_Rx: LinIfChecksumType=ENHANCED, LinIfPid=32, LinIfFrameType=UNCONDITIONAL
              LinIfPduDirection
                LinIfRxPdu: LinIfUserRxIndicationUL=PDUR, LinIfRxPduRef=Vcu_Lin3_RxMsg1_oATOM_HWLIN3_ec029e32_Rx
          LinIfNodeType  # CT_ATOM_HWLIN3
            CT_ATOM_HWLIN3_049974df (LinIfMaster): LinIfJitter=0.0001, LinIfLoadBalancingOffset=0
          Vcu_Lin3_Schedule_a1d48d3a (LinIfScheduleTable):
            LinIfRunMode = RUN_CONTINUOUS
            LinIfScheduleTableIndex = 1
            LinIfScheduleTableName = 
            LinIfResumePosition = START_FROM_BEGINNING
            LinIfScheduleMode = LINTP_APPLICATIVE_SCHEDULE
            4 x LinIfEntry, all with LinIfDelay=0.02:
              Vcu_Lin3_Schedule_f5fe3a0d: LinIfEntryIndex=2, LinIfFrameRef=FT_Vcu_Lin3_RxMsg1_9e9a16c4_Rx
              Vcu_Lin3_Schedule_1aac8cec: LinIfEntryIndex=3, LinIfFrameRef=FT_Vcu_Lin3_RxMsg2_0793477e_Rx
              Vcu_Lin3_Schedule_f02a518e: LinIfEntryIndex=0, LinIfFrameRef=FT_Vcu_Lin3_TxMsg1_48c3f5d9_Tx
              Vcu_Lin3_Schedule_1f78e76f: LinIfEntryIndex=1, LinIfFrameRef=FT_Vcu_Lin3_TxMsg2_d1caa463_Tx
          FT_Vcu_Lin3_RxMsg2_0793477e_Rx (LinIfFrame): LinIfChecksumType=ENHANCED, LinIfLength=8, LinIfPid=97, LinIfFrameType=UNCONDITIONAL
            LinIfPduDirection
              LinIfRxPdu: LinIfUserRxIndicationUL=PDUR, LinIfRxPduRef=Vcu_Lin3_RxMsg2_oATOM_HWLIN3_67d1a02b_Rx
          FT_Vcu_Lin3_TxMsg1_48c3f5d9_Tx (LinIfFrame): LinIfChecksumType=ENHANCED, LinIfLength=8, LinIfPid=94, LinIfFrameType=UNCONDITIONAL
            LinIfPduDirection
              LinIfTxPdu_b7981150 (LinIfTxPdu): LinIfTxPduId=2, LinIfUserTxUL=PDUR, LinIfTxPduRef=Vcu_Lin3_TxMsg1_oATOM_HWLIN3_b97bff22_Tx
