AUTOSAR XML (schema 00048)
package /Fee
  module config Fee: implementation-config-variant=VARIANT-POST-BUILD, module-description=Fee_Impl
    CommonPublishedInformation:
      ArMajorVersion = 4
      ArMinorVersion = 2
      ArPatchVersion = 2
      ModuleId = 21
      Release = _TRICORE_TC377
      SwMajorVersion = 10
      SwMinorVersion = 40
      SwPatchVersion = 2
      VendorId = 17
    FeeBlockConfiguration_0 (FeeBlockConfiguration):
      FeeBlockNumber = 16
      FeeBlockSize = 4
      FeeImmediateData = false
      FeeNumberOfWriteCycles = 0
      FeeQsBlockAddress = 0
      FeeQsBlockInstances = 0
      FeeQuasiStaticManager = false
      FeeDeviceIndex = FlsGeneral
    FeeGeneral:
      FeeBlockTypeConfigured = FEE_DOUBLE_SECTOR_DATA_ONLY
      FeeDevErrorDetect = false
      FeeInitCheckApi = false
      FeeMainFunctionPeriod = 0.01
      FeePollingMode = false
      FeeSafetyEnable = false
      FeeSetModeSupported = true
      FeeVersionInfoApi = false
      FeeVirtualPageSize = 8
    FeeIfxSpecificConfig:
      FeeCancelAllApi = false
      FeeEraseAllEnable = true
      FeeGcRestart = FEE_GC_RESTART_INIT
      FeeGetCycleCountApi = false
      FeeGetPrevDataApi = false
      FeeMaxBlockCount = 10
      FeeMaxBytesPerCycle = FEE_MAX_BYTES_512
      FeeNvmIllegalStateNotification = NULL_PTR
      FeeQsHardenErrorNotification = NULL_PTR
      FeeQsIllegalStateNotification = NULL_PTR
      FeeStateVarStructure = Fee_StateVar
      FeeThresholdValue = 512
      FeeUnConfigBlkOverflowHandle = FEE_CONTINUE
      FeeUnConfigBlock = FEE_UNCONFIG_BLOCK_IGNORE
      FeeUseEraseSuspend = false
      FeeVirginFlashIllegalState = false
    FeePublishedInformation: FeeBlockOverhead=17, FeePageOverhead=1
    16 x FeeBlockConfiguration, all with FeeQsBlockInstances=0, FeeQsBlockAddress=0, FeeQuasiStaticManager=false, FeeImmediateData=false, FeeDeviceIndex=FlsGeneral:
      FeeBlockConfiguration_0_cons0: FeeBlockNumber=17, FeeBlockSize=4, FeeNumberOfWriteCycles=0
      FeeBlockConfiguration_UserData0: FeeBlockNumber=96, FeeBlockSize=14, FeeNumberOfWriteCycles=0
      Fee_SWC_NVBlockDescriptor_UserData1: FeeBlockNumber=48, FeeBlockSize=12, FeeNumberOfWriteCycles=100000
      Fee_SWC_NVBlockDescriptor_UserData2: FeeBlockNumber=64, FeeBlockSize=34, FeeNumberOfWriteCycles=100000
      FeeSWC1NvBlockNeed_UserData3: FeeBlockNumber=80, FeeBlockSize=12, FeeNumberOfWriteCycles=0
      Fee_DemPrimaryDataBlock0: FeeBlockNumber=32, FeeBlockSize=38, FeeNumberOfWriteCycles=0
      Fee_DemPrimaryDataBlock1: FeeBlockNumber=112, FeeBlockSize=38, FeeNumberOfWriteCycles=0
      FeeBlockConfiguration_UserData0_003: FeeBlockNumber=256, FeeBlockSize=22, FeeNumberOfWriteCycles=0
      FeeDIAG_SWC_NvBlockNeed_DiagDID_00: FeeBlockNumber=144, FeeBlockSize=6, FeeNumberOfWriteCycles=0
      FeeDIAG_SWC_NvBlockNeed_AttemptCounter: FeeBlockNumber=160, FeeBlockSize=3, FeeNumberOfWriteCycles=0
      Fee_DemPrimaryDataBlock2: FeeBlockNumber=192, FeeBlockSize=38, FeeNumberOfWriteCycles=0
      Fee_DemPrimaryDataBlock3: FeeBlockNumber=208, FeeBlockSize=38, FeeNumberOfWriteCycles=0
      Fee_DemPrimaryDataBlock4: FeeBlockNumber=240, FeeBlockSize=38, FeeNumberOfWriteCycles=0
      FeeDIAG_SWC_NvBlockNeed_DID_F193: FeeBlockNumber=224, FeeBlockSize=4, FeeNumberOfWriteCycles=0
      Fee_DemAdminDataBlock: FeeBlockNumber=176, FeeBlockSize=14, FeeNumberOfWriteCycles=0
      Fee_DemStatusDataBlock: FeeBlockNumber=128, FeeBlockSize=22, FeeNumberOfWriteCycles=0
