AUTOSAR XML (schema 00048)
package /Fee
  module config Fee: implementation-config-variant=VARIANT-POST-BUILD, module-description=Fee_Impl
    CommonPublishedInformation:
      ArMajorVersion = 4
      ArMinorVersion = 2
      ArPatchVersion = 2
      ModuleId = 21
      Release = _TRICORE_TC377
      SwMajorVersion = 10
      SwMinorVersion = 40
      SwPatchVersion = 2
      VendorId = 17
    FeeBlockConfiguration_0 (FeeBlockConfiguration):
      FeeBlockNumber = 16
      FeeBlockSize = 4
      FeeImmediateData = false
      FeeNumberOfWriteCycles = 0
      FeeQsBlockAddress = 0
      FeeQsBlockInstances = 0
      FeeQuasiStaticManager = false
      FeeDeviceIndex = FlsGeneral
    FeeGeneral:
      FeeBlockTypeConfigured = FEE_DOUBLE_SECTOR_DATA_ONLY
      FeeDevErrorDetect = false
      FeeInitCheckApi = false
      FeeMainFunctionPeriod = 0.01
      FeePollingMode = false
      FeeSafetyEnable = false
      FeeSetModeSupported = true
      FeeVersionInfoApi = false
      FeeVirtualPageSize = 8
    FeeIfxSpecificConfig:
      FeeCancelAllApi = false
      FeeEraseAllEnable = true
      FeeGcRestart = FEE_GC_RESTART_INIT
      FeeGetCycleCountApi = false
      FeeGetPrevDataApi = false
      FeeMaxBlockCount = 10
      FeeMaxBytesPerCycle = FEE_MAX_BYTES_512
      FeeNvmIllegalStateNotification = NULL_PTR
      FeeQsHardenErrorNotification = NULL_PTR
      FeeQsIllegalStateNotification = NULL_PTR
      FeeStateVarStructure = Fee_StateVar
      FeeThresholdValue = 512
      FeeUnConfigBlkOverflowHandle = FEE_CONTINUE
      FeeUnConfigBlock = FEE_UNCONFIG_BLOCK_IGNORE
      FeeUseEraseSuspend = false
      FeeVirginFlashIllegalState = false
    FeePublishedInformation: FeeBlockOverhead=17, FeePageOverhead=1
    FeeBlockConfiguration_0_cons0 (FeeBlockConfiguration):
      FeeBlockNumber = 17
      FeeQsBlockInstances = 0
      FeeQsBlockAddress = 0
      FeeQuasiStaticManager = false
      FeeBlockSize = 4
      FeeImmediateData = false
      FeeNumberOfWriteCycles = 0
      FeeDeviceIndex = FlsGeneral
    FeeBlockConfiguration_UserData0 (FeeBlockConfiguration):
      FeeBlockNumber = 32
      FeeQsBlockInstances = 0
      FeeQsBlockAddress = 0
      FeeQuasiStaticManager = false
      FeeBlockSize = 4
      FeeImmediateData = false
      FeeNumberOfWriteCycles = 0
      FeeDeviceIndex = FlsGeneral
