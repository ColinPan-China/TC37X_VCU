AUTOSAR XML (schema 00048)
package /ActiveEcuC
  module config LinSM: implementation-config-variant=VARIANT-PRE-COMPILE, module-description=LinSM_Impl
    LinSMConfigSet
      3 x LinSMChannel, all with LinSMNodeType=MASTER, LinSMConfirmationTimeout=1, LinSMSleepSupport=true:
        CHNL_45618847: LinSMTransceiverHandling=true, LinSMTransceiverPassiveMode=false, LinSMComMNetworkHandleRef=CN_LIN00_b12a0454
          CHNL_45618847_32a17f26 (LinSMSchedule): LinSMScheduleIndex=0, LinSMScheduleIndexRef=NULLSchedule_CHNL_45618847
          TCU_LIN_Schedule_740f8639 (LinSMSchedule): LinSMScheduleIndex=1, LinSMScheduleIndexRef=TCU_LIN_Schedule_740f8639
        CHNL_8e3d5be2: LinSMTransceiverHandling=false, LinSMComMNetworkHandleRef=CN_LIN01_c62d34c2
          CHNL_8e3d5be2_a66eb9f7 (LinSMSchedule): LinSMScheduleIndex=0, LinSMScheduleIndexRef=NULLSchedule
          Vcu_Lin0_Schedule_0e999bb4 (LinSMSchedule): LinSMScheduleIndex=1, LinSMScheduleIndexRef=Vcu_Lin0_Schedule_0e999bb4
        CHNL_08a9294c: LinSMTransceiverHandling=false, LinSMComMNetworkHandleRef=CN_LIN02_5f246578
          CHNL_08a9294c_f4be7c2c (LinSMSchedule): LinSMScheduleIndex=0, LinSMScheduleIndexRef=NULLSchedule_CHNL_08a9294c
          Vcu_Lin3_Schedule_bdb0899f (LinSMSchedule): LinSMScheduleIndex=1, LinSMScheduleIndexRef=Vcu_Lin3_Schedule_bdb0899f
    LinSMGeneral: LinSMDevErrorDetect=true, LinSMMainProcessingPeriod=0.01, LinSMVersionInfoApi=false
      LinSMGeneration: LinSMOutOfBoundsWriteSanitizer=false, LinSMOutOfBoundsReadSanitizer=false, LinSMShortSymbols=false
