AUTOSAR XML (schema 00048)
package /ActiveEcuC
  module config LinSM: implementation-config-variant=VARIANT-PRE-COMPILE, module-description=LinSM_Impl
    LinSMConfigSet
      3 x LinSMChannel, all with LinSMNodeType=MASTER, LinSMConfirmationTimeout=1, LinSMSleepSupport=true, LinSMTransceiverHandling=false:
        CHNL_a1e6ddd5: LinSMComMNetworkHandleRef=CN_ATOM_HWLIN1_64cfd50f
          4 x LinSMSchedule:
            DiagResponseSchedule_f0e03ba7: LinSMScheduleIndex=2, LinSMScheduleIndexRef=DiagResponseSchedule_f0e03ba7
            CHNL_a1e6ddd5_53da5b68: LinSMScheduleIndex=0, LinSMScheduleIndexRef=NULLSchedule_CHNL_a1e6ddd5
            VCU_LIN_Schedule_fbca640b: LinSMScheduleIndex=3, LinSMScheduleIndexRef=VCU_LIN_Schedule_fbca640b
            DiagRequestSchedule_72b11ad9: LinSMScheduleIndex=1, LinSMScheduleIndexRef=DiagRequestSchedule_72b11ad9
        CHNL_f12b4c66: LinSMComMNetworkHandleRef=CN_ATOM_HWLIN4_14a52180
          CHNL_f12b4c66_5ac1747e (LinSMSchedule): LinSMScheduleIndex=0, LinSMScheduleIndexRef=NULLSchedule
          Vcu_Lin0_Schedule_7bfb014e (LinSMSchedule): LinSMScheduleIndex=1, LinSMScheduleIndexRef=Vcu_Lin0_Schedule_7bfb014e
        CHNL_ec2e7cde: LinSMComMNetworkHandleRef=CN_ATOM_HWLIN3_8ac1b423
          Vcu_Lin3_Schedule_a1d48d3a (LinSMSchedule): LinSMScheduleIndex=1, LinSMScheduleIndexRef=Vcu_Lin3_Schedule_a1d48d3a
          CHNL_ec2e7cde_ba7ec765 (LinSMSchedule): LinSMScheduleIndex=0, LinSMScheduleIndexRef=NULLSchedule_CHNL_ec2e7cde
    LinSMGeneral: LinSMDevErrorDetect=true, LinSMMainProcessingPeriod=0.01, LinSMVersionInfoApi=false
      LinSMGeneration: LinSMOutOfBoundsWriteSanitizer=false, LinSMOutOfBoundsReadSanitizer=false, LinSMShortSymbols=false
