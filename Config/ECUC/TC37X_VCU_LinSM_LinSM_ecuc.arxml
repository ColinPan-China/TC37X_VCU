AUTOSAR XML (schema 00048)
package /ActiveEcuC
  module config LinSM: implementation-config-variant=VARIANT-PRE-COMPILE, module-description=LinSM_Impl
    LinSMConfigSet
      CHNL_45618847 (LinSMChannel):
        LinSMNodeType = MASTER
        LinSMConfirmationTimeout = 1
        LinSMSleepSupport = true
        LinSMTransceiverHandling = false
        LinSMComMNetworkHandleRef = CN_LIN00_b12a0454
        CHNL_45618847_32a17f26 (LinSMSchedule): LinSMScheduleIndex=0, LinSMScheduleIndexRef=NULLSchedule
        Vcu_Lin0_Schedule_8fbcfe93 (LinSMSchedule): LinSMScheduleIndex=1, LinSMScheduleIndexRef=Vcu_Lin0_Schedule_8fbcfe93
    LinSMGeneral: LinSMDevErrorDetect=true, LinSMMainProcessingPeriod=0.01, LinSMVersionInfoApi=false
      LinSMGeneration: LinSMOutOfBoundsWriteSanitizer=false, LinSMOutOfBoundsReadSanitizer=false, LinSMShortSymbols=false
