AUTOSAR XML (schema 00048)
package /ActiveEcuC
  module config LinSM: implementation-config-variant=VARIANT-PRE-COMPILE, module-description=LinSM_Impl
    LinSMConfigSet
      CHNL_45618847 (LinSMChannel):
        LinSMNodeType = MASTER
        LinSMConfirmationTimeout = 1
        LinSMSleepSupport = true
        LinSMTransceiverHandling = true
        LinSMTransceiverPassiveMode = false
        LinSMComMNetworkHandleRef = CN_LIN00_b12a0454
        CHNL_45618847_32a17f26 (LinSMSchedule): LinSMScheduleIndex=0, LinSMScheduleIndexRef=NULLSchedule
        TCU_LIN_Schedule_740f8639 (LinSMSchedule): LinSMScheduleIndex=1, LinSMScheduleIndexRef=TCU_LIN_Schedule_740f8639
    LinSMGeneral: LinSMDevErrorDetect=true, LinSMMainProcessingPeriod=0.01, LinSMVersionInfoApi=false
      LinSMGeneration: LinSMOutOfBoundsWriteSanitizer=false, LinSMOutOfBoundsReadSanitizer=false, LinSMShortSymbols=false
