AUTOSAR XML (schema 00048)
package /ActiveEcuC
  module config Eth: implementation-config-variant=VARIANT-PRE-COMPILE, module-description=Eth_Impl
    EthGeneral:
      EthDevErrorDetect = true
      EthVersionInfoApi = false
      EthIndex = 0
      EthMaxCtrlsSupported = 1
      EthUpdatePhysAddrFilter = true
      EthEnableRxInterrupt = true
      EthEnableTxInterrupt = true
      EthOsIsrCategory = CATEGORY_2
      EthRuntimeMeasurementSupport = false
      EthEnableZeroCopyExtensions = false
      EthEnableHeaderAccessApi = false
      EthUsePeripheralAccessApi = false
      EthRuntimeEnvironment = ETH_AUTOSAR_OS
      EthSafeBswChecks = false
      EthMainFunctionPeriod = 0.02
      EthGetEtherStatsApi = false
      EthPreCtrlInitUserCallout = NULL_PTR
      EthPostCtrlInitUserCallout = NULL_PTR
      EthEnableExplicitBufferMapping = true
      EthGetAndResetMeasurementDataApi = true
    EthConfigSet
      EthCtrlConfig:
        EthCtrlEnableMii = true
        EthCtrlEnableRxInterrupt = true
        EthCtrlEnableTxInterrupt = true
        EthCtrlIdx = 0
        EthCtrlRxBufLenByte = 1522
        EthCtrlTxBufLenByte = 1522
        EthRxBufTotal = 2
        EthTxBufTotal = 2
        EthCtrlEnableMacWriteAccess = false
        EthCtrlEnableQoS = false
        EthCtrlEnablePtp = false
        EthCtrlEnableTrafficShaping = NO_TRAFFIC_SHAPING
        EthEnableAVBConformance = false
        EthCtrlMiiInterface = ETH_RGMII_MODE
        EthCtrlResetLoopMaxCycles = 1000
        EthCtrlMiiLoopMaxCycles = 1000
        EthCtrlLoopMaxCycles = 1000
        EthEthSwtMgmtHdrLen = 0
        EthCtrlEnableOsfMode = true
        EthCtrlCsrClkRange = CLK_100_150_MHZ
        EthCtrlPrtSpdSel = PS_100_MBITS
        EthCtrlSkewTx = 2
        EthCtrlSkewRx = 0
        EthCtrlEnableVlanIDBasedFramesQueuing = false
        EthCtrlPhysAddr = 00:03:19:00:00:02
        EthCtrlEnablePpsEventOnTimeApi = false
        EthRxBufConfig: EthRxSegmentNumber=2, EthRxSegmentSize=1522, EthRxMaxFrameSize=1522
        EthTxBufConfig: EthCtrlTxBufLenByte=1522, EthTxBufTotal=2
        EthCtrlOffloading:
          EthCtrlEnableOffloadChecksumIPv4 = false
          EthCtrlEnableOffloadChecksumICMP = false
          EthCtrlEnableOffloadChecksumTCP = false
          EthCtrlEnableOffloadChecksumUDP = false
          EthCtrlEnableOffloadChecksumTCPv6 = false
          EthCtrlEnableOffloadChecksumICMPv6 = false
          EthCtrlEnableOffloadChecksumIPv6HeaderRouting = false
          EthCtrlEnableOffloadChecksumIPv6HeaderDestinationOptions = false
          EthCtrlEnableOffloadChecksumIPv6HeaderHopByHopOptions = false
          EthCtrlEnableOffloadChecksumUDPv6 = false
        EthRuntimeEnvironment
          EthAutosarOs: EthRegBaseAddress=4026650624
        EthInterruptMapping
          IrqHdlrQ0Rx (EthIrqEvent): EthIrqEventDescription=Ethernet Rx interrupt queue 0
          IrqHdlrQ0Tx (EthIrqEvent): EthIrqEventDescription=Ethernet Tx interrupt queue 0
          ETHSR2_ISR (EthInterruptServiceRoutine): EthPreIsrUserFunction=NULL_PTR, EthPostIsrUserFunction=NULL_PTR
            EthIrqEventList_TX (EthIrqEventList): EthIrqHandlerPos=1, EthIrqHandlerRef=IrqHdlrQ0Tx
          ETHSR6_ISR (EthInterruptServiceRoutine): EthPreIsrUserFunction=NULL_PTR, EthPostIsrUserFunction=NULL_PTR
            EthIrqEventList_RX (EthIrqEventList): EthIrqHandlerPos=0, EthIrqHandlerRef=IrqHdlrQ0Rx
        EthCtrlPinRouting:
          Eth_GPCTL_ALT0 = ETH_ALT_2
          Eth_GPCTL_ALT{1..10} = ETH_ALT_0
