AUTOSAR XML (schema 00048)
package /ActiveEcuC
  module config LinTrcv: implementation-config-variant=VARIANT-PRE-COMPILE, module-description=LinTrcv_Impl
    LinTrcvChannel_HWLIN1 (LinTrcvChannel):
      LinTrcvChannelId = 0
      LinTrcvChannelUsed = true
      LinTrcvInitState = LINTRCV_TRCV_MODE_NORMAL
      LinTrcvWakeupByBusUsed = false
      LinTrcvWakeupByPinUsed = false
      LinTrcvSleepInitWorkaround = false
      LinTrcvWakeupSourceRef = CN_ATOM_HWLIN1_64cfd50f
      LinTrcvAccess
        LinTrcvDioAccess
          3 x LinTrcvDioChannelAccess:
            PinEN: LinTrcvHardwareInterfaceName=DioPinEn, LinTrcvDioSymRefName=DioChannel_P23_5_LIN_SLP
            PinRX: LinTrcvHardwareInterfaceName=DioPinRx, LinTrcvDioSymRefName=DioChannel_P15_1_ASCLIN1_RX
            PinTX: LinTrcvHardwareInterfaceName=DioPinTx, LinTrcvDioSymRefName=DioChannel_P15_0_ASCLIN1_TX
      LinTrcvWakeupSourceDetectionDefinition: LinTrcvWakeUpByBusIdentification=TxHighRxLow, LinTrcvWakeUpByPinIdentification=TxLowRxLow
    LinTrcvGeneral: LinTrcvDevErrorDetect=true, LinTrcvGetVersionInfo=false, LinTrcvIndex=0, LinTrcvWaitCount=0, LinTrcvWakeUpSupport=false, LinTrcvSafeBswChecks=false
