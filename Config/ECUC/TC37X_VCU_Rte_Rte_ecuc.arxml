AUTOSAR XML (schema 00048)
package /ActiveEcuC
  module config Rte: implementation-config-variant=VARIANT-PRE-COMPILE, module-description=Rte_Impl
    RteOsInteraction
      12 x RteUsedOsActivation, all with RteExpectedActivationOffset=0, RteExpectedTickDuration=0:
        Rte_Al_TE_PowerMng_SWC_Led_Runnable1000ms: RteActivationOsAlarmRef=Rte_Al_TE_PowerMng_SWC_Led_Runnable1000ms, RteActivationOsTaskRef=Core0_AswTask
        Rte_Al_TE_Com_SWC_Com_Runnable_2ms: RteActivationOsAlarmRef=Rte_Al_TE_Com_SWC_Com_Runnable_2ms, RteActivationOsTaskRef=Core0_AswTask
        Rte_Al_TE_Core1App_SWC_Core1App_Runnable100ms: RteActivationOsAlarmRef=Rte_Al_TE_Core1App_SWC_Core1App_Runnable100ms, RteActivationOsTaskRef=Core1_AswTask
        Rte_Al_TE_Core2App_SWC_Core2App_Runnable100ms: RteActivationOsAlarmRef=Rte_Al_TE_Core2App_SWC_Core2App_Runnable100ms, RteActivationOsTaskRef=Core2_AswTask
        Rte_Al_TE2_Core0_BswTask_0_10ms: RteActivationOsAlarmRef=Rte_Al_TE2_Core0_BswTask_0_10ms, RteActivationOsTaskRef=Core0_BswTask
        Rte_Al_TE2_EcuM_EcuM_MainFunction: RteActivationOsAlarmRef=Rte_Al_TE2_EcuM_EcuM_MainFunction, RteActivationOsTaskRef=Core1_BswTask
        Rte_Al_TE3_EcuM_EcuM_MainFunction: RteActivationOsAlarmRef=Rte_Al_TE3_EcuM_EcuM_MainFunction, RteActivationOsTaskRef=Core2_BswTask
        Rte_Al_TE_Core0_AswTask_0_10ms: RteActivationOsAlarmRef=Rte_Al_TE_Core0_AswTask_0_10ms, RteActivationOsTaskRef=Core0_AswTask
        Rte_Al_TE2_Core0_BswTask_0_20ms: RteActivationOsAlarmRef=Rte_Al_TE2_Core0_BswTask_0_20ms, RteActivationOsTaskRef=Core0_BswTask
        Rte_Al_TE2_Core0_BswTask_0_5ms: RteActivationOsAlarmRef=Rte_Al_TE2_Core0_BswTask_0_5ms, RteActivationOsTaskRef=Core0_BswTask
        Rte_Al_TE_Com_SWC_Com_Runnable_20ms: RteActivationOsAlarmRef=Rte_Al_TE_Com_SWC_Com_Runnable_20ms, RteActivationOsTaskRef=Core0_AswTask
        Rte_Al_TE_EthIf_EthIf_MainFunctionState: RteActivationOsAlarmRef=Rte_Al_TE_EthIf_EthIf_MainFunctionState, RteActivationOsTaskRef=Core0_BswTask
    RteGeneration:
      RteGenerationMode = COMPATIBILITY_MODE
      RteIocInteractionReturnValue = RTE_IOC
      RteValueRangeCheckEnabled = false
      RteCalibrationSupport = NONE
      RteCodeVendorId = 30
      RteDevErrorDetect = false
      RteDevErrorDetectUninit = false
      RteMeasurementSupport = false
      RteOptimizationMode = MEMORY
      RteVfbTraceEnabled = false
      RteEnforceIoc = true
      RteEnforceQueuedIoc = true
    RteInitializationBehavior: RteInitializationStrategy=RTE_INITIALIZATION_STRATEGY_AT_DATA_DECLARATION, RteSectionInitializationPolicy=INIT
    RteBswGeneral: RteSchMVersionInfoApi=false, RteUseComShadowSignalApi=false
    BswM (RteBswModuleInstance): RteBswImplementationRef=BswM_Impl, RteBswModuleConfigurationRef=BswM
      BswM_MainFunctionTimingEvent0 (RteBswEventToTaskMapping):
        RteBswImmediateRestart = false
        RteBswPositionInTask = 0
        RteBswEventRef = BswM_MainFunctionTimingEvent0
        RteBswMappedToTaskRef = Core0_BswTask
        RteBswUsedOsEventRef = Rte_Ev_Cyclic2_Core0_BswTask_0_10ms
        RteBswUsedOsAlarmRef = Rte_Al_TE2_Core0_BswTask_0_10ms
      BSWM_EXCLUSIVE_AREA_0 (RteBswExclusiveAreaImpl): RteExclusiveAreaImplMechanism=ALL_INTERRUPT_BLOCKING, RteBswExclusiveAreaRef=BSWM_EXCLUSIVE_AREA_0
    3 x RteSwComponentInstance:
      BswM_EcuSwComposition: RteSoftwareComponentInstanceRef=BswM
        Timer_BswM_MainFunction (RteEventToTaskMapping):
          RteImmediateRestart = false
          RtePositionInTask = 0
          RteEventRef = Timer_BswM_MainFunction
          RteMappedToTaskRef = Core0_BswTask
          RteUsedOsEventRef = Rte_Ev_Cyclic2_Core0_BswTask_0_10ms
          RteUsedOsAlarmRef = Rte_Al_TE2_Core0_BswTask_0_10ms
      EcuM_EcuSwComposition: RteSoftwareComponentInstanceRef=EcuM
        8 x RteEventToTaskMapping, all with RteImmediateRestart=false:
          Timer_EcuM_MainFunction: RtePositionInTask=1, RteEventRef=Timer_EcuM_MainFunction, RteMappedToTaskRef=Core0_BswTask, RteUsedOsAlarmRef=Rte_Al_TE2_Core0_BswTask_0_10ms, RteUsedOsEventRef=Rte_Ev_Cyclic2_Core0_BswTask_0_10ms
          OpEventSelectShutdownTarget_SelectShutdownTarget_EcuM_ShutdownTarget: RteEventRef=OpEventSelectShutdownTarget_SelectShutdownTarget_EcuM_ShutdownTarget
          OpEventGetShutdownTarget_GetShutdownTarget_EcuM_ShutdownTarget: RteEventRef=OpEventGetShutdownTarget_GetShutdownTarget_EcuM_ShutdownTarget
          OpEventGetLastShutdownTarget_GetLastShutdownTarget_EcuM_ShutdownTarget: RteEventRef=OpEventGetLastShutdownTarget_GetLastShutdownTarget_EcuM_ShutdownTarget
          OpEventSelectShutdownCause_SelectShutdownCause_EcuM_ShutdownTarget: RteEventRef=OpEventSelectShutdownCause_SelectShutdownCause_EcuM_ShutdownTarget
          OpEventGetShutdownCause_GetShutdownCause_EcuM_ShutdownTarget: RteEventRef=OpEventGetShutdownCause_GetShutdownCause_EcuM_ShutdownTarget
          OpEventSelectBootTarget_SelectBootTarget_EcuM_BootTarget: RteEventRef=OpEventSelectBootTarget_SelectBootTarget_EcuM_BootTarget
          OpEventGetBootTarget_GetBootTarget_EcuM_BootTarget: RteEventRef=OpEventGetBootTarget_GetBootTarget_EcuM_BootTarget
      Os_OsCore0_swc_EcuSwComposition: RteSoftwareComponentInstanceRef=Os_OsCore0_swc
        OpEventGetCounterValue_GetCounterValue_OsService_SystemTimer_Core0 (RteEventToTaskMapping): RteImmediateRestart=false, RteEventRef=OpEventGetCounterValue_GetCounterValue_OsService_SystemTimer_Core0
        OpEventGetElapsedValue_GetElapsedValue_OsService_SystemTimer_Core0 (RteEventToTaskMapping): RteImmediateRestart=false, RteEventRef=OpEventGetElapsedValue_GetElapsedValue_OsService_SystemTimer_Core0
    6 x RteBswModuleInstance:
      EcuM: RteBswImplementationRef=EcuM_Impl, RteBswModuleConfigurationRef=EcuM
        EcuM_MainFunctionTimingEvent0 (RteBswEventToTaskMapping):
          RteBswImmediateRestart = false
          RteBswPositionInTask = 1
          RteBswEventRef = EcuM_MainFunctionTimingEvent0
          RteBswMappedToTaskRef = Core0_BswTask
          RteBswUsedOsAlarmRef = Rte_Al_TE2_Core0_BswTask_0_10ms
          RteBswUsedOsEventRef = Rte_Ev_Cyclic2_Core0_BswTask_0_10ms
        4 x RteBswExclusiveAreaImpl, all with RteExclusiveAreaImplMechanism=ALL_INTERRUPT_BLOCKING:
          ECUM_EXCLUSIVE_AREA_{0..3}: RteBswExclusiveAreaRef=ECUM_EXCLUSIVE_AREA_{0..3}
        EcuM_MainFunctionTimingEvent1 (RteBswEventToTaskMapping):
          RteBswImmediateRestart = false
          RteBswPositionInTask = 0
          RteBswEventRef = EcuM_MainFunctionTimingEvent1
          RteBswMappedToTaskRef = Core1_BswTask
          RteBswUsedOsAlarmRef = Rte_Al_TE2_EcuM_EcuM_MainFunction
        EcuM_MainFunctionTimingEvent2 (RteBswEventToTaskMapping):
          RteBswImmediateRestart = false
          RteBswPositionInTask = 0
          RteBswEventRef = EcuM_MainFunctionTimingEvent2
          RteBswMappedToTaskRef = Core2_BswTask
          RteBswUsedOsAlarmRef = Rte_Al_TE3_EcuM_EcuM_MainFunction
      Rte: RteBswImplementationRef=Rte_Impl, RteBswModuleConfigurationRef=Rte
        Rte_ComSendSignalProxyPeriodicTimingEvent0 (RteBswEventToTaskMapping):
          RteBswImmediateRestart = false
          RteBswPositionInTask = 10
          RteBswEventRef = Rte_ComSendSignalProxyPeriodicTimingEvent0
          RteBswMappedToTaskRef = Core0_BswTask
      Dio: RteBswImplementationRef=Dio_Impl, RteBswModuleConfigurationRef=Dio
      McalLib: RteBswImplementationRef=McalLib_Impl, RteBswModuleConfigurationRef=McalLib
        4 x RteBswExclusiveAreaImpl, all with RteExclusiveAreaImplMechanism=ALL_INTERRUPT_BLOCKING:
          PeripheralEndInit: RteBswExclusiveAreaRef=PeripheralEndInit
          SafetyEndInit: RteBswExclusiveAreaRef=SafetyEndInit
          CpuEndInit: RteBswExclusiveAreaRef=CpuEndInit
          StmTimerResolution: RteBswExclusiveAreaRef=StmTimerResolution
      Mcu: RteBswImplementationRef=Mcu_Impl, RteBswModuleConfigurationRef=Mcu
        TomTgcReg (RteBswExclusiveAreaImpl): RteExclusiveAreaImplMechanism=ALL_INTERRUPT_BLOCKING, RteBswExclusiveAreaRef=TomTgcReg
        AtomAgcReg (RteBswExclusiveAreaImpl): RteExclusiveAreaImplMechanism=ALL_INTERRUPT_BLOCKING, RteBswExclusiveAreaRef=AtomAgcReg
      Port: RteBswImplementationRef=Port_Impl, RteBswModuleConfigurationRef=Port
    SWC1_EcuSwComposition (RteSwComponentInstance): RteSoftwareComponentInstanceRef=SWC1
      4 x RteEventToTaskMapping, all with RteImmediateRestart=false:
        SWC1_InitEvent: RtePositionInTask=0, RteEventRef=SWC1_InitEvent, RteMappedToTaskRef=Core0_AswInit
        TMT_SWC1_Runnable10ms: RtePositionInTask=0, RteEventRef=TMT_SWC1_Runnable10ms, RteMappedToTaskRef=Core0_AswTask, RteUsedOsEventRef=Rte_Ev_Cyclic_Core0_AswTask_0_10ms, RteUsedOsAlarmRef=Rte_Al_TE_Core0_AswTask_0_10ms
        OIT_NvSWC_NvMNotifyJobFinished_UserData1_JobFinished_NvSWC_NvMNotifyJobFinished_UserData1_JobFinished: RteEventRef=OIT_NvSWC_NvMNotifyJobFinished_UserData1_JobFinished_NvSWC_NvMNotifyJobFinished_UserData1_JobFinished
        OIT_NvSWC_NvMNotifyJobFinished_UserData2_JobFinished_NvSWC_NvMNotifyJobFinished_UserData2_JobFinished: RteEventRef=OIT_NvSWC_NvMNotifyJobFinished_UserData2_JobFinished_NvSWC_NvMNotifyJobFinished_UserData2_JobFinished
      NvmBlock_SWC1_NvBlockNeed_UserData3 (RteNvRamAllocation):
        RteNvmRamBlockLocationSymbol = Rte_SWC1_NvBlockNeed_UserData3_MirrorBlock
        RteNvmRomBlockLocationSymbol = Rte_SWC1_NvBlockNeed_UserData3_DefaultValue
        RteNvmBlockRef = SWC1NvBlockNeed_UserData3
        RteSwNvRamMappingRef = NvBlockNeed_UserData3
    SWC1 (RteSwComponentType): RteComponentTypeRef=SWC1, RteImplementationRef=SWC1_Implementation
      ComponentTypeCalibration (RteComponentTypeCalibration): RteCalibrationSupportEnabled=false
    ComM_EcuSwComposition (RteSwComponentInstance): RteSoftwareComponentInstanceRef=ComM
      79 x RteEventToTaskMapping, all with RteImmediateRestart=false:
        Timer_ComM_MainFunction_0: RtePositionInTask=2, RteEventRef=Timer_ComM_MainFunction_0, RteMappedToTaskRef=Core0_BswTask, RteUsedOsEventRef=Rte_Ev_Cyclic2_Core0_BswTask_0_20ms, RteUsedOsAlarmRef=Rte_Al_TE2_Core0_BswTask_0_20ms
        OpEventLimitECUToNoComMode_LimitECUToNoComMode_modeLimitation: RteEventRef=OpEventLimitECUToNoComMode_LimitECUToNoComMode_modeLimitation
        OpEventReadInhibitCounter_ReadInhibitCounter_modeLimitation: RteEventRef=OpEventReadInhibitCounter_ReadInhibitCounter_modeLimitation
        OpEventResetInhibitCounter_ResetInhibitCounter_modeLimitation: RteEventRef=OpEventResetInhibitCounter_ResetInhibitCounter_modeLimitation
        OpEventSetECUGroupClassification_SetECUGroupClassification_modeLimitation: RteEventRef=OpEventSetECUGroupClassification_SetECUGroupClassification_modeLimitation
        OpEventGetInhibitionStatus_GetInhibitionStatus_CL_CN_TC37X_VCU_CAN00_07b6c9c8: RteEventRef=OpEventGetInhibitionStatus_GetInhibitionStatus_CL_CN_TC37X_VCU_CAN00_07b6c9c8
        OpEventGetInhibitionStatus_GetInhibitionStatus_CW_CN_TC37X_VCU_CAN00_07b6c9c8: RteEventRef=OpEventGetInhibitionStatus_GetInhibitionStatus_CW_CN_TC37X_VCU_CAN00_07b6c9c8
        OpEventLimitChannelToNoComMode_LimitChannelToNoComMode_CL_CN_TC37X_VCU_CAN00_07b6c9c8: RteEventRef=OpEventLimitChannelToNoComMode_LimitChannelToNoComMode_CL_CN_TC37X_VCU_CAN00_07b6c9c8
        OpEventPreventWakeUp_PreventWakeUp_CW_CN_TC37X_VCU_CAN00_07b6c9c8: RteEventRef=OpEventPreventWakeUp_PreventWakeUp_CW_CN_TC37X_VCU_CAN00_07b6c9c8
        OpEventRequestComMode_RequestComMode_UR_CN_TC37X_VCU_CAN00_b1b4f272: RteEventRef=OpEventRequestComMode_RequestComMode_UR_CN_TC37X_VCU_CAN00_b1b4f272
        OpEventGetCurrentComMode_GetCurrentComMode_UR_CN_TC37X_VCU_CAN00_b1b4f272: RteEventRef=OpEventGetCurrentComMode_GetCurrentComMode_UR_CN_TC37X_VCU_CAN00_b1b4f272
        OpEventGetMaxComMode_GetMaxComMode_UR_CN_TC37X_VCU_CAN00_b1b4f272: RteEventRef=OpEventGetMaxComMode_GetMaxComMode_UR_CN_TC37X_VCU_CAN00_b1b4f272
        OpEventGetRequestedComMode_GetRequestedComMode_UR_CN_TC37X_VCU_CAN00_b1b4f272: RteEventRef=OpEventGetRequestedComMode_GetRequestedComMode_UR_CN_TC37X_VCU_CAN00_b1b4f272
        Timer_ComM_MainFunction_1: RtePositionInTask=20, RteEventRef=Timer_ComM_MainFunction_1, RteMappedToTaskRef=Core0_BswTask, RteUsedOsEventRef=Rte_Ev_Cyclic2_Core0_BswTask_0_20ms, RteUsedOsAlarmRef=Rte_Al_TE2_Core0_BswTask_0_20ms
        OpEventGetInhibitionStatus_GetInhibitionStatus_CL_CN_TC37X_VCU_CAN01_70b1f95e: RteEventRef=OpEventGetInhibitionStatus_GetInhibitionStatus_CL_CN_TC37X_VCU_CAN01_70b1f95e
        OpEventGetInhibitionStatus_GetInhibitionStatus_CW_CN_TC37X_VCU_CAN01_70b1f95e: RteEventRef=OpEventGetInhibitionStatus_GetInhibitionStatus_CW_CN_TC37X_VCU_CAN01_70b1f95e
        OpEventLimitChannelToNoComMode_LimitChannelToNoComMode_CL_CN_TC37X_VCU_CAN01_70b1f95e: RteEventRef=OpEventLimitChannelToNoComMode_LimitChannelToNoComMode_CL_CN_TC37X_VCU_CAN01_70b1f95e
        OpEventPreventWakeUp_PreventWakeUp_CW_CN_TC37X_VCU_CAN01_70b1f95e: RteEventRef=OpEventPreventWakeUp_PreventWakeUp_CW_CN_TC37X_VCU_CAN01_70b1f95e
        OpEventRequestComMode_RequestComMode_UR_CN_TC37X_VCU_CAN01_5e76994c: RteEventRef=OpEventRequestComMode_RequestComMode_UR_CN_TC37X_VCU_CAN01_5e76994c
        OpEventGetCurrentComMode_GetCurrentComMode_UR_CN_TC37X_VCU_CAN01_5e76994c: RteEventRef=OpEventGetCurrentComMode_GetCurrentComMode_UR_CN_TC37X_VCU_CAN01_5e76994c
        OpEventGetMaxComMode_GetMaxComMode_UR_CN_TC37X_VCU_CAN01_5e76994c: RteEventRef=OpEventGetMaxComMode_GetMaxComMode_UR_CN_TC37X_VCU_CAN01_5e76994c
        OpEventGetRequestedComMode_GetRequestedComMode_UR_CN_TC37X_VCU_CAN01_5e76994c: RteEventRef=OpEventGetRequestedComMode_GetRequestedComMode_UR_CN_TC37X_VCU_CAN01_5e76994c
        Timer_ComM_MainFunction_2: RtePositionInTask=21, RteEventRef=Timer_ComM_MainFunction_2, RteMappedToTaskRef=Core0_BswTask, RteUsedOsEventRef=Rte_Ev_Cyclic2_Core0_BswTask_0_20ms, RteUsedOsAlarmRef=Rte_Al_TE2_Core0_BswTask_0_20ms
        OpEventGetInhibitionStatus_GetInhibitionStatus_CL_CN_LIN00_b12a0454: RteEventRef=OpEventGetInhibitionStatus_GetInhibitionStatus_CL_CN_LIN00_b12a0454
        OpEventGetInhibitionStatus_GetInhibitionStatus_CW_CN_LIN00_b12a0454: RteEventRef=OpEventGetInhibitionStatus_GetInhibitionStatus_CW_CN_LIN00_b12a0454
        OpEventLimitChannelToNoComMode_LimitChannelToNoComMode_CL_CN_LIN00_b12a0454: RteEventRef=OpEventLimitChannelToNoComMode_LimitChannelToNoComMode_CL_CN_LIN00_b12a0454
        OpEventPreventWakeUp_PreventWakeUp_CW_CN_LIN00_b12a0454: RteEventRef=OpEventPreventWakeUp_PreventWakeUp_CW_CN_LIN00_b12a0454
        OpEventRequestComMode_RequestComMode_UR_CN_LIN00_984dfd9e: RteEventRef=OpEventRequestComMode_RequestComMode_UR_CN_LIN00_984dfd9e
        OpEventGetCurrentComMode_GetCurrentComMode_UR_CN_LIN00_984dfd9e: RteEventRef=OpEventGetCurrentComMode_GetCurrentComMode_UR_CN_LIN00_984dfd9e
        OpEventGetMaxComMode_GetMaxComMode_UR_CN_LIN00_984dfd9e: RteEventRef=OpEventGetMaxComMode_GetMaxComMode_UR_CN_LIN00_984dfd9e
        OpEventGetRequestedComMode_GetRequestedComMode_UR_CN_LIN00_984dfd9e: RteEventRef=OpEventGetRequestedComMode_GetRequestedComMode_UR_CN_LIN00_984dfd9e
        Timer_ComM_MainFunction_3: RtePositionInTask=25, RteEventRef=Timer_ComM_MainFunction_3, RteMappedToTaskRef=Core0_BswTask, RteUsedOsEventRef=Rte_Ev_Cyclic2_Core0_BswTask_0_20ms, RteUsedOsAlarmRef=Rte_Al_TE2_Core0_BswTask_0_20ms
        OpEventGetInhibitionStatus_GetInhibitionStatus_CL_CN_KAMA_FP_EPT_0303_275b3e6e: RteEventRef=OpEventGetInhibitionStatus_GetInhibitionStatus_CL_CN_KAMA_FP_EPT_0303_275b3e6e
        OpEventGetInhibitionStatus_GetInhibitionStatus_CW_CN_KAMA_FP_EPT_0303_275b3e6e: RteEventRef=OpEventGetInhibitionStatus_GetInhibitionStatus_CW_CN_KAMA_FP_EPT_0303_275b3e6e
        OpEventLimitChannelToNoComMode_LimitChannelToNoComMode_CL_CN_KAMA_FP_EPT_0303_275b3e6e: RteEventRef=OpEventLimitChannelToNoComMode_LimitChannelToNoComMode_CL_CN_KAMA_FP_EPT_0303_275b3e6e
        OpEventPreventWakeUp_PreventWakeUp_CW_CN_KAMA_FP_EPT_0303_275b3e6e: RteEventRef=OpEventPreventWakeUp_PreventWakeUp_CW_CN_KAMA_FP_EPT_0303_275b3e6e
        OpEventRequestComMode_RequestComMode_UR_CN_KAMA_FP_EPT_0303_b67fd6a6: RteEventRef=OpEventRequestComMode_RequestComMode_UR_CN_KAMA_FP_EPT_0303_b67fd6a6
        OpEventGetCurrentComMode_GetCurrentComMode_UR_CN_KAMA_FP_EPT_0303_b67fd6a6: RteEventRef=OpEventGetCurrentComMode_GetCurrentComMode_UR_CN_KAMA_FP_EPT_0303_b67fd6a6
        OpEventGetMaxComMode_GetMaxComMode_UR_CN_KAMA_FP_EPT_0303_b67fd6a6: RteEventRef=OpEventGetMaxComMode_GetMaxComMode_UR_CN_KAMA_FP_EPT_0303_b67fd6a6
        OpEventGetRequestedComMode_GetRequestedComMode_UR_CN_KAMA_FP_EPT_0303_b67fd6a6: RteEventRef=OpEventGetRequestedComMode_GetRequestedComMode_UR_CN_KAMA_FP_EPT_0303_b67fd6a6
        OpEventRequestComMode_RequestComMode_UR_ComMUser_PNC24: RteEventRef=OpEventRequestComMode_RequestComMode_UR_ComMUser_PNC24
        OpEventRequestComMode_RequestComMode_UR_ComMUser_PNC26: RteEventRef=OpEventRequestComMode_RequestComMode_UR_ComMUser_PNC26
        OpEventRequestComMode_RequestComMode_UR_ComMUser_PNC31: RteEventRef=OpEventRequestComMode_RequestComMode_UR_ComMUser_PNC31
        OpEventGetCurrentComMode_GetCurrentComMode_UR_ComMUser_PNC24: RteEventRef=OpEventGetCurrentComMode_GetCurrentComMode_UR_ComMUser_PNC24
        OpEventGetCurrentComMode_GetCurrentComMode_UR_ComMUser_PNC26: RteEventRef=OpEventGetCurrentComMode_GetCurrentComMode_UR_ComMUser_PNC26
        OpEventGetCurrentComMode_GetCurrentComMode_UR_ComMUser_PNC31: RteEventRef=OpEventGetCurrentComMode_GetCurrentComMode_UR_ComMUser_PNC31
        OpEventGetCurrentPNCComMode_GetCurrentPNCComMode_UR_CN_KAMA_FP_EPT_0303_b67fd6a6: RteEventRef=OpEventGetCurrentPNCComMode_GetCurrentPNCComMode_UR_CN_KAMA_FP_EPT_0303_b67fd6a6
        OpEventGetCurrentPNCComMode_GetCurrentPNCComMode_UR_CN_LIN00_984dfd9e: RteEventRef=OpEventGetCurrentPNCComMode_GetCurrentPNCComMode_UR_CN_LIN00_984dfd9e
        OpEventGetCurrentPNCComMode_GetCurrentPNCComMode_UR_CN_TC37X_VCU_CAN00_b1b4f272: RteEventRef=OpEventGetCurrentPNCComMode_GetCurrentPNCComMode_UR_CN_TC37X_VCU_CAN00_b1b4f272
        OpEventGetCurrentPNCComMode_GetCurrentPNCComMode_UR_CN_TC37X_VCU_CAN01_5e76994c: RteEventRef=OpEventGetCurrentPNCComMode_GetCurrentPNCComMode_UR_CN_TC37X_VCU_CAN01_5e76994c
        OpEventGetCurrentPNCComMode_GetCurrentPNCComMode_UR_ComMUser_PNC24: RteEventRef=OpEventGetCurrentPNCComMode_GetCurrentPNCComMode_UR_ComMUser_PNC24
        OpEventGetCurrentPNCComMode_GetCurrentPNCComMode_UR_ComMUser_PNC26: RteEventRef=OpEventGetCurrentPNCComMode_GetCurrentPNCComMode_UR_ComMUser_PNC26
        OpEventGetCurrentPNCComMode_GetCurrentPNCComMode_UR_ComMUser_PNC31: RteEventRef=OpEventGetCurrentPNCComMode_GetCurrentPNCComMode_UR_ComMUser_PNC31
        OpEventGetMaxComMode_GetMaxComMode_UR_ComMUser_PNC24: RteEventRef=OpEventGetMaxComMode_GetMaxComMode_UR_ComMUser_PNC24
        OpEventGetMaxComMode_GetMaxComMode_UR_ComMUser_PNC26: RteEventRef=OpEventGetMaxComMode_GetMaxComMode_UR_ComMUser_PNC26
        OpEventGetMaxComMode_GetMaxComMode_UR_ComMUser_PNC31: RteEventRef=OpEventGetMaxComMode_GetMaxComMode_UR_ComMUser_PNC31
        OpEventGetRequestedComMode_GetRequestedComMode_UR_ComMUser_PNC24: RteEventRef=OpEventGetRequestedComMode_GetRequestedComMode_UR_ComMUser_PNC24
        OpEventGetRequestedComMode_GetRequestedComMode_UR_ComMUser_PNC26: RteEventRef=OpEventGetRequestedComMode_GetRequestedComMode_UR_ComMUser_PNC26
        OpEventGetRequestedComMode_GetRequestedComMode_UR_ComMUser_PNC31: RteEventRef=OpEventGetRequestedComMode_GetRequestedComMode_UR_ComMUser_PNC31
        Timer_ComM_MainFunction_4: RtePositionInTask=26, RteEventRef=Timer_ComM_MainFunction_4, RteMappedToTaskRef=Core0_BswTask, RteUsedOsEventRef=Rte_Ev_Cyclic2_Core0_BswTask_0_20ms, RteUsedOsAlarmRef=Rte_Al_TE2_Core0_BswTask_0_20ms
        OpEventGetInhibitionStatus_GetInhibitionStatus_CL_CN_TC37X_VCU_CAN03_9ebf9872: RteEventRef=OpEventGetInhibitionStatus_GetInhibitionStatus_CL_CN_TC37X_VCU_CAN03_9ebf9872
        OpEventGetInhibitionStatus_GetInhibitionStatus_CW_CN_TC37X_VCU_CAN03_9ebf9872: RteEventRef=OpEventGetInhibitionStatus_GetInhibitionStatus_CW_CN_TC37X_VCU_CAN03_9ebf9872
        OpEventLimitChannelToNoComMode_LimitChannelToNoComMode_CL_CN_TC37X_VCU_CAN03_9ebf9872: RteEventRef=OpEventLimitChannelToNoComMode_LimitChannelToNoComMode_CL_CN_TC37X_VCU_CAN03_9ebf9872
        OpEventPreventWakeUp_PreventWakeUp_CW_CN_TC37X_VCU_CAN03_9ebf9872: RteEventRef=OpEventPreventWakeUp_PreventWakeUp_CW_CN_TC37X_VCU_CAN03_9ebf9872
        OpEventRequestComMode_RequestComMode_UR_CN_TC37X_VCU_CAN03_5a834971: RteEventRef=OpEventRequestComMode_RequestComMode_UR_CN_TC37X_VCU_CAN03_5a834971
        OpEventGetCurrentComMode_GetCurrentComMode_UR_CN_TC37X_VCU_CAN03_5a834971: RteEventRef=OpEventGetCurrentComMode_GetCurrentComMode_UR_CN_TC37X_VCU_CAN03_5a834971
        OpEventGetCurrentPNCComMode_GetCurrentPNCComMode_UR_CN_TC37X_VCU_CAN03_5a834971: RteEventRef=OpEventGetCurrentPNCComMode_GetCurrentPNCComMode_UR_CN_TC37X_VCU_CAN03_5a834971
        OpEventGetMaxComMode_GetMaxComMode_UR_CN_TC37X_VCU_CAN03_5a834971: RteEventRef=OpEventGetMaxComMode_GetMaxComMode_UR_CN_TC37X_VCU_CAN03_5a834971
        OpEventGetRequestedComMode_GetRequestedComMode_UR_CN_TC37X_VCU_CAN03_5a834971: RteEventRef=OpEventGetRequestedComMode_GetRequestedComMode_UR_CN_TC37X_VCU_CAN03_5a834971
        Timer_ComM_MainFunction_5: RtePositionInTask=31, RteEventRef=Timer_ComM_MainFunction_5, RteMappedToTaskRef=Core0_BswTask, RteUsedOsEventRef=Rte_Ev_Cyclic2_Core0_BswTask_0_20ms, RteUsedOsAlarmRef=Rte_Al_TE2_Core0_BswTask_0_20ms
        OpEventGetInhibitionStatus_GetInhibitionStatus_CL_ComMChannel_ETH: RteEventRef=OpEventGetInhibitionStatus_GetInhibitionStatus_CL_ComMChannel_ETH
        OpEventGetInhibitionStatus_GetInhibitionStatus_CW_ComMChannel_ETH: RteEventRef=OpEventGetInhibitionStatus_GetInhibitionStatus_CW_ComMChannel_ETH
        OpEventLimitChannelToNoComMode_LimitChannelToNoComMode_CL_ComMChannel_ETH: RteEventRef=OpEventLimitChannelToNoComMode_LimitChannelToNoComMode_CL_ComMChannel_ETH
        OpEventPreventWakeUp_PreventWakeUp_CW_ComMChannel_ETH: RteEventRef=OpEventPreventWakeUp_PreventWakeUp_CW_ComMChannel_ETH
        OpEventRequestComMode_RequestComMode_UR_ComMUser_ETH: RteEventRef=OpEventRequestComMode_RequestComMode_UR_ComMUser_ETH
        OpEventGetCurrentComMode_GetCurrentComMode_UR_ComMUser_ETH: RteEventRef=OpEventGetCurrentComMode_GetCurrentComMode_UR_ComMUser_ETH
        OpEventGetCurrentPNCComMode_GetCurrentPNCComMode_UR_ComMUser_ETH: RteEventRef=OpEventGetCurrentPNCComMode_GetCurrentPNCComMode_UR_ComMUser_ETH
        OpEventGetMaxComMode_GetMaxComMode_UR_ComMUser_ETH: RteEventRef=OpEventGetMaxComMode_GetMaxComMode_UR_ComMUser_ETH
        OpEventGetRequestedComMode_GetRequestedComMode_UR_ComMUser_ETH: RteEventRef=OpEventGetRequestedComMode_GetRequestedComMode_UR_ComMUser_ETH
    Det_EcuSwComposition (RteSwComponentInstance): RteSoftwareComponentInstanceRef=Det
    9 x RteBswModuleInstance:
      Can: RteBswImplementationRef=Can_Impl, RteBswModuleConfigurationRef=Can
        3 x RteBswEventToTaskMapping, all with RteBswImmediateRestart=false, RteBswMappedToTaskRef=Core0_BswTask, RteBswUsedOsEventRef=Rte_Ev_Cyclic2_Core0_BswTask_0_10ms, RteBswUsedOsAlarmRef=Rte_Al_TE2_Core0_BswTask_0_10ms:
          Can_MainFunction_BusOffTimingEvent0: RteBswPositionInTask=5, RteBswEventRef=Can_MainFunction_BusOffTimingEvent0
          Can_MainFunction_WakeupTimingEvent0: RteBswPositionInTask=7, RteBswEventRef=Can_MainFunction_WakeupTimingEvent0
          Can_MainFunction_ModeTimingEvent0: RteBswPositionInTask=6, RteBswEventRef=Can_MainFunction_ModeTimingEvent0
        8 x RteBswExclusiveAreaImpl:
          CAN_EXCLUSIVE_AREA_{0..5}: RteExclusiveAreaImplMechanism=ALL_INTERRUPT_BLOCKING, RteBswExclusiveAreaRef=CAN_EXCLUSIVE_AREA_{0..5}
          CAN_EXCLUSIVE_AREA_6: RteExclusiveAreaImplMechanism=CUSTOM, RteBswExclusiveAreaRef=CAN_EXCLUSIVE_AREA_6
          CAN_EXCLUSIVE_AREA_7: RteExclusiveAreaImplMechanism=ALL_INTERRUPT_BLOCKING, RteBswExclusiveAreaRef=CAN_EXCLUSIVE_AREA_7
      CanIf: RteBswImplementationRef=CanIf_Impl, RteBswModuleConfigurationRef=CanIf
        8 x RteBswExclusiveAreaImpl:
          CANIF_EXCLUSIVE_AREA_0: RteExclusiveAreaImplMechanism=CUSTOM, RteBswExclusiveAreaRef=CANIF_EXCLUSIVE_AREA_0
          CANIF_EXCLUSIVE_AREA_{1..7}: RteExclusiveAreaImplMechanism=ALL_INTERRUPT_BLOCKING, RteBswExclusiveAreaRef=CANIF_EXCLUSIVE_AREA_{1..7}
      CanSM: RteBswImplementationRef=CanSM_Impl, RteBswModuleConfigurationRef=CanSM
        CanSM_MainFunctionTimingEvent0 (RteBswEventToTaskMapping):
          RteBswImmediateRestart = false
          RteBswPositionInTask = 4
          RteBswEventRef = CanSM_MainFunctionTimingEvent0
          RteBswMappedToTaskRef = Core0_BswTask
          RteBswUsedOsEventRef = Rte_Ev_Cyclic2_Core0_BswTask_0_10ms
          RteBswUsedOsAlarmRef = Rte_Al_TE2_Core0_BswTask_0_10ms
        6 x RteBswExclusiveAreaImpl:
          CANSM_EXCLUSIVE_AREA_1: RteExclusiveAreaImplMechanism=CUSTOM, RteBswExclusiveAreaRef=CANSM_EXCLUSIVE_AREA_1
          CANSM_EXCLUSIVE_AREA_2: RteExclusiveAreaImplMechanism=ALL_INTERRUPT_BLOCKING, RteBswExclusiveAreaRef=CANSM_EXCLUSIVE_AREA_2
          CANSM_EXCLUSIVE_AREA_3: RteExclusiveAreaImplMechanism=ALL_INTERRUPT_BLOCKING, RteBswExclusiveAreaRef=CANSM_EXCLUSIVE_AREA_3
          CANSM_EXCLUSIVE_AREA_4: RteExclusiveAreaImplMechanism=CUSTOM, RteBswExclusiveAreaRef=CANSM_EXCLUSIVE_AREA_4
          CANSM_EXCLUSIVE_AREA_5: RteExclusiveAreaImplMechanism=ALL_INTERRUPT_BLOCKING, RteBswExclusiveAreaRef=CANSM_EXCLUSIVE_AREA_5
          CANSM_EXCLUSIVE_AREA_6: RteExclusiveAreaImplMechanism=ALL_INTERRUPT_BLOCKING, RteBswExclusiveAreaRef=CANSM_EXCLUSIVE_AREA_6
      Com: RteBswImplementationRef=Com_Impl, RteBswModuleConfigurationRef=Com
        3 x RteBswExclusiveAreaImpl, all with RteExclusiveAreaImplMechanism=ALL_INTERRUPT_BLOCKING:
          COM_EXCLUSIVE_AREA_TX: RteBswExclusiveAreaRef=COM_EXCLUSIVE_AREA_TX
          COM_EXCLUSIVE_AREA_RX: RteBswExclusiveAreaRef=COM_EXCLUSIVE_AREA_RX
          COM_EXCLUSIVE_AREA_BOTH: RteBswExclusiveAreaRef=COM_EXCLUSIVE_AREA_BOTH
        Com_MainFunctionRx_ComMainFunctionRxTimingEvent0 (RteBswEventToTaskMapping):
          RteBswImmediateRestart = false
          RteBswPositionInTask = 8
          RteBswEventRef = Com_MainFunctionRx_ComMainFunctionRxTimingEvent0
          RteBswMappedToTaskRef = Core0_BswTask
          RteBswUsedOsEventRef = Rte_Ev_Cyclic2_Core0_BswTask_0_10ms
          RteBswUsedOsAlarmRef = Rte_Al_TE2_Core0_BswTask_0_10ms
        Com_MainFunctionTx_ComMainFunctionTxTimingEvent0 (RteBswEventToTaskMapping):
          RteBswImmediateRestart = false
          RteBswPositionInTask = 9
          RteBswEventRef = Com_MainFunctionTx_ComMainFunctionTxTimingEvent0
          RteBswMappedToTaskRef = Core0_BswTask
          RteBswUsedOsEventRef = Rte_Ev_Cyclic2_Core0_BswTask_0_10ms
          RteBswUsedOsAlarmRef = Rte_Al_TE2_Core0_BswTask_0_10ms
      ComM: RteBswImplementationRef=ComM_Impl, RteBswModuleConfigurationRef=ComM
        ComM_MainFunction_0TimingEvent0 (RteBswEventToTaskMapping):
          RteBswImmediateRestart = false
          RteBswPositionInTask = 2
          RteBswEventRef = ComM_MainFunction_0TimingEvent0
          RteBswMappedToTaskRef = Core0_BswTask
          RteBswUsedOsEventRef = Rte_Ev_Cyclic2_Core0_BswTask_0_20ms
          RteBswUsedOsAlarmRef = Rte_Al_TE2_Core0_BswTask_0_20ms
        8 x RteBswExclusiveAreaImpl:
          COMM_EXCLUSIVE_AREA_0: RteExclusiveAreaImplMechanism=ALL_INTERRUPT_BLOCKING, RteBswExclusiveAreaRef=COMM_EXCLUSIVE_AREA_0
          COMM_EXCLUSIVE_AREA_1: RteExclusiveAreaImplMechanism=CUSTOM, RteBswExclusiveAreaRef=COMM_EXCLUSIVE_AREA_1
          COMM_EXCLUSIVE_AREA_{2..7}: RteExclusiveAreaImplMechanism=ALL_INTERRUPT_BLOCKING, RteBswExclusiveAreaRef=COMM_EXCLUSIVE_AREA_{2..7}
        5 x RteBswEventToTaskMapping, all with RteBswImmediateRestart=false, RteBswMappedToTaskRef=Core0_BswTask, RteBswUsedOsEventRef=Rte_Ev_Cyclic2_Core0_BswTask_0_20ms, RteBswUsedOsAlarmRef=Rte_Al_TE2_Core0_BswTask_0_20ms:
          ComM_MainFunction_1TimingEvent0: RteBswPositionInTask=20, RteBswEventRef=ComM_MainFunction_1TimingEvent0
          ComM_MainFunction_2TimingEvent0: RteBswPositionInTask=21, RteBswEventRef=ComM_MainFunction_2TimingEvent0
          ComM_MainFunction_3TimingEvent0: RteBswPositionInTask=25, RteBswEventRef=ComM_MainFunction_3TimingEvent0
          ComM_MainFunction_4TimingEvent0: RteBswPositionInTask=26, RteBswEventRef=ComM_MainFunction_4TimingEvent0
          ComM_MainFunction_5TimingEvent0: RteBswPositionInTask=31, RteBswEventRef=ComM_MainFunction_5TimingEvent0
      Det: RteBswImplementationRef=Det_Impl, RteBswModuleConfigurationRef=Det
        DET_EXCLUSIVE_AREA_0 (RteBswExclusiveAreaImpl): RteExclusiveAreaImplMechanism=ALL_INTERRUPT_BLOCKING, RteBswExclusiveAreaRef=DET_EXCLUSIVE_AREA_0
      PduR: RteBswImplementationRef=PduR_Impl, RteBswModuleConfigurationRef=PduR
        PDUR_EXCLUSIVE_AREA_0 (RteBswExclusiveAreaImpl): RteExclusiveAreaImplMechanism=ALL_INTERRUPT_BLOCKING, RteBswExclusiveAreaRef=PDUR_EXCLUSIVE_AREA_0
      CanNm: RteBswImplementationRef=CanNm_Impl, RteBswModuleConfigurationRef=CanNm
        CanNm_MainFunctionTimingEvent0 (RteBswEventToTaskMapping):
          RteBswImmediateRestart = false
          RteBswPositionInTask = 3
          RteBswEventRef = CanNm_MainFunctionTimingEvent0
          RteBswMappedToTaskRef = Core0_BswTask
          RteBswUsedOsEventRef = Rte_Ev_Cyclic2_Core0_BswTask_0_10ms
          RteBswUsedOsAlarmRef = Rte_Al_TE2_Core0_BswTask_0_10ms
        7 x RteBswExclusiveAreaImpl, all with RteExclusiveAreaImplMechanism=ALL_INTERRUPT_BLOCKING:
          CANNM_EXCLUSIVE_AREA_{0..6}: RteBswExclusiveAreaRef=CANNM_EXCLUSIVE_AREA_{0..6}
      Nm: RteBswImplementationRef=Nm_Impl, RteBswModuleConfigurationRef=Nm
        4 x RteBswExclusiveAreaImpl, all with RteExclusiveAreaImplMechanism=ALL_INTERRUPT_BLOCKING:
          NM_EXCLUSIVE_AREA_{0..3}: RteBswExclusiveAreaRef=NM_EXCLUSIVE_AREA_{0..3}
    PowerMng_SWC_EcuSwComposition (RteSwComponentInstance): RteSoftwareComponentInstanceRef=PowerMng_SWC
      TMT_Led_Runnable1000ms (RteEventToTaskMapping):
        RteImmediateRestart = false
        RtePositionInTask = 1
        RteEventRef = TMT_Led_Runnable1000ms
        RteMappedToTaskRef = Core0_AswTask
        RteUsedOsEventRef = Rte_Ev_Run_PowerMng_SWC_Led_Runnable1000ms
        RteUsedOsAlarmRef = Rte_Al_TE_PowerMng_SWC_Led_Runnable1000ms
      PowerMng_SWC_InitEvent (RteEventToTaskMapping): RteImmediateRestart=false, RtePositionInTask=1, RteEventRef=PowerMng_SWC_InitEvent, RteMappedToTaskRef=Core0_AswInit
    PowerMng_SWC (RteSwComponentType): RteComponentTypeRef=PowerMng_SWC, RteImplementationRef=PowerMng_SWC_Implementation
      ComponentTypeCalibration (RteComponentTypeCalibration): RteCalibrationSupportEnabled=false
    Com_SWC_EcuSwComposition (RteSwComponentInstance): RteSoftwareComponentInstanceRef=Com_SWC
      5 x RteEventToTaskMapping, all with RteImmediateRestart=false:
        DRT_Rte_Msg200h_Rx_Notification_VcuRxMsg1_Sig0_VcuRxMsg1_Sig0: RtePositionInTask=3, RteEventRef=DRT_Rte_Msg200h_Rx_Notification_VcuRxMsg1_Sig0_VcuRxMsg1_Sig0, RteMappedToTaskRef=Core0_AswTask, RteUsedOsEventRef=Rte_Ev_Run_Com_SWC_Rte_Msg200h_Rx_Notification
        DRT_Rte_Msg201h_Rx_Notification_VcuRxMsg2_Sig0_VcuRxMsg2_Sig0: RtePositionInTask=4, RteEventRef=DRT_Rte_Msg201h_Rx_Notification_VcuRxMsg2_Sig0_VcuRxMsg2_Sig0, RteMappedToTaskRef=Core0_AswTask, RteUsedOsEventRef=Rte_Ev_Run_Com_SWC_Rte_Msg201h_Rx_Notification
        TMT_Com_Runnable_2ms: RtePositionInTask=2, RteEventRef=TMT_Com_Runnable_2ms, RteMappedToTaskRef=Core0_AswTask, RteUsedOsEventRef=Rte_Ev_Run_Com_SWC_Com_Runnable_2ms, RteUsedOsAlarmRef=Rte_Al_TE_Com_SWC_Com_Runnable_2ms
        TMT_Com_Runnable_20ms: RtePositionInTask=9, RteEventRef=TMT_Com_Runnable_20ms, RteMappedToTaskRef=Core0_AswTask, RteUsedOsEventRef=Rte_Ev_Run_Com_SWC_Com_Runnable_20ms, RteUsedOsAlarmRef=Rte_Al_TE_Com_SWC_Com_Runnable_20ms
        Com_SWC_InitEvent: RtePositionInTask=4, RteEventRef=Com_SWC_InitEvent, RteMappedToTaskRef=Core0_AswInit
    Com_SWC (RteSwComponentType): RteComponentTypeRef=Com_SWC, RteImplementationRef=Com_SWC_Implementation
      ComponentTypeCalibration (RteComponentTypeCalibration): RteCalibrationSupportEnabled=false
    3 x RteBswModuleInstance:
      Fee: RteBswImplementationRef=Fee_Impl, RteBswModuleConfigurationRef=Fee
        Fee_MainFunctionTimingEvent0 (RteBswEventToTaskMapping):
          RteBswImmediateRestart = false
          RteBswPositionInTask = 11
          RteBswEventRef = Fee_MainFunctionTimingEvent0
          RteBswMappedToTaskRef = Core0_BswTask
          RteBswUsedOsEventRef = Rte_Ev_Cyclic2_Core0_BswTask_0_10ms
          RteBswUsedOsAlarmRef = Rte_Al_TE2_Core0_BswTask_0_10ms
      Fls: RteBswImplementationRef=Fls_Impl, RteBswModuleConfigurationRef=Fls
        Fls_17_Dmu_MainFunctionTimingEvent0 (RteBswEventToTaskMapping):
          RteBswImmediateRestart = false
          RteBswPositionInTask = 12
          RteBswEventRef = Fls_17_Dmu_MainFunctionTimingEvent0
          RteBswMappedToTaskRef = Core0_BswTask
          RteBswUsedOsEventRef = Rte_Ev_Cyclic2_Core0_BswTask_0_10ms
          RteBswUsedOsAlarmRef = Rte_Al_TE2_Core0_BswTask_0_10ms
        6 x RteBswExclusiveAreaImpl, all with RteExclusiveAreaImplMechanism=ALL_INTERRUPT_BLOCKING:
          Init: RteBswExclusiveAreaRef=Init
          Erase: RteBswExclusiveAreaRef=Erase
          Write: RteBswExclusiveAreaRef=Write
          Main: RteBswExclusiveAreaRef=Main
          ResumeErase: RteBswExclusiveAreaRef=ResumeErase
          UserContentCount: RteBswExclusiveAreaRef=UserContentCount
      NvM: RteBswImplementationRef=NvM_Impl, RteBswModuleConfigurationRef=NvM
        NvM_MainFunctionTimingEvent0 (RteBswEventToTaskMapping):
          RteBswImmediateRestart = false
          RteBswPositionInTask = 13
          RteBswEventRef = NvM_MainFunctionTimingEvent0
          RteBswMappedToTaskRef = Core0_BswTask
          RteBswUsedOsEventRef = Rte_Ev_Cyclic2_Core0_BswTask_0_10ms
          RteBswUsedOsAlarmRef = Rte_Al_TE2_Core0_BswTask_0_10ms
        NVM_EXCLUSIVE_AREA_0 (RteBswExclusiveAreaImpl): RteExclusiveAreaImplMechanism=ALL_INTERRUPT_BLOCKING, RteBswExclusiveAreaRef=NVM_EXCLUSIVE_AREA_0
    NvM_EcuSwComposition (RteSwComponentInstance): RteSoftwareComponentInstanceRef=NvM
      33 x RteEventToTaskMapping, all with RteImmediateRestart=false:
        Timer_NvM_MainFunction: RtePositionInTask=13, RteEventRef=Timer_NvM_MainFunction, RteMappedToTaskRef=Core0_BswTask, RteUsedOsEventRef=Rte_Ev_Cyclic2_Core0_BswTask_0_10ms, RteUsedOsAlarmRef=Rte_Al_TE2_Core0_BswTask_0_10ms
        OpEventGetErrorStatus_GetErrorStatus_PS_SWC1NvBlockNeed_UserData3: RteEventRef=OpEventGetErrorStatus_GetErrorStatus_PS_SWC1NvBlockNeed_UserData3
        OpEventSetRamBlockStatus_SetRamBlockStatus_PS_SWC1NvBlockNeed_UserData3: RteEventRef=OpEventSetRamBlockStatus_SetRamBlockStatus_PS_SWC1NvBlockNeed_UserData3
        OpEventReadBlock_ReadBlock_PS_SWC1NvBlockNeed_UserData3: RteEventRef=OpEventReadBlock_ReadBlock_PS_SWC1NvBlockNeed_UserData3
        OpEventWriteBlock_WriteBlock_PS_SWC1NvBlockNeed_UserData3: RteEventRef=OpEventWriteBlock_WriteBlock_PS_SWC1NvBlockNeed_UserData3
        OpEventRestoreBlockDefaults_RestoreBlockDefaults_PS_SWC1NvBlockNeed_UserData3: RteEventRef=OpEventRestoreBlockDefaults_RestoreBlockDefaults_PS_SWC1NvBlockNeed_UserData3
        OpEventInvalidateNvBlock_InvalidateNvBlock_PS_SWC1NvBlockNeed_UserData3: RteEventRef=OpEventInvalidateNvBlock_InvalidateNvBlock_PS_SWC1NvBlockNeed_UserData3
        OpEventEraseBlock_EraseBlock_PS_SWC1NvBlockNeed_UserData3: RteEventRef=OpEventEraseBlock_EraseBlock_PS_SWC1NvBlockNeed_UserData3
        OpEventSetBlockProtection_SetBlockProtection_PAdmin_SWC1NvBlockNeed_UserData3: RteEventRef=OpEventSetBlockProtection_SetBlockProtection_PAdmin_SWC1NvBlockNeed_UserData3
        OpEventGetErrorStatus_GetErrorStatus_PS_DIAG_SWC_NvBlockNeed_DiagDID_00: RteEventRef=OpEventGetErrorStatus_GetErrorStatus_PS_DIAG_SWC_NvBlockNeed_DiagDID_00
        OpEventSetRamBlockStatus_SetRamBlockStatus_PS_DIAG_SWC_NvBlockNeed_DiagDID_00: RteEventRef=OpEventSetRamBlockStatus_SetRamBlockStatus_PS_DIAG_SWC_NvBlockNeed_DiagDID_00
        OpEventReadBlock_ReadBlock_PS_DIAG_SWC_NvBlockNeed_DiagDID_00: RteEventRef=OpEventReadBlock_ReadBlock_PS_DIAG_SWC_NvBlockNeed_DiagDID_00
        OpEventWriteBlock_WriteBlock_PS_DIAG_SWC_NvBlockNeed_DiagDID_00: RteEventRef=OpEventWriteBlock_WriteBlock_PS_DIAG_SWC_NvBlockNeed_DiagDID_00
        OpEventRestoreBlockDefaults_RestoreBlockDefaults_PS_DIAG_SWC_NvBlockNeed_DiagDID_00: RteEventRef=OpEventRestoreBlockDefaults_RestoreBlockDefaults_PS_DIAG_SWC_NvBlockNeed_DiagDID_00
        OpEventInvalidateNvBlock_InvalidateNvBlock_PS_DIAG_SWC_NvBlockNeed_DiagDID_00: RteEventRef=OpEventInvalidateNvBlock_InvalidateNvBlock_PS_DIAG_SWC_NvBlockNeed_DiagDID_00
        OpEventEraseBlock_EraseBlock_PS_DIAG_SWC_NvBlockNeed_DiagDID_00: RteEventRef=OpEventEraseBlock_EraseBlock_PS_DIAG_SWC_NvBlockNeed_DiagDID_00
        OpEventSetBlockProtection_SetBlockProtection_PAdmin_DIAG_SWC_NvBlockNeed_DiagDID_00: RteEventRef=OpEventSetBlockProtection_SetBlockProtection_PAdmin_DIAG_SWC_NvBlockNeed_DiagDID_00
        OpEventGetErrorStatus_GetErrorStatus_PS_DIAG_SWC_NvBlockNeed_AttemptCounter: RteEventRef=OpEventGetErrorStatus_GetErrorStatus_PS_DIAG_SWC_NvBlockNeed_AttemptCounter
        OpEventSetRamBlockStatus_SetRamBlockStatus_PS_DIAG_SWC_NvBlockNeed_AttemptCounter: RteEventRef=OpEventSetRamBlockStatus_SetRamBlockStatus_PS_DIAG_SWC_NvBlockNeed_AttemptCounter
        OpEventReadBlock_ReadBlock_PS_DIAG_SWC_NvBlockNeed_AttemptCounter: RteEventRef=OpEventReadBlock_ReadBlock_PS_DIAG_SWC_NvBlockNeed_AttemptCounter
        OpEventWriteBlock_WriteBlock_PS_DIAG_SWC_NvBlockNeed_AttemptCounter: RteEventRef=OpEventWriteBlock_WriteBlock_PS_DIAG_SWC_NvBlockNeed_AttemptCounter
        OpEventRestoreBlockDefaults_RestoreBlockDefaults_PS_DIAG_SWC_NvBlockNeed_AttemptCounter: RteEventRef=OpEventRestoreBlockDefaults_RestoreBlockDefaults_PS_DIAG_SWC_NvBlockNeed_AttemptCounter
        OpEventInvalidateNvBlock_InvalidateNvBlock_PS_DIAG_SWC_NvBlockNeed_AttemptCounter: RteEventRef=OpEventInvalidateNvBlock_InvalidateNvBlock_PS_DIAG_SWC_NvBlockNeed_AttemptCounter
        OpEventEraseBlock_EraseBlock_PS_DIAG_SWC_NvBlockNeed_AttemptCounter: RteEventRef=OpEventEraseBlock_EraseBlock_PS_DIAG_SWC_NvBlockNeed_AttemptCounter
        OpEventSetBlockProtection_SetBlockProtection_PAdmin_DIAG_SWC_NvBlockNeed_AttemptCounter: RteEventRef=OpEventSetBlockProtection_SetBlockProtection_PAdmin_DIAG_SWC_NvBlockNeed_AttemptCounter
        OpEventGetErrorStatus_GetErrorStatus_PS_DIAG_SWC_NvBlockNeed_DID_F193: RteEventRef=OpEventGetErrorStatus_GetErrorStatus_PS_DIAG_SWC_NvBlockNeed_DID_F193
        OpEventSetRamBlockStatus_SetRamBlockStatus_PS_DIAG_SWC_NvBlockNeed_DID_F193: RteEventRef=OpEventSetRamBlockStatus_SetRamBlockStatus_PS_DIAG_SWC_NvBlockNeed_DID_F193
        OpEventReadBlock_ReadBlock_PS_DIAG_SWC_NvBlockNeed_DID_F193: RteEventRef=OpEventReadBlock_ReadBlock_PS_DIAG_SWC_NvBlockNeed_DID_F193
        OpEventWriteBlock_WriteBlock_PS_DIAG_SWC_NvBlockNeed_DID_F193: RteEventRef=OpEventWriteBlock_WriteBlock_PS_DIAG_SWC_NvBlockNeed_DID_F193
        OpEventRestoreBlockDefaults_RestoreBlockDefaults_PS_DIAG_SWC_NvBlockNeed_DID_F193: RteEventRef=OpEventRestoreBlockDefaults_RestoreBlockDefaults_PS_DIAG_SWC_NvBlockNeed_DID_F193
        OpEventInvalidateNvBlock_InvalidateNvBlock_PS_DIAG_SWC_NvBlockNeed_DID_F193: RteEventRef=OpEventInvalidateNvBlock_InvalidateNvBlock_PS_DIAG_SWC_NvBlockNeed_DID_F193
        OpEventEraseBlock_EraseBlock_PS_DIAG_SWC_NvBlockNeed_DID_F193: RteEventRef=OpEventEraseBlock_EraseBlock_PS_DIAG_SWC_NvBlockNeed_DID_F193
        OpEventSetBlockProtection_SetBlockProtection_PAdmin_DIAG_SWC_NvBlockNeed_DID_F193: RteEventRef=OpEventSetBlockProtection_SetBlockProtection_PAdmin_DIAG_SWC_NvBlockNeed_DID_F193
    NvM_SWC_EcuSwComposition (RteSwComponentInstance): RteSoftwareComponentInstanceRef=NvM_SWC
      NvmBlock_NvM_SWC_NVNeed_NVBlockDescriptor_UserData1 (RteNvRamAllocation):
        RteNvmRomBlockLocationSymbol = Rte_NvM_SWC_NVBlockDescriptor_UserData1_ROM_NVBlockDescriptor_UserData1
        RteNvmBlockRef = NvM_SWC_NVBlockDescriptor_UserData1
        RteSwNvBlockDescriptorRef = NVBlockDescriptor_UserData1
      DRT_NvM_SWC_Runnable_NvM_Data_IF_UserData1_Recv_Element_UserData1 (RteEventToTaskMapping):
        RteImmediateRestart = false
        RtePositionInTask = 5
        RteEventRef = DRT_NvM_SWC_Runnable_NvM_Data_IF_UserData1_Recv_Element_UserData1
        RteMappedToTaskRef = Core0_AswTask
      NvmBlock_NvM_SWC_NVNeed_NVBlockDescriptor_UserData2 (RteNvRamAllocation):
        RteNvmRomBlockLocationSymbol = Rte_NvM_SWC_NVBlockDescriptor_UserData2_ROM_NVBlockDescriptor_UserData2
        RteNvmBlockRef = NvM_SWC_NVBlockDescriptor_UserData2
        RteSwNvBlockDescriptorRef = NVBlockDescriptor_UserData2
      7 x RteEventToTaskMapping, all with RteImmediateRestart=false:
        DRT_NvM_SWC_UserData2_Runnable_NvM_Data_IF_UserData2_Rcev_Element_UserData2: RtePositionInTask=6, RteEventRef=DRT_NvM_SWC_UserData2_Runnable_NvM_Data_IF_UserData2_Rcev_Element_UserData2, RteMappedToTaskRef=Core0_AswTask
        OIT_NvMService_NVBlockDescriptor_UserData2_WriteBlock_NvMService_NVBlockDescriptor_UserData2_WriteBlock: RteEventRef=OIT_NvMService_NVBlockDescriptor_UserData2_WriteBlock_NvMService_NVBlockDescriptor_UserData2_WriteBlock
        OIT_NvMService_NVBlockDescriptor_UserData2_SetRamBlockStatus_NvMService_NVBlockDescriptor_UserData2_SetRamBlockStatus: RteEventRef=OIT_NvMService_NVBlockDescriptor_UserData2_SetRamBlockStatus_NvMService_NVBlockDescriptor_UserData2_SetRamBlockStatus
        OIT_NvMService_NVBlockDescriptor_UserData2_ReadBlock_NvMService_NVBlockDescriptor_UserData2_ReadBlock: RteEventRef=OIT_NvMService_NVBlockDescriptor_UserData2_ReadBlock_NvMService_NVBlockDescriptor_UserData2_ReadBlock
        OIT_NvMService_NVBlockDescriptor_UserData2_InvalidateNvBlock_NvMService_NVBlockDescriptor_UserData2_InvalidateNvBlock: RteEventRef=OIT_NvMService_NVBlockDescriptor_UserData2_InvalidateNvBlock_NvMService_NVBlockDescriptor_UserData2_InvalidateNvBlock
        OIT_NvMService_NVBlockDescriptor_UserData2_GetErrorStatus_NvMService_NVBlockDescriptor_UserData2_GetErrorStatus: RteEventRef=OIT_NvMService_NVBlockDescriptor_UserData2_GetErrorStatus_NvMService_NVBlockDescriptor_UserData2_GetErrorStatus
        OIT_NvMService_NVBlockDescriptor_UserData2_EraseBlock_NvMService_NVBlockDescriptor_UserData2_EraseBlock: RteEventRef=OIT_NvMService_NVBlockDescriptor_UserData2_EraseBlock_NvMService_NVBlockDescriptor_UserData2_EraseBlock
    NvM_SWC (RteSwComponentType): RteComponentTypeRef=NvM_SWC, RteImplementationRef=NvM_SWC_Implementation
      ComponentTypeCalibration (RteComponentTypeCalibration): RteCalibrationSupportEnabled=false
    4 x RteBswModuleInstance:
      Xcp: RteBswImplementationRef=Xcp_Impl, RteBswModuleConfigurationRef=Xcp
        Xcp_MainFunctionTimingEvent0 (RteBswEventToTaskMapping):
          RteBswImmediateRestart = false
          RteBswPositionInTask = 15
          RteBswEventRef = Xcp_MainFunctionTimingEvent0
          RteBswMappedToTaskRef = Core0_BswTask
          RteBswUsedOsEventRef = Rte_Ev_Cyclic2_Core0_BswTask_0_5ms
          RteBswUsedOsAlarmRef = Rte_Al_TE2_Core0_BswTask_0_5ms
        CanXcp_MainFunctionTimingEvent0 (RteBswEventToTaskMapping):
          RteBswImmediateRestart = false
          RteBswPositionInTask = 14
          RteBswEventRef = CanXcp_MainFunctionTimingEvent0
          RteBswMappedToTaskRef = Core0_BswTask
          RteBswUsedOsEventRef = Rte_Ev_Cyclic2_Core0_BswTask_0_5ms
          RteBswUsedOsAlarmRef = Rte_Al_TE2_Core0_BswTask_0_5ms
        8 x RteBswExclusiveAreaImpl, all with RteExclusiveAreaImplMechanism=ALL_INTERRUPT_BLOCKING:
          XCP_EXCLUSIVE_AREA_{0..2}: RteBswExclusiveAreaRef=XCP_EXCLUSIVE_AREA_{0..2}
          CANXCP_EXCLUSIVE_AREA_0: RteBswExclusiveAreaRef=CANXCP_EXCLUSIVE_AREA_0
          FRXCP_EXCLUSIVE_AREA_{0..2}: RteBswExclusiveAreaRef=FRXCP_EXCLUSIVE_AREA_{0..2}
          TCPIPXCP_EXCLUSIVE_AREA_0: RteBswExclusiveAreaRef=TCPIPXCP_EXCLUSIVE_AREA_0
      CanTp: RteBswImplementationRef=CanTp_Impl, RteBswModuleConfigurationRef=CanTp
        CanTp_MainFunctionTimingEvent0 (RteBswEventToTaskMapping):
          RteBswImmediateRestart = false
          RteBswPositionInTask = 16
          RteBswEventRef = CanTp_MainFunctionTimingEvent0
          RteBswMappedToTaskRef = Core0_BswTask
          RteBswUsedOsEventRef = Rte_Ev_Cyclic2_Core0_BswTask_0_5ms
          RteBswUsedOsAlarmRef = Rte_Al_TE2_Core0_BswTask_0_5ms
        CANTP_EXCLUSIVE_AREA_0 (RteBswExclusiveAreaImpl): RteExclusiveAreaImplMechanism=ALL_INTERRUPT_BLOCKING, RteBswExclusiveAreaRef=CANTP_EXCLUSIVE_AREA_0
      Dcm: RteBswImplementationRef=Dcm_Impl, RteBswModuleConfigurationRef=Dcm
        Dcm_MainFunctionTimingEvent0 (RteBswEventToTaskMapping):
          RteBswImmediateRestart = false
          RteBswPositionInTask = 17
          RteBswEventRef = Dcm_MainFunctionTimingEvent0
          RteBswMappedToTaskRef = Core0_BswTask
          RteBswUsedOsEventRef = Rte_Ev_Cyclic2_Core0_BswTask_0_10ms
          RteBswUsedOsAlarmRef = Rte_Al_TE2_Core0_BswTask_0_10ms
        DCM_EXCLUSIVE_AREA_0 (RteBswExclusiveAreaImpl): RteExclusiveAreaImplMechanism=ALL_INTERRUPT_BLOCKING, RteBswExclusiveAreaRef=DCM_EXCLUSIVE_AREA_0
      Dem: RteBswImplementationRef=Dem_Impl, RteBswModuleConfigurationRef=Dem
        Dem_MasterMainFunctionTimingEvent0 (RteBswEventToTaskMapping):
          RteBswImmediateRestart = false
          RteBswPositionInTask = 18
          RteBswEventRef = Dem_MasterMainFunctionTimingEvent0
          RteBswMappedToTaskRef = Core0_BswTask
          RteBswUsedOsEventRef = Rte_Ev_Cyclic2_Core0_BswTask_0_10ms
          RteBswUsedOsAlarmRef = Rte_Al_TE2_Core0_BswTask_0_10ms
        Dem_SatelliteMainFunctionTimingEvent0 (RteBswEventToTaskMapping):
          RteBswImmediateRestart = false
          RteBswPositionInTask = 19
          RteBswEventRef = Dem_SatelliteMainFunctionTimingEvent0
          RteBswMappedToTaskRef = Core0_BswTask
          RteBswUsedOsEventRef = Rte_Ev_Cyclic2_Core0_BswTask_0_10ms
          RteBswUsedOsAlarmRef = Rte_Al_TE2_Core0_BswTask_0_10ms
        5 x RteBswExclusiveAreaImpl, all with RteExclusiveAreaImplMechanism=ALL_INTERRUPT_BLOCKING:
          DEM_EXCLUSIVE_AREA_{0..4}: RteBswExclusiveAreaRef=DEM_EXCLUSIVE_AREA_{0..4}
    4 x RteSwComponentInstance:
      DemMaster_0_EcuSwComposition: RteSoftwareComponentInstanceRef=DemMaster_0
        26 x RteEventToTaskMapping, all with RteImmediateRestart=false:
          Timer_Dem_MasterMainFunction: RtePositionInTask=18, RteEventRef=Timer_Dem_MasterMainFunction, RteMappedToTaskRef=Core0_BswTask, RteUsedOsEventRef=Rte_Ev_Cyclic2_Core0_BswTask_0_10ms, RteUsedOsAlarmRef=Rte_Al_TE2_Core0_BswTask_0_10ms
          OpEventPostRunRequested_GetPostRunRequested_DemServices: RteEventRef=OpEventPostRunRequested_GetPostRunRequested_DemServices
          OpEventGetDTCStatusAvailabilityMask_GetDTCStatusAvailabilityMask_DemServices: RteEventRef=OpEventGetDTCStatusAvailabilityMask_GetDTCStatusAvailabilityMask_DemServices
          OpEventGetIndicatorStatus_GetIndicatorStatus_IndStatus_WarningIndicator: RteEventRef=OpEventGetIndicatorStatus_GetIndicatorStatus_IndStatus_WarningIndicator
          OpEventGetEventUdsStatus_GetEventUdsStatus_GeneralEvtInfo: RteEventRef=OpEventGetEventUdsStatus_GetEventUdsStatus_GeneralEvtInfo
          OpEventGetEventStatus_GetEventStatus_GeneralEvtInfo: RteEventRef=OpEventGetEventStatus_GetEventStatus_GeneralEvtInfo
          OpEventGetEventFailed_GetEventFailed_GeneralEvtInfo: RteEventRef=OpEventGetEventFailed_GetEventFailed_GeneralEvtInfo
          OpEventGetEventTested_GetEventTested_GeneralEvtInfo: RteEventRef=OpEventGetEventTested_GetEventTested_GeneralEvtInfo
          OpEventGetDTCOfEvent_GetDTCOfEvent_GeneralEvtInfo: RteEventRef=OpEventGetDTCOfEvent_GetDTCOfEvent_GeneralEvtInfo
          OpEventGetFaultDetectionCounter_GetFaultDetectionCounter_GeneralEvtInfo: RteEventRef=OpEventGetFaultDetectionCounter_GetFaultDetectionCounter_GeneralEvtInfo
          OpEventGetEventFreezeFrameDataEx_GetEventFreezeFrameDataEx_GeneralEvtInfo: RteEventRef=OpEventGetEventFreezeFrameDataEx_GetEventFreezeFrameDataEx_GeneralEvtInfo
          OpEventGetEventExtendedDataRecordEx_GetEventExtendedDataRecordEx_GeneralEvtInfo: RteEventRef=OpEventGetEventExtendedDataRecordEx_GetEventExtendedDataRecordEx_GeneralEvtInfo
          OpEventGetEventEnableCondition_GetEventEnableCondition_GeneralEvtInfo: RteEventRef=OpEventGetEventEnableCondition_GetEventEnableCondition_GeneralEvtInfo
          OpEventGetDebouncingOfEvent_GetDebouncingOfEvent_GeneralEvtInfo: RteEventRef=OpEventGetDebouncingOfEvent_GetDebouncingOfEvent_GeneralEvtInfo
          OpEventGetMonitorStatus_GetMonitorStatus_GeneralEvtInfo: RteEventRef=OpEventGetMonitorStatus_GetMonitorStatus_GeneralEvtInfo
          OpEventGetOperationCycleState_GetOperationCycleState_OpCycle_PowerCycle: RteEventRef=OpEventGetOperationCycleState_GetOperationCycleState_OpCycle_PowerCycle
          OpEventSetOperationCycleState_SetOperationCycleState_OpCycle_PowerCycle: RteEventRef=OpEventSetOperationCycleState_SetOperationCycleState_OpCycle_PowerCycle
          OpEventClearDTC_ClearDTC_ClearDTC_DemClient: RteEventRef=OpEventClearDTC_ClearDTC_ClearDTC_DemClient
          OpEventSelectDTC_SelectDTC_ClearDTC_DemClient: RteEventRef=OpEventSelectDTC_SelectDTC_ClearDTC_DemClient
          OpEventGetEventMemoryOverflow_GetEventMemoryOverflow_OverflowIndPrimaryMemory_DemClient: RteEventRef=OpEventGetEventMemoryOverflow_GetEventMemoryOverflow_OverflowIndPrimaryMemory_DemClient
          OpEventGetNumberOfEventMemoryEntries_GetNumberOfEventMemoryEntries_OverflowIndPrimaryMemory_DemClient: RteEventRef=OpEventGetNumberOfEventMemoryEntries_GetNumberOfEventMemoryEntries_OverflowIndPrimaryMemory_DemClient
          OpEventSetEnableCondition_SetEnableCondition_EnableCond_Example_EnableCondition2: RteEventRef=OpEventSetEnableCondition_SetEnableCondition_EnableCond_Example_EnableCondition2
          OpEventSetEnableCondition_SetEnableCondition_EnableCond_Example_EnableCondition1: RteEventRef=OpEventSetEnableCondition_SetEnableCondition_EnableCond_Example_EnableCondition1
          OpEventSetEnableCondition_SetEnableCondition_EnableCond_KL15_High: RteEventRef=OpEventSetEnableCondition_SetEnableCondition_EnableCond_KL15_High
          OpEventGetOperationCycleState_GetOperationCycleState_OpCycle_IgnitionCycle: RteEventRef=OpEventGetOperationCycleState_GetOperationCycleState_OpCycle_IgnitionCycle
          OpEventSetOperationCycleState_SetOperationCycleState_OpCycle_IgnitionCycle: RteEventRef=OpEventSetOperationCycleState_SetOperationCycleState_OpCycle_IgnitionCycle
      DemSatellite_0_EcuSwComposition: RteSoftwareComponentInstanceRef=DemSatellite_0
        111 x RteEventToTaskMapping, all with RteImmediateRestart=false:
          Timer_Dem_SatelliteMainFunction: RtePositionInTask=19, RteEventRef=Timer_Dem_SatelliteMainFunction, RteMappedToTaskRef=Core0_BswTask, RteUsedOsEventRef=Rte_Ev_Cyclic2_Core0_BswTask_0_10ms, RteUsedOsAlarmRef=Rte_Al_TE2_Core0_BswTask_0_10ms
          OpEventGetEventUdsStatus_GetEventUdsStatus_GeneralEvtInfo: RteEventRef=OpEventGetEventUdsStatus_GetEventUdsStatus_GeneralEvtInfo
          OpEventGetEventStatus_GetEventStatus_GeneralEvtInfo: RteEventRef=OpEventGetEventStatus_GetEventStatus_GeneralEvtInfo
          OpEventGetEventFailed_GetEventFailed_GeneralEvtInfo: RteEventRef=OpEventGetEventFailed_GetEventFailed_GeneralEvtInfo
          OpEventGetEventTested_GetEventTested_GeneralEvtInfo: RteEventRef=OpEventGetEventTested_GetEventTested_GeneralEvtInfo
          OpEventGetDTCOfEvent_GetDTCOfEvent_GeneralEvtInfo: RteEventRef=OpEventGetDTCOfEvent_GetDTCOfEvent_GeneralEvtInfo
          OpEventGetFaultDetectionCounter_GetFaultDetectionCounter_GeneralEvtInfo: RteEventRef=OpEventGetFaultDetectionCounter_GetFaultDetectionCounter_GeneralEvtInfo
          OpEventGetEventFreezeFrameDataEx_GetEventFreezeFrameDataEx_GeneralEvtInfo: RteEventRef=OpEventGetEventFreezeFrameDataEx_GetEventFreezeFrameDataEx_GeneralEvtInfo
          OpEventGetEventExtendedDataRecordEx_GetEventExtendedDataRecordEx_GeneralEvtInfo: RteEventRef=OpEventGetEventExtendedDataRecordEx_GetEventExtendedDataRecordEx_GeneralEvtInfo
          OpEventGetEventEnableCondition_GetEventEnableCondition_GeneralEvtInfo: RteEventRef=OpEventGetEventEnableCondition_GetEventEnableCondition_GeneralEvtInfo
          OpEventGetDebouncingOfEvent_GetDebouncingOfEvent_GeneralEvtInfo: RteEventRef=OpEventGetDebouncingOfEvent_GetDebouncingOfEvent_GeneralEvtInfo
          OpEventGetMonitorStatus_GetMonitorStatus_GeneralEvtInfo: RteEventRef=OpEventGetMonitorStatus_GetMonitorStatus_GeneralEvtInfo
          OpEventGetEventUdsStatus_GetEventUdsStatus_EvtInfo_DTC_0X000002_001: RteEventRef=OpEventGetEventUdsStatus_GetEventUdsStatus_EvtInfo_DTC_0X000002
          OpEventGetEventUdsStatus_GetEventUdsStatus_Event_DTC_0X000002_001: RteEventRef=OpEventGetEventUdsStatus_GetEventUdsStatus_Event_DTC_0X000002
          OpEventGetEventUdsStatus_GetEventUdsStatus_EvtInfo_DTC_0X000004: RteEventRef=OpEventGetEventUdsStatus_GetEventUdsStatus_EvtInfo_DTC_0X000004
          OpEventGetEventUdsStatus_GetEventUdsStatus_Event_DTC_0X000004: RteEventRef=OpEventGetEventUdsStatus_GetEventUdsStatus_Event_DTC_0X000004
          OpEventGetEventUdsStatus_GetEventUdsStatus_EvtInfo_DTC_0X000003_001: RteEventRef=OpEventGetEventUdsStatus_GetEventUdsStatus_EvtInfo_DTC_0X000003
          OpEventGetEventUdsStatus_GetEventUdsStatus_Event_DTC_0X000003_001: RteEventRef=OpEventGetEventUdsStatus_GetEventUdsStatus_Event_DTC_0X000003
          OpEventGetEventStatus_GetEventStatus_EvtInfo_DTC_0X000002_001: RteEventRef=OpEventGetEventStatus_GetEventStatus_EvtInfo_DTC_0X000002
          OpEventGetEventStatus_GetEventStatus_Event_DTC_0X000002_001: RteEventRef=OpEventGetEventStatus_GetEventStatus_Event_DTC_0X000002
          OpEventGetEventStatus_GetEventStatus_EvtInfo_DTC_0X000004: RteEventRef=OpEventGetEventStatus_GetEventStatus_EvtInfo_DTC_0X000004
          OpEventGetEventStatus_GetEventStatus_Event_DTC_0X000004: RteEventRef=OpEventGetEventStatus_GetEventStatus_Event_DTC_0X000004
          OpEventGetEventStatus_GetEventStatus_EvtInfo_DTC_0X000003_001: RteEventRef=OpEventGetEventStatus_GetEventStatus_EvtInfo_DTC_0X000003
          OpEventGetEventStatus_GetEventStatus_Event_DTC_0X000003_001: RteEventRef=OpEventGetEventStatus_GetEventStatus_Event_DTC_0X000003
          OpEventGetEventFailed_GetEventFailed_EvtInfo_DTC_0X000002_001: RteEventRef=OpEventGetEventFailed_GetEventFailed_EvtInfo_DTC_0X000002
          OpEventGetEventFailed_GetEventFailed_Event_DTC_0X000002_001: RteEventRef=OpEventGetEventFailed_GetEventFailed_Event_DTC_0X000002
          OpEventGetEventFailed_GetEventFailed_EvtInfo_DTC_0X000004: RteEventRef=OpEventGetEventFailed_GetEventFailed_EvtInfo_DTC_0X000004
          OpEventGetEventFailed_GetEventFailed_Event_DTC_0X000004: RteEventRef=OpEventGetEventFailed_GetEventFailed_Event_DTC_0X000004
          OpEventGetEventFailed_GetEventFailed_EvtInfo_DTC_0X000003_001: RteEventRef=OpEventGetEventFailed_GetEventFailed_EvtInfo_DTC_0X000003
          OpEventGetEventFailed_GetEventFailed_Event_DTC_0X000003_001: RteEventRef=OpEventGetEventFailed_GetEventFailed_Event_DTC_0X000003
          OpEventGetEventTested_GetEventTested_EvtInfo_DTC_0X000002_001: RteEventRef=OpEventGetEventTested_GetEventTested_EvtInfo_DTC_0X000002
          OpEventGetEventTested_GetEventTested_Event_DTC_0X000002_001: RteEventRef=OpEventGetEventTested_GetEventTested_Event_DTC_0X000002
          OpEventGetEventTested_GetEventTested_EvtInfo_DTC_0X000004: RteEventRef=OpEventGetEventTested_GetEventTested_EvtInfo_DTC_0X000004
          OpEventGetEventTested_GetEventTested_Event_DTC_0X000004: RteEventRef=OpEventGetEventTested_GetEventTested_Event_DTC_0X000004
          OpEventGetEventTested_GetEventTested_EvtInfo_DTC_0X000003_001: RteEventRef=OpEventGetEventTested_GetEventTested_EvtInfo_DTC_0X000003
          OpEventGetEventTested_GetEventTested_Event_DTC_0X000003_001: RteEventRef=OpEventGetEventTested_GetEventTested_Event_DTC_0X000003
          OpEventGetDTCOfEvent_GetDTCOfEvent_EvtInfo_DTC_0X000002_001: RteEventRef=OpEventGetDTCOfEvent_GetDTCOfEvent_EvtInfo_DTC_0X000002
          OpEventGetDTCOfEvent_GetDTCOfEvent_Event_DTC_0X000002_001: RteEventRef=OpEventGetDTCOfEvent_GetDTCOfEvent_Event_DTC_0X000002
          OpEventGetDTCOfEvent_GetDTCOfEvent_EvtInfo_DTC_0X000004: RteEventRef=OpEventGetDTCOfEvent_GetDTCOfEvent_EvtInfo_DTC_0X000004
          OpEventGetDTCOfEvent_GetDTCOfEvent_Event_DTC_0X000004: RteEventRef=OpEventGetDTCOfEvent_GetDTCOfEvent_Event_DTC_0X000004
          OpEventGetDTCOfEvent_GetDTCOfEvent_EvtInfo_DTC_0X000003_001: RteEventRef=OpEventGetDTCOfEvent_GetDTCOfEvent_EvtInfo_DTC_0X000003
          OpEventGetDTCOfEvent_GetDTCOfEvent_Event_DTC_0X000003_001: RteEventRef=OpEventGetDTCOfEvent_GetDTCOfEvent_Event_DTC_0X000003
          OpEventGetFaultDetectionCounter_GetFaultDetectionCounter_EvtInfo_DTC_0X000002_001: RteEventRef=OpEventGetFaultDetectionCounter_GetFaultDetectionCounter_EvtInfo_DTC_0X000002
          OpEventGetFaultDetectionCounter_GetFaultDetectionCounter_Event_DTC_0X000002_001: RteEventRef=OpEventGetFaultDetectionCounter_GetFaultDetectionCounter_Event_DTC_0X000002
          OpEventGetFaultDetectionCounter_GetFaultDetectionCounter_EvtInfo_DTC_0X000004: RteEventRef=OpEventGetFaultDetectionCounter_GetFaultDetectionCounter_EvtInfo_DTC_0X000004
          OpEventGetFaultDetectionCounter_GetFaultDetectionCounter_Event_DTC_0X000004: RteEventRef=OpEventGetFaultDetectionCounter_GetFaultDetectionCounter_Event_DTC_0X000004
          OpEventGetFaultDetectionCounter_GetFaultDetectionCounter_EvtInfo_DTC_0X000003_001: RteEventRef=OpEventGetFaultDetectionCounter_GetFaultDetectionCounter_EvtInfo_DTC_0X000003
          OpEventGetFaultDetectionCounter_GetFaultDetectionCounter_Event_DTC_0X000003_001: RteEventRef=OpEventGetFaultDetectionCounter_GetFaultDetectionCounter_Event_DTC_0X000003
          OpEventGetEventFreezeFrameDataEx_GetEventFreezeFrameDataEx_EvtInfo_DTC_0X000002_001: RteEventRef=OpEventGetEventFreezeFrameDataEx_GetEventFreezeFrameDataEx_EvtInfo_DTC_0X000002
          OpEventGetEventFreezeFrameDataEx_GetEventFreezeFrameDataEx_Event_DTC_0X000002_001: RteEventRef=OpEventGetEventFreezeFrameDataEx_GetEventFreezeFrameDataEx_Event_DTC_0X000002
          OpEventGetEventFreezeFrameDataEx_GetEventFreezeFrameDataEx_EvtInfo_DTC_0X000004: RteEventRef=OpEventGetEventFreezeFrameDataEx_GetEventFreezeFrameDataEx_EvtInfo_DTC_0X000004
          OpEventGetEventFreezeFrameDataEx_GetEventFreezeFrameDataEx_Event_DTC_0X000004: RteEventRef=OpEventGetEventFreezeFrameDataEx_GetEventFreezeFrameDataEx_Event_DTC_0X000004
          OpEventGetEventFreezeFrameDataEx_GetEventFreezeFrameDataEx_EvtInfo_DTC_0X000003_001: RteEventRef=OpEventGetEventFreezeFrameDataEx_GetEventFreezeFrameDataEx_EvtInfo_DTC_0X000003
          OpEventGetEventFreezeFrameDataEx_GetEventFreezeFrameDataEx_Event_DTC_0X000003_001: RteEventRef=OpEventGetEventFreezeFrameDataEx_GetEventFreezeFrameDataEx_Event_DTC_0X000003
          OpEventGetEventExtendedDataRecordEx_GetEventExtendedDataRecordEx_EvtInfo_DTC_0X000002_001: RteEventRef=OpEventGetEventExtendedDataRecordEx_GetEventExtendedDataRecordEx_EvtInfo_DTC_0X000002
          OpEventGetEventExtendedDataRecordEx_GetEventExtendedDataRecordEx_Event_DTC_0X000002_001: RteEventRef=OpEventGetEventExtendedDataRecordEx_GetEventExtendedDataRecordEx_Event_DTC_0X000002
          OpEventGetEventExtendedDataRecordEx_GetEventExtendedDataRecordEx_EvtInfo_DTC_0X000004: RteEventRef=OpEventGetEventExtendedDataRecordEx_GetEventExtendedDataRecordEx_EvtInfo_DTC_0X000004
          OpEventGetEventExtendedDataRecordEx_GetEventExtendedDataRecordEx_Event_DTC_0X000004: RteEventRef=OpEventGetEventExtendedDataRecordEx_GetEventExtendedDataRecordEx_Event_DTC_0X000004
          OpEventGetEventExtendedDataRecordEx_GetEventExtendedDataRecordEx_EvtInfo_DTC_0X000003_001: RteEventRef=OpEventGetEventExtendedDataRecordEx_GetEventExtendedDataRecordEx_EvtInfo_DTC_0X000003
          OpEventGetEventExtendedDataRecordEx_GetEventExtendedDataRecordEx_Event_DTC_0X000003_001: RteEventRef=OpEventGetEventExtendedDataRecordEx_GetEventExtendedDataRecordEx_Event_DTC_0X000003
          OpEventGetEventEnableCondition_GetEventEnableCondition_EvtInfo_DTC_0X000002_001: RteEventRef=OpEventGetEventEnableCondition_GetEventEnableCondition_EvtInfo_DTC_0X000002
          OpEventGetEventEnableCondition_GetEventEnableCondition_EvtInfo_DTC_0X000004: RteEventRef=OpEventGetEventEnableCondition_GetEventEnableCondition_EvtInfo_DTC_0X000004
          OpEventGetEventEnableCondition_GetEventEnableCondition_EvtInfo_DTC_0X000003_001: RteEventRef=OpEventGetEventEnableCondition_GetEventEnableCondition_EvtInfo_DTC_0X000003
          OpEventGetDebouncingOfEvent_GetDebouncingOfEvent_EvtInfo_DTC_0X000002_001: RteEventRef=OpEventGetDebouncingOfEvent_GetDebouncingOfEvent_EvtInfo_DTC_0X000002
          OpEventGetDebouncingOfEvent_GetDebouncingOfEvent_EvtInfo_DTC_0X000004: RteEventRef=OpEventGetDebouncingOfEvent_GetDebouncingOfEvent_EvtInfo_DTC_0X000004
          OpEventGetDebouncingOfEvent_GetDebouncingOfEvent_EvtInfo_DTC_0X000003_001: RteEventRef=OpEventGetDebouncingOfEvent_GetDebouncingOfEvent_EvtInfo_DTC_0X000003
          OpEventGetMonitorStatus_GetMonitorStatus_EvtInfo_DTC_0X000002_001: RteEventRef=OpEventGetMonitorStatus_GetMonitorStatus_EvtInfo_DTC_0X000002
          OpEventGetMonitorStatus_GetMonitorStatus_EvtInfo_DTC_0X000004: RteEventRef=OpEventGetMonitorStatus_GetMonitorStatus_EvtInfo_DTC_0X000004
          OpEventGetMonitorStatus_GetMonitorStatus_EvtInfo_DTC_0X000003_001: RteEventRef=OpEventGetMonitorStatus_GetMonitorStatus_EvtInfo_DTC_0X000003
          OpEventSetEventStatus_SetEventStatus_Event_DTC_0X000002_001: RteEventRef=OpEventSetEventStatus_SetEventStatus_Event_DTC_0X000002
          OpEventSetEventStatus_SetEventStatus_Event_DTC_0X000004: RteEventRef=OpEventSetEventStatus_SetEventStatus_Event_DTC_0X000004
          OpEventSetEventStatus_SetEventStatus_Event_DTC_0X000003_001: RteEventRef=OpEventSetEventStatus_SetEventStatus_Event_DTC_0X000003
          OpEventResetEventStatus_ResetEventStatus_Event_DTC_0X000002_001: RteEventRef=OpEventResetEventStatus_ResetEventStatus_Event_DTC_0X000002
          OpEventResetEventStatus_ResetEventStatus_Event_DTC_0X000004: RteEventRef=OpEventResetEventStatus_ResetEventStatus_Event_DTC_0X000004
          OpEventResetEventStatus_ResetEventStatus_Event_DTC_0X000003_001: RteEventRef=OpEventResetEventStatus_ResetEventStatus_Event_DTC_0X000003
          OpEventResetEventDebounceStatus_ResetEventDebounceStatus_Event_DTC_0X000002_001: RteEventRef=OpEventResetEventDebounceStatus_ResetEventDebounceStatus_Event_DTC_0X000002
          OpEventResetEventDebounceStatus_ResetEventDebounceStatus_Event_DTC_0X000004: RteEventRef=OpEventResetEventDebounceStatus_ResetEventDebounceStatus_Event_DTC_0X000004
          OpEventResetEventDebounceStatus_ResetEventDebounceStatus_Event_DTC_0X000003_001: RteEventRef=OpEventResetEventDebounceStatus_ResetEventDebounceStatus_Event_DTC_0X000003
          OpEventGetEventUdsStatus_GetEventUdsStatus_EvtInfo_CAN00_BUSOFF: RteEventRef=OpEventGetEventUdsStatus_GetEventUdsStatus_EvtInfo_CAN00_BUSOFF
          OpEventGetEventStatus_GetEventStatus_EvtInfo_CAN00_BUSOFF: RteEventRef=OpEventGetEventStatus_GetEventStatus_EvtInfo_CAN00_BUSOFF
          OpEventGetEventFailed_GetEventFailed_EvtInfo_CAN00_BUSOFF: RteEventRef=OpEventGetEventFailed_GetEventFailed_EvtInfo_CAN00_BUSOFF
          OpEventGetEventTested_GetEventTested_EvtInfo_CAN00_BUSOFF: RteEventRef=OpEventGetEventTested_GetEventTested_EvtInfo_CAN00_BUSOFF
          OpEventGetDTCOfEvent_GetDTCOfEvent_EvtInfo_CAN00_BUSOFF: RteEventRef=OpEventGetDTCOfEvent_GetDTCOfEvent_EvtInfo_CAN00_BUSOFF
          OpEventGetFaultDetectionCounter_GetFaultDetectionCounter_EvtInfo_CAN00_BUSOFF: RteEventRef=OpEventGetFaultDetectionCounter_GetFaultDetectionCounter_EvtInfo_CAN00_BUSOFF
          OpEventGetEventFreezeFrameDataEx_GetEventFreezeFrameDataEx_EvtInfo_CAN00_BUSOFF: RteEventRef=OpEventGetEventFreezeFrameDataEx_GetEventFreezeFrameDataEx_EvtInfo_CAN00_BUSOFF
          OpEventGetEventExtendedDataRecordEx_GetEventExtendedDataRecordEx_EvtInfo_CAN00_BUSOFF: RteEventRef=OpEventGetEventExtendedDataRecordEx_GetEventExtendedDataRecordEx_EvtInfo_CAN00_BUSOFF
          OpEventGetEventEnableCondition_GetEventEnableCondition_EvtInfo_CAN00_BUSOFF: RteEventRef=OpEventGetEventEnableCondition_GetEventEnableCondition_EvtInfo_CAN00_BUSOFF
          OpEventGetDebouncingOfEvent_GetDebouncingOfEvent_EvtInfo_CAN00_BUSOFF: RteEventRef=OpEventGetDebouncingOfEvent_GetDebouncingOfEvent_EvtInfo_CAN00_BUSOFF
          OpEventGetMonitorStatus_GetMonitorStatus_EvtInfo_CAN00_BUSOFF: RteEventRef=OpEventGetMonitorStatus_GetMonitorStatus_EvtInfo_CAN00_BUSOFF
          OpEventGetEventUdsStatus_GetEventUdsStatus_EvtInfo_CAN01_ComLost: RteEventRef=OpEventGetEventUdsStatus_GetEventUdsStatus_EvtInfo_CAN01_ComLost
          OpEventGetEventUdsStatus_GetEventUdsStatus_Event_CAN01_ComLost: RteEventRef=OpEventGetEventUdsStatus_GetEventUdsStatus_Event_CAN01_ComLost
          OpEventGetEventStatus_GetEventStatus_EvtInfo_CAN01_ComLost: RteEventRef=OpEventGetEventStatus_GetEventStatus_EvtInfo_CAN01_ComLost
          OpEventGetEventStatus_GetEventStatus_Event_CAN01_ComLost: RteEventRef=OpEventGetEventStatus_GetEventStatus_Event_CAN01_ComLost
          OpEventGetEventFailed_GetEventFailed_EvtInfo_CAN01_ComLost: RteEventRef=OpEventGetEventFailed_GetEventFailed_EvtInfo_CAN01_ComLost
          OpEventGetEventFailed_GetEventFailed_Event_CAN01_ComLost: RteEventRef=OpEventGetEventFailed_GetEventFailed_Event_CAN01_ComLost
          OpEventGetEventTested_GetEventTested_EvtInfo_CAN01_ComLost: RteEventRef=OpEventGetEventTested_GetEventTested_EvtInfo_CAN01_ComLost
          OpEventGetEventTested_GetEventTested_Event_CAN01_ComLost: RteEventRef=OpEventGetEventTested_GetEventTested_Event_CAN01_ComLost
          OpEventGetDTCOfEvent_GetDTCOfEvent_EvtInfo_CAN01_ComLost: RteEventRef=OpEventGetDTCOfEvent_GetDTCOfEvent_EvtInfo_CAN01_ComLost
          OpEventGetDTCOfEvent_GetDTCOfEvent_Event_CAN01_ComLost: RteEventRef=OpEventGetDTCOfEvent_GetDTCOfEvent_Event_CAN01_ComLost
          OpEventGetFaultDetectionCounter_GetFaultDetectionCounter_EvtInfo_CAN01_ComLost: RteEventRef=OpEventGetFaultDetectionCounter_GetFaultDetectionCounter_EvtInfo_CAN01_ComLost
          OpEventGetFaultDetectionCounter_GetFaultDetectionCounter_Event_CAN01_ComLost: RteEventRef=OpEventGetFaultDetectionCounter_GetFaultDetectionCounter_Event_CAN01_ComLost
          OpEventGetEventFreezeFrameDataEx_GetEventFreezeFrameDataEx_EvtInfo_CAN01_ComLost: RteEventRef=OpEventGetEventFreezeFrameDataEx_GetEventFreezeFrameDataEx_EvtInfo_CAN01_ComLost
          OpEventGetEventFreezeFrameDataEx_GetEventFreezeFrameDataEx_Event_CAN01_ComLost: RteEventRef=OpEventGetEventFreezeFrameDataEx_GetEventFreezeFrameDataEx_Event_CAN01_ComLost
          OpEventGetEventExtendedDataRecordEx_GetEventExtendedDataRecordEx_EvtInfo_CAN01_ComLost: RteEventRef=OpEventGetEventExtendedDataRecordEx_GetEventExtendedDataRecordEx_EvtInfo_CAN01_ComLost
          OpEventGetEventExtendedDataRecordEx_GetEventExtendedDataRecordEx_Event_CAN01_ComLost: RteEventRef=OpEventGetEventExtendedDataRecordEx_GetEventExtendedDataRecordEx_Event_CAN01_ComLost
          OpEventGetEventEnableCondition_GetEventEnableCondition_EvtInfo_CAN01_ComLost: RteEventRef=OpEventGetEventEnableCondition_GetEventEnableCondition_EvtInfo_CAN01_ComLost
          OpEventGetDebouncingOfEvent_GetDebouncingOfEvent_EvtInfo_CAN01_ComLost: RteEventRef=OpEventGetDebouncingOfEvent_GetDebouncingOfEvent_EvtInfo_CAN01_ComLost
          OpEventGetMonitorStatus_GetMonitorStatus_EvtInfo_CAN01_ComLost: RteEventRef=OpEventGetMonitorStatus_GetMonitorStatus_EvtInfo_CAN01_ComLost
          OpEventSetEventStatus_SetEventStatus_Event_CAN01_ComLost: RteEventRef=OpEventSetEventStatus_SetEventStatus_Event_CAN01_ComLost
          OpEventResetEventStatus_ResetEventStatus_Event_CAN01_ComLost: RteEventRef=OpEventResetEventStatus_ResetEventStatus_Event_CAN01_ComLost
          OpEventResetEventDebounceStatus_ResetEventDebounceStatus_Event_CAN01_ComLost: RteEventRef=OpEventResetEventDebounceStatus_ResetEventDebounceStatus_Event_CAN01_ComLost
      Dcm_EcuSwComposition: RteSoftwareComponentInstanceRef=Dcm
        7 x RteEventToTaskMapping, all with RteImmediateRestart=false:
          Timer_Dcm_MainFunction: RtePositionInTask=17, RteEventRef=Timer_Dcm_MainFunction, RteMappedToTaskRef=Core0_BswTask, RteUsedOsEventRef=Rte_Ev_Cyclic2_Core0_BswTask_0_10ms, RteUsedOsAlarmRef=Rte_Al_TE2_Core0_BswTask_0_10ms
          OpEventGetActiveProtocol_GetActiveProtocol_DCMServices: RteEventRef=OpEventGetActiveProtocol_GetActiveProtocol_DCMServices
          OpEventGetSesCtrlType_GetSesCtrlType_DCMServices: RteEventRef=OpEventGetSesCtrlType_GetSesCtrlType_DCMServices
          OpEventResetToDefaultSession_ResetToDefaultSession_DCMServices: RteEventRef=OpEventResetToDefaultSession_ResetToDefaultSession_DCMServices
          OpEventGetSecurityLevel_GetSecurityLevel_DCMServices: RteEventRef=OpEventGetSecurityLevel_GetSecurityLevel_DCMServices
          OpEventSetActiveDiagnostic_SetActiveDiagnostic_DCMServices: RteEventRef=OpEventSetActiveDiagnostic_SetActiveDiagnostic_DCMServices
          OpEventGetRequestKind_GetRequestKind_DCMServices: RteEventRef=OpEventGetRequestKind_GetRequestKind_DCMServices
      DIAG_SWC_EcuSwComposition: RteSoftwareComponentInstanceRef=DIAG_SWC
        NvmBlock_DIAG_SWC_NvBlockNeed_DiagDID_00 (RteNvRamAllocation):
          RteNvmRamBlockLocationSymbol = Rte_DIAG_SWC_NvBlockNeed_DiagDID_00_MirrorBlock
          RteNvmRomBlockLocationSymbol = Rte_DIAG_SWC_NvBlockNeed_DiagDID_00_DefaultValue
          RteNvmBlockRef = DIAG_SWC_NvBlockNeed_DiagDID_00
          RteSwNvRamMappingRef = NvBlockNeed_DiagDID_00
        12 x RteEventToTaskMapping, all with RteImmediateRestart=false:
          OIT_DataServices_VCU_DID_00_DataRecord_WriteData_DataServices_VCU_DID_00_DataRecord_WriteData: RteEventRef=OIT_DataServices_VCU_DID_00_DataRecord_WriteData_DataServices_VCU_DID_00_DataRecord_WriteData
          OIT_DataServices_VCU_DID_00_DataRecord_ConditionCheckRead_DataServices_VCU_DID_00_DataRecord_ConditionCheckRead: RteEventRef=OIT_DataServices_VCU_DID_00_DataRecord_ConditionCheckRead_DataServices_VCU_DID_00_DataRecord_ConditionCheckRead
          OIT_DataServices_VCU_DID_00_DataRecord_ReadData_DataServices_VCU_DID_00_DataRecord_ReadData: RteEventRef=OIT_DataServices_VCU_DID_00_DataRecord_ReadData_DataServices_VCU_DID_00_DataRecord_ReadData
          OIT_RoutineServices_Vcu_Roution_00_RequestResults_RoutineServices_Vcu_Roution_00_RequestResults: RteEventRef=OIT_RoutineServices_Vcu_Roution_00_RequestResults_RoutineServices_Vcu_Roution_00_RequestResults
          OIT_RoutineServices_Vcu_Roution_00_Stop_RoutineServices_Vcu_Roution_00_Stop: RteEventRef=OIT_RoutineServices_Vcu_Roution_00_Stop_RoutineServices_Vcu_Roution_00_Stop
          OIT_RoutineServices_Vcu_Roution_00_Start_RoutineServices_Vcu_Roution_00_Start: RteEventRef=OIT_RoutineServices_Vcu_Roution_00_Start_RoutineServices_Vcu_Roution_00_Start
          DIAG_SWC_InitEvent: RtePositionInTask=3, RteEventRef=DIAG_SWC_InitEvent, RteMappedToTaskRef=Core0_AswInit
          TMT_DTCMonitorRunnable_10ms: RtePositionInTask=8, RteEventRef=TMT_DTCMonitorRunnable_10ms, RteMappedToTaskRef=Core0_AswTask, RteUsedOsEventRef=Rte_Ev_Cyclic_Core0_AswTask_0_10ms, RteUsedOsAlarmRef=Rte_Al_TE_Core0_AswTask_0_10ms
          OIT_SecurityAccess_Level_3_SetSecurityAttemptCounter_SecurityAccess_Level_3_SetSecurityAttemptCounter: RteEventRef=OIT_SecurityAccess_Level_3_SetSecurityAttemptCounter_SecurityAccess_Level_3_SetSecurityAttemptCounter
          OIT_SecurityAccess_Level_3_GetSecurityAttemptCounter_SecurityAccess_Level_3_GetSecurityAttemptCounter: RteEventRef=OIT_SecurityAccess_Level_3_GetSecurityAttemptCounter_SecurityAccess_Level_3_GetSecurityAttemptCounter
          OIT_SecurityAccess_Level_3_CompareKey_SecurityAccess_Level_3_CompareKey: RteEventRef=OIT_SecurityAccess_Level_3_CompareKey_SecurityAccess_Level_3_CompareKey
          OIT_SecurityAccess_Level_3_GetSeed_SecurityAccess_Level_3_GetSeed: RteEventRef=OIT_SecurityAccess_Level_3_GetSeed_SecurityAccess_Level_3_GetSeed
        NvmBlock_DIAG_SWC_NvBlockNeed_AttemptCounter (RteNvRamAllocation):
          RteNvmRamBlockLocationSymbol = Rte_DIAG_SWC_NvBlockNeed_AttemptCounter_MirrorBlock
          RteNvmRomBlockLocationSymbol = Rte_DIAG_SWC_NvBlockNeed_AttemptCounter_DefaultValue
          RteNvmBlockRef = DIAG_SWC_NvBlockNeed_AttemptCounter
          RteSwNvRamMappingRef = NvBlockNeed_AttemptCounter
        4 x RteEventToTaskMapping, all with RteImmediateRestart=false:
          OIT_CBReadData_DID_0xf1a{0..3}_F1A{0..3}_Data_ReadData_CBReadData_DID_0xf1a{0..3}_F1A{0..3}_Data_ReadData: RteEventRef=OIT_CBReadData_DID_0xf1a{0..3}_F1A{0..3}_Data_ReadData_CBReadData_DID_0xf1a{0..3}_F1A{0..3}_Data_ReadData
        NvmBlock_DIAG_SWC_NvBlockNeed (RteNvRamAllocation):
          RteNvmRamBlockLocationSymbol = Rte_DIAG_SWC_NvBlockNeed_DID_F193_MirrorBlock
          RteNvmRomBlockLocationSymbol = Rte_DIAG_SWC_NvBlockNeed_DID_F193_DefaultValue
          RteNvmBlockRef = DIAG_SWC_NvBlockNeed_DID_F193
          RteSwNvRamMappingRef = NvBlockNeed_DID_F193
        5 x RteEventToTaskMapping, all with RteImmediateRestart=false:
          OIT_DataServices_Hardware_Version_Hardware_Version_Number_WriteData_DataServices_Hardware_Version_Hardware_Version_Numbe125FF288: RteEventRef=OIT_DataServices_Hardware_Version_Hardware_Version_Number_WriteData_DataServices_Hardware_Version_Hardware_Version_Numbe125FF288
          OIT_DataServices_Hardware_Version_Hardware_Version_Number_ConditionCheckRead_DataServices_Hardware_Version_Hardware_Vers10245F7A: RteEventRef=OIT_DataServices_Hardware_Version_Hardware_Version_Number_ConditionCheckRead_DataServices_Hardware_Version_Hardware_Vers10245F7A
          OIT_DataServices_Hardware_Version_Hardware_Version_Number_ReadData_DataServices_Hardware_Version_Hardware_Version_Number62630144: RteEventRef=OIT_DataServices_Hardware_Version_Hardware_Version_Number_ReadData_DataServices_Hardware_Version_Hardware_Version_Number62630144
          MST_EcuReset_JumpFBL_0: RtePositionInTask=10, RteEventRef=MST_EcuReset_JumpFBL_0, RteMappedToTaskRef=Core0_AswTask, RteUsedOsEventRef=Rte_Ev_Run_DIAG_SWC_EcuReset_JumpFBL
          MST_EcuReset_JumpFBL_1: RtePositionInTask=10, RteEventRef=MST_EcuReset_JumpFBL_1, RteUsedOsEventRef=Rte_Ev_Run_DIAG_SWC_EcuReset_JumpFBL, RteMappedToTaskRef=Core0_AswTask
    DIAG_SWC (RteSwComponentType): RteComponentTypeRef=DIAG_SWC, RteImplementationRef=DIAG_SWC_Implementation
      ComponentTypeCalibration (RteComponentTypeCalibration): RteCalibrationSupportEnabled=false
    Adc (RteBswModuleInstance): RteBswImplementationRef=Adc_Impl, RteBswModuleConfigurationRef=Adc
      KernelData (RteBswExclusiveAreaImpl): RteExclusiveAreaImplMechanism=ALL_INTERRUPT_BLOCKING, RteBswExclusiveAreaRef=KernelData
      SrcRegAccess (RteBswExclusiveAreaImpl): RteExclusiveAreaImplMechanism=ALL_INTERRUPT_BLOCKING, RteBswExclusiveAreaRef=SrcRegAccess
    IoHwAb_SWC_EcuSwComposition (RteSwComponentInstance): RteSoftwareComponentInstanceRef=IoHwAb_SWC
      IoHwAb_SWC_InitEvent (RteEventToTaskMapping): RteImmediateRestart=false, RtePositionInTask=2, RteEventRef=IoHwAb_SWC_InitEvent, RteMappedToTaskRef=Core0_AswInit
      TMT_IoHwAb_SWC_Runnable (RteEventToTaskMapping):
        RteImmediateRestart = false
        RtePositionInTask = 7
        RteEventRef = TMT_IoHwAb_SWC_Runnable
        RteMappedToTaskRef = Core0_AswTask
        RteUsedOsEventRef = Rte_Ev_Cyclic_Core0_AswTask_0_10ms
        RteUsedOsAlarmRef = Rte_Al_TE_Core0_AswTask_0_10ms
    IoHwAb_SWC (RteSwComponentType): RteComponentTypeRef=IoHwAb_SWC, RteImplementationRef=IoHwAb_SWC_Implementation
      ComponentTypeCalibration (RteComponentTypeCalibration): RteCalibrationSupportEnabled=false
    7 x RteBswModuleInstance:
      LinIf: RteBswImplementationRef=LinIf_Impl, RteBswModuleConfigurationRef=LinIf
        LinIf_MainFunctionTimingEvent0 (RteBswEventToTaskMapping):
          RteBswImmediateRestart = false
          RteBswPositionInTask = 22
          RteBswEventRef = LinIf_MainFunctionTimingEvent0
          RteBswMappedToTaskRef = Core0_BswTask
          RteBswUsedOsEventRef = Rte_Ev_Cyclic2_Core0_BswTask_0_5ms
          RteBswUsedOsAlarmRef = Rte_Al_TE2_Core0_BswTask_0_5ms
        3 x RteBswExclusiveAreaImpl, all with RteExclusiveAreaImplMechanism=ALL_INTERRUPT_BLOCKING:
          LINIF_EXCLUSIVE_AREA_{0..2}: RteBswExclusiveAreaRef=LINIF_EXCLUSIVE_AREA_{0..2}
      LinSM: RteBswImplementationRef=LinSM_Impl, RteBswModuleConfigurationRef=LinSM
        LinSM_MainFunctionTimingEvent0 (RteBswEventToTaskMapping):
          RteBswImmediateRestart = false
          RteBswPositionInTask = 23
          RteBswEventRef = LinSM_MainFunctionTimingEvent0
          RteBswMappedToTaskRef = Core0_BswTask
          RteBswUsedOsEventRef = Rte_Ev_Cyclic2_Core0_BswTask_0_10ms
          RteBswUsedOsAlarmRef = Rte_Al_TE2_Core0_BswTask_0_10ms
        5 x RteBswExclusiveAreaImpl, all with RteExclusiveAreaImplMechanism=ALL_INTERRUPT_BLOCKING:
          LINSM_EXCLUSIVE_AREA_{0..4}: RteBswExclusiveAreaRef=LINSM_EXCLUSIVE_AREA_{0..4}
      LinTrcv: RteBswImplementationRef=LinTrcv_Impl, RteBswModuleConfigurationRef=LinTrcv
        LINTRCV_30_TLE7259_EXCLUSIVE_AREA_0 (RteBswExclusiveAreaImpl): RteExclusiveAreaImplMechanism=ALL_INTERRUPT_BLOCKING, RteBswExclusiveAreaRef=LINTRCV_30_TLE7259_EXCLUSIVE_AREA_0
      Spi: RteBswImplementationRef=Spi_Impl, RteBswModuleConfigurationRef=Spi
        11 x RteBswExclusiveAreaImpl, all with RteExclusiveAreaImplMechanism=ALL_INTERRUPT_BLOCKING:
          Buffer_Update: RteBswExclusiveAreaRef=Buffer_Update
          SyncLock: RteBswExclusiveAreaRef=SyncLock
          ChannelLock: RteBswExclusiveAreaRef=ChannelLock
          Cancel_Seq: RteBswExclusiveAreaRef=Cancel_Seq
          Queue_Update_QSPI{0..5}: RteBswExclusiveAreaRef=Queue_Update_QSPI{0..5}
          Queue_Update: RteBswExclusiveAreaRef=Queue_Update
        Spi_MainFunction_HandlingTimingEvent0 (RteBswEventToTaskMapping):
          RteBswImmediateRestart = false
          RteBswPositionInTask = 24
          RteBswEventRef = Spi_MainFunction_HandlingTimingEvent0
          RteBswMappedToTaskRef = Core0_BswTask
          RteBswUsedOsEventRef = Rte_Ev_Cyclic2_Core0_BswTask_0_5ms
          RteBswUsedOsAlarmRef = Rte_Al_TE2_Core0_BswTask_0_5ms
      Dma: RteBswImplementationRef=Dma_Impl, RteBswModuleConfigurationRef=Dma
        9 x RteBswExclusiveAreaImpl, all with RteExclusiveAreaImplMechanism=ALL_INTERRUPT_BLOCKING:
          ChannelInitDeinit: RteBswExclusiveAreaRef=ChannelInitDeinit
          ChannelFreezeResume: RteBswExclusiveAreaRef=ChannelFreezeResume
          ChannelHWTrigger: RteBswExclusiveAreaRef=ChannelHWTrigger
          ChannelStartStop: RteBswExclusiveAreaRef=ChannelStartStop
          ChannelSwitchBuffer: RteBswExclusiveAreaRef=ChannelSwitchBuffer
          ChEventStatus: RteBswExclusiveAreaRef=ChEventStatus
          MEErrorStatus: RteBswExclusiveAreaRef=MEErrorStatus
          InterruptStatus: RteBswExclusiveAreaRef=InterruptStatus
          ChannelConfigUpdate: RteBswExclusiveAreaRef=ChannelConfigUpdate
      Irq: RteBswImplementationRef=Irq_Impl, RteBswModuleConfigurationRef=Irq
      Pwm: RteBswImplementationRef=Pwm_Impl, RteBswModuleConfigurationRef=Pwm
        HandleNotification (RteBswExclusiveAreaImpl): RteExclusiveAreaImplMechanism=ALL_INTERRUPT_BLOCKING, RteBswExclusiveAreaRef=HandleNotification
        PeriodAndDutyUpdate (RteBswExclusiveAreaImpl): RteExclusiveAreaImplMechanism=ALL_INTERRUPT_BLOCKING, RteBswExclusiveAreaRef=PeriodAndDutyUpdate
    4 x RteSwComponentInstance:
      Os_OsCore1_swc_EcuSwComposition: RteSoftwareComponentInstanceRef=Os_OsCore1_swc
        OpEventGetCounterValue_GetCounterValue_OsService_SystemTimer_Core1 (RteEventToTaskMapping): RteImmediateRestart=false, RteEventRef=OpEventGetCounterValue_GetCounterValue_OsService_SystemTimer_Core1
        OpEventGetElapsedValue_GetElapsedValue_OsService_SystemTimer_Core1 (RteEventToTaskMapping): RteImmediateRestart=false, RteEventRef=OpEventGetElapsedValue_GetElapsedValue_OsService_SystemTimer_Core1
      Os_OsCore2_swc_EcuSwComposition: RteSoftwareComponentInstanceRef=Os_OsCore2_swc
        OpEventGetCounterValue_GetCounterValue_OsService_SystemTimer_Core2 (RteEventToTaskMapping): RteImmediateRestart=false, RteEventRef=OpEventGetCounterValue_GetCounterValue_OsService_SystemTimer_Core2
        OpEventGetElapsedValue_GetElapsedValue_OsService_SystemTimer_Core2 (RteEventToTaskMapping): RteImmediateRestart=false, RteEventRef=OpEventGetElapsedValue_GetElapsedValue_OsService_SystemTimer_Core2
      Core2App_SWC_EcuSwComposition: RteSoftwareComponentInstanceRef=Core2App_SWC
        Core2App_SWC_InitEvent (RteEventToTaskMapping): RteImmediateRestart=false, RtePositionInTask=0, RteEventRef=Core2App_SWC_InitEvent, RteMappedToTaskRef=Core2_AswInit
        TMT_Core2App_Runnable100ms (RteEventToTaskMapping):
          RteImmediateRestart = false
          RtePositionInTask = 0
          RteEventRef = TMT_Core2App_Runnable100ms
          RteMappedToTaskRef = Core2_AswTask
          RteUsedOsAlarmRef = Rte_Al_TE_Core2App_SWC_Core2App_Runnable100ms
      Core1App_SWC_EcuSwComposition: RteSoftwareComponentInstanceRef=Core1App_SWC
        Core1App_SWC_InitEvent (RteEventToTaskMapping): RteImmediateRestart=false, RtePositionInTask=0, RteEventRef=Core1App_SWC_InitEvent, RteMappedToTaskRef=Core1_AswInit
        TMT_Core1App_Runnable100ms (RteEventToTaskMapping):
          RteImmediateRestart = false
          RtePositionInTask = 0
          RteEventRef = TMT_Core1App_Runnable100ms
          RteMappedToTaskRef = Core1_AswTask
          RteUsedOsAlarmRef = Rte_Al_TE_Core1App_SWC_Core1App_Runnable100ms
    Core2App_SWC (RteSwComponentType): RteComponentTypeRef=Core2App_SWC, RteImplementationRef=Core2App_SWC_Implementation
      ComponentTypeCalibration (RteComponentTypeCalibration): RteCalibrationSupportEnabled=false
    Core1App_SWC (RteSwComponentType): RteComponentTypeRef=Core1App_SWC, RteImplementationRef=Core1App_SWC_Implementation
      ComponentTypeCalibration (RteComponentTypeCalibration): RteCalibrationSupportEnabled=false
    4 x RteBswModuleInstance:
      Eth: RteBswImplementationRef=Eth_Impl, RteBswModuleConfigurationRef=Eth
        Eth_30_Tc3xx_MainFunctionTimingEvent0 (RteBswEventToTaskMapping):
          RteBswImmediateRestart = false
          RteBswPositionInTask = 27
          RteBswEventRef = Eth_30_Tc3xx_MainFunctionTimingEvent0
          RteBswMappedToTaskRef = Core0_BswTask
          RteBswUsedOsEventRef = Rte_Ev_Cyclic2_Core0_BswTask_0_20ms
          RteBswUsedOsAlarmRef = Rte_Al_TE2_Core0_BswTask_0_20ms
        4 x RteBswExclusiveAreaImpl, all with RteExclusiveAreaImplMechanism=ALL_INTERRUPT_BLOCKING:
          ETH_30_TC3XX_EXCLUSIVE_AREA_DATA: RteBswExclusiveAreaRef=ETH_30_TC3XX_EXCLUSIVE_AREA_DATA
          ETH_30_TC3XX_EXCLUSIVE_AREA_MII: RteBswExclusiveAreaRef=ETH_30_TC3XX_EXCLUSIVE_AREA_MII
          ETH_30_TC3XX_EXCLUSIVE_AREA_DATA_MULTI_CORE: RteBswExclusiveAreaRef=ETH_30_TC3XX_EXCLUSIVE_AREA_DATA_MULTI_CORE
          ETH_30_TC3XX_EXCLUSIVE_AREA_DISABLE_MAC: RteBswExclusiveAreaRef=ETH_30_TC3XX_EXCLUSIVE_AREA_DISABLE_MAC
      EthTrcv: RteBswImplementationRef=EthTrcv_Impl, RteBswModuleConfigurationRef=EthTrcv
      EthIf: RteBswImplementationRef=EthIf_Impl, RteBswModuleConfigurationRef=EthIf
        3 x RteBswEventToTaskMapping, all with RteBswImmediateRestart=false, RteBswMappedToTaskRef=Core0_BswTask:
          EthIf_MainFunctionRxTimingEvent0: RteBswPositionInTask=28, RteBswEventRef=EthIf_MainFunctionRxTimingEvent0, RteBswUsedOsEventRef=Rte_Ev_Cyclic2_Core0_BswTask_0_5ms, RteBswUsedOsAlarmRef=Rte_Al_TE2_Core0_BswTask_0_5ms
          EthIf_MainFunctionTxTimingEvent0: RteBswPositionInTask=30, RteBswEventRef=EthIf_MainFunctionTxTimingEvent0, RteBswUsedOsEventRef=Rte_Ev_Cyclic2_Core0_BswTask_0_5ms, RteBswUsedOsAlarmRef=Rte_Al_TE2_Core0_BswTask_0_5ms
          EthIf_MainFunctionStateTimingEvent0: RteBswPositionInTask=29, RteBswEventRef=EthIf_MainFunctionStateTimingEvent0, RteBswUsedOsEventRef=Rte_Ev_Run_EthIf_EthIf_MainFunctionState, RteBswUsedOsAlarmRef=Rte_Al_TE_EthIf_EthIf_MainFunctionState
        5 x RteBswExclusiveAreaImpl, all with RteExclusiveAreaImplMechanism=ALL_INTERRUPT_BLOCKING:
          ETHIF_EXCLUSIVE_AREA_CTRL_INIT: RteBswExclusiveAreaRef=ETHIF_EXCLUSIVE_AREA_CTRL_INIT
          ETHIF_EXCLUSIVE_AREA_SET_CTRL_MODE: RteBswExclusiveAreaRef=ETHIF_EXCLUSIVE_AREA_SET_CTRL_MODE
          ETHIF_EXCLUSIVE_AREA_TX_MIRROR_ELEMENT: RteBswExclusiveAreaRef=ETHIF_EXCLUSIVE_AREA_TX_MIRROR_ELEMENT
          ETHIF_EXCLUSIVE_AREA_RXTX_STATS: RteBswExclusiveAreaRef=ETHIF_EXCLUSIVE_AREA_RXTX_STATS
          ETHIF_EXCLUSIVE_AREA_SIGNAL_QUALITY: RteBswExclusiveAreaRef=ETHIF_EXCLUSIVE_AREA_SIGNAL_QUALITY
      EthSM: RteBswImplementationRef=EthSM_Impl, RteBswModuleConfigurationRef=EthSM
        EthSM_MainFunctionTimingEvent0 (RteBswEventToTaskMapping):
          RteBswImmediateRestart = false
          RteBswPositionInTask = 32
          RteBswEventRef = EthSM_MainFunctionTimingEvent0
          RteBswMappedToTaskRef = Core0_BswTask
          RteBswUsedOsEventRef = Rte_Ev_Cyclic2_Core0_BswTask_0_20ms
          RteBswUsedOsAlarmRef = Rte_Al_TE2_Core0_BswTask_0_20ms
