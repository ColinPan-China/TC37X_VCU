AUTOSAR XML (schema 00048)
package /ActiveEcuC
  module config Xcp: implementation-config-variant=VARIANT-PRE-COMPILE, module-description=Xcp_Impl
    XcpCmdConfig: XcpOpenCommandInterface=false
      XcpStandard:
        XcpBlockUpload = false
        XcpCommunicationModeInfo = false
        XcpGetIdGeneric = false
        XcpMemoryReadProtection = false
        XcpSeedKey = false
        XcpUserDefinedCommand = false
      XcpAsynchMessage: XcpEventCodes=true, XcpServiceRequestMessage=false
      XcpPageSwitching: XcpCopyPage=true, XcpFreezeMode=false, XcpGeneralPagingInfo=false
      XcpDaqAndStim:
        XcpFixedTimestamp = false
        XcpGetDAQEventInfo = true
        XcpMaxNumberOfOdtDaq = 123
        XcpMaxNumberOfOdtEntries = 124
        XcpMaxNumberOfOdtStim = 1
        XcpOverrunIndication = true
        XcpResolutionInfo = true
        XcpResumeMode = false
        XcpSynchronousDataStimulation = true
        XcpWriteDAQMultiple = false
        XcpDAQMessageHeader = ODT
        XcpComplementaryDAQ = false
      XcpCalibration: XcpBlockDownload=true, XcpMIN_STForBlockDownload=1, XcpModifyBits=true, XcpShortDownload=true
    XcpGeneral:
      XcpDevErrorDetect = true
      XcpMainFunctionPeriod = 0.005
      XcpMaxEventChannel = 255
      XcpOnCanEnabled = true
      XcpOnCddEnabled = false
      XcpOnEthernetEnabled = false
      XcpOnFlexRayEnabled = false
      XcpPrescalerSupported = false
      XcpVersionInfoApi = false
      XcpBootloaderDownload = false
      XcpControl = true
      XcpMultiClientSupport = false
      XcpRuntimeMeasurementSupport = false
      XcpSafeBswChecks = true
      XcpSessionStatusAPI = false
      XcpTypeSafeCopy = false
      XcpDAQMemAccessByApplication = true
      XcpDaqConfigType = DAQ_DYNAMIC
      XcpMaxCto = 8
      XcpMaxDto = 8
      XcpTimestampTicks = 100
      XcpTimestampType = NO_TIME_STAMP
      XcpTimestampUnit = TIMESTAMP_UNIT_1US
      XcpCounterRef = SystemTimer
      XcpA2L: XcpTimeoutT1=2000, XcpTimeoutT2=10000, XcpTimeoutT3=2000, XcpTimeoutT4=2000, XcpTimeoutT5=2000, XcpTimeoutT6=2000, XcpTimeoutT7=0
    XcpConfig
      XcpTransportLayer
        XcpOnCan: XcpOnCanMaxCto=8, XcpOnCanMaxDto=8, XcpOnCanConfirmationTimeout=10, XcpOnCanMultiConnectionProtection=false, XcpOnCanVariableDlc=true
      XcpEventChannel_10MS (XcpEventChannel):
        XcpEventChannelMaxDaqList = 100
        XcpEventChannelNumber = 1
        XcpEventChannelTimeCycle = 1
        XcpEventChannelTimeUnit = TIMESTAMP_UNIT_10MS
        XcpEventChannelType = DAQ
        XcpEventChannelPriority = 0
        XcpEventChannelCoreRef = XcpCoreDefinition
      XcpCoreDefinition: XcpSendQueueSize=256
      XcpEventChannel_20MS (XcpEventChannel):
        XcpEventChannelMaxDaqList = 1
        XcpEventChannelNumber = 0
        XcpEventChannelTimeCycle = 2
        XcpEventChannelTimeUnit = TIMESTAMP_UNIT_10MS
        XcpEventChannelType = DAQ
        XcpEventChannelPriority = 0
        XcpEventChannelCoreRef = XcpCoreDefinition
      XCP_Response_oTC37X_VCU_CAN12_XCP_931ee635_Tx (XcpPdu)
        XCP_Response_oTC37X_VCU_CAN12_XCP_931ee635_Tx (XcpTxPdu): XcpTxPduId=0, XcpTxPduRef=XCP_Response_oTC37X_VCU_CAN12_XCP_931ee635_Tx
      XCP_Request_oTC37X_VCU_CAN12_XCP_52af259e_Rx (XcpPdu)
        XCP_Request_oTC37X_VCU_CAN12_XCP_52af259e_Rx (XcpRxPdu):
          XcpRxPduId = 0
          XcpRxPduRef = XCP_Request_oTC37X_VCU_CAN12_XCP_52af259e_Rx
          XcpTxPduContRef = XCP_Response_oTC37X_VCU_CAN12_XCP_931ee635_Tx/XCP_Response_oTC37X_VCU_CAN12_XCP_931ee635_Tx
