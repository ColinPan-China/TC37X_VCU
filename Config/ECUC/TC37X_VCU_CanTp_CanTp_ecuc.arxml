AUTOSAR XML (schema 00048)
package /ActiveEcuC
  module config CanTp: implementation-config-variant=VARIANT-PRE-COMPILE, module-description=CanTp_Impl
    CanTpGeneral:
      CanTpChangeParameterApi = false
      CanTpDevErrorDetect = true
      CanTpPaddingByte = 204
      CanTpReadParameterApi = false
      CanTpVersionInfoApi = false
      CanTpPaddingActive = true
      CanTpHavePaddingByte = false
      CanTpNumRxChannels = 0
      CanTpNumTxChannels = 0
      CanTpEnableSplitMainFunction = false
      CanTpSupportStandardAddressing = true
      CanTpSupportExtendedAddressing = true
      CanTpSupportMixed11Addressing = true
      CanTpSupportMixed29Addressing = true
      CanTpSupportNormalFixedAddressing = true
      CanTpSupportCustomAddressing = false
      CanTpOnlyNotifyInformedAppl = true
      CanTpRc = false
      CanTpTc = true
      CanTpSafeBswChecks = false
      CanTpEnableConstantBS = true
      CanTpEnableTransmitQueue = false
      CanTpUseOnlyFirstFc = true
    CanTpConfig: CanTpMainFunctionPeriod=0.005
      TPCH_1341a116 (CanTpChannel): CanTpChannelMode=CANTP_MODE_FULL_DUPLEX
        CanTpTxNSdu_fe7a15ff (CanTpTxNSdu):
          CanTpTxAddressingFormat = CANTP_STANDARD
          CanTpTxDl = 8
          CanTpTxTaType = CANTP_PHYSICAL
          CanTpNas = 0.1
          CanTpNcs = 0.2
          CanTpTc = false
          CanTpTxNSduId = 0
          CanTpTxPaddingActivation = CANTP_ON
          CanTpNbs = 0.5
          CanTpTxNSduRef = Vcu_Uds_Response_oTC37X_VCU_CAN00_39638a1a_Tx
          CanTpTxNPdu_4116ec52 (CanTpTxNPdu): CanTpTxNPduConfirmationPduId=0, CanTpTxNPduRef=Vcu_Uds_Response_Tp_oTC37X_VCU_CAN00_834178f3_Tx
          CanTpRxFcNPdu_4116ec52 (CanTpRxFcNPdu): CanTpRxFcNPduId=0, CanTpRxFcNPduRef=Vcu_Uds_Phy_Request_Tp_oTC37X_VCU_CAN00_58c52463_Rx
        CanTpRxNSdu_fe7a15ff (CanTpRxNSdu):
          CanTpRxAddressingFormat = CANTP_STANDARD
          CanTpRxDl = 8
          CanTpRxTaType = CANTP_PHYSICAL
          CanTpNbr = 0.1
          CanTpRxNSduId = 0
          CanTpRxPaddingActivation = CANTP_ON
          CanTpBs = 8
          CanTpNar = 0.1
          CanTpNcr = 0.5
          CanTpRxWftMax = 15
          CanTpSTmin = 0.02
          CanTpRxNSduRef = Vcu_Uds_Phy_Request_oTC37X_VCU_CAN00_16119f6f_Rx
          CanTpRxNPdu_63ec38a0 (CanTpRxNPdu): CanTpRxNPduId=0, CanTpRxNPduRef=Vcu_Uds_Phy_Request_Tp_oTC37X_VCU_CAN00_58c52463_Rx
          CanTpTxFcNPdu_63ec38a0 (CanTpTxFcNPdu): CanTpTxFcNPduConfirmationPduId=0, CanTpTxFcNPduRef=Vcu_Uds_Response_Tp_oTC37X_VCU_CAN00_834178f3_Tx
      TPCH_d230b3ef (CanTpChannel): CanTpChannelMode=CANTP_MODE_FULL_DUPLEX
        CanTpRxNSdu_c12348c5 (CanTpRxNSdu):
          CanTpRxAddressingFormat = CANTP_STANDARD
          CanTpRxDl = 8
          CanTpRxTaType = CANTP_FUNCTIONAL
          CanTpNbr = 0.1
          CanTpRxNSduId = 1
          CanTpRxPaddingActivation = CANTP_ON
          CanTpRxNSduRef = Vcu_Uds_Func_Request_oTC37X_VCU_CAN00_455d4346_Rx
          CanTpRxNPdu_257d590c (CanTpRxNPdu): CanTpRxNPduId=1, CanTpRxNPduRef=Vcu_Uds_Func_Request_Tp_oTC37X_VCU_CAN00_3dbedef7_Rx
