AUTOSAR XML (schema 00048)
package /ActiveEcuC
  module config CanTp: implementation-config-variant=VARIANT-PRE-COMPILE, module-description=CanTp_Impl
    CanTpGeneral:
      CanTpChangeParameterApi = false
      CanTpDevErrorDetect = true
      CanTpPaddingByte = 204
      CanTpReadParameterApi = false
      CanTpVersionInfoApi = false
      CanTpPaddingActive = true
      CanTpHavePaddingByte = false
      CanTpNumRxChannels = 0
      CanTpNumTxChannels = 0
      CanTpEnableSplitMainFunction = false
      CanTpSupportStandardAddressing = true
      CanTpSupportExtendedAddressing = true
      CanTpSupportMixed11Addressing = true
      CanTpSupportMixed29Addressing = true
      CanTpSupportNormalFixedAddressing = true
      CanTpSupportCustomAddressing = false
      CanTpOnlyNotifyInformedAppl = true
      CanTpRc = false
      CanTpTc = true
      CanTpSafeBswChecks = false
      CanTpEnableConstantBS = true
      CanTpEnableTransmitQueue = false
      CanTpUseOnlyFirstFc = true
    CanTpConfig: CanTpMainFunctionPeriod=0.005
      4 x CanTpChannel, all with CanTpChannelMode=CANTP_MODE_FULL_DUPLEX:
        TPCH_3a358898
          CanTpRxNSdu_7625a0cc (CanTpRxNSdu):
            CanTpRxAddressingFormat = CANTP_STANDARD
            CanTpRxDl = 8
            CanTpRxTaType = CANTP_PHYSICAL
            CanTpNbr = 0.1
            CanTpRxNSduId = 1
            CanTpRxPaddingActivation = CANTP_ON
            CanTpBs = 8
            CanTpNar = 0.1
            CanTpNcr = 0.5
            CanTpRxWftMax = 15
            CanTpSTmin = 0.02
            CanTpRxNSduRef = Vcu_Uds_Phy_Request_oTC37X_VCU_CAN00_20_5b6ce511_Rx
            CanTpRxNPdu_0c44da42 (CanTpRxNPdu): CanTpRxNPduId=0, CanTpRxNPduRef=Vcu_Uds_Phy_Request_Tp_oTC37X_VCU_CAN00_20_d4f97d85_Rx
            CanTpTxFcNPdu_0c44da42 (CanTpTxFcNPdu): CanTpTxFcNPduConfirmationPduId=0, CanTpTxFcNPduRef=Vcu_Uds_Response_Tp_oTC37X_VCU_CAN00_20_d53190cf_Tx
          CanTpTxNSdu_7625a0cc (CanTpTxNSdu):
            CanTpTxAddressingFormat = CANTP_STANDARD
            CanTpTxDl = 8
            CanTpTxTaType = CANTP_PHYSICAL
            CanTpNas = 0.1
            CanTpNcs = 0.2
            CanTpTc = false
            CanTpTxNSduId = 1
            CanTpTxPaddingActivation = CANTP_ON
            CanTpNbs = 0.5
            CanTpTxNSduRef = Vcu_Uds_Response_oTC37X_VCU_CAN00_20_80e8b981_Tx
            CanTpTxNPdu_2ebe0eb0 (CanTpTxNPdu): CanTpTxNPduConfirmationPduId=0, CanTpTxNPduRef=Vcu_Uds_Response_Tp_oTC37X_VCU_CAN00_20_d53190cf_Tx
            CanTpRxFcNPdu_2ebe0eb0 (CanTpRxFcNPdu): CanTpRxFcNPduId=0, CanTpRxFcNPduRef=Vcu_Uds_Phy_Request_Tp_oTC37X_VCU_CAN00_20_d4f97d85_Rx
        TPCH_0a4b7734
          CanTpRxNSdu_cffa7786 (CanTpRxNSdu):
            CanTpRxAddressingFormat = CANTP_STANDARD
            CanTpRxDl = 8
            CanTpRxTaType = CANTP_CANFD_PHYSICAL
            CanTpNbr = 0.1
            CanTpRxNSduId = 0
            CanTpRxPaddingActivation = CANTP_ON
            CanTpBs = 8
            CanTpNar = 0.1
            CanTpNcr = 0.5
            CanTpRxWftMax = 15
            CanTpSTmin = 0.02
            CanTpRxNSduRef = Vcu_Uds_Phy_Request_oTC37X_VCU_CAN00_16119f6f_Rx
            CanTpTxFcNPdu_c503a1b2 (CanTpTxFcNPdu): CanTpTxFcNPduConfirmationPduId=1, CanTpTxFcNPduRef=Vcu_Uds_Response_Tp_oTC37X_VCU_CAN00_834178f3_Tx
            CanTpRxNPdu_c503a1b2 (CanTpRxNPdu): CanTpRxNPduId=1, CanTpRxNPduRef=Vcu_Uds_Phy_Request_Tp_oTC37X_VCU_CAN00_58c52463_Rx
          CanTpTxNSdu_cffa7786 (CanTpTxNSdu):
            CanTpTxAddressingFormat = CANTP_STANDARD
            CanTpTxDl = 8
            CanTpTxTaType = CANTP_CANFD_PHYSICAL
            CanTpNas = 0.1
            CanTpNcs = 0.2
            CanTpTc = false
            CanTpTxNSduId = 0
            CanTpTxPaddingActivation = CANTP_ON
            CanTpNbs = 0.5
            CanTpTxNSduRef = Vcu_Uds_Response_oTC37X_VCU_CAN00_39638a1a_Tx
            CanTpRxFcNPdu_e7f97540 (CanTpRxFcNPdu): CanTpRxFcNPduId=1, CanTpRxFcNPduRef=Vcu_Uds_Phy_Request_Tp_oTC37X_VCU_CAN00_58c52463_Rx
            CanTpTxNPdu_e7f97540 (CanTpTxNPdu): CanTpTxNPduConfirmationPduId=1, CanTpTxNPduRef=Vcu_Uds_Response_Tp_oTC37X_VCU_CAN00_834178f3_Tx
        TPCH_64c5e4aa
          CanTpRxNSdu_130e7058 (CanTpRxNSdu):
            CanTpRxAddressingFormat = CANTP_STANDARD
            CanTpRxDl = 8
            CanTpRxTaType = CANTP_CANFD_FUNCTIONAL
            CanTpNbr = 0.1
            CanTpRxNSduId = 2
            CanTpRxPaddingActivation = CANTP_ON
            CanTpRxNSduRef = Vcu_Uds_Func_Request_oTC37X_VCU_CAN00_455d4346_Rx
            CanTpRxNPdu_49d53416 (CanTpRxNPdu): CanTpRxNPduId=2, CanTpRxNPduRef=Vcu_Uds_Func_Request_Tp_oTC37X_VCU_CAN00_3dbedef7_Rx
        TPCH_ba4eeba6
          CanTpRxNSdu_07292aa5 (CanTpRxNSdu):
            CanTpRxAddressingFormat = CANTP_STANDARD
            CanTpRxDl = 8
            CanTpRxTaType = CANTP_FUNCTIONAL
            CanTpNbr = 0.1
            CanTpRxNSduId = 3
            CanTpRxPaddingActivation = CANTP_ON
            CanTpRxNSduRef = Vcu_Uds_Func_Request_oTC37X_VCU_CAN00_20_3e171f85_Rx
            CanTpRxNPdu_42e8777b (CanTpRxNPdu): CanTpRxNPduId=3, CanTpRxNPduRef=Vcu_Uds_Func_Request_Tp_oTC37X_VCU_CAN00_20_0767cc4f_Rx
