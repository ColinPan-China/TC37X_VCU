AUTOSAR XML (schema 00048)
package /ActiveEcuC
  module config CanTp: implementation-config-variant=VARIANT-PRE-COMPILE, module-description=CanTp_Impl
    CanTpGeneral:
      CanTpChangeParameterApi = false
      CanTpDevErrorDetect = true
      CanTpPaddingByte = 204
      CanTpReadParameterApi = false
      CanTpVersionInfoApi = false
      CanTpPaddingActive = true
      CanTpHavePaddingByte = false
      CanTpNumRxChannels = 0
      CanTpNumTxChannels = 0
      CanTpEnableSplitMainFunction = false
      CanTpSupportStandardAddressing = true
      CanTpSupportExtendedAddressing = true
      CanTpSupportMixed11Addressing = true
      CanTpSupportMixed29Addressing = true
      CanTpSupportNormalFixedAddressing = true
      CanTpSupportCustomAddressing = false
      CanTpOnlyNotifyInformedAppl = true
      CanTpRc = false
      CanTpTc = true
      CanTpSafeBswChecks = false
      CanTpEnableConstantBS = true
      CanTpEnableTransmitQueue = false
      CanTpUseOnlyFirstFc = true
      CanTpEnableSynchronousTransmit = true
    CanTpConfig: CanTpMainFunctionPeriod=0.005
      6 x CanTpChannel, all with CanTpChannelMode=CANTP_MODE_FULL_DUPLEX:
        TPCH_3ae27ed3
          CanTpRxNSdu_ba12c012 (CanTpRxNSdu):
            CanTpRxAddressingFormat = CANTP_STANDARD
            CanTpRxDl = 8
            CanTpRxTaType = CANTP_PHYSICAL
            CanTpNbr = 0.1
            CanTpRxNSduId = 2
            CanTpRxPaddingActivation = CANTP_ON
            CanTpBs = 8
            CanTpNar = 0.1
            CanTpNcr = 0.5
            CanTpRxWftMax = 15
            CanTpSTmin = 0.02
            CanTpRxNSduRef = DiagReq_VCU_OBD_oATOM_CAN_Matrix_PT_V600_20250211_7d1d4961_Rx
            CanTpRxNPdu_fb36dff5 (CanTpRxNPdu): CanTpRxNPduId=1, CanTpRxNPduRef=DiagReq_VCU_OBD_Tp_oATOM_CAN_Matrix_PT_V600_20250211_5296c73a_Rx
            CanTpTxFcNPdu_fb36dff5 (CanTpTxFcNPdu): CanTpTxFcNPduConfirmationPduId=0, CanTpTxFcNPduRef=DiagResp_VCU_OBD_Tp_oATOM_CAN_Matrix_PT_V600_20250211_09b7b9b1_Tx
          CanTpTxNSdu_ba12c012 (CanTpTxNSdu):
            CanTpTxAddressingFormat = CANTP_STANDARD
            CanTpTxDl = 8
            CanTpTxTaType = CANTP_PHYSICAL
            CanTpNas = 0.1
            CanTpNcs = 0.2
            CanTpTc = false
            CanTpTxNSduId = 0
            CanTpTxPaddingActivation = CANTP_ON
            CanTpNbs = 0.5
            CanTpTxNSduRef = DiagResp_VCU_OBD_oATOM_CAN_Matrix_PT_V600_20250211_e13d53cd_Tx
            CanTpTxNPdu_d9cc0b07 (CanTpTxNPdu): CanTpTxNPduConfirmationPduId=0, CanTpTxNPduRef=DiagResp_VCU_OBD_Tp_oATOM_CAN_Matrix_PT_V600_20250211_09b7b9b1_Tx
            CanTpRxFcNPdu_d9cc0b07 (CanTpRxFcNPdu): CanTpRxFcNPduId=1, CanTpRxFcNPduRef=DiagReq_VCU_OBD_Tp_oATOM_CAN_Matrix_PT_V600_20250211_5296c73a_Rx
        TPCH_d6131cae
          CanTpRxNSdu_7765ad4f (CanTpRxNSdu):
            CanTpRxAddressingFormat = CANTP_STANDARD
            CanTpRxDl = 8
            CanTpRxTaType = CANTP_FUNCTIONAL
            CanTpNbr = 0.1
            CanTpRxNSduId = 4
            CanTpRxPaddingActivation = CANTP_ON
            CanTpRxNSduRef = DiagReq_PT_oATOM_CAN_Matrix_PT_V600_20250211_c86f8199_Rx
            CanTpRxNPdu_822169b4 (CanTpRxNPdu): CanTpRxNPduId=5, CanTpRxNPduRef=DiagReq_PT_Tp_oATOM_CAN_Matrix_PT_V600_20250211_5469a8b1_Rx
        TPCH_2c47ace3
          CanTpRxNSdu_1de5980a (CanTpRxNSdu):
            CanTpRxAddressingFormat = CANTP_STANDARD
            CanTpRxDl = 8
            CanTpRxTaType = CANTP_FUNCTIONAL
            CanTpNbr = 0.1
            CanTpRxNSduId = 1
            CanTpRxPaddingActivation = CANTP_ON
            CanTpRxNSduRef = DiagReq_OBD_oATOM_CAN_Matrix_PT_V600_20250211_2ff897c4_Rx
            CanTpRxNPdu_8a537d14 (CanTpRxNPdu): CanTpRxNPduId=0, CanTpRxNPduRef=DiagReq_OBD_Tp_oATOM_CAN_Matrix_PT_V600_20250211_42fea685_Rx
        TPCH_eaa2056c
          CanTpTxNSdu_a047006e (CanTpTxNSdu):
            CanTpTxAddressingFormat = CANTP_STANDARD
            CanTpTxDl = 8
            CanTpTxTaType = CANTP_PHYSICAL
            CanTpNas = 0.1
            CanTpNcs = 0.2
            CanTpTc = false
            CanTpTxNSduId = 1
            CanTpTxPaddingActivation = CANTP_ON
            CanTpNbs = 0.5
            CanTpTxNSduRef = DiagResp_VCU_oATOM_CAN_Matrix_PT_V600_20250211_1dcc985c_Tx
            CanTpRxFcNPdu_341356c5 (CanTpRxFcNPdu): CanTpRxFcNPduId=2, CanTpRxFcNPduRef=DiagReq_VCU_Tp_oATOM_CAN_Matrix_PT_V600_20250211_3ecea241_Rx
            CanTpTxNPdu_341356c5 (CanTpTxNPdu): CanTpTxNPduConfirmationPduId=1, CanTpTxNPduRef=DiagResp_VCU_Tp_oATOM_CAN_Matrix_PT_V600_20250211_17d2a785_Tx
          CanTpRxNSdu_a047006e (CanTpRxNSdu):
            CanTpRxAddressingFormat = CANTP_STANDARD
            CanTpRxDl = 8
            CanTpRxTaType = CANTP_PHYSICAL
            CanTpNbr = 0.1
            CanTpRxNSduId = 5
            CanTpRxPaddingActivation = CANTP_ON
            CanTpBs = 8
            CanTpNar = 0.1
            CanTpNcr = 0.5
            CanTpRxWftMax = 15
            CanTpSTmin = 0.02
            CanTpRxNSduRef = DiagReq_VCU_oATOM_CAN_Matrix_PT_V600_20250211_a64ab01c_Rx
            CanTpRxNPdu_16e98237 (CanTpRxNPdu): CanTpRxNPduId=2, CanTpRxNPduRef=DiagReq_VCU_Tp_oATOM_CAN_Matrix_PT_V600_20250211_3ecea241_Rx
            CanTpTxFcNPdu_16e98237 (CanTpTxFcNPdu): CanTpTxFcNPduConfirmationPduId=1, CanTpTxFcNPduRef=DiagResp_VCU_Tp_oATOM_CAN_Matrix_PT_V600_20250211_17d2a785_Tx
        TPCH_0f88ef82
          CanTpRxNSdu_09d1a149 (CanTpRxNSdu):
            CanTpRxAddressingFormat = CANTP_STANDARD
            CanTpRxDl = 8
            CanTpRxTaType = CANTP_FUNCTIONAL
            CanTpNbr = 0.1
            CanTpRxNSduId = 0
            CanTpRxPaddingActivation = CANTP_ON
            CanTpRxNSduRef = DiagReq_ALL_oATOM_CAN_Matrix_PT_V600_20250211_278c238c_Rx
            CanTpRxNPdu_4e4f92b2 (CanTpRxNPdu): CanTpRxNPduId=3, CanTpRxNPduRef=DiagReq_ALL_Tp_oATOM_CAN_Matrix_PT_V600_20250211_ebb6a46c_Rx
        TPCH_780a11be
          CanTpRxNSdu_3169c424 (CanTpRxNSdu):
            CanTpRxAddressingFormat = CANTP_STANDARD
            CanTpRxDl = 8
            CanTpRxTaType = CANTP_FUNCTIONAL
            CanTpNbr = 0.1
            CanTpRxNSduId = 3
            CanTpRxPaddingActivation = CANTP_ON
            CanTpRxNSduRef = DiagReq_FUN_oATOM_CAN_Matrix_PT_V600_20250211_f00b311f_Rx
            CanTpRxNPdu_0b84ecc7 (CanTpRxNPdu): CanTpRxNPduId=4, CanTpRxNPduRef=DiagReq_FUN_Tp_oATOM_CAN_Matrix_PT_V600_20250211_1fcbc442_Rx
