AUTOSAR XML (schema 00048)
package /Port
  module config Port: implementation-config-variant=VARIANT-POST-BUILD, module-description=Port_Impl
    CommonPublishedInformation:
      ArMajorVersion = 4
      ArMinorVersion = 2
      ArPatchVersion = 2
      ModuleId = 124
      Release = _TRICORE_TC377
      SwMajorVersion = 10
      SwMinorVersion = 40
      SwPatchVersion = 1
      VendorId = 17
    PortConfigSet
      17 x PortContainer:
        PortContainer_0: PortNumber=0, PortNumberOfPortPins=13
          13 x PortPin, all with PortPinControllerSelect=DISABLE, PortPinDirectionChangeable=false, PortPinEmergencyStop=false, PortPinEnableAnalogInputOnly=PORT_PIN_ANALOG_INPUT_DISABLE, PortPinInputPadLevel=PORT_INPUT_LEVEL_CMOS_AUTOMOTIVE, PortPinInputPullResistor=PORT_PIN_IN_PULL_UP, PortPinLevelValue=PORT_PIN_LEVEL_LOW, PortPinMode=PORT_PIN_MODE_ALL, PortPinModeChangeable=false, PortPinOutputPadDriveStrength=PORT_PIN_DEFAULT_DRIVER, PortPinOutputPinDriveMode=PORT_PIN_OUT_PUSHPULL:
            PortPin_0: PortPinDirection=PORT_PIN_IN, PortPinId=0, PortPinInitialMode=GPIO, PortPinSymbolicName=PORT_0_PIN_0
            PortPin_1: PortPinDirection=PORT_PIN_IN, PortPinId=1, PortPinInitialMode=GPIO, PortPinSymbolicName=PORT_0_PIN_1
            PortPin_10: PortPinDirection=PORT_PIN_OUT, PortPinId=10, PortPinInitialMode=GPIO, PortPinSymbolicName=PORT_0_PIN_10
            PortPin_11: PortPinDirection=PORT_PIN_IN, PortPinId=11, PortPinInitialMode=GPIO, PortPinSymbolicName=PORT_0_PIN_11
            PortPin_12: PortPinDirection=PORT_PIN_IN, PortPinId=12, PortPinInitialMode=GPIO, PortPinSymbolicName=PORT_0_PIN_12
            PortPin_2: PortPinDirection=PORT_PIN_OUT, PortPinId=2, PortPinInitialMode=ALT5, PortPinSymbolicName=PORT_0_PIN_2
            PortPin_3: PortPinDirection=PORT_PIN_IN, PortPinId=3, PortPinInitialMode=GPIO, PortPinSymbolicName=PORT_0_PIN_3
            PortPin_4: PortPinDirection=PORT_PIN_OUT, PortPinId=4, PortPinInitialMode=ALT1, PortPinSymbolicName=PORT_0_PIN_4
            PortPin_5: PortPinDirection=PORT_PIN_OUT, PortPinId=5, PortPinInitialMode=ALT1, PortPinSymbolicName=PORT_0_PIN_5
            PortPin_6: PortPinDirection=PORT_PIN_IN, PortPinId=6, PortPinInitialMode=GPIO, PortPinSymbolicName=PORT_0_PIN_6
            PortPin_{7..9}: PortPinDirection=PORT_PIN_OUT, PortPinId={7..9}, PortPinInitialMode=GPIO, PortPinSymbolicName=PORT_0_PIN_{7..9}
        PortContainer_1: PortNumber=1, PortNumberOfPortPins=5
          5 x PortPin, all with PortPinControllerSelect=DISABLE, PortPinDirectionChangeable=false, PortPinEmergencyStop=false, PortPinEnableAnalogInputOnly=PORT_PIN_ANALOG_INPUT_DISABLE, PortPinInputPadLevel=PORT_INPUT_LEVEL_CMOS_AUTOMOTIVE, PortPinInputPullResistor=PORT_PIN_IN_PULL_UP, PortPinLevelValue=PORT_PIN_LEVEL_LOW, PortPinMode=PORT_PIN_MODE_ALL, PortPinModeChangeable=false, PortPinOutputPadDriveStrength=PORT_PIN_DEFAULT_DRIVER, PortPinOutputPinDriveMode=PORT_PIN_OUT_PUSHPULL:
            PortPin_0: PortPinDirection=PORT_PIN_IN, PortPinId=19, PortPinInitialMode=GPIO, PortPinSymbolicName=PORT_1_PIN_3
            PortPin_1: PortPinDirection=PORT_PIN_OUT, PortPinId=20, PortPinInitialMode=ALT4, PortPinSymbolicName=PORT_1_PIN_4
            PortPin_2: PortPinDirection=PORT_PIN_IN, PortPinId=21, PortPinInitialMode=GPIO, PortPinSymbolicName=PORT_1_PIN_5
            PortPin_3: PortPinDirection=PORT_PIN_OUT, PortPinId=22, PortPinInitialMode=ALT4, PortPinSymbolicName=PORT_1_PIN_6
            PortPin_4: PortPinDirection=PORT_PIN_OUT, PortPinId=23, PortPinInitialMode=ALT4, PortPinSymbolicName=PORT_1_PIN_7
        PortContainer_10: PortNumber=10, PortNumberOfPortPins=9
          9 x PortPin, all with PortPinControllerSelect=DISABLE, PortPinDirectionChangeable=false, PortPinEmergencyStop=false, PortPinEnableAnalogInputOnly=PORT_PIN_ANALOG_INPUT_DISABLE, PortPinInputPadLevel=PORT_INPUT_LEVEL_CMOS_AUTOMOTIVE, PortPinInputPullResistor=PORT_PIN_IN_PULL_UP, PortPinMode=PORT_PIN_MODE_ALL, PortPinModeChangeable=false, PortPinOutputPadDriveStrength=PORT_PIN_DEFAULT_DRIVER, PortPinOutputPinDriveMode=PORT_PIN_OUT_PUSHPULL:
            PortPin_0: PortPinDirection=PORT_PIN_IN, PortPinId=160, PortPinInitialMode=GPIO, PortPinLevelValue=PORT_PIN_LEVEL_LOW, PortPinSymbolicName=PORT_10_PIN_0
            PortPin_1: PortPinDirection=PORT_PIN_IN, PortPinId=161, PortPinInitialMode=GPIO, PortPinLevelValue=PORT_PIN_LEVEL_LOW, PortPinSymbolicName=PORT_10_PIN_1
            PortPin_2: PortPinDirection=PORT_PIN_IN, PortPinId=162, PortPinInitialMode=GPIO, PortPinLevelValue=PORT_PIN_LEVEL_LOW, PortPinSymbolicName=PORT_10_PIN_2
            PortPin_3: PortPinDirection=PORT_PIN_OUT, PortPinId=163, PortPinInitialMode=ALT6, PortPinLevelValue=PORT_PIN_LEVEL_LOW, PortPinSymbolicName=PORT_10_PIN_3
            PortPin_4: PortPinDirection=PORT_PIN_IN, PortPinId=164, PortPinInitialMode=GPIO, PortPinLevelValue=PORT_PIN_LEVEL_LOW, PortPinSymbolicName=PORT_10_PIN_4
            PortPin_5: PortPinDirection=PORT_PIN_OUT, PortPinId=165, PortPinInitialMode=ALT2, PortPinLevelValue=PORT_PIN_LEVEL_LOW, PortPinSymbolicName=PORT_10_PIN_5
            PortPin_6: PortPinDirection=PORT_PIN_IN, PortPinId=166, PortPinInitialMode=GPIO, PortPinLevelValue=PORT_PIN_LEVEL_LOW, PortPinSymbolicName=PORT_10_PIN_6
            PortPin_7: PortPinDirection=PORT_PIN_IN, PortPinId=167, PortPinInitialMode=GPIO, PortPinLevelValue=PORT_PIN_LEVEL_LOW, PortPinSymbolicName=PORT_10_PIN_7
            PortPin_8: PortPinDirection=PORT_PIN_OUT, PortPinId=168, PortPinInitialMode=GPIO, PortPinLevelValue=PORT_PIN_LEVEL_HIGH, PortPinSymbolicName=PORT_10_PIN_8
        PortContainer_11: PortNumber=11, PortNumberOfPortPins=16
          16 x PortPin, all with PortPinDirectionChangeable=false, PortPinEmergencyStop=false, PortPinEnableAnalogInputOnly=PORT_PIN_ANALOG_INPUT_DISABLE, PortPinInputPullResistor=PORT_PIN_IN_PULL_UP, PortPinLevelValue=PORT_PIN_LEVEL_LOW, PortPinMode=PORT_PIN_MODE_ALL, PortPinModeChangeable=false, PortPinOutputPinDriveMode=PORT_PIN_OUT_PUSHPULL:
            PortPin_0_ETH_TXD3: PortPinControllerSelect=ENABLE, PortPinDirection=PORT_PIN_OUT, PortPinId=176, PortPinInitialMode=ALT6, PortPinInputPadLevel=PORT_INPUT_LEVEL_CMOS_AUTOMOTIVE, PortPinOutputPadDriveStrength=PORT_PIN_RGMII_DRIVER, PortPinSymbolicName=PORT_11_PIN_0
            PortPin_1_ETH_TXD2: PortPinControllerSelect=ENABLE, PortPinDirection=PORT_PIN_OUT, PortPinId=177, PortPinInitialMode=ALT6, PortPinInputPadLevel=PORT_INPUT_LEVEL_CMOS_AUTOMOTIVE, PortPinOutputPadDriveStrength=PORT_PIN_RGMII_DRIVER, PortPinSymbolicName=PORT_11_PIN_1
            PortPin_10_ETH_RXD0: PortPinControllerSelect=DISABLE, PortPinDirection=PORT_PIN_IN, PortPinId=186, PortPinInitialMode=GPIO, PortPinInputPadLevel=PORT_RGMII_INPUT, PortPinOutputPadDriveStrength=PORT_PIN_DEFAULT_DRIVER, PortPinSymbolicName=PORT_11_PIN_10
            PortPin_11_ETH_RCTL: PortPinControllerSelect=DISABLE, PortPinDirection=PORT_PIN_IN, PortPinId=187, PortPinInitialMode=GPIO, PortPinInputPadLevel=PORT_RGMII_INPUT, PortPinOutputPadDriveStrength=PORT_PIN_DEFAULT_DRIVER, PortPinSymbolicName=PORT_11_PIN_11
            PortPin_12_ETH_RXCLK: PortPinControllerSelect=DISABLE, PortPinDirection=PORT_PIN_IN, PortPinId=188, PortPinInitialMode=GPIO, PortPinInputPadLevel=PORT_RGMII_INPUT, PortPinOutputPadDriveStrength=PORT_PIN_DEFAULT_DRIVER, PortPinSymbolicName=PORT_11_PIN_12
            PortPin_13: PortPinControllerSelect=DISABLE, PortPinDirection=PORT_PIN_IN, PortPinId=189, PortPinInitialMode=GPIO, PortPinInputPadLevel=PORT_INPUT_LEVEL_CMOS_AUTOMOTIVE, PortPinOutputPadDriveStrength=PORT_PIN_DEFAULT_DRIVER, PortPinSymbolicName=PORT_11_PIN_13
            PortPin_14: PortPinControllerSelect=DISABLE, PortPinDirection=PORT_PIN_IN, PortPinId=190, PortPinInitialMode=GPIO, PortPinInputPadLevel=PORT_INPUT_LEVEL_CMOS_AUTOMOTIVE, PortPinOutputPadDriveStrength=PORT_PIN_DEFAULT_DRIVER, PortPinSymbolicName=PORT_11_PIN_14
            PortPin_15: PortPinControllerSelect=DISABLE, PortPinDirection=PORT_PIN_IN, PortPinId=191, PortPinInitialMode=GPIO, PortPinInputPadLevel=PORT_INPUT_LEVEL_CMOS_AUTOMOTIVE, PortPinOutputPadDriveStrength=PORT_PIN_DEFAULT_DRIVER, PortPinSymbolicName=PORT_11_PIN_15
            PortPin_2_ETH_TXD1: PortPinControllerSelect=ENABLE, PortPinDirection=PORT_PIN_OUT, PortPinId=178, PortPinInitialMode=ALT6, PortPinInputPadLevel=PORT_INPUT_LEVEL_CMOS_AUTOMOTIVE, PortPinOutputPadDriveStrength=PORT_PIN_RGMII_DRIVER, PortPinSymbolicName=PORT_11_PIN_2
            PortPin_3_ETH_TXD0: PortPinControllerSelect=ENABLE, PortPinDirection=PORT_PIN_OUT, PortPinId=179, PortPinInitialMode=ALT6, PortPinInputPadLevel=PORT_INPUT_LEVEL_CMOS_AUTOMOTIVE, PortPinOutputPadDriveStrength=PORT_PIN_RGMII_DRIVER, PortPinSymbolicName=PORT_11_PIN_3
            PortPin_4_ETH_TXCLK: PortPinControllerSelect=ENABLE, PortPinDirection=PORT_PIN_OUT, PortPinId=180, PortPinInitialMode=ALT7, PortPinInputPadLevel=PORT_INPUT_LEVEL_CMOS_AUTOMOTIVE, PortPinOutputPadDriveStrength=PORT_PIN_RGMII_DRIVER, PortPinSymbolicName=PORT_11_PIN_4
            PortPin_5_ETH_GREFCLK: PortPinControllerSelect=DISABLE, PortPinDirection=PORT_PIN_IN, PortPinId=181, PortPinInitialMode=GPIO, PortPinInputPadLevel=PORT_RGMII_INPUT, PortPinOutputPadDriveStrength=PORT_PIN_DEFAULT_DRIVER, PortPinSymbolicName=PORT_11_PIN_5
            PortPin_6_ETH_TCTL: PortPinControllerSelect=ENABLE, PortPinDirection=PORT_PIN_OUT, PortPinId=182, PortPinInitialMode=ALT6, PortPinInputPadLevel=PORT_INPUT_LEVEL_CMOS_AUTOMOTIVE, PortPinOutputPadDriveStrength=PORT_PIN_RGMII_DRIVER, PortPinSymbolicName=PORT_11_PIN_6
            PortPin_7_ETH_RXD3: PortPinControllerSelect=DISABLE, PortPinDirection=PORT_PIN_IN, PortPinId=183, PortPinInitialMode=GPIO, PortPinInputPadLevel=PORT_RGMII_INPUT, PortPinOutputPadDriveStrength=PORT_PIN_DEFAULT_DRIVER, PortPinSymbolicName=PORT_11_PIN_7
            PortPin_8_ETH_RXD2: PortPinControllerSelect=DISABLE, PortPinDirection=PORT_PIN_IN, PortPinId=184, PortPinInitialMode=GPIO, PortPinInputPadLevel=PORT_RGMII_INPUT, PortPinOutputPadDriveStrength=PORT_PIN_DEFAULT_DRIVER, PortPinSymbolicName=PORT_11_PIN_8
            PortPin_9_ETH_RXD1: PortPinControllerSelect=DISABLE, PortPinDirection=PORT_PIN_IN, PortPinId=185, PortPinInitialMode=GPIO, PortPinInputPadLevel=PORT_RGMII_INPUT, PortPinOutputPadDriveStrength=PORT_PIN_DEFAULT_DRIVER, PortPinSymbolicName=PORT_11_PIN_9
        PortContainer_12: PortNumber=12, PortNumberOfPortPins=2
          PortPin_0_MDC (PortPin):
            PortPinControllerSelect = DISABLE
            PortPinDirection = PORT_PIN_OUT
            PortPinDirectionChangeable = false
            PortPinEmergencyStop = false
            PortPinEnableAnalogInputOnly = PORT_PIN_ANALOG_INPUT_DISABLE
            PortPinId = 192
            PortPinInitialMode = ALT6
            PortPinInputPadLevel = PORT_INPUT_LEVEL_CMOS_AUTOMOTIVE
            PortPinInputPullResistor = PORT_PIN_IN_PULL_UP
            PortPinLevelValue = PORT_PIN_LEVEL_LOW
            PortPinMode = PORT_PIN_MODE_ALL
            PortPinModeChangeable = false
            PortPinOutputPadDriveStrength = PORT_PIN_DEFAULT_DRIVER
            PortPinOutputPinDriveMode = PORT_PIN_OUT_PUSHPULL
            PortPinSymbolicName = PORT_12_PIN_0
          PortPin_1_MDIO (PortPin):
            PortPinControllerSelect = DISABLE
            PortPinDirection = PORT_PIN_IN
            PortPinDirectionChangeable = false
            PortPinEmergencyStop = false
            PortPinEnableAnalogInputOnly = PORT_PIN_ANALOG_INPUT_DISABLE
            PortPinId = 193
            PortPinInitialMode = GPIO
            PortPinInputPadLevel = PORT_INPUT_LEVEL_CMOS_AUTOMOTIVE
            PortPinInputPullResistor = PORT_PIN_IN_PULL_UP
            PortPinLevelValue = PORT_PIN_LEVEL_LOW
            PortPinMode = PORT_PIN_MODE_ALL
            PortPinModeChangeable = false
            PortPinOutputPadDriveStrength = PORT_PIN_DEFAULT_DRIVER
            PortPinOutputPinDriveMode = PORT_PIN_OUT_PUSHPULL
            PortPinSymbolicName = PORT_12_PIN_1
        PortContainer_13: PortNumber=13, PortNumberOfPortPins=4
          PortLVDS_0 (PortLVDS):
            PortLVDSMode = LVDSH
            PortLVDSPadSupply = V3_3
            PortLVDSPinPair = Pin_0_Pin_1
            PortLVDSRxEnController = PORT_CONTROLLED
            PortLVDSRxPathEnable = false
            PortLVDSRxTerminationMode = INTERNAL_TERMINATION
            PortLVDSTxEnController = PORT_CONTROLLED
            PortLVDSTxPathEnable = false
            PortLVDSTxPowerDownPullDown = DISABLE
          PortLVDS_1 (PortLVDS):
            PortLVDSMode = LVDSH
            PortLVDSPadSupply = V3_3
            PortLVDSPinPair = Pin_2_Pin_3
            PortLVDSRxEnController = PORT_CONTROLLED
            PortLVDSRxPathEnable = false
            PortLVDSRxTerminationMode = INTERNAL_TERMINATION
            PortLVDSTxEnController = PORT_CONTROLLED
            PortLVDSTxPathEnable = false
            PortLVDSTxPowerDownPullDown = DISABLE
          4 x PortPin, all with PortPinControllerSelect=DISABLE, PortPinDirection=PORT_PIN_OUT, PortPinDirectionChangeable=false, PortPinEmergencyStop=false, PortPinEnableAnalogInputOnly=PORT_PIN_ANALOG_INPUT_DISABLE, PortPinInitialMode=GPIO, PortPinInputPadLevel=PORT_INPUT_LEVEL_CMOS_AUTOMOTIVE, PortPinInputPullResistor=PORT_PIN_IN_PULL_UP, PortPinLevelValue=PORT_PIN_LEVEL_LOW, PortPinMode=PORT_PIN_MODE_ALL, PortPinModeChangeable=false, PortPinOutputPadDriveStrength=PORT_PIN_DEFAULT_DRIVER, PortPinOutputPinDriveMode=PORT_PIN_OUT_PUSHPULL:
            PortPin_0: PortPinId=208, PortPinSymbolicName=PORT_13_PIN_0
            PortPin_1: PortPinId=209, PortPinSymbolicName=PORT_13_PIN_1
            PortPin_2: PortPinId=210, PortPinSymbolicName=PORT_13_PIN_2
            PortPin_3: PortPinId=211, PortPinSymbolicName=PORT_13_PIN_3
        PortContainer_14: PortNumber=14, PortNumberOfPortPins=11
          PortLVDS_0 (PortLVDS):
            PortLVDSMode = LVDSH
            PortLVDSPadSupply = V3_3
            PortLVDSPinPair = Pin_9_Pin_10
            PortLVDSRxEnController = PORT_CONTROLLED
            PortLVDSRxPathEnable = false
            PortLVDSRxTerminationMode = INTERNAL_TERMINATION
            PortLVDSTxEnController = PORT_CONTROLLED
            PortLVDSTxPathEnable = false
            PortLVDSTxPowerDownPullDown = DISABLE
          11 x PortPin, all with PortPinControllerSelect=DISABLE, PortPinDirectionChangeable=false, PortPinEmergencyStop=false, PortPinEnableAnalogInputOnly=PORT_PIN_ANALOG_INPUT_DISABLE, PortPinInputPadLevel=PORT_INPUT_LEVEL_CMOS_AUTOMOTIVE, PortPinInputPullResistor=PORT_PIN_IN_PULL_UP, PortPinLevelValue=PORT_PIN_LEVEL_LOW, PortPinMode=PORT_PIN_MODE_ALL, PortPinModeChangeable=false, PortPinOutputPadDriveStrength=PORT_PIN_DEFAULT_DRIVER, PortPinOutputPinDriveMode=PORT_PIN_OUT_PUSHPULL:
            PortPin_0: PortPinDirection=PORT_PIN_OUT, PortPinId=224, PortPinInitialMode=ALT5, PortPinSymbolicName=PORT_14_PIN_0
            PortPin_1: PortPinDirection=PORT_PIN_IN, PortPinId=225, PortPinInitialMode=GPIO, PortPinSymbolicName=PORT_14_PIN_1
            PortPin_10: PortPinDirection=PORT_PIN_IN, PortPinId=234, PortPinInitialMode=GPIO, PortPinSymbolicName=PORT_14_PIN_10
            PortPin_2: PortPinDirection=PORT_PIN_IN, PortPinId=226, PortPinInitialMode=GPIO, PortPinSymbolicName=PORT_14_PIN_2
            PortPin_3: PortPinDirection=PORT_PIN_IN, PortPinId=227, PortPinInitialMode=GPIO, PortPinSymbolicName=PORT_14_PIN_3
            PortPin_4: PortPinDirection=PORT_PIN_IN, PortPinId=228, PortPinInitialMode=GPIO, PortPinSymbolicName=PORT_14_PIN_4
            PortPin_5: PortPinDirection=PORT_PIN_IN, PortPinId=229, PortPinInitialMode=GPIO, PortPinSymbolicName=PORT_14_PIN_5
            PortPin_6: PortPinDirection=PORT_PIN_IN, PortPinId=230, PortPinInitialMode=GPIO, PortPinSymbolicName=PORT_14_PIN_6
            PortPin_7: PortPinDirection=PORT_PIN_IN, PortPinId=231, PortPinInitialMode=GPIO, PortPinSymbolicName=PORT_14_PIN_7
            PortPin_8: PortPinDirection=PORT_PIN_IN, PortPinId=232, PortPinInitialMode=GPIO, PortPinSymbolicName=PORT_14_PIN_8
            PortPin_9: PortPinDirection=PORT_PIN_IN, PortPinId=233, PortPinInitialMode=GPIO, PortPinSymbolicName=PORT_14_PIN_9
        PortContainer_15: PortNumber=15, PortNumberOfPortPins=9
          9 x PortPin, all with PortPinControllerSelect=DISABLE, PortPinDirectionChangeable=false, PortPinEmergencyStop=false, PortPinEnableAnalogInputOnly=PORT_PIN_ANALOG_INPUT_DISABLE, PortPinInputPadLevel=PORT_INPUT_LEVEL_CMOS_AUTOMOTIVE, PortPinInputPullResistor=PORT_PIN_IN_PULL_UP, PortPinLevelValue=PORT_PIN_LEVEL_LOW, PortPinMode=PORT_PIN_MODE_ALL, PortPinModeChangeable=false, PortPinOutputPadDriveStrength=PORT_PIN_DEFAULT_DRIVER, PortPinOutputPinDriveMode=PORT_PIN_OUT_PUSHPULL:
            PortPin_0: PortPinDirection=PORT_PIN_OUT, PortPinId=240, PortPinInitialMode=ALT2, PortPinSymbolicName=PORT_15_PIN_0
            PortPin_1: PortPinDirection=PORT_PIN_IN, PortPinId=241, PortPinInitialMode=GPIO, PortPinSymbolicName=PORT_15_PIN_1
            PortPin_2: PortPinDirection=PORT_PIN_OUT, PortPinId=242, PortPinInitialMode=ALT3, PortPinSymbolicName=PORT_15_PIN_2
            PortPin_3: PortPinDirection=PORT_PIN_OUT, PortPinId=243, PortPinInitialMode=ALT3, PortPinSymbolicName=PORT_15_PIN_3
            PortPin_4: PortPinDirection=PORT_PIN_IN, PortPinId=244, PortPinInitialMode=GPIO, PortPinSymbolicName=PORT_15_PIN_4
            PortPin_5: PortPinDirection=PORT_PIN_IN, PortPinId=245, PortPinInitialMode=GPIO, PortPinSymbolicName=PORT_15_PIN_5
            PortPin_6: PortPinDirection=PORT_PIN_OUT, PortPinId=246, PortPinInitialMode=ALT3, PortPinSymbolicName=PORT_15_PIN_6
            PortPin_7: PortPinDirection=PORT_PIN_IN, PortPinId=247, PortPinInitialMode=GPIO, PortPinSymbolicName=PORT_15_PIN_7
            PortPin_8: PortPinDirection=PORT_PIN_IN, PortPinId=248, PortPinInitialMode=GPIO, PortPinSymbolicName=PORT_15_PIN_8
        PortContainer_2: PortNumber=2, PortNumberOfPortPins=12
          12 x PortPin, all with PortPinControllerSelect=DISABLE, PortPinDirectionChangeable=false, PortPinEmergencyStop=false, PortPinEnableAnalogInputOnly=PORT_PIN_ANALOG_INPUT_DISABLE, PortPinInitialMode=GPIO, PortPinInputPadLevel=PORT_INPUT_LEVEL_CMOS_AUTOMOTIVE, PortPinInputPullResistor=PORT_PIN_IN_PULL_UP, PortPinLevelValue=PORT_PIN_LEVEL_LOW, PortPinMode=PORT_PIN_MODE_ALL, PortPinModeChangeable=false, PortPinOutputPadDriveStrength=PORT_PIN_DEFAULT_DRIVER, PortPinOutputPinDriveMode=PORT_PIN_OUT_PUSHPULL:
            PortPin_0_IN12: PortPinDirection=PORT_PIN_OUT, PortPinId=32, PortPinSymbolicName=PORT_2_PIN_0
            PortPin_1_IN11: PortPinDirection=PORT_PIN_OUT, PortPinId=33, PortPinSymbolicName=PORT_2_PIN_1
            PortPin_10: PortPinDirection=PORT_PIN_IN, PortPinId=42, PortPinSymbolicName=PORT_2_PIN_10
            PortPin_11: PortPinDirection=PORT_PIN_IN, PortPinId=43, PortPinSymbolicName=PORT_2_PIN_11
            PortPin_2_IN10: PortPinDirection=PORT_PIN_OUT, PortPinId=34, PortPinSymbolicName=PORT_2_PIN_2
            PortPin_3_IN9: PortPinDirection=PORT_PIN_OUT, PortPinId=35, PortPinSymbolicName=PORT_2_PIN_3
            PortPin_4: PortPinDirection=PORT_PIN_IN, PortPinId=36, PortPinSymbolicName=PORT_2_PIN_4
            PortPin_5: PortPinDirection=PORT_PIN_IN, PortPinId=37, PortPinSymbolicName=PORT_2_PIN_5
            PortPin_6: PortPinDirection=PORT_PIN_IN, PortPinId=38, PortPinSymbolicName=PORT_2_PIN_6
            PortPin_7: PortPinDirection=PORT_PIN_IN, PortPinId=39, PortPinSymbolicName=PORT_2_PIN_7
            PortPin_8: PortPinDirection=PORT_PIN_IN, PortPinId=40, PortPinSymbolicName=PORT_2_PIN_8
            PortPin_9: PortPinDirection=PORT_PIN_IN, PortPinId=41, PortPinSymbolicName=PORT_2_PIN_9
        PortContainer_20: PortNumber=20, PortNumberOfPortPins=13
          13 x PortPin, all with PortPinControllerSelect=DISABLE, PortPinDirectionChangeable=false, PortPinEmergencyStop=false, PortPinEnableAnalogInputOnly=PORT_PIN_ANALOG_INPUT_DISABLE, PortPinInputPadLevel=PORT_INPUT_LEVEL_CMOS_AUTOMOTIVE, PortPinInputPullResistor=PORT_PIN_IN_PULL_UP, PortPinLevelValue=PORT_PIN_LEVEL_LOW, PortPinMode=PORT_PIN_MODE_ALL, PortPinModeChangeable=false, PortPinOutputPadDriveStrength=PORT_PIN_DEFAULT_DRIVER, PortPinOutputPinDriveMode=PORT_PIN_OUT_PUSHPULL:
            PortPin_0: PortPinDirection=PORT_PIN_IN, PortPinId=320, PortPinInitialMode=GPIO, PortPinSymbolicName=PORT_20_PIN_0
            PortPin_1: PortPinDirection=PORT_PIN_IN, PortPinId=321, PortPinInitialMode=GPIO, PortPinSymbolicName=PORT_20_PIN_1
            PortPin_10: PortPinDirection=PORT_PIN_IN, PortPinId=332, PortPinInitialMode=GPIO, PortPinSymbolicName=PORT_20_PIN_12
            PortPin_11: PortPinDirection=PORT_PIN_IN, PortPinId=333, PortPinInitialMode=GPIO, PortPinSymbolicName=PORT_20_PIN_13
            PortPin_12: PortPinDirection=PORT_PIN_IN, PortPinId=334, PortPinInitialMode=GPIO, PortPinSymbolicName=PORT_20_PIN_14
            PortPin_2: PortPinDirection=PORT_PIN_IN, PortPinId=322, PortPinInitialMode=GPIO, PortPinSymbolicName=PORT_20_PIN_2
            PortPin_3: PortPinDirection=PORT_PIN_IN, PortPinId=323, PortPinInitialMode=GPIO, PortPinSymbolicName=PORT_20_PIN_3
            PortPin_4: PortPinDirection=PORT_PIN_IN, PortPinId=326, PortPinInitialMode=GPIO, PortPinSymbolicName=PORT_20_PIN_6
            PortPin_5_CAN00_RX: PortPinDirection=PORT_PIN_IN, PortPinId=327, PortPinInitialMode=GPIO, PortPinSymbolicName=PORT_20_PIN_7
            PortPin_6_CAN00_TX: PortPinDirection=PORT_PIN_OUT, PortPinId=328, PortPinInitialMode=ALT5, PortPinSymbolicName=PORT_20_PIN_8
            PortPin_7: PortPinDirection=PORT_PIN_IN, PortPinId=329, PortPinInitialMode=GPIO, PortPinSymbolicName=PORT_20_PIN_9
            PortPin_8: PortPinDirection=PORT_PIN_IN, PortPinId=330, PortPinInitialMode=GPIO, PortPinSymbolicName=PORT_20_PIN_10
            PortPin_9: PortPinDirection=PORT_PIN_IN, PortPinId=331, PortPinInitialMode=GPIO, PortPinSymbolicName=PORT_20_PIN_11
        PortContainer_21: PortNumber=21, PortNumberOfPortPins=8
          3 x PortLVDS, all with PortLVDSMode=LVDSH, PortLVDSPadSupply=V3_3, PortLVDSRxEnController=PORT_CONTROLLED, PortLVDSRxPathEnable=false, PortLVDSRxTerminationMode=INTERNAL_TERMINATION, PortLVDSTxEnController=PORT_CONTROLLED, PortLVDSTxPathEnable=false, PortLVDSTxPowerDownPullDown=DISABLE:
            PortLVDS_0: PortLVDSPinPair=Pin_0_Pin_1
            PortLVDS_1: PortLVDSPinPair=Pin_2_Pin_3
            PortLVDS_2: PortLVDSPinPair=Pin_4_Pin_5
          8 x PortPin, all with PortPinControllerSelect=DISABLE, PortPinDirection=PORT_PIN_IN, PortPinDirectionChangeable=false, PortPinEmergencyStop=false, PortPinEnableAnalogInputOnly=PORT_PIN_ANALOG_INPUT_DISABLE, PortPinInitialMode=GPIO, PortPinInputPadLevel=PORT_INPUT_LEVEL_CMOS_AUTOMOTIVE, PortPinInputPullResistor=PORT_PIN_IN_PULL_UP, PortPinLevelValue=PORT_PIN_LEVEL_LOW, PortPinMode=PORT_PIN_MODE_ALL, PortPinModeChangeable=false, PortPinOutputPadDriveStrength=PORT_PIN_DEFAULT_DRIVER, PortPinOutputPinDriveMode=PORT_PIN_OUT_PUSHPULL:
            PortPin_0: PortPinId=336, PortPinSymbolicName=PORT_21_PIN_0
            PortPin_1: PortPinId=337, PortPinSymbolicName=PORT_21_PIN_1
            PortPin_2: PortPinId=338, PortPinSymbolicName=PORT_21_PIN_2
            PortPin_3: PortPinId=339, PortPinSymbolicName=PORT_21_PIN_3
            PortPin_4: PortPinId=340, PortPinSymbolicName=PORT_21_PIN_4
            PortPin_5: PortPinId=341, PortPinSymbolicName=PORT_21_PIN_5
            PortPin_6: PortPinId=342, PortPinSymbolicName=PORT_21_PIN_6
            PortPin_7: PortPinId=343, PortPinSymbolicName=PORT_21_PIN_7
        PortContainer_22: PortNumber=22, PortNumberOfPortPins=12
          PortLVDS_0 (PortLVDS):
            PortLVDSMode = LVDSH
            PortLVDSPadSupply = V3_3
            PortLVDSPinPair = Pin_0_Pin_1
            PortLVDSRxEnController = PORT_CONTROLLED
            PortLVDSRxPathEnable = false
            PortLVDSRxTerminationMode = INTERNAL_TERMINATION
            PortLVDSTxEnController = PORT_CONTROLLED
            PortLVDSTxPathEnable = false
            PortLVDSTxPowerDownPullDown = DISABLE
          PortLVDS_1 (PortLVDS):
            PortLVDSMode = LVDSH
            PortLVDSPadSupply = V3_3
            PortLVDSPinPair = Pin_2_Pin_3
            PortLVDSRxEnController = PORT_CONTROLLED
            PortLVDSRxPathEnable = false
            PortLVDSRxTerminationMode = INTERNAL_TERMINATION
            PortLVDSTxEnController = PORT_CONTROLLED
            PortLVDSTxPathEnable = false
            PortLVDSTxPowerDownPullDown = DISABLE
          12 x PortPin, all with PortPinControllerSelect=DISABLE, PortPinDirectionChangeable=false, PortPinEmergencyStop=false, PortPinEnableAnalogInputOnly=PORT_PIN_ANALOG_INPUT_DISABLE, PortPinInputPadLevel=PORT_INPUT_LEVEL_CMOS_AUTOMOTIVE, PortPinInputPullResistor=PORT_PIN_IN_PULL_UP, PortPinLevelValue=PORT_PIN_LEVEL_LOW, PortPinMode=PORT_PIN_MODE_ALL, PortPinModeChangeable=false, PortPinOutputPadDriveStrength=PORT_PIN_DEFAULT_DRIVER, PortPinOutputPinDriveMode=PORT_PIN_OUT_PUSHPULL:
            PortPin_0: PortPinDirection=PORT_PIN_OUT, PortPinId=352, PortPinInitialMode=ALT3, PortPinSymbolicName=PORT_22_PIN_0
            PortPin_1: PortPinDirection=PORT_PIN_IN, PortPinId=353, PortPinInitialMode=GPIO, PortPinSymbolicName=PORT_22_PIN_1
            PortPin_10: PortPinDirection=PORT_PIN_IN, PortPinId=362, PortPinInitialMode=GPIO, PortPinSymbolicName=PORT_22_PIN_10
            PortPin_11: PortPinDirection=PORT_PIN_IN, PortPinId=363, PortPinInitialMode=GPIO, PortPinSymbolicName=PORT_22_PIN_11
            PortPin_2: PortPinDirection=PORT_PIN_OUT, PortPinId=354, PortPinInitialMode=ALT3, PortPinSymbolicName=PORT_22_PIN_2
            PortPin_3: PortPinDirection=PORT_PIN_OUT, PortPinId=355, PortPinInitialMode=ALT3, PortPinSymbolicName=PORT_22_PIN_3
            PortPin_4: PortPinDirection=PORT_PIN_IN, PortPinId=356, PortPinInitialMode=GPIO, PortPinSymbolicName=PORT_22_PIN_4
            PortPin_5: PortPinDirection=PORT_PIN_IN, PortPinId=357, PortPinInitialMode=GPIO, PortPinSymbolicName=PORT_22_PIN_5
            PortPin_6: PortPinDirection=PORT_PIN_IN, PortPinId=358, PortPinInitialMode=GPIO, PortPinSymbolicName=PORT_22_PIN_6
            PortPin_7: PortPinDirection=PORT_PIN_IN, PortPinId=359, PortPinInitialMode=GPIO, PortPinSymbolicName=PORT_22_PIN_7
            PortPin_8: PortPinDirection=PORT_PIN_IN, PortPinId=360, PortPinInitialMode=GPIO, PortPinSymbolicName=PORT_22_PIN_8
            PortPin_9: PortPinDirection=PORT_PIN_IN, PortPinId=361, PortPinInitialMode=GPIO, PortPinSymbolicName=PORT_22_PIN_9
        PortContainer_23: PortNumber=23, PortNumberOfPortPins=8
          8 x PortPin, all with PortPinControllerSelect=DISABLE, PortPinDirectionChangeable=false, PortPinEmergencyStop=false, PortPinEnableAnalogInputOnly=PORT_PIN_ANALOG_INPUT_DISABLE, PortPinInputPadLevel=PORT_INPUT_LEVEL_CMOS_AUTOMOTIVE, PortPinInputPullResistor=PORT_PIN_IN_PULL_UP, PortPinLevelValue=PORT_PIN_LEVEL_LOW, PortPinMode=PORT_PIN_MODE_ALL, PortPinModeChangeable=false, PortPinOutputPadDriveStrength=PORT_PIN_DEFAULT_DRIVER, PortPinOutputPinDriveMode=PORT_PIN_OUT_PUSHPULL:
            PortPin_0: PortPinDirection=PORT_PIN_IN, PortPinId=368, PortPinInitialMode=GPIO, PortPinSymbolicName=PORT_23_PIN_0
            PortPin_1: PortPinDirection=PORT_PIN_OUT, PortPinId=369, PortPinInitialMode=ALT5, PortPinSymbolicName=PORT_23_PIN_1
            PortPin_2: PortPinDirection=PORT_PIN_IN, PortPinId=370, PortPinInitialMode=GPIO, PortPinSymbolicName=PORT_23_PIN_2
            PortPin_3: PortPinDirection=PORT_PIN_IN, PortPinId=371, PortPinInitialMode=GPIO, PortPinSymbolicName=PORT_23_PIN_3
            PortPin_4: PortPinDirection=PORT_PIN_IN, PortPinId=372, PortPinInitialMode=GPIO, PortPinSymbolicName=PORT_23_PIN_4
            PortPin_5: PortPinDirection=PORT_PIN_OUT, PortPinId=373, PortPinInitialMode=GPIO, PortPinSymbolicName=PORT_23_PIN_5
            PortPin_6: PortPinDirection=PORT_PIN_IN, PortPinId=374, PortPinInitialMode=GPIO, PortPinSymbolicName=PORT_23_PIN_6
            PortPin_7: PortPinDirection=PORT_PIN_IN, PortPinId=375, PortPinInitialMode=GPIO, PortPinSymbolicName=PORT_23_PIN_7
        PortContainer_32: PortNumber=32, PortNumberOfPortPins=8
          8 x PortPin, all with PortPinControllerSelect=DISABLE, PortPinDirection=PORT_PIN_IN, PortPinDirectionChangeable=false, PortPinEmergencyStop=false, PortPinEnableAnalogInputOnly=PORT_PIN_ANALOG_INPUT_DISABLE, PortPinInitialMode=GPIO, PortPinInputPadLevel=PORT_INPUT_LEVEL_CMOS_AUTOMOTIVE, PortPinInputPullResistor=PORT_PIN_IN_PULL_UP, PortPinLevelValue=PORT_PIN_LEVEL_LOW, PortPinMode=PORT_PIN_MODE_ALL, PortPinModeChangeable=false, PortPinOutputPadDriveStrength=PORT_PIN_DEFAULT_DRIVER, PortPinOutputPinDriveMode=PORT_PIN_OUT_PUSHPULL:
            PortPin_0: PortPinId=512, PortPinSymbolicName=PORT_32_PIN_0
            PortPin_1: PortPinId=513, PortPinSymbolicName=PORT_32_PIN_1
            PortPin_2: PortPinId=514, PortPinSymbolicName=PORT_32_PIN_2
            PortPin_3: PortPinId=515, PortPinSymbolicName=PORT_32_PIN_3
            PortPin_4: PortPinId=516, PortPinSymbolicName=PORT_32_PIN_4
            PortPin_5: PortPinId=517, PortPinSymbolicName=PORT_32_PIN_5
            PortPin_6: PortPinId=518, PortPinSymbolicName=PORT_32_PIN_6
            PortPin_7: PortPinId=519, PortPinSymbolicName=PORT_32_PIN_7
        PortContainer_33: PortNumber=33, PortNumberOfPortPins=16
          16 x PortPin, all with PortPinControllerSelect=DISABLE, PortPinDirection=PORT_PIN_IN, PortPinDirectionChangeable=false, PortPinEmergencyStop=false, PortPinEnableAnalogInputOnly=PORT_PIN_ANALOG_INPUT_DISABLE, PortPinInitialMode=GPIO, PortPinInputPadLevel=PORT_INPUT_LEVEL_CMOS_AUTOMOTIVE, PortPinInputPullResistor=PORT_PIN_IN_PULL_UP, PortPinLevelValue=PORT_PIN_LEVEL_LOW, PortPinMode=PORT_PIN_MODE_ALL, PortPinModeChangeable=false, PortPinOutputPadDriveStrength=PORT_PIN_DEFAULT_DRIVER, PortPinOutputPinDriveMode=PORT_PIN_OUT_PUSHPULL:
            PortPin_0: PortPinId=528, PortPinSymbolicName=PORT_33_PIN_0
            PortPin_1: PortPinId=529, PortPinSymbolicName=PORT_33_PIN_1
            PortPin_10: PortPinId=538, PortPinSymbolicName=PORT_33_PIN_10
            PortPin_11: PortPinId=539, PortPinSymbolicName=PORT_33_PIN_11
            PortPin_12: PortPinId=540, PortPinSymbolicName=PORT_33_PIN_12
            PortPin_13: PortPinId=541, PortPinSymbolicName=PORT_33_PIN_13
            PortPin_14: PortPinId=542, PortPinSymbolicName=PORT_33_PIN_14
            PortPin_15: PortPinId=543, PortPinSymbolicName=PORT_33_PIN_15
            PortPin_2: PortPinId=530, PortPinSymbolicName=PORT_33_PIN_2
            PortPin_3: PortPinId=531, PortPinSymbolicName=PORT_33_PIN_3
            PortPin_4: PortPinId=532, PortPinSymbolicName=PORT_33_PIN_4
            PortPin_5: PortPinId=533, PortPinSymbolicName=PORT_33_PIN_5
            PortPin_6: PortPinId=534, PortPinSymbolicName=PORT_33_PIN_6
            PortPin_7: PortPinId=535, PortPinSymbolicName=PORT_33_PIN_7
            PortPin_8: PortPinId=536, PortPinSymbolicName=PORT_33_PIN_8
            PortPin_9: PortPinId=537, PortPinSymbolicName=PORT_33_PIN_9
        PortContainer_34: PortNumber=34, PortNumberOfPortPins=5
          5 x PortPin, all with PortPinControllerSelect=DISABLE, PortPinDirection=PORT_PIN_IN, PortPinDirectionChangeable=false, PortPinEmergencyStop=false, PortPinEnableAnalogInputOnly=PORT_PIN_ANALOG_INPUT_DISABLE, PortPinInitialMode=GPIO, PortPinInputPadLevel=PORT_INPUT_LEVEL_CMOS_AUTOMOTIVE, PortPinInputPullResistor=PORT_PIN_IN_PULL_UP, PortPinLevelValue=PORT_PIN_LEVEL_LOW, PortPinMode=PORT_PIN_MODE_ALL, PortPinModeChangeable=false, PortPinOutputPadDriveStrength=PORT_PIN_DEFAULT_DRIVER, PortPinOutputPinDriveMode=PORT_PIN_OUT_PUSHPULL:
            PortPin_0: PortPinId=545, PortPinSymbolicName=PORT_34_PIN_1
            PortPin_1: PortPinId=546, PortPinSymbolicName=PORT_34_PIN_2
            PortPin_2: PortPinId=547, PortPinSymbolicName=PORT_34_PIN_3
            PortPin_3: PortPinId=548, PortPinSymbolicName=PORT_34_PIN_4
            PortPin_4: PortPinId=549, PortPinSymbolicName=PORT_34_PIN_5
        PortContainer_40: PortNumber=40, PortNumberOfPortPins=15
          15 x PortPin, all with PortPinControllerSelect=DISABLE, PortPinDirection=PORT_PIN_IN, PortPinDirectionChangeable=false, PortPinEmergencyStop=false, PortPinEnableAnalogInputOnly=PORT_PIN_ANALOG_INPUT_DISABLE, PortPinInitialMode=GPIO, PortPinInputPadLevel=PORT_INPUT_LEVEL_CMOS_AUTOMOTIVE, PortPinLevelValue=PORT_PIN_LEVEL_LOW, PortPinMode=PORT_PIN_MODE_ALL, PortPinModeChangeable=false, PortPinOutputPadDriveStrength=PORT_PIN_DEFAULT_DRIVER, PortPinOutputPinDriveMode=PORT_PIN_OUT_PUSHPULL:
            PortPin_0: PortPinId=640, PortPinInputPullResistor=PORT_PIN_IN_PULL_UP, PortPinSymbolicName=PORT_40_PIN_0
            PortPin_1: PortPinId=641, PortPinInputPullResistor=PORT_PIN_IN_NO_PULL, PortPinSymbolicName=PORT_40_PIN_1
            PortPin_10: PortPinId=650, PortPinInputPullResistor=PORT_PIN_IN_NO_PULL, PortPinSymbolicName=PORT_40_PIN_10
            PortPin_11: PortPinId=651, PortPinInputPullResistor=PORT_PIN_IN_NO_PULL, PortPinSymbolicName=PORT_40_PIN_11
            PortPin_12: PortPinId=652, PortPinInputPullResistor=PORT_PIN_IN_NO_PULL, PortPinSymbolicName=PORT_40_PIN_12
            PortPin_13: PortPinId=653, PortPinInputPullResistor=PORT_PIN_IN_PULL_UP, PortPinSymbolicName=PORT_40_PIN_13
            PortPin_14: PortPinId=654, PortPinInputPullResistor=PORT_PIN_IN_PULL_UP, PortPinSymbolicName=PORT_40_PIN_14
            PortPin_2: PortPinId=642, PortPinInputPullResistor=PORT_PIN_IN_PULL_UP, PortPinSymbolicName=PORT_40_PIN_2
            PortPin_3: PortPinId=643, PortPinInputPullResistor=PORT_PIN_IN_PULL_UP, PortPinSymbolicName=PORT_40_PIN_3
            PortPin_4: PortPinId=644, PortPinInputPullResistor=PORT_PIN_IN_PULL_UP, PortPinSymbolicName=PORT_40_PIN_4
            PortPin_5: PortPinId=645, PortPinInputPullResistor=PORT_PIN_IN_PULL_UP, PortPinSymbolicName=PORT_40_PIN_5
            PortPin_6: PortPinId=646, PortPinInputPullResistor=PORT_PIN_IN_PULL_UP, PortPinSymbolicName=PORT_40_PIN_6
            PortPin_7: PortPinId=647, PortPinInputPullResistor=PORT_PIN_IN_PULL_UP, PortPinSymbolicName=PORT_40_PIN_7
            PortPin_8: PortPinId=648, PortPinInputPullResistor=PORT_PIN_IN_PULL_UP, PortPinSymbolicName=PORT_40_PIN_8
            PortPin_9: PortPinId=649, PortPinInputPullResistor=PORT_PIN_IN_PULL_UP, PortPinSymbolicName=PORT_40_PIN_9
    PortGeneral:
      PortDevErrorDetect = true
      PortInitApiMode = PORT_MCAL_SUPERVISOR
      PortInitCheckApi = true
      PortSafetyEnable = false
      PortSetPinDirectionApi = true
      PortSetPinModeApi = true
      PortVersionInfoApi = false
