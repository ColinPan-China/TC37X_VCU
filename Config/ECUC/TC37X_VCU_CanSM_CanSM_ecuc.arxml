AUTOSAR XML (schema 00048)
package /ActiveEcuC
  module config CanSM: implementation-config-variant=VARIANT-PRE-COMPILE, module-description=CanSM_Impl
    CanSMConfiguration: CanSMModeRequestRepetitionMax=10, CanSMModeRequestRepetitionTime=0.1
      6 x CanSMManagerNetwork, all with CanSMBorCounterL1ToL2=5, CanSMBorTimeL1=1, CanSMBorTimeL2=3, CanSMBorTimeTxEnsured=5, CanSMBorTxConfirmationPolling=false:
        CHNL_d841867f: CanSMComMNetworkHandleRef=CN_TC37X_VCU_CAN00_07b6c9c8
          CT_TC37X_VCU_CAN00_5fde07f6 (CanSMController): CanSMControllerId=CT_TC37X_VCU_CAN00_22cb8fec
          CanSMDemEventParameterRefs
        CHNL_131d55da: CanSMComMNetworkHandleRef=CN_TC37X_VCU_CAN01_70b1f95e
          CT_TC37X_VCU_CAN01_9a653c82 (CanSMController): CanSMControllerId=CT_TC37X_VCU_CAN01_55ccbf7a
        CHNL_5ed5f4d1: CanSMComMNetworkHandleRef=CN_TC37X_VCU_CAN03_9ebf9872
          CT_TC37X_VCU_CAN03_ca624c2b (CanSMController): CanSMControllerId=CT_TC37X_VCU_CAN03_bbc2de56
        CHNL_785eea40: CanSMComMNetworkHandleRef=CN_ATOM_CANFD_Matrix_CH_V600_202502_a4d436ac
          CT_ATOM_CANFD_Matrix_CH_V600_202502_c1a25aaa (CanSMController): CanSMControllerId=CT_ATOM_CANFD_Matrix_CH_V600_202502_37050292
        CHNL_8132b304: CanSMComMNetworkHandleRef=CN_TC37X_VCU_CAN12_XCP_d05a85ac
          CT_TC37X_VCU_CAN12_XCP_c2d7ab5b (CanSMController): CanSMControllerId=CT_TC37X_VCU_CAN12_XCP_5a889f4b
        CHNL_beb59c29: CanSMComMNetworkHandleRef=CN_ATOM_CAN_Matrix_PT_V600_20250211_9b894f3d
          CT_ATOM_CAN_Matrix_PT_V600_20250211_beb1e4a8 (CanSMController): CanSMControllerId=CT_ATOM_CAN_Matrix_PT_V600_20250211_08587b03
    CanSMGeneral:
      CanSMDevErrorDetect = true
      CanSMMainFunctionTimePeriod = 0.01
      CanSMVersionInfoApi = false
      CanSMBorCheckLevel = false
      CanSMSafeBswChecks = false
      CanSMSetBaudrateApi = false
      CanSMGeneration: CanSMOutOfBoundsWriteSanitizer=false, CanSMOutOfBoundsReadSanitizer=false
