AUTOSAR XML (schema 00048)
package /ActiveEcuC
  module config CanSM: implementation-config-variant=VARIANT-PRE-COMPILE, module-description=CanSM_Impl
    CanSMConfiguration: CanSMModeRequestRepetitionMax=10, CanSMModeRequestRepetitionTime=0.1
      5 x CanSMManagerNetwork, all with CanSMBorCounterL1ToL2=5, CanSMBorTimeL1=1, CanSMBorTimeL2=3, CanSMBorTimeTxEnsured=5, CanSMBorTxConfirmationPolling=false:
        CHNL_d841867f: CanSMComMNetworkHandleRef=CN_TC37X_VCU_CAN00_07b6c9c8
          CT_TC37X_VCU_CAN00_5fde07f6 (CanSMController): CanSMControllerId=CT_TC37X_VCU_CAN00_22cb8fec
          CanSMDemEventParameterRefs: CANSM_E_BUS_OFF=CAN00_BUSOFF
        CHNL_131d55da: CanSMComMNetworkHandleRef=CN_TC37X_VCU_CAN01_70b1f95e
          CT_TC37X_VCU_CAN01_9a653c82 (CanSMController): CanSMControllerId=CT_TC37X_VCU_CAN01_55ccbf7a
        CHNL_f95a0907: CanSMComMNetworkHandleRef=CN_KAMA_FP_EPT_0303_275b3e6e
          CT_KAMA_FP_EPT_0303_62c0567e (CanSMController): CanSMControllerId=CT_KAMA_FP_EPT_0303_1b7da7f9
        CHNL_33fe2cc0: CanSMComMNetworkHandleRef=CN_TC37X_VCU_CAN12_f0a399a5
          CT_TC37X_VCU_CAN12_58747941 (CanSMController): CanSMControllerId=CT_TC37X_VCU_CAN12_d5dedf81
        CHNL_5ed5f4d1: CanSMComMNetworkHandleRef=CN_TC37X_VCU_CAN03_9ebf9872
          CT_TC37X_VCU_CAN03_ca624c2b (CanSMController): CanSMControllerId=CT_TC37X_VCU_CAN03_bbc2de56
    CanSMGeneral:
      CanSMDevErrorDetect = true
      CanSMMainFunctionTimePeriod = 0.01
      CanSMVersionInfoApi = false
      CanSMBorCheckLevel = false
      CanSMSafeBswChecks = false
      CanSMSetBaudrateApi = false
      CanSMGeneration: CanSMOutOfBoundsWriteSanitizer=false, CanSMOutOfBoundsReadSanitizer=false
