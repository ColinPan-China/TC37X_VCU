AUTOSAR XML (schema 00048)
package /ActiveEcuC
  module config CanTrcv: implementation-config-variant=VARIANT-PRE-COMPILE, module-description=CanTrcv_Impl
    CanTrcvGeneral:
      CanTrcvSafeBswChecks = true
      CanTrcvDevErrorDetect = true
      CanTrcvGetVersionInfo = false
      CanTrcvWakeUpSupport = CANTRCV_WAKEUP_BY_POLLING
      CanTrcvIndex = 0
      CanTrcvMainFunctionPeriod = 0.01
    CanTrcvConfigSet
      CanTrcvChannel_PT (CanTrcvChannel):
        CanTrcvInitState = CANTRCV_OP_MODE_NORMAL
        CanTrcvChannelId = 0
        CanTrcvChannelUsed = true
        CanTrcvControlsPowerSupply = false
        CanTrcvHwPnSupport = false
        CanTrcvMaxBaudrate = 1000
        CanTrcvWakeupByBusUsed = true
        CanTrcvWakeupSourceRef = CN_ATOM_CAN_Matrix_PT_V600_20250211_9b894f3d
        CanTrcvAccess
          CanTrcvDioAccess
            PinSTB (CanTrcvDioChannelAccess): CanTrcvHardwareInterfaceName=PinSTB, CanTrcvDioSymNameRef=DioChannel_P32_2
            PinRXD (CanTrcvDioChannelAccess): CanTrcvHardwareInterfaceName=PinRXD, CanTrcvDioSymNameRef=DioChannel_P00_3_PT_CAN_RX
