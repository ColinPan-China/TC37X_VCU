AUTOSAR XML (schema 00049)
package /ActiveEcuC
  module config McalLib: implementation-config-variant=VARIANT-PRE-COMPILE, module-description=McalLib_Impl
    McalLibPublishedInformation:
      McalLibMcalAvailableCores = 3
      McalLibDsprCore0StartAddr = 1879048192
      McalLibDsprCore0EndAddr = 1879293951
      McalLibDsprCore1StartAddr = 1610612736
      McalLibDsprCore1EndAddr = 1610858495
      McalLibDsprCore2StartAddr = 1342177280
      McalLibDsprCore2EndAddr = 1342275583
      McalLibDsprCore3StartAddr = 0
      McalLibDsprCore3EndAddr = 0
      McalLibDsprCore4StartAddr = 0
      McalLibDsprCore4EndAddr = 0
      McalLibDsprCore5StartAddr = 0
      McalLibDsprCore5EndAddr = 0
      McalLibPsprCore0StartAddr = 1880096768
      McalLibPsprCore0EndAddr = 1880162303
      McalLibPsprCore1StartAddr = 1611661312
      McalLibPsprCore1EndAddr = 1611726847
      McalLibPsprCore2StartAddr = 1343225856
      McalLibPsprCore2EndAddr = 1343291391
      McalLibPsprCore3StartAddr = 0
      McalLibPsprCore3EndAddr = 0
      McalLibPsprCore4StartAddr = 0
      McalLibPsprCore4EndAddr = 0
      McalLibPsprCore5StartAddr = 0
      McalLibPsprCore5EndAddr = 0
      McalLibBackUpClockFreq = 100
    CommonPublishedInformation:
      ArMajorVersion = 4
      ArMinorVersion = 2
      ArPatchVersion = 2
      SwMajorVersion = 10
      SwMinorVersion = 40
      SwPatchVersion = 1
      ModuleId = 255
      VendorId = 17
      Release = _TRICORE_TC377
    McalLibGeneral: McalLibSafetyEnable=true
