AUTOSAR XML (schema 00049)
package /McalLib
  module config McalLib: implementation-config-variant=VARIANT-PRE-COMPILE, module-description=McalLib_Impl
    CommonPublishedInformation:
      ArMajorVersion = 4
      ArMinorVersion = 2
      ArPatchVersion = 2
      ModuleId = 255
      Release = _TRICORE_TC377
      SwMajorVersion = 10
      SwMinorVersion = 40
      SwPatchVersion = 1
      VendorId = 17
    McalLibGeneral: McalLibSafetyEnable=false
    McalLibPublishedInformation:
      McalLibBackUpClockFreq = 100
      McalLibDsprCore0EndAddr = 1879293951
      McalLibDsprCore0StartAddr = 1879048192
      McalLibDsprCore1EndAddr = 1610858495
      McalLibDsprCore1StartAddr = 1610612736
      McalLibDsprCore2EndAddr = 1342275583
      McalLibDsprCore2StartAddr = 1342177280
      McalLibDsprCore3EndAddr = 0
      McalLibDsprCore3StartAddr = 0
      McalLibDsprCore4EndAddr = 0
      McalLibDsprCore4StartAddr = 0
      McalLibDsprCore5EndAddr = 0
      McalLibDsprCore5StartAddr = 0
      McalLibMcalAvailableCores = 3
      McalLibPsprCore0EndAddr = 1880162303
      McalLibPsprCore0StartAddr = 1880096768
      McalLibPsprCore1EndAddr = 1611726847
      McalLibPsprCore1StartAddr = 1611661312
      McalLibPsprCore2EndAddr = 1343291391
      McalLibPsprCore2StartAddr = 1343225856
      McalLibPsprCore3EndAddr = 0
      McalLibPsprCore3StartAddr = 0
      McalLibPsprCore4EndAddr = 0
      McalLibPsprCore4StartAddr = 0
      McalLibPsprCore5EndAddr = 0
      McalLibPsprCore5StartAddr = 0
