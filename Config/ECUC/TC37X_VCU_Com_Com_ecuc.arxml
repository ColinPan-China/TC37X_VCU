[part 1 of 2: package /ActiveEcuC]
AUTOSAR XML (schema 00048)
package /ActiveEcuC
  module config Com: implementation-config-variant=VARIANT-PRE-COMPILE, module-description=Com_Impl
    ComGeneration:
      ComOutOfBoundsWriteProtectionStrategy = NONE
      ComOutOfBoundsWriteSanitizer = false
      ComOutOfBoundsReadSanitizer = false
      ComReduceConstantData2Define = false
      ComBoolDataInArrayOfStructStrategy = BOOLEAN
      ComDeduplicateIndirectedData = true
      ComDataDeduplicationStrategy = WITH_CAST
      ComReduceBoolDataByNegationThreshold = 2
      ComReduceBoolDataByNumericalComparisonThreshold = 2
      ComReduceBoolDataByNumericalRelationThreshold = 2
      ComReduceBoolDataByNumericalOperandStrategy = WITH_ANY_VALUE
      ComReduceNumericalDataByOffsetThreshold = 2
      ComReduceNumericalDataByArraySubtractionThreshold = 2
      ComReduceDataByStreaming = false
      ComShortSymbols = false
      ComInterfacesForDeactivatedData = false
      ComReferringKeysInComments = false
    ComOptimization:
      ComTxProcessingISRLockThreshold = 1
      ComRxProcessingISRLockThreshold = 1
      ComGatewayProcessingISRLockThreshold = 1
      ComGatewayDescriptionProcessingISRLockThreshold = 1
      ComIPduGroupISRLockThreshold = 1
    ComConfig: ComConfigurationId=0, ComRxDeferredNotificationCacheSize=1, ComRxImmediateNotificationCacheSize=0
      ComMainFunctionRx: ComMainRxTimeBase=0.01
      ComMainFunctionTx: ComMainTxTimeBase=0.01
      VCU_oTC37X_VCU_CAN01_Rx_1837cb5c (ComIPduGroup): ComIPduGroupHandleId=11
      VCU_oTC37X_VCU_CAN01_Tx_4e6d6cda (ComIPduGroup): ComIPduGroupHandleId=12
      6 x ComSignal, all with ComBitSize=16, ComSignalEndianness=LITTLE_ENDIAN, ComSignalInitValue=0, ComSignalType=SINT16, ComTimeout=0, ComSignalAccess=ACCESS_UNCLEAR:
        VcuRxMsg4_Sig3_oVcuRxMsg4_oTC37X_VCU_CAN01_93b0db97_Rx: ComBitPosition=48, ComHandleId=552, ComSystemTemplateSystemSignalRef=VcuRxMsg4_Sig3
        VcuRxMsg3_Sig1_oVcuRxMsg3_oTC37X_VCU_CAN01_4b1ed439_Rx: ComBitPosition=16, ComHandleId=540, ComSystemTemplateSystemSignalRef=VcuRxMsg3_Sig1
        VcuRxMsg3_Sig3_oVcuRxMsg3_oTC37X_VCU_CAN01_8d116671_Rx: ComBitPosition=48, ComHandleId=544, ComSystemTemplateSystemSignalRef=VcuRxMsg3_Sig3
        VcuRxMsg4_Sig1_oVcuRxMsg4_oTC37X_VCU_CAN01_55bf69df_Rx: ComBitPosition=16, ComHandleId=548, ComSystemTemplateSystemSignalRef=VcuRxMsg4_Sig1
        VcuRxMsg3_Sig2_oVcuRxMsg3_oTC37X_VCU_CAN01_ee16bf55_Rx: ComBitPosition=32, ComHandleId=542, ComSystemTemplateSystemSignalRef=VcuRxMsg3_Sig2
        VcuRxMsg4_Sig2_oVcuRxMsg4_oTC37X_VCU_CAN01_f0b702b3_Rx: ComBitPosition=32, ComHandleId=550, ComSystemTemplateSystemSignalRef=VcuRxMsg4_Sig2
      VcuRxMsg3_oTC37X_VCU_CAN01_0a530e81_Rx (ComIPdu):
        ComIPduDirection = RECEIVE
        ComIPduType = NORMAL
        ComIPduHandleId = 96
        ComIPduSignalProcessing = DEFERRED
        ComIPduCancellationSupport = false
        ComIPduGroupRef = VCU_oTC37X_VCU_CAN01_Rx_1837cb5c
        ComIPduSignalRef = VcuRxMsg3_Sig0_oVcuRxMsg3_oTC37X_VCU_CAN01_28190d1d_Rx
        ComIPduSignalRef = VcuRxMsg3_Sig1_oVcuRxMsg3_oTC37X_VCU_CAN01_4b1ed439_Rx
        ComIPduSignalRef = VcuRxMsg3_Sig2_oVcuRxMsg3_oTC37X_VCU_CAN01_ee16bf55_Rx
        ComIPduSignalRef = VcuRxMsg3_Sig3_oVcuRxMsg3_oTC37X_VCU_CAN01_8d116671_Rx
        ComPduIdRef = VcuRxMsg3_oTC37X_VCU_CAN01_0a530e81_Rx
        ComIPduMainFunctionRef = ComMainFunctionRx
      VcuRxMsg3_Sig0_oVcuRxMsg3_oTC37X_VCU_CAN01_28190d1d_Rx (ComSignal):
        ComBitPosition = 0
        ComBitSize = 16
        ComSignalEndianness = LITTLE_ENDIAN
        ComSignalInitValue = 0
        ComSignalType = SINT16
        ComTimeout = 0
        ComSignalAccess = ACCESS_UNCLEAR
        ComHandleId = 538
        ComSystemTemplateSystemSignalRef = VcuRxMsg3_Sig0
      VcuRxMsg4_Sig0_oVcuRxMsg4_oTC37X_VCU_CAN01_36b8b0fb_Rx (ComSignal):
        ComBitPosition = 0
        ComBitSize = 16
        ComSignalEndianness = LITTLE_ENDIAN
        ComSignalInitValue = 0
        ComSignalType = SINT16
        ComTimeout = 0
        ComSignalAccess = ACCESS_UNCLEAR
        ComHandleId = 546
        ComSystemTemplateSystemSignalRef = VcuRxMsg4_Sig0
      VcuRxMsg4_oTC37X_VCU_CAN01_eb7d04e5_Rx (ComIPdu):
        ComIPduDirection = RECEIVE
        ComIPduType = NORMAL
        ComIPduHandleId = 97
        ComIPduSignalProcessing = DEFERRED
        ComIPduCancellationSupport = false
        ComIPduGroupRef = VCU_oTC37X_VCU_CAN01_Rx_1837cb5c
        ComIPduSignalRef = VcuRxMsg4_Sig0_oVcuRxMsg4_oTC37X_VCU_CAN01_36b8b0fb_Rx
        ComIPduSignalRef = VcuRxMsg4_Sig1_oVcuRxMsg4_oTC37X_VCU_CAN01_55bf69df_Rx
        ComIPduSignalRef = VcuRxMsg4_Sig2_oVcuRxMsg4_oTC37X_VCU_CAN01_f0b702b3_Rx
        ComIPduSignalRef = VcuRxMsg4_Sig3_oVcuRxMsg4_oTC37X_VCU_CAN01_93b0db97_Rx
        ComPduIdRef = VcuRxMsg4_oTC37X_VCU_CAN01_eb7d04e5_Rx
        ComIPduMainFunctionRef = ComMainFunctionRx
      VCU_oLIN00_Rx_4b9dfc53 (ComIPduGroup): ComIPduGroupHandleId=5
      VCU_oLIN00_Tx_1dc75bd5 (ComIPduGroup): ComIPduGroupHandleId=6
      TCU_HVCH_heating_rq_oTCU_HVCH_Cmd_oLIN00_5e3a32b2_Tx (ComSignal):
        ComBitPosition = 0
        ComBitSize = 7
        ComSignalEndianness = LITTLE_ENDIAN
        ComSignalInitValue = 0
        ComSignalType = UINT8
        ComSignalAccess = ACCESS_UNCLEAR
        ComHandleId = 252
        ComTransferProperty = PENDING
        ComSystemTemplateSystemSignalRef = TCU_HVCH_heating_rq
      VCU_EXV_1_oLIN00_50eec975_Tx (ComIPdu):
        ComIPduDirection = SEND
        ComIPduType = NORMAL
        ComIPduHandleId = 17
        ComIPduSignalProcessing = DEFERRED
        ComIPduCancellationSupport = false
        ComIPduGroupRef = VCU_oLIN00_Tx_1dc75bd5
        ComIPduSignalRef = TMM_EXV1_EnableRequest_oVCU_EXV_1_oLIN00_d988d266_Tx
        ComIPduSignalRef = TMM_EXV1_PositionRequest_oVCU_EXV_1_oLIN00_cbd2de27_Tx
        ComIPduSignalRef = TMM_EXV1_initRequest_oVCU_EXV_1_oLIN00_082350ea_Tx
        ComPduIdRef = VCU_EXV_1_oLIN00_50eec975_Tx
        ComIPduMainFunctionRef = ComMainFunctionTx
        ComTxIPdu: ComTxIPduUnusedAreasDefault=255, ComMinimumDelayTime=0
          ComTxModeTrue
            ComTxMode: ComTxModeMode=NONE
          ComTxModeFalse
            ComTxMode: ComTxModeMode=NONE
      HVCH_LIN_Flt_oHVCH_Rsp01_oLIN00_9aaa25bf_Rx (ComSignal):
        ComBitPosition = 44
        ComBitSize = 1
        ComSignalEndianness = LITTLE_ENDIAN
        ComSignalInitValue = 0
        ComSignalType = BOOLEAN
        ComSignalAccess = ACCESS_UNCLEAR
        ComHandleId = 36
        ComSystemTemplateSystemSignalRef = HVCH_LIN_Flt
      TCU_HVCH_Cmd_oLIN00_385d5651_Tx (ComIPdu):
        ComIPduDirection = SEND
        ComIPduType = NORMAL
        ComIPduHandleId = 2
        ComIPduSignalProcessing = DEFERRED
        ComIPduCancellationSupport = false
        ComIPduGroupRef = VCU_oLIN00_Tx_1dc75bd5
        ComIPduSignalRef = TCU_HVCHMaxPowerLimit_oTCU_HVCH_Cmd_oLIN00_4bc53e0b_Tx
        ComIPduSignalRef = TCU_HVCH_On_Rq_oTCU_HVCH_Cmd_oLIN00_9f442eaf_Tx
        ComIPduSignalRef = TCU_HVCH_TmaxLim_output_oTCU_HVCH_Cmd_oLIN00_5e45d521_Tx
        ComIPduSignalRef = TCU_HVCH_heating_rq_oTCU_HVCH_Cmd_oLIN00_5e3a32b2_Tx
        ComPduIdRef = TCU_HVCH_Cmd_oLIN00_385d5651_Tx
        ComIPduMainFunctionRef = ComMainFunctionTx
        ComTxIPdu: ComTxIPduUnusedAreasDefault=255, ComMinimumDelayTime=0
          ComTxModeTrue
            ComTxMode: ComTxModeMode=NONE
          ComTxModeFalse
            ComTxMode: ComTxModeMode=NONE
      EXV_2_VCU_oLIN00_1e4a3daf_Rx (ComIPdu):
        ComIPduDirection = RECEIVE
        ComIPduType = NORMAL
        ComIPduHandleId = 43
        ComIPduSignalProcessing = DEFERRED
        ComIPduCancellationSupport = false
        ComIPduGroupRef = VCU_oLIN00_Rx_4b9dfc53
        ComIPduSignalRef = EXV2_CurrentInitState_oEXV_2_VCU_oLIN00_adb498ec_Rx
        ComIPduSignalRef = EXV2_CurrentPosition_oEXV_2_VCU_oLIN00_91e32486_Rx
        ComIPduSignalRef = EXV2_FaultState_oEXV_2_VCU_oLIN00_41c0e318_Rx
        ComIPduSignalRef = EXV2_ResponseError_oEXV_2_VCU_oLIN00_e747f934_Rx
        ComIPduSignalRef = EXV2_RunState_oEXV_2_VCU_oLIN00_859c8088_Rx
        ComIPduSignalRef = EXV2_TemperatureWarn_oEXV_2_VCU_oLIN00_5f7c92a2_Rx
        ComIPduSignalRef = EXV2_VoltageState_oEXV_2_VCU_oLIN00_8f3a2738_Rx
        ComPduIdRef = EXV_2_VCU_oLIN00_1e4a3daf_Rx
        ComIPduMainFunctionRef = ComMainFunctionRx
      13 x ComSignal, all with ComSignalEndianness=LITTLE_ENDIAN, ComSignalAccess=ACCESS_UNCLEAR:
        HVCH_Status_oHVCH_Rsp01_oLIN00_60afdc75_Rx: ComBitPosition=32, ComBitSize=3, ComSignalInitValue=0, ComSignalType=UINT8, ComHandleId=40, ComSystemTemplateSystemSignalRef=HVCH_Status
        EXV2_Fault_Stat_oEXV2_Status_oLIN00_ab6350b6_Rx: ComBitPosition=8, ComBitSize=4, ComSignalInitValue=0, ComSignalType=UINT8, ComHandleId=18, ComSystemTemplateSystemSignalRef=EXV2_Fault_Stat
        HVCH_DutyCycle_oHVCH_Rsp01_oLIN00_ad1e6a22_Rx: ComBitPosition=24, ComBitSize=8, ComSignalInitValue=50, ComSignalType=UINT8, ComHandleId=29, ComSystemTemplateSystemSignalRef=HVCH_DutyCycle
        Breakage_Fault_STA_oSVA_VCU_STD_oLIN00_a3ac9cf8_Rx: ComBitPosition=3, ComBitSize=1, ComSignalInitValue=0, ComSignalType=BOOLEAN, ComHandleId=2, ComSystemTemplateSystemSignalRef=Breakage_Fault_STA
        PMP3_PumpPowerSta_oPMP3_Sts_oLIN00_884db7a7_Rx: ComBitPosition=4, ComBitSize=2, ComSignalInitValue=0, ComSignalType=UINT8, ComHandleId=55, ComSystemTemplateSystemSignalRef=PMP3_PumpPowerSta
        Act_Pos_sta_oSVA_VCU_STD_oLIN00_642c9ffa_Rx: ComBitPosition=8, ComBitSize=12, ComSignalInitValue=0, ComSignalType=UINT16, ComHandleId=0, ComSystemTemplateSystemSignalRef=Act_Pos_sta
        EXV2_RunState_oEXV_2_VCU_oLIN00_859c8088_Rx: ComBitPosition=3, ComBitSize=1, ComSignalInitValue=0, ComSignalType=BOOLEAN, ComHandleId=22, ComSystemTemplateSystemSignalRef=EXV2_RunState
        PMP2_PumpMotorSta_oPMP2_Sts_oLIN00_d6d3ab88_Rx: ComBitPosition=1, ComBitSize=2, ComSignalInitValue=0, ComSignalType=UINT8, ComHandleId=47, ComSystemTemplateSystemSignalRef=PMP2_PumpMotorSta
        Target_Pos_cmd_oVCU_SVA_CMD_oLIN00_b87f26ef_Tx: ComBitPosition=16, ComBitSize=12, ComSignalInitValue=0, ComSignalType=UINT16, ComHandleId=259, ComTransferProperty=PENDING, ComSystemTemplateSystemSignalRef=Target_Pos_cmd
        PMP2_PumpTempSta_oPMP2_Sts_oLIN00_81f2fa55_Rx: ComBitPosition=6, ComBitSize=2, ComSignalInitValue=0, ComSignalType=UINT8, ComHandleId=49, ComSystemTemplateSystemSignalRef=PMP2_PumpTempSta
        TMM_EXV1_PositionRequest_oVCU_EXV_1_oLIN00_cbd2de27_Tx: ComBitPosition=0, ComBitSize=16, ComSignalInitValue=0, ComSignalType=UINT16, ComHandleId=254, ComTransferProperty=PENDING, ComSystemTemplateSystemSignalRef=TMM_EXV1_PositionRequest
        EXV2_CurrentInitState_oEXV_2_VCU_oLIN00_adb498ec_Rx: ComBitPosition=1, ComBitSize=2, ComSignalInitValue=0, ComSignalType=UINT8, ComHandleId=15, ComSystemTemplateSystemSignalRef=EXV2_CurrentInitState
        EXV1_ResponseError_oEXV_1_VCU_oLIN00_cbce9ad1_Rx: ComBitPosition=0, ComBitSize=1, ComSignalInitValue=0, ComSignalType=BOOLEAN, ComHandleId=11, ComSystemTemplateSystemSignalRef=EXV1_ResponseError
      PMP_Cmd_oLIN00_3912b28b_Tx (ComIPdu):
        ComIPduDirection = SEND
        ComIPduType = NORMAL
        ComIPduHandleId = 1
        ComIPduSignalProcessing = DEFERRED
        ComIPduCancellationSupport = false
        ComIPduGroupRef = VCU_oLIN00_Tx_1dc75bd5
        ComIPduSignalRef = ECC_PMP2_SpdSet_oPMP_Cmd_oLIN00_8cabc4b7_Tx
        ComIPduSignalRef = ECC_PMP3_SpdSet_oPMP_Cmd_oLIN00_0d8ea190_Tx
        ComPduIdRef = PMP_Cmd_oLIN00_3912b28b_Tx
        ComIPduMainFunctionRef = ComMainFunctionTx
        ComTxIPdu: ComTxIPduUnusedAreasDefault=255, ComMinimumDelayTime=0
          ComTxModeTrue
            ComTxMode: ComTxModeMode=NONE
          ComTxModeFalse
            ComTxMode: ComTxModeMode=NONE
      4 x ComSignal, all with ComSignalEndianness=LITTLE_ENDIAN, ComSignalInitValue=0, ComSignalType=UINT8, ComSignalAccess=ACCESS_UNCLEAR:
        HVCH_CurrSens_Flt_oHVCH_Rsp01_oLIN00_09f7bc74_Rx: ComBitPosition=56, ComBitSize=5, ComHandleId=28, ComSystemTemplateSystemSignalRef=HVCH_CurrSens_Flt
        ECC_PMP2_SpdSet_oPMP_Cmd_oLIN00_8cabc4b7_Tx: ComBitPosition=8, ComBitSize=8, ComHandleId=49, ComTransferProperty=PENDING, ComSystemTemplateSystemSignalRef=ECC_PMP2_SpdSet
        Calibration_sta_oSVA_VCU_STD_oLIN00_dcb4af08_Rx: ComBitPosition=0, ComBitSize=2, ComHandleId=7, ComSystemTemplateSystemSignalRef=Calibration_sta
        EXV1_FaultState_oEXV_1_VCU_oLIN00_72ff14f0_Rx: ComBitPosition=4, ComBitSize=4, ComHandleId=10, ComSystemTemplateSystemSignalRef=EXV1_FaultState
      EDCU_EXV2_oLIN00_1f8750a5_Tx (ComIPdu):
        ComIPduDirection = SEND
        ComIPduType = NORMAL
        ComIPduHandleId = 0
        ComIPduSignalProcessing = DEFERRED
        ComIPduCancellationSupport = false
        ComIPduGroupRef = VCU_oLIN00_Tx_1dc75bd5
        ComIPduSignalRef = EDCU_EXV2_Cmd_Init_Rq_oEDCU_EXV2_oLIN00_0144aec9_Tx
        ComIPduSignalRef = EDCU_EXV2_Cmd_Move_Enbl_oEDCU_EXV2_oLIN00_d6797517_Tx
        ComIPduSignalRef = EDCU_EXV2_Cmd_Set_Rq_oEDCU_EXV2_oLIN00_66e5876a_Tx
        ComPduIdRef = EDCU_EXV2_oLIN00_1f8750a5_Tx
        ComIPduMainFunctionRef = ComMainFunctionTx
        ComTxIPdu: ComTxIPduUnusedAreasDefault=255, ComMinimumDelayTime=0
          ComTxModeTrue
            ComTxMode: ComTxModeMode=NONE
          ComTxModeFalse
            ComTxMode: ComTxModeMode=NONE
      4 x ComSignal, all with ComSignalEndianness=LITTLE_ENDIAN, ComSignalInitValue=0, ComSignalAccess=ACCESS_UNCLEAR:
        HVCH_defectHeaterCircuits_oHVCH_Rsp01_oLIN00_61948e74_Rx: ComBitPosition=35, ComBitSize=3, ComSignalType=UINT8, ComHandleId=43, ComSystemTemplateSystemSignalRef=HVCH_defectHeaterCircuits
        RsErr_EXV2_oEXV2_Status_oLIN00_5c35655a_Rx: ComBitPosition=0, ComBitSize=1, ComSignalType=BOOLEAN, ComHandleId=59, ComSystemTemplateSystemSignalRef=RsErr_EXV2
        HVCH_HV_Voltage_Valid_oHVCH_Rsp01_oLIN00_2914831e_Rx: ComBitPosition=40, ComBitSize=2, ComSignalType=UINT8, ComHandleId=32, ComSystemTemplateSystemSignalRef=HVCH_HV_Voltage_Valid
        PMP2_PumpDryRunningSta_oPMP2_Sts_oLIN00_3e217a22_Rx: ComBitPosition=3, ComBitSize=1, ComSignalType=BOOLEAN, ComHandleId=45, ComSystemTemplateSystemSignalRef=PMP2_PumpDryRunningSta
      VCU_EXV_2_oLIN00_de61ce96_Tx (ComIPdu):
        ComIPduDirection = SEND
        ComIPduType = NORMAL
        ComIPduHandleId = 18
        ComIPduSignalProcessing = DEFERRED
        ComIPduCancellationSupport = false
        ComIPduGroupRef = VCU_oLIN00_Tx_1dc75bd5
        ComIPduSignalRef = TMM_EXV2_EnableRequest_oVCU_EXV_2_oLIN00_0c106490_Tx
        ComIPduSignalRef = TMM_EXV2_PositionRequest_oVCU_EXV_2_oLIN00_ce8ee7dd_Tx
        ComIPduSignalRef = TMM_EXV2_initRequest_oVCU_EXV_2_oLIN00_95846e7a_Tx
        ComPduIdRef = VCU_EXV_2_oLIN00_de61ce96_Tx
        ComIPduMainFunctionRef = ComMainFunctionTx
        ComTxIPdu: ComTxIPduUnusedAreasDefault=255, ComMinimumDelayTime=0
          ComTxModeTrue
            ComTxMode: ComTxModeMode=NONE
          ComTxModeFalse
            ComTxMode: ComTxModeMode=NONE
      5 x ComSignal, all with ComSignalEndianness=LITTLE_ENDIAN, ComSignalInitValue=0, ComSignalAccess=ACCESS_UNCLEAR:
        EXV2_TemperatureWarn_oEXV_2_VCU_oLIN00_5f7c92a2_Rx: ComBitPosition=10, ComBitSize=2, ComSignalType=UINT8, ComHandleId=24, ComSystemTemplateSystemSignalRef=EXV2_TemperatureWarn
        HVCH_Off_ShrtCurr_oHVCH_Rsp01_oLIN00_bf58ab45_Rx: ComBitPosition=46, ComBitSize=1, ComSignalType=BOOLEAN, ComHandleId=38, ComSystemTemplateSystemSignalRef=HVCH_Off_ShrtCurr
        LIN_Resp_Error_sta_oSVA_VCU_STD_oLIN00_47f7ca93_Rx: ComBitPosition=32, ComBitSize=1, ComSignalType=BOOLEAN, ComHandleId=44, ComSystemTemplateSystemSignalRef=LIN_Resp_Error_sta
        EXV1_CurrentInitState_oEXV_1_VCU_oLIN00_beca31e2_Rx: ComBitPosition=1, ComBitSize=2, ComSignalType=UINT8, ComHandleId=8, ComSystemTemplateSystemSignalRef=EXV1_CurrentInitState
        HVCH_TempSens_Flt_oHVCH_Rsp01_oLIN00_66cb2c71_Rx: ComBitPosition=42, ComBitSize=1, ComSignalType=BOOLEAN, ComHandleId=42, ComSystemTemplateSystemSignalRef=HVCH_TempSens_Flt
      EXV2_Status_oLIN00_d5e93929_Rx (ComIPdu):
        ComIPduDirection = RECEIVE
        ComIPduType = NORMAL
        ComIPduHandleId = 41
        ComIPduSignalProcessing = DEFERRED
        ComIPduCancellationSupport = false
        ComIPduGroupRef = VCU_oLIN00_Rx_4b9dfc53
        ComIPduSignalRef = EXV2_Fault_Stat_oEXV2_Status_oLIN00_ab6350b6_Rx
        ComIPduSignalRef = EXV2_OvrTemp_Warn_oEXV2_Status_oLIN00_ba77659e_Rx
        ComIPduSignalRef = EXV2_Pos_oEXV2_Status_oLIN00_da80603b_Rx
        ComIPduSignalRef = EXV2_Run_Stat_oEXV2_Status_oLIN00_0e992e12_Rx
        ComIPduSignalRef = EXV2_Volt_Stat_oEXV2_Status_oLIN00_c8727eb0_Rx
        ComIPduSignalRef = EXV2_curInit_Stat_oEXV2_Status_oLIN00_b0ace0f5_Rx
        ComIPduSignalRef = RsErr_EXV2_oEXV2_Status_oLIN00_5c35655a_Rx
        ComPduIdRef = EXV2_Status_oLIN00_d5e93929_Rx
        ComIPduMainFunctionRef = ComMainFunctionRx
      3 x ComSignal, all with ComSignalEndianness=LITTLE_ENDIAN, ComSignalInitValue=0, ComSignalAccess=ACCESS_UNCLEAR:
        TMM_EXV2_initRequest_oVCU_EXV_2_oLIN00_95846e7a_Tx: ComBitPosition=24, ComBitSize=3, ComSignalType=UINT8, ComHandleId=258, ComTransferProperty=PENDING, ComSystemTemplateSystemSignalRef=TMM_EXV2_initRequest
        EXV2_VoltageState_oEXV_2_VCU_oLIN00_8f3a2738_Rx: ComBitPosition=8, ComBitSize=2, ComSignalType=UINT8, ComHandleId=26, ComSystemTemplateSystemSignalRef=EXV2_VoltageState
        EXV2_Run_Stat_oEXV2_Status_oLIN00_0e992e12_Rx: ComBitPosition=4, ComBitSize=1, ComSignalType=BOOLEAN, ComHandleId=23, ComSystemTemplateSystemSignalRef=EXV2_Run_Stat
      EXV_1_VCU_oLIN00_69d4ef5f_Rx (ComIPdu):
        ComIPduDirection = RECEIVE
        ComIPduType = NORMAL
        ComIPduHandleId = 42
        ComIPduSignalProcessing = DEFERRED
        ComIPduCancellationSupport = false
        ComIPduGroupRef = VCU_oLIN00_Rx_4b9dfc53
        ComIPduSignalRef = EXV1_CurrentInitState_oEXV_1_VCU_oLIN00_beca31e2_Rx
        ComIPduSignalRef = EXV1_CurrentPosition_oEXV_1_VCU_oLIN00_6daec86f_Rx
        ComIPduSignalRef = EXV1_FaultState_oEXV_1_VCU_oLIN00_72ff14f0_Rx
        ComIPduSignalRef = EXV1_ResponseError_oEXV_1_VCU_oLIN00_cbce9ad1_Rx
        ComIPduSignalRef = EXV1_RunState_oEXV_1_VCU_oLIN00_f0dc555f_Rx
        ComIPduSignalRef = EXV1_TemperatureWarn_oEXV_1_VCU_oLIN00_a3317e4b_Rx
        ComIPduSignalRef = EXV1_VoltageState_oEXV_1_VCU_oLIN00_31bbfd77_Rx
        ComPduIdRef = EXV_1_VCU_oLIN00_69d4ef5f_Rx
        ComIPduMainFunctionRef = ComMainFunctionRx
      6 x ComSignal, all with ComSignalEndianness=LITTLE_ENDIAN, ComSignalInitValue=0, ComSignalAccess=ACCESS_UNCLEAR:
        HVCH_TempLim_oHVCH_Rsp01_oLIN00_d22e6add_Rx: ComBitPosition=43, ComBitSize=1, ComSignalType=BOOLEAN, ComHandleId=41, ComSystemTemplateSystemSignalRef=HVCH_TempLim
        EDCU_EXV2_Cmd_Move_Enbl_oEDCU_EXV2_oLIN00_d6797517_Tx: ComBitPosition=16, ComBitSize=1, ComSignalType=BOOLEAN, ComHandleId=52, ComTransferProperty=PENDING, ComSystemTemplateSystemSignalRef=EDCU_EXV2_Cmd_Move_Enbl
        TCU_HVCH_TmaxLim_output_oTCU_HVCH_Cmd_oLIN00_5e45d521_Tx: ComBitPosition=24, ComBitSize=8, ComSignalType=UINT8, ComHandleId=251, ComTransferProperty=PENDING, ComSystemTemplateSystemSignalRef=TCU_HVCH_TmaxLim_output
        EXV1_CurrentPosition_oEXV_1_VCU_oLIN00_6daec86f_Rx: ComBitPosition=16, ComBitSize=16, ComSignalType=UINT16, ComHandleId=9, ComSystemTemplateSystemSignalRef=EXV1_CurrentPosition
        PMP3_PumpInputVolt_oPMP3_Sts_oLIN00_75dfecf6_Rx: ComBitPosition=8, ComBitSize=8, ComSignalType=UINT8, ComHandleId=53, ComSystemTemplateSystemSignalRef=PMP3_PumpInputVolt
        EXV1_VoltageState_oEXV_1_VCU_oLIN00_31bbfd77_Rx: ComBitPosition=8, ComBitSize=2, ComSignalType=UINT8, ComHandleId=14, ComSystemTemplateSystemSignalRef=EXV1_VoltageState
      PMP3_Sts_oLIN00_511c4704_Rx (ComIPdu):
        ComIPduDirection = RECEIVE
        ComIPduType = NORMAL
        ComIPduHandleId = 68
        ComIPduSignalProcessing = DEFERRED
        ComIPduCancellationSupport = false
        ComIPduGroupRef = VCU_oLIN00_Rx_4b9dfc53
        ComIPduSignalRef = PMP3_PumpDryRunningSta_oPMP3_Sts_oLIN00_30f4e2d8_Rx
        ComIPduSignalRef = PMP3_PumpInputVolt_oPMP3_Sts_oLIN00_75dfecf6_Rx
        ComIPduSignalRef = PMP3_PumpMotorSta_oPMP3_Sts_oLIN00_43910f36_Rx
        ComIPduSignalRef = PMP3_PumpPowerSta_oPMP3_Sts_oLIN00_884db7a7_Rx
        ComIPduSignalRef = PMP3_PumpTempSta_oPMP3_Sts_oLIN00_26375532_Rx
        ComIPduSignalRef = PMP3_RESP_ERROR_oPMP3_Sts_oLIN00_9f14f3a0_Rx
        ComIPduSignalRef = PMP3_RealRPM_oPMP3_Sts_oLIN00_fa6fbf8a_Rx
        ComPduIdRef = PMP3_Sts_oLIN00_511c4704_Rx
        ComIPduMainFunctionRef = ComMainFunctionRx
      9 x ComSignal, all with ComSignalEndianness=LITTLE_ENDIAN, ComSignalInitValue=0, ComSignalAccess=ACCESS_UNCLEAR:
        TCU_HVCHMaxPowerLimit_oTCU_HVCH_Cmd_oLIN00_4bc53e0b_Tx: ComBitPosition=16, ComBitSize=8, ComSignalType=UINT8, ComHandleId=249, ComTransferProperty=PENDING, ComSystemTemplateSystemSignalRef=TCU_HVCHMaxPowerLimit
        ECC_PMP3_SpdSet_oPMP_Cmd_oLIN00_0d8ea190_Tx: ComBitPosition=16, ComBitSize=8, ComSignalType=UINT8, ComHandleId=50, ComTransferProperty=PENDING, ComSystemTemplateSystemSignalRef=ECC_PMP3_SpdSet
        TCU_HVCH_On_Rq_oTCU_HVCH_Cmd_oLIN00_9f442eaf_Tx: ComBitPosition=8, ComBitSize=2, ComSignalDataInvalidValue=3, ComSignalType=UINT8, ComHandleId=250, ComTransferProperty=PENDING, ComSystemTemplateSystemSignalRef=TCU_HVCH_On_Rq
        TMM_EXV2_PositionRequest_oVCU_EXV_2_oLIN00_ce8ee7dd_Tx: ComBitPosition=0, ComBitSize=16, ComSignalType=UINT16, ComHandleId=257, ComTransferProperty=PENDING, ComSystemTemplateSystemSignalRef=TMM_EXV2_PositionRequest
        EXV2_curInit_Stat_oEXV2_Status_oLIN00_b0ace0f5_Rx: ComBitPosition=2, ComBitSize=2, ComSignalType=UINT8, ComHandleId=27, ComSystemTemplateSystemSignalRef=EXV2_curInit_Stat
        EDCU_EXV2_Cmd_Init_Rq_oEDCU_EXV2_oLIN00_0144aec9_Tx: ComBitPosition=24, ComBitSize=3, ComSignalType=UINT8, ComHandleId=51, ComTransferProperty=PENDING, ComSystemTemplateSystemSignalRef=EDCU_EXV2_Cmd_Init_Rq
        TMM_EXV1_initRequest_oVCU_EXV_1_oLIN00_082350ea_Tx: ComBitPosition=24, ComBitSize=3, ComSignalType=UINT8, ComHandleId=255, ComTransferProperty=PENDING, ComSystemTemplateSystemSignalRef=TMM_EXV1_initRequest
        EXV1_RunState_oEXV_1_VCU_oLIN00_f0dc555f_Rx: ComBitPosition=3, ComBitSize=1, ComSignalType=BOOLEAN, ComHandleId=12, ComSystemTemplateSystemSignalRef=EXV1_RunState
        HVCH_IntelTemp_oHVCH_Rsp02_oLIN00_2b487110_Rx: ComBitPosition=0, ComBitSize=8, ComSignalType=UINT8, ComHandleId=34, ComSystemTemplateSystemSignalRef=HVCH_IntelTemp
      SVA_VCU_STD_oLIN00_4526aa1c_Rx (ComIPdu):
        ComIPduDirection = RECEIVE
        ComIPduType = NORMAL
        ComIPduHandleId = 87
        ComIPduSignalProcessing = DEFERRED
        ComIPduCancellationSupport = false
        ComIPduGroupRef = VCU_oLIN00_Rx_4b9dfc53
        ComIPduSignalRef = Act_Pos_sta_oSVA_VCU_STD_oLIN00_642c9ffa_Rx
        ComIPduSignalRef = Blockage_Fault_STA_oSVA_VCU_STD_oLIN00_6c89246f_Rx
        ComIPduSignalRef = Breakage_Fault_STA_oSVA_VCU_STD_oLIN00_a3ac9cf8_Rx
        ComIPduSignalRef = Calibration_sta_oSVA_VCU_STD_oLIN00_dcb4af08_Rx
        ComIPduSignalRef = LIN_Resp_Error_sta_oSVA_VCU_STD_oLIN00_47f7ca93_Rx
        ComPduIdRef = SVA_VCU_STD_oLIN00_4526aa1c_Rx
        ComIPduMainFunctionRef = ComMainFunctionRx
      EXV2_Volt_Stat_oEXV2_Status_oLIN00_c8727eb0_Rx (ComSignal):
        ComBitPosition = 12
        ComBitSize = 2
        ComSignalEndianness = LITTLE_ENDIAN
        ComSignalInitValue = 0
        ComSignalType = UINT8
        ComSignalAccess = ACCESS_UNCLEAR
        ComHandleId = 25
        ComSystemTemplateSystemSignalRef = EXV2_Volt_Stat
      HVCH_Rsp02_oLIN00_286c390c_Rx (ComIPdu):
        ComIPduDirection = RECEIVE
        ComIPduType = NORMAL
        ComIPduHandleId = 45
        ComIPduSignalProcessing = DEFERRED
        ComIPduCancellationSupport = false
        ComIPduGroupRef = VCU_oLIN00_Rx_4b9dfc53
        ComIPduSignalRef = HVCH_IntelTemp_oHVCH_Rsp02_oLIN00_2b487110_Rx
        ComPduIdRef = HVCH_Rsp02_oLIN00_286c390c_Rx
        ComIPduMainFunctionRef = ComMainFunctionRx
      HVCH_Rsp01_oLIN00_a6e33eef_Rx (ComIPdu):
        ComIPduDirection = RECEIVE
        ComIPduType = NORMAL
        ComIPduHandleId = 44
        ComIPduSignalProcessing = DEFERRED
        ComIPduCancellationSupport = false
        ComIPduGroupRef = VCU_oLIN00_Rx_4b9dfc53
        ComIPduSignalRef = HVCH_CurrSens_Flt_oHVCH_Rsp01_oLIN00_09f7bc74_Rx
        ComIPduSignalRef = HVCH_DutyCycle_oHVCH_Rsp01_oLIN00_ad1e6a22_Rx
        ComIPduSignalRef = HVCH_ExtPwrSup_Flt_oHVCH_Rsp01_oLIN00_28926933_Rx
        ComIPduSignalRef = HVCH_HV_DC_curr_oHVCH_Rsp01_oLIN00_f613e39d_Rx
        ComIPduSignalRef = HVCH_HV_Voltage_Valid_oHVCH_Rsp01_oLIN00_2914831e_Rx
        ComIPduSignalRef = HVCH_HV_voltage_oHVCH_Rsp01_oLIN00_3d3da318_Rx
        ComIPduSignalRef = HVCH_InternalPCBTemp_oHVCH_Rsp01_oLIN00_398b53e8_Rx
        ComIPduSignalRef = HVCH_LIN_Flt_oHVCH_Rsp01_oLIN00_9aaa25bf_Rx
        ComIPduSignalRef = HVCH_MediumTemp_oHVCH_Rsp01_oLIN00_a3387de4_Rx
        ComIPduSignalRef = HVCH_Off_ShrtCurr_oHVCH_Rsp01_oLIN00_bf58ab45_Rx
        ComIPduSignalRef = HVCH_RsErr_oHVCH_Rsp01_oLIN00_527b0f8f_Rx
        ComIPduSignalRef = HVCH_Status_oHVCH_Rsp01_oLIN00_60afdc75_Rx
        ComIPduSignalRef = HVCH_TempLim_oHVCH_Rsp01_oLIN00_d22e6add_Rx
        ComIPduSignalRef = HVCH_TempSens_Flt_oHVCH_Rsp01_oLIN00_66cb2c71_Rx
        ComIPduSignalRef = HVCH_defectHeaterCircuits_oHVCH_Rsp01_oLIN00_61948e74_Rx
        ComPduIdRef = HVCH_Rsp01_oLIN00_a6e33eef_Rx
        ComIPduMainFunctionRef = ComMainFunctionRx
      3 x ComSignal, all with ComSignalEndianness=LITTLE_ENDIAN, ComSignalInitValue=0, ComSignalType=UINT8, ComSignalAccess=ACCESS_UNCLEAR:
        HVCH_HV_voltage_oHVCH_Rsp01_oLIN00_3d3da318_Rx: ComBitPosition=8, ComBitSize=8, ComHandleId=33, ComSystemTemplateSystemSignalRef=HVCH_HV_voltage
        PMP2_PumpInputVolt_oPMP2_Sts_oLIN00_1fa0a533_Rx: ComBitPosition=8, ComBitSize=8, ComHandleId=46, ComSystemTemplateSystemSignalRef=PMP2_PumpInputVolt
        PMP2_PumpPowerSta_oPMP2_Sts_oLIN00_1d0f1319_Rx: ComBitPosition=4, ComBitSize=2, ComHandleId=48, ComSystemTemplateSystemSignalRef=PMP2_PumpPowerSta
      PMP2_Sts_oLIN00_cab90b6b_Rx (ComIPdu):
        ComIPduDirection = RECEIVE
        ComIPduType = NORMAL
        ComIPduHandleId = 67
        ComIPduSignalProcessing = DEFERRED
        ComIPduCancellationSupport = false
        ComIPduGroupRef = VCU_oLIN00_Rx_4b9dfc53
        ComIPduSignalRef = PMP2_PumpDryRunningSta_oPMP2_Sts_oLIN00_3e217a22_Rx
        ComIPduSignalRef = PMP2_PumpInputVolt_oPMP2_Sts_oLIN00_1fa0a533_Rx
        ComIPduSignalRef = PMP2_PumpMotorSta_oPMP2_Sts_oLIN00_d6d3ab88_Rx
        ComIPduSignalRef = PMP2_PumpPowerSta_oPMP2_Sts_oLIN00_1d0f1319_Rx
        ComIPduSignalRef = PMP2_PumpTempSta_oPMP2_Sts_oLIN00_81f2fa55_Rx
        ComIPduSignalRef = PMP2_RESP_ERROR_oPMP2_Sts_oLIN00_67b666eb_Rx
        ComIPduSignalRef = PMP2_RealRPM_oPMP2_Sts_oLIN00_86d75572_Rx
        ComPduIdRef = PMP2_Sts_oLIN00_cab90b6b_Rx
        ComIPduMainFunctionRef = ComMainFunctionRx
      23 x ComSignal, all with ComSignalEndianness=LITTLE_ENDIAN, ComSignalInitValue=0, ComSignalAccess=ACCESS_UNCLEAR:
        PMP3_RESP_ERROR_oPMP3_Sts_oLIN00_9f14f3a0_Rx: ComBitPosition=0, ComBitSize=1, ComSignalType=BOOLEAN, ComHandleId=57, ComSystemTemplateSystemSignalRef=PMP3_RESP_ERROR
        TMM_EXV2_EnableRequest_oVCU_EXV_2_oLIN00_0c106490_Tx: ComBitPosition=16, ComBitSize=1, ComSignalType=BOOLEAN, ComHandleId=256, ComTransferProperty=PENDING, ComSystemTemplateSystemSignalRef=TMM_EXV2_EnableRequest
        EXV2_ResponseError_oEXV_2_VCU_oLIN00_e747f934_Rx: ComBitPosition=0, ComBitSize=1, ComSignalType=BOOLEAN, ComHandleId=21, ComSystemTemplateSystemSignalRef=EXV2_ResponseError
        HVCH_ExtPwrSup_Flt_oHVCH_Rsp01_oLIN00_28926933_Rx: ComBitPosition=45, ComBitSize=1, ComSignalType=BOOLEAN, ComHandleId=30, ComSystemTemplateSystemSignalRef=HVCH_ExtPwrSup_Flt
        HVCH_MediumTemp_oHVCH_Rsp01_oLIN00_a3387de4_Rx: ComBitPosition=16, ComBitSize=8, ComSignalType=UINT8, ComHandleId=37, ComSystemTemplateSystemSignalRef=HVCH_MediumTemp
        PMP3_PumpDryRunningSta_oPMP3_Sts_oLIN00_30f4e2d8_Rx: ComBitPosition=3, ComBitSize=1, ComSignalType=BOOLEAN, ComHandleId=52, ComSystemTemplateSystemSignalRef=PMP3_PumpDryRunningSta
        HVCH_InternalPCBTemp_oHVCH_Rsp01_oLIN00_398b53e8_Rx: ComBitPosition=48, ComBitSize=8, ComSignalType=UINT8, ComHandleId=35, ComSystemTemplateSystemSignalRef=HVCH_InternalPCBTemp
        Calibration_cmd_oVCU_SVA_CMD_oLIN00_6732180a_Tx: ComBitPosition=8, ComBitSize=1, ComSignalType=BOOLEAN, ComHandleId=48, ComTransferProperty=PENDING, ComSystemTemplateSystemSignalRef=Calibration_cmd
        PMP2_RealRPM_oPMP2_Sts_oLIN00_86d75572_Rx: ComBitPosition=24, ComBitSize=8, ComSignalType=UINT8, ComHandleId=51, ComSystemTemplateSystemSignalRef=PMP2_RealRPM
        EXV2_CurrentPosition_oEXV_2_VCU_oLIN00_91e32486_Rx: ComBitPosition=16, ComBitSize=16, ComSignalType=UINT16, ComHandleId=16, ComSystemTemplateSystemSignalRef=EXV2_CurrentPosition
        Blockage_Fault_STA_oSVA_VCU_STD_oLIN00_6c89246f_Rx: ComBitPosition=2, ComBitSize=1, ComSignalType=BOOLEAN, ComHandleId=1, ComSystemTemplateSystemSignalRef=Blockage_Fault_STA
        PMP3_RealRPM_oPMP3_Sts_oLIN00_fa6fbf8a_Rx: ComBitPosition=24, ComBitSize=8, ComSignalType=UINT8, ComHandleId=58, ComSystemTemplateSystemSignalRef=PMP3_RealRPM
        EXV2_OvrTemp_Warn_oEXV2_Status_oLIN00_ba77659e_Rx: ComBitPosition=14, ComBitSize=2, ComSignalType=UINT8, ComHandleId=19, ComSystemTemplateSystemSignalRef=EXV2_OvrTemp_Warn
        PMP3_PumpTempSta_oPMP3_Sts_oLIN00_26375532_Rx: ComBitPosition=6, ComBitSize=2, ComSignalType=UINT8, ComHandleId=56, ComSystemTemplateSystemSignalRef=PMP3_PumpTempSta
        HVCH_HV_DC_curr_oHVCH_Rsp01_oLIN00_f613e39d_Rx: ComBitPosition=0, ComBitSize=8, ComSignalType=UINT8, ComHandleId=31, ComSystemTemplateSystemSignalRef=HVCH_HV_DC_curr
        EXV1_TemperatureWarn_oEXV_1_VCU_oLIN00_a3317e4b_Rx: ComBitPosition=10, ComBitSize=2, ComSignalType=UINT8, ComHandleId=13, ComSystemTemplateSystemSignalRef=EXV1_TemperatureWarn
        EXV2_FaultState_oEXV_2_VCU_oLIN00_41c0e318_Rx: ComBitPosition=4, ComBitSize=4, ComSignalType=UINT8, ComHandleId=17, ComSystemTemplateSystemSignalRef=EXV2_FaultState
        EDCU_EXV2_Cmd_Set_Rq_oEDCU_EXV2_oLIN00_66e5876a_Tx: ComBitPosition=0, ComBitSize=16, ComSignalType=UINT16, ComHandleId=53, ComTransferProperty=PENDING, ComSystemTemplateSystemSignalRef=EDCU_EXV2_Cmd_Set_Rq
        HVCH_RsErr_oHVCH_Rsp01_oLIN00_527b0f8f_Rx: ComBitPosition=61, ComBitSize=1, ComSignalType=BOOLEAN, ComHandleId=39, ComSystemTemplateSystemSignalRef=HVCH_RsErr
        EXV2_Pos_oEXV2_Status_oLIN00_da80603b_Rx: ComBitPosition=16, ComBitSize=16, ComSignalType=UINT16, ComHandleId=20, ComSystemTemplateSystemSignalRef=EXV2_Pos
        TMM_EXV1_EnableRequest_oVCU_EXV_1_oLIN00_d988d266_Tx: ComBitPosition=16, ComBitSize=1, ComSignalType=BOOLEAN, ComHandleId=253, ComTransferProperty=PENDING, ComSystemTemplateSystemSignalRef=TMM_EXV1_EnableRequest
        PMP2_RESP_ERROR_oPMP2_Sts_oLIN00_67b666eb_Rx: ComBitPosition=0, ComBitSize=1, ComSignalType=BOOLEAN, ComHandleId=50, ComSystemTemplateSystemSignalRef=PMP2_RESP_ERROR
        PMP3_PumpMotorSta_oPMP3_Sts_oLIN00_43910f36_Rx: ComBitPosition=1, ComBitSize=2, ComSignalType=UINT8, ComHandleId=54, ComSystemTemplateSystemSignalRef=PMP3_PumpMotorSta
      VCU_SVA_CMD_oLIN00_756d14f6_Tx (ComIPdu):
        ComIPduDirection = SEND
        ComIPduType = NORMAL
        ComIPduHandleId = 30
        ComIPduSignalProcessing = DEFERRED
        ComIPduCancellationSupport = false
        ComIPduGroupRef = VCU_oLIN00_Tx_1dc75bd5
        ComIPduSignalRef = Calibration_cmd_oVCU_SVA_CMD_oLIN00_6732180a_Tx
        ComIPduSignalRef = Target_Pos_cmd_oVCU_SVA_CMD_oLIN00_b87f26ef_Tx
        ComPduIdRef = VCU_SVA_CMD_oLIN00_756d14f6_Tx
        ComIPduMainFunctionRef = ComMainFunctionTx
        ComTxIPdu: ComTxIPduUnusedAreasDefault=255, ComMinimumDelayTime=0
          ComTxModeTrue
            ComTxMode: ComTxModeMode=NONE
          ComTxModeFalse
            ComTxMode: ComTxModeMode=NONE
      VcuAdcTxMsg2_Sig1_oVcuCan03TxMsg2_oTC37X_VCU_CAN03_0a1d7eaa_Tx (ComSignal):
        ComBitPosition = 16
        ComBitSize = 16
        ComSignalEndianness = LITTLE_ENDIAN
        ComSignalInitValue = 0
        ComSignalType = SINT16
        ComTimeout = 0
        ComTransferProperty = PENDING
        ComSignalAccess = ACCESS_UNCLEAR
        ComHandleId = 265
        ComSystemTemplateSystemSignalRef = VcuAdcTxMsg2_Sig1
      VcuAdcTxMsg1_Sig0_oVcuCan03TxMsg1_oTC37X_VCU_CAN03_1782ee05_Tx (ComSignal):
        ComBitPosition = 0
        ComBitSize = 16
        ComSignalEndianness = LITTLE_ENDIAN
        ComSignalInitValue = 0
        ComSignalType = SINT16
        ComTimeout = 0
        ComTransferProperty = PENDING
        ComSignalAccess = ACCESS_UNCLEAR
        ComHandleId = 260
        ComSystemTemplateSystemSignalRef = VcuAdcTxMsg1_Sig0
      VCU_oTC37X_VCU_CAN03_Rx_b23e03d7 (ComIPduGroup): ComIPduGroupHandleId=13
      3 x ComSignal, all with ComBitSize=16, ComSignalEndianness=LITTLE_ENDIAN, ComSignalInitValue=0, ComSignalType=SINT16, ComTimeout=0, ComSignalAccess=ACCESS_UNCLEAR:
        VcuAdcTxMsg1_Sig1_oVcuCan03TxMsg1_oTC37X_VCU_CAN03_3300bf33_Tx: ComBitPosition=16, ComTransferProperty=PENDING, ComHandleId=261, ComSystemTemplateSystemSignalRef=VcuAdcTxMsg1_Sig1
        VcuRxMsg3_Sig1_oVcuCan03RxMsg1_oTC37X_VCU_CAN03_8f9ddda0_Rx: ComBitPosition=16, ComHandleId=539, ComSystemTemplateSystemSignalRef=VcuRxMsg3_Sig1
        VcuRxMsg4_Sig2_oVcuCan03RxMsg2_oTC37X_VCU_CAN03_3a53c786_Rx: ComBitPosition=32, ComHandleId=549, ComSystemTemplateSystemSignalRef=VcuRxMsg4_Sig2
      VcuCan03RxMsg2_oTC37X_VCU_CAN03_9d657a3d_Rx (ComIPdu):
        ComIPduDirection = RECEIVE
        ComIPduType = NORMAL
        ComIPduHandleId = 92
        ComIPduSignalProcessing = DEFERRED
        ComIPduCancellationSupport = false
        ComIPduGroupRef = VCU_oTC37X_VCU_CAN03_Rx_b23e03d7
        ComIPduSignalRef = VcuRxMsg4_Sig0_oVcuCan03RxMsg2_oTC37X_VCU_CAN03_735765ea_Rx
        ComIPduSignalRef = VcuRxMsg4_Sig1_oVcuCan03RxMsg2_oTC37X_VCU_CAN03_57d534dc_Rx
        ComIPduSignalRef = VcuRxMsg4_Sig2_oVcuCan03RxMsg2_oTC37X_VCU_CAN03_3a53c786_Rx
        ComIPduSignalRef = VcuRxMsg4_Sig3_oVcuCan03RxMsg2_oTC37X_VCU_CAN03_1ed196b0_Rx
        ComPduIdRef = VcuCan03RxMsg2_oTC37X_VCU_CAN03_9d657a3d_Rx
        ComIPduMainFunctionRef = ComMainFunctionRx
      6 x ComSignal, all with ComBitSize=16, ComSignalEndianness=LITTLE_ENDIAN, ComSignalInitValue=0, ComSignalType=SINT16, ComTimeout=0, ComSignalAccess=ACCESS_UNCLEAR:
        VcuAdcTxMsg2_Sig2_oVcuCan03TxMsg2_oTC37X_VCU_CAN03_679b8df0_Tx: ComBitPosition=32, ComTransferProperty=PENDING, ComHandleId=266, ComSystemTemplateSystemSignalRef=VcuAdcTxMsg2_Sig2
        VcuRxMsg4_Sig0_oVcuCan03RxMsg2_oTC37X_VCU_CAN03_735765ea_Rx: ComBitPosition=0, ComHandleId=545, ComSystemTemplateSystemSignalRef=VcuRxMsg4_Sig0
        VcuRxMsg4_Sig1_oVcuCan03RxMsg2_oTC37X_VCU_CAN03_57d534dc_Rx: ComBitPosition=16, ComHandleId=547, ComSystemTemplateSystemSignalRef=VcuRxMsg4_Sig1
        VcuRxMsg3_Sig0_oVcuCan03RxMsg1_oTC37X_VCU_CAN03_ab1f8c96_Rx: ComBitPosition=0, ComHandleId=537, ComSystemTemplateSystemSignalRef=VcuRxMsg3_Sig0
        VcuRxMsg4_Sig3_oVcuCan03RxMsg2_oTC37X_VCU_CAN03_1ed196b0_Rx: ComBitPosition=48, ComHandleId=551, ComSystemTemplateSystemSignalRef=VcuRxMsg4_Sig3
        VcuAdcTxMsg1_Sig3_oVcuCan03TxMsg1_oTC37X_VCU_CAN03_7a041d5f_Tx: ComBitPosition=48, ComTransferProperty=PENDING, ComHandleId=263, ComSystemTemplateSystemSignalRef=VcuAdcTxMsg1_Sig3
      VcuCan03RxMsg1_oTC37X_VCU_CAN03_77e3a75f_Rx (ComIPdu):
        ComIPduDirection = RECEIVE
        ComIPduType = NORMAL
        ComIPduHandleId = 91
        ComIPduSignalProcessing = DEFERRED
        ComIPduCancellationSupport = false
        ComIPduGroupRef = VCU_oTC37X_VCU_CAN03_Rx_b23e03d7
        ComIPduSignalRef = VcuRxMsg3_Sig0_oVcuCan03RxMsg1_oTC37X_VCU_CAN03_ab1f8c96_Rx
        ComIPduSignalRef = VcuRxMsg3_Sig1_oVcuCan03RxMsg1_oTC37X_VCU_CAN03_8f9ddda0_Rx
        ComIPduSignalRef = VcuRxMsg3_Sig2_oVcuCan03RxMsg1_oTC37X_VCU_CAN03_e21b2efa_Rx
        ComIPduSignalRef = VcuRxMsg3_Sig3_oVcuCan03RxMsg1_oTC37X_VCU_CAN03_c6997fcc_Rx
        ComPduIdRef = VcuCan03RxMsg1_oTC37X_VCU_CAN03_77e3a75f_Rx
        ComIPduMainFunctionRef = ComMainFunctionRx
      3 x ComSignal, all with ComBitSize=16, ComSignalEndianness=LITTLE_ENDIAN, ComSignalInitValue=0, ComSignalType=SINT16, ComTimeout=0, ComSignalAccess=ACCESS_UNCLEAR:
        VcuAdcTxMsg2_Sig0_oVcuCan03TxMsg2_oTC37X_VCU_CAN03_2e9f2f9c_Tx: ComBitPosition=0, ComTransferProperty=PENDING, ComHandleId=264, ComSystemTemplateSystemSignalRef=VcuAdcTxMsg2_Sig0
        VcuAdcTxMsg1_Sig2_oVcuCan03TxMsg1_oTC37X_VCU_CAN03_5e864c69_Tx: ComBitPosition=32, ComTransferProperty=PENDING, ComHandleId=262, ComSystemTemplateSystemSignalRef=VcuAdcTxMsg1_Sig2
        VcuRxMsg3_Sig3_oVcuCan03RxMsg1_oTC37X_VCU_CAN03_c6997fcc_Rx: ComBitPosition=48, ComHandleId=543, ComSystemTemplateSystemSignalRef=VcuRxMsg3_Sig3
      VcuCan03TxMsg1_oTC37X_VCU_CAN03_9a29d525_Tx (ComIPdu):
        ComIPduDirection = SEND
        ComIPduType = NORMAL
        ComIPduHandleId = 45
        ComIPduSignalProcessing = DEFERRED
        ComIPduCancellationSupport = false
        ComIPduGroupRef = VCU_oTC37X_VCU_CAN03_Tx_e464a451
        ComIPduSignalRef = VcuAdcTxMsg1_Sig0_oVcuCan03TxMsg1_oTC37X_VCU_CAN03_1782ee05_Tx
        ComIPduSignalRef = VcuAdcTxMsg1_Sig1_oVcuCan03TxMsg1_oTC37X_VCU_CAN03_3300bf33_Tx
        ComIPduSignalRef = VcuAdcTxMsg1_Sig2_oVcuCan03TxMsg1_oTC37X_VCU_CAN03_5e864c69_Tx
        ComIPduSignalRef = VcuAdcTxMsg1_Sig3_oVcuCan03TxMsg1_oTC37X_VCU_CAN03_7a041d5f_Tx
        ComPduIdRef = VcuCan03TxMsg1_oTC37X_VCU_CAN03_9a29d525_Tx
        ComIPduMainFunctionRef = ComMainFunctionTx
        ComTxIPdu: ComMinimumDelayTime=0, ComTxIPduUnusedAreasDefault=0
          ComTxModeTrue
            ComTxMode: ComTxModeMode=PERIODIC, ComTxModeTimeOffset=0, ComTxModeTimePeriod=0.5
          ComTxModeFalse
            ComTxMode: ComTxModeMode=PERIODIC, ComTxModeTimeOffset=0, ComTxModeTimePeriod=0.5
      VcuRxMsg3_Sig2_oVcuCan03RxMsg1_oTC37X_VCU_CAN03_e21b2efa_Rx (ComSignal):
        ComBitPosition = 32
        ComBitSize = 16
        ComSignalEndianness = LITTLE_ENDIAN
        ComSignalInitValue = 0
        ComSignalType = SINT16
        ComTimeout = 0
        ComSignalAccess = ACCESS_UNCLEAR
        ComHandleId = 541
        ComSystemTemplateSystemSignalRef = VcuRxMsg3_Sig2
      VcuCan03TxMsg2_oTC37X_VCU_CAN03_70af0847_Tx (ComIPdu):
        ComIPduDirection = SEND
        ComIPduType = NORMAL
        ComIPduHandleId = 46
        ComIPduSignalProcessing = DEFERRED
        ComIPduCancellationSupport = false
        ComIPduGroupRef = VCU_oTC37X_VCU_CAN03_Tx_e464a451
        ComIPduSignalRef = VcuAdcTxMsg2_Sig0_oVcuCan03TxMsg2_oTC37X_VCU_CAN03_2e9f2f9c_Tx
        ComIPduSignalRef = VcuAdcTxMsg2_Sig1_oVcuCan03TxMsg2_oTC37X_VCU_CAN03_0a1d7eaa_Tx
        ComIPduSignalRef = VcuAdcTxMsg2_Sig2_oVcuCan03TxMsg2_oTC37X_VCU_CAN03_679b8df0_Tx
        ComIPduSignalRef = VcuAdcTxMsg2_Sig3_oVcuCan03TxMsg2_oTC37X_VCU_CAN03_4319dcc6_Tx
        ComPduIdRef = VcuCan03TxMsg2_oTC37X_VCU_CAN03_70af0847_Tx
        ComIPduMainFunctionRef = ComMainFunctionTx
        ComTxIPdu: ComMinimumDelayTime=0, ComTxIPduUnusedAreasDefault=0
          ComTxModeTrue
            ComTxMode: ComTxModeMode=PERIODIC, ComTxModeTimeOffset=0, ComTxModeTimePeriod=0.5
          ComTxModeFalse
            ComTxMode: ComTxModeMode=PERIODIC, ComTxModeTimeOffset=0, ComTxModeTimePeriod=0.5
      VCU_oTC37X_VCU_CAN03_Tx_e464a451 (ComIPduGroup): ComIPduGroupHandleId=14
      VcuAdcTxMsg2_Sig3_oVcuCan03TxMsg2_oTC37X_VCU_CAN03_4319dcc6_Tx (ComSignal):
        ComBitPosition = 48
        ComBitSize = 16
        ComSignalEndianness = LITTLE_ENDIAN
        ComSignalInitValue = 0
        ComSignalType = SINT16
        ComTimeout = 0
        ComTransferProperty = PENDING
        ComSignalAccess = ACCESS_UNCLEAR
        ComHandleId = 267
        ComSystemTemplateSystemSignalRef = VcuAdcTxMsg2_Sig3
      VCU_oLIN01_Rx_f3219b36 (ComIPduGroup): ComIPduGroupHandleId=7
      Vcu_Lin0_TxMsg2_oLIN01_0a12d45a_Tx (ComIPdu):
        ComIPduDirection = SEND
        ComIPduType = NORMAL
        ComIPduHandleId = 50
        ComIPduSignalProcessing = DEFERRED
        ComIPduCancellationSupport = false
        ComIPduGroupRef = VCU_oLIN01_Tx_a57b3cb0
        ComIPduSignalRef = Vcu_Lin0_TxMsg2_Sig0_oVcu_Lin0_TxMsg2_oLIN01_ca2bd13d_Tx
        ComIPduSignalRef = Vcu_Lin0_TxMsg2_Sig1_oVcu_Lin0_TxMsg2_oLIN01_6fa04133_Tx
        ComIPduSignalRef = Vcu_Lin0_TxMsg2_Sig2_oVcu_Lin0_TxMsg2_oLIN01_5a4df760_Tx
        ComIPduSignalRef = Vcu_Lin0_TxMsg2_Sig3_oVcu_Lin0_TxMsg2_oLIN01_ffc6676e_Tx
        ComPduIdRef = Vcu_Lin0_TxMsg2_oLIN01_0a12d45a_Tx
        ComIPduMainFunctionRef = ComMainFunctionTx
        ComTxIPdu: ComTxIPduUnusedAreasDefault=255, ComMinimumDelayTime=0
          ComTxModeTrue
            ComTxMode: ComTxModeMode=NONE
          ComTxModeFalse
            ComTxMode: ComTxModeMode=NONE
      VCU_oLIN01_Tx_a57b3cb0 (ComIPduGroup): ComIPduGroupHandleId=8
      Vcu_Lin0_TxMsg1_Sig1_oVcu_Lin0_TxMsg1_oLIN01_a58e63c8_Tx (ComSignal):
        ComBitPosition = 8
        ComBitSize = 8
        ComSignalEndianness = LITTLE_ENDIAN
        ComSignalInitValue = 0
        ComSignalType = UINT8
        ComSignalAccess = ACCESS_UNCLEAR
        ComHandleId = 273
        ComTransferProperty = PENDING
        ComSystemTemplateSystemSignalRef = Vcu_Lin0_TxMsg1_Sig1
      Vcu_Lin0_RxMsg2_oLIN01_aaf70b87_Rx (ComIPdu):
        ComIPduDirection = RECEIVE
        ComIPduType = NORMAL
        ComIPduHandleId = 99
        ComIPduSignalProcessing = DEFERRED
        ComIPduCancellationSupport = false
        ComIPduGroupRef = VCU_oLIN01_Rx_f3219b36
        ComIPduSignalRef = Vcu_Lin0_RxMsg2_Sig0_oVcu_Lin0_RxMsg2_oLIN01_a6197493_Rx
        ComIPduSignalRef = Vcu_Lin0_RxMsg2_Sig1_oVcu_Lin0_RxMsg2_oLIN01_0392e49d_Rx
        ComIPduSignalRef = Vcu_Lin0_RxMsg2_Sig2_oVcu_Lin0_RxMsg2_oLIN01_367f52ce_Rx
        ComIPduSignalRef = Vcu_Lin0_RxMsg2_Sig3_oVcu_Lin0_RxMsg2_oLIN01_93f4c2c0_Rx
        ComPduIdRef = Vcu_Lin0_RxMsg2_oLIN01_aaf70b87_Rx
        ComIPduMainFunctionRef = ComMainFunctionRx
      4 x ComSignal, all with ComBitSize=8, ComSignalEndianness=LITTLE_ENDIAN, ComSignalInitValue=0, ComSignalType=UINT8, ComSignalAccess=ACCESS_UNCLEAR:
        Vcu_Lin0_RxMsg2_Sig0_oVcu_Lin0_RxMsg2_oLIN01_a6197493_Rx: ComBitPosition=0, ComHandleId=555, ComSystemTemplateSystemSignalRef=Vcu_Lin0_RxMsg2_Sig0
        Vcu_Lin0_RxMsg2_Sig2_oVcu_Lin0_RxMsg2_oLIN01_367f52ce_Rx: ComBitPosition=16, ComHandleId=558, ComSystemTemplateSystemSignalRef=Vcu_Lin0_RxMsg2_Sig2
        Vcu_Lin0_TxMsg1_Sig0_oVcu_Lin0_TxMsg1_oLIN01_0005f3c6_Tx: ComBitPosition=0, ComHandleId=272, ComTransferProperty=PENDING, ComSystemTemplateSystemSignalRef=Vcu_Lin0_TxMsg1_Sig0
        Vcu_Lin0_TxMsg1_Sig3_oVcu_Lin0_TxMsg1_oLIN01_35e84595_Tx: ComBitPosition=24, ComHandleId=275, ComTransferProperty=PENDING, ComSystemTemplateSystemSignalRef=Vcu_Lin0_TxMsg1_Sig3
      Vcu_Lin0_RxMsg1_oLIN01_24780c64_Rx (ComIPdu):
        ComIPduDirection = RECEIVE
        ComIPduType = NORMAL
        ComIPduHandleId = 98
        ComIPduSignalProcessing = DEFERRED
        ComIPduCancellationSupport = false
        ComIPduGroupRef = VCU_oLIN01_Rx_f3219b36
        ComIPduSignalRef = Vcu_Lin0_RxMsg1_Sig0_oVcu_Lin0_RxMsg1_oLIN01_6c375668_Rx
        ComIPduSignalRef = Vcu_Lin0_RxMsg1_Sig1_oVcu_Lin0_RxMsg1_oLIN01_c9bcc666_Rx
        ComIPduSignalRef = Vcu_Lin0_RxMsg2_Sig2_oVcu_Lin0_RxMsg1_oLIN01_b8f0552d_Rx
        ComIPduSignalRef = Vcu_Lin0_RxMsg2_Sig3_oVcu_Lin0_RxMsg1_oLIN01_1d7bc523_Rx
        ComPduIdRef = Vcu_Lin0_RxMsg1_oLIN01_24780c64_Rx
        ComIPduMainFunctionRef = ComMainFunctionRx
      9 x ComSignal, all with ComBitSize=8, ComSignalEndianness=LITTLE_ENDIAN, ComSignalInitValue=0, ComSignalType=UINT8, ComSignalAccess=ACCESS_UNCLEAR:
        Vcu_Lin0_RxMsg2_Sig3_oVcu_Lin0_RxMsg2_oLIN01_93f4c2c0_Rx: ComBitPosition=32, ComHandleId=560, ComSystemTemplateSystemSignalRef=Vcu_Lin0_RxMsg2_Sig3
        Vcu_Lin0_TxMsg2_Sig1_oVcu_Lin0_TxMsg2_oLIN01_6fa04133_Tx: ComBitPosition=8, ComHandleId=277, ComTransferProperty=PENDING, ComSystemTemplateSystemSignalRef=Vcu_Lin0_TxMsg2_Sig1
        Vcu_Lin0_TxMsg2_Sig3_oVcu_Lin0_TxMsg2_oLIN01_ffc6676e_Tx: ComBitPosition=24, ComHandleId=279, ComTransferProperty=PENDING, ComSystemTemplateSystemSignalRef=Vcu_Lin0_TxMsg2_Sig3
        Vcu_Lin0_RxMsg1_Sig1_oVcu_Lin0_RxMsg1_oLIN01_c9bcc666_Rx: ComBitPosition=0, ComHandleId=554, ComSystemTemplateSystemSignalRef=Vcu_Lin0_RxMsg1_Sig1
        Vcu_Lin0_RxMsg2_Sig3_oVcu_Lin0_RxMsg1_oLIN01_1d7bc523_Rx: ComBitPosition=24, ComHandleId=559, ComSystemTemplateSystemSignalRef=Vcu_Lin0_RxMsg2_Sig3
        Vcu_Lin0_TxMsg1_Sig2_oVcu_Lin0_TxMsg1_oLIN01_9063d59b_Tx: ComBitPosition=16, ComHandleId=274, ComTransferProperty=PENDING, ComSystemTemplateSystemSignalRef=Vcu_Lin0_TxMsg1_Sig2
        Vcu_Lin0_TxMsg2_Sig2_oVcu_Lin0_TxMsg2_oLIN01_5a4df760_Tx: ComBitPosition=16, ComHandleId=278, ComTransferProperty=PENDING, ComSystemTemplateSystemSignalRef=Vcu_Lin0_TxMsg2_Sig2
        Vcu_Lin0_RxMsg2_Sig2_oVcu_Lin0_RxMsg1_oLIN01_b8f0552d_Rx: ComBitPosition=16, ComHandleId=557, ComSystemTemplateSystemSignalRef=Vcu_Lin0_RxMsg2_Sig2
        Vcu_Lin0_TxMsg2_Sig0_oVcu_Lin0_TxMsg2_oLIN01_ca2bd13d_Tx: ComBitPosition=0, ComHandleId=276, ComTransferProperty=PENDING, ComSystemTemplateSystemSignalRef=Vcu_Lin0_TxMsg2_Sig0
      Vcu_Lin0_TxMsg1_oLIN01_849dd3b9_Tx (ComIPdu):
        ComIPduDirection = SEND
        ComIPduType = NORMAL
        ComIPduHandleId = 49
        ComIPduSignalProcessing = DEFERRED
        ComIPduCancellationSupport = false
        ComIPduGroupRef = VCU_oLIN01_Tx_a57b3cb0
        ComIPduSignalRef = Vcu_Lin0_TxMsg1_Sig0_oVcu_Lin0_TxMsg1_oLIN01_0005f3c6_Tx
        ComIPduSignalRef = Vcu_Lin0_TxMsg1_Sig1_oVcu_Lin0_TxMsg1_oLIN01_a58e63c8_Tx
        ComIPduSignalRef = Vcu_Lin0_TxMsg1_Sig2_oVcu_Lin0_TxMsg1_oLIN01_9063d59b_Tx
        ComIPduSignalRef = Vcu_Lin0_TxMsg1_Sig3_oVcu_Lin0_TxMsg1_oLIN01_35e84595_Tx
        ComPduIdRef = Vcu_Lin0_TxMsg1_oLIN01_849dd3b9_Tx
        ComIPduMainFunctionRef = ComMainFunctionTx
        ComTxIPdu: ComTxIPduUnusedAreasDefault=255, ComMinimumDelayTime=0
          ComTxModeTrue
            ComTxMode: ComTxModeMode=NONE
          ComTxModeFalse
            ComTxMode: ComTxModeMode=NONE
      Vcu_Lin0_RxMsg1_Sig0_oVcu_Lin0_RxMsg1_oLIN01_6c375668_Rx (ComSignal):
        ComBitPosition = 8
        ComBitSize = 8
        ComSignalEndianness = LITTLE_ENDIAN
        ComSignalInitValue = 0
        ComSignalType = UINT8
        ComSignalAccess = ACCESS_UNCLEAR
        ComHandleId = 553
        ComSystemTemplateSystemSignalRef = Vcu_Lin0_RxMsg1_Sig0
      Vcu_Lin0_RxMsg2_Sig1_oVcu_Lin0_RxMsg2_oLIN01_0392e49d_Rx (ComSignal):
        ComBitPosition = 8
        ComBitSize = 8
        ComSignalEndianness = LITTLE_ENDIAN
        ComSignalInitValue = 0
        ComSignalType = UINT8
        ComSignalAccess = ACCESS_UNCLEAR
        ComHandleId = 556
        ComSystemTemplateSystemSignalRef = Vcu_Lin0_RxMsg2_Sig1
      10 x ComSignalGroup, all with ComTransferProperty=PENDING, ComSignalGroupAccess=ACCESS_UNCLEAR:
        SG_VCU_AccPedal_SigGroup_oVCU_AccPedal_oATOM_CANFD_Matrix_CH_V600_202502_aa50ac8d_Tx: ComHandleId=7, ComSystemTemplateSignalGroupRef=SG_VCU_AccPedal_SigGroup
          13 x ComGroupSignal, all with ComSignalEndianness=BIG_ENDIAN, ComSignalInitValue=0, ComTransferProperty=PENDING, ComSignalAccess=ACCESS_UNCLEAR:
            VCU_TargetGear_oVCU_AccPedal_oATOM_CANFD_Matrix_CH_V600_202502_d928d8b4_Tx: ComBitPosition=43, ComBitSize=3, ComSignalType=UINT8, ComHandleId=100, ComSystemTemplateSystemSignalRef=VCU_TargetGear
            VCU_VehicleSpeedValid_oVCU_AccPedal_oATOM_CANFD_Matrix_CH_V600_202502_70135d30_Tx: ComBitPosition=15, ComBitSize=1, ComSignalType=BOOLEAN, ComHandleId=103, ComSystemTemplateSystemSignalRef=VCU_VehicleSpeedValid
            VCU_VirtualACPedal_oVCU_AccPedal_oATOM_CANFD_Matrix_CH_V600_202502_03ae7390_Tx: ComBitPosition=25, ComBitSize=10, ComSignalType=UINT16, ComHandleId=106, ComSystemTemplateSystemSignalRef=VCU_VirtualACPedal
            VCU_Kickdown_oVCU_AccPedal_oATOM_CANFD_Matrix_CH_V600_202502_17d4134b_Tx: ComBitPosition=56, ComBitSize=1, ComSignalType=BOOLEAN, ComHandleId=99, ComSystemTemplateSystemSignalRef=VCU_Kickdown
            VCU_VehicleSpeed_oVCU_AccPedal_oATOM_CANFD_Matrix_CH_V600_202502_da00c229_Tx: ComBitPosition=55, ComBitSize=13, ComSignalType=UINT16, ComHandleId=104, ComSystemTemplateSystemSignalRef=VCU_VehicleSpeed
            VCU_VLCTorqueRequestAvailable_oVCU_AccPedal_oATOM_CANFD_Matrix_CH_V600_202502_d00cfa4f_Tx: ComBitPosition=58, ComBitSize=1, ComSignalType=BOOLEAN, ComHandleId=102, ComSystemTemplateSystemSignalRef=VCU_VLCTorqueRequestAvailable
            VCU_VirtualACPedalValid_oVCU_AccPedal_oATOM_CANFD_Matrix_CH_V600_202502_4b161096_Tx: ComBitPosition=26, ComBitSize=1, ComSignalType=BOOLEAN, ComHandleId=105, ComSystemTemplateSystemSignalRef=VCU_VirtualACPedalValid
            MessageCounter_0D2_oVCU_AccPedal_oATOM_CANFD_Matrix_CH_V600_202502_630306b4_Tx: ComBitPosition=11, ComBitSize=4, ComSignalType=UINT8, ComHandleId=95, ComSystemTemplateSystemSignalRef=MessageCounter_0D2
            VCU_AccelerationPedalValid_oVCU_AccPedal_oATOM_CANFD_Matrix_CH_V600_202502_365d9f08_Tx: ComBitPosition=29, ComBitSize=1, ComSignalType=BOOLEAN, ComHandleId=96, ComSystemTemplateSystemSignalRef=VCU_AccelerationPedalValid
            VCU_AccelerationPedal_oVCU_AccPedal_oATOM_CANFD_Matrix_CH_V600_202502_f84e7cef_Tx: ComBitPosition=23, ComBitSize=10, ComSignalType=UINT16, ComHandleId=97, ComSystemTemplateSystemSignalRef=VCU_AccelerationPedal
            VCU_EPBReq_oVCU_AccPedal_oATOM_CANFD_Matrix_CH_V600_202502_4a2bfea4_Tx: ComBitPosition=14, ComBitSize=2, ComSignalType=UINT8, ComHandleId=98, ComSystemTemplateSystemSignalRef=VCU_EPBReq
            VCU_VLCTorqueRequestActive_oVCU_AccPedal_oATOM_CANFD_Matrix_CH_V600_202502_a1329f5d_Tx: ComBitPosition=57, ComBitSize=1, ComSignalType=BOOLEAN, ComHandleId=101, ComSystemTemplateSystemSignalRef=VCU_VLCTorqueRequestActive
            Checksum_0D2_oVCU_AccPedal_oATOM_CANFD_Matrix_CH_V600_202502_51727e14_Tx: ComBitPosition=7, ComBitSize=8, ComSignalType=UINT8, ComHandleId=94, ComSystemTemplateSystemSignalRef=Checksum_0D2
        SG_VCU_HMIsignals_01_SigGroup_oVCU_HMIsignals_01_oATOM_CANFD_Matrix_CH_V600_202502_c30c8d8f_Tx: ComHandleId=14, ComSystemTemplateSignalGroupRef=SG_VCU_HMIsignals_01_SigGroup
          14 x ComGroupSignal, all with ComSignalEndianness=BIG_ENDIAN, ComSignalInitValue=0, ComTransferProperty=PENDING, ComSignalAccess=ACCESS_UNCLEAR:
            VCU_DCDCFail_oVCU_HMIsignals_01_oATOM_CANFD_Matrix_CH_V600_202502_8211651e_Tx: ComBitPosition=21, ComBitSize=1, ComSignalType=BOOLEAN, ComHandleId=168, ComSystemTemplateSystemSignalRef=VCU_DCDCFail
            VCU_HVBatCriFail_oVCU_HMIsignals_01_oATOM_CANFD_Matrix_CH_V600_202502_05faf04f_Tx: ComBitPosition=29, ComBitSize=2, ComSignalType=UINT8, ComHandleId=170, ComSystemTemplateSystemSignalRef=VCU_HVBatCriFail
            VCU_HVILError_oVCU_HMIsignals_01_oATOM_CANFD_Matrix_CH_V600_202502_f1e2e871_Tx: ComBitPosition=18, ComBitSize=1, ComSignalType=BOOLEAN, ComHandleId=172, ComSystemTemplateSystemSignalRef=VCU_HVILError
            VCU_InvldGearSel_oVCU_HMIsignals_01_oATOM_CANFD_Matrix_CH_V600_202502_773f11d0_Tx: ComBitPosition=51, ComBitSize=4, ComSignalType=UINT8, ComHandleId=174, ComSystemTemplateSystemSignalRef=VCU_InvldGearSel
            VCU_ReachLimitStd_oVCU_HMIsignals_01_oATOM_CANFD_Matrix_CH_V600_202502_5cd2e319_Tx: ComBitPosition=15, ComBitSize=1, ComSignalType=BOOLEAN, ComHandleId=178, ComSystemTemplateSystemSignalRef=VCU_ReachLimitStd
            MessageCounter_317_oVCU_HMIsignals_01_oATOM_CANFD_Matrix_CH_V600_202502_18685520_Tx: ComBitPosition=11, ComBitSize=4, ComSignalType=UINT8, ComHandleId=166, ComSystemTemplateSystemSignalRef=MessageCounter_317
            VCU_HVBatOvrTemp_oVCU_HMIsignals_01_oATOM_CANFD_Matrix_CH_V600_202502_1ab841cc_Tx: ComBitPosition=19, ComBitSize=1, ComSignalType=BOOLEAN, ComHandleId=171, ComSystemTemplateSystemSignalRef=VCU_HVBatOvrTemp
            Checksum_317_oVCU_HMIsignals_01_oATOM_CANFD_Matrix_CH_V600_202502_7e8714d3_Tx: ComBitPosition=7, ComBitSize=8, ComSignalType=UINT8, ComHandleId=165, ComSystemTemplateSystemSignalRef=Checksum_317
            VCU_DriveMotOvrTemp_oVCU_HMIsignals_01_oATOM_CANFD_Matrix_CH_V600_202502_2b850699_Tx: ComBitPosition=22, ComBitSize=1, ComSignalType=BOOLEAN, ComHandleId=169, ComSystemTemplateSystemSignalRef=VCU_DriveMotOvrTemp
            VCU_LimpHome_oVCU_HMIsignals_01_oATOM_CANFD_Matrix_CH_V600_202502_664ff33a_Tx: ComBitPosition=16, ComBitSize=1, ComSignalType=BOOLEAN, ComHandleId=175, ComSystemTemplateSystemSignalRef=VCU_LimpHome
            VCU_HVInsulResFault_oVCU_HMIsignals_01_oATOM_CANFD_Matrix_CH_V600_202502_e6836204_Tx: ComBitPosition=17, ComBitSize=1, ComSignalType=BOOLEAN, ComHandleId=173, ComSystemTemplateSystemSignalRef=VCU_HVInsulResFault
            VCU_MileagelowRemind_oVCU_HMIsignals_01_oATOM_CANFD_Matrix_CH_V600_202502_1b14b376_Tx: ComBitPosition=61, ComBitSize=1, ComSignalType=BOOLEAN, ComHandleId=176, ComSystemTemplateSystemSignalRef=VCU_MileagelowRemind
            VCU_CriSysFailure_oVCU_HMIsignals_01_oATOM_CANFD_Matrix_CH_V600_202502_13fa69e3_Tx: ComBitPosition=25, ComBitSize=2, ComSignalType=UINT8, ComHandleId=167, ComSystemTemplateSystemSignalRef=VCU_CriSysFailure
            VCU_PlugStatus_oVCU_HMIsignals_01_oATOM_CANFD_Matrix_CH_V600_202502_250fa71e_Tx: ComBitPosition=55, ComBitSize=3, ComSignalType=UINT8, ComHandleId=177, ComSystemTemplateSystemSignalRef=VCU_PlugStatus
        SG_IBS_Status_02_SigGroup_oIBS_Status_02_oATOM_CANFD_Matrix_CH_V600_202502_8df002b0_Rx: ComHandleId=44, ComSystemTemplateSignalGroupRef=SG_IBS_Status_02_SigGroup
          18 x ComGroupSignal, all with ComSignalEndianness=BIG_ENDIAN, ComSignalInitValue=0, ComSignalAccess=ACCESS_UNCLEAR:
            IBS_AEBActive_oIBS_Status_02_oATOM_CANFD_Matrix_CH_V600_202502_27fddc4e_Rx: ComBitPosition=26, ComBitSize=1, ComSignalType=BOOLEAN, ComHandleId=320, ComSystemTemplateSystemSignalRef=IBS_AEBActive
            IBS_EPBworkingSts_oIBS_Status_02_oATOM_CANFD_Matrix_CH_V600_202502_fc06f35e_Rx: ComBitPosition=19, ComBitSize=3, ComSignalType=UINT8, ComHandleId=329, ComSystemTemplateSystemSignalRef=IBS_EPBworkingSts
            IBS_AEBAvailable_oIBS_Status_02_oATOM_CANFD_Matrix_CH_V600_202502_586c329d_Rx: ComBitPosition=33, ComBitSize=1, ComSignalType=BOOLEAN, ComHandleId=321, ComSystemTemplateSystemSignalRef=IBS_AEBAvailable
            Checksum_0B3_oIBS_Status_02_oATOM_CANFD_Matrix_CH_V600_202502_a2ce7b09_Rx: ComBitPosition=7, ComBitSize=8, ComSignalType=UINT8, ComHandleId=319, ComSystemTemplateSystemSignalRef=Checksum_0B3
            IBS_HHCAvailable_oIBS_Status_02_oATOM_CANFD_Matrix_CH_V600_202502_a333cc25_Rx: ComBitPosition=24, ComBitSize=1, ComSignalType=BOOLEAN, ComHandleId=332, ComSystemTemplateSystemSignalRef=IBS_HHCAvailable
            IBS_AWBActive_oIBS_Status_02_oATOM_CANFD_Matrix_CH_V600_202502_47745887_Rx: ComBitPosition=36, ComBitSize=1, ComSignalType=BOOLEAN, ComHandleId=323, ComSystemTemplateSystemSignalRef=IBS_AWBActive
            IBS_TCSActive_oIBS_Status_02_oATOM_CANFD_Matrix_CH_V600_202502_a64ac2d8_Rx: ComBitPosition=31, ComBitSize=1, ComSignalType=BOOLEAN, ComHandleId=334, ComSystemTemplateSystemSignalRef=IBS_TCSActive
            IBS_HDCAvailable_oIBS_Status_02_oATOM_CANFD_Matrix_CH_V600_202502_deb691a6_Rx: ComBitPosition=27, ComBitSize=1, ComSignalType=BOOLEAN, ComHandleId=330, ComSystemTemplateSystemSignalRef=IBS_HDCAvailable
            IBS_EPBFailureLamp_oIBS_Status_02_oATOM_CANFD_Matrix_CH_V600_202502_94ade1a4_Rx: ComBitPosition=23, ComBitSize=2, ComSignalType=UINT8, ComHandleId=327, ComSystemTemplateSystemSignalRef=IBS_EPBFailureLamp
            IBS_VDCActive_oIBS_Status_02_oATOM_CANFD_Matrix_CH_V600_202502_7ab0d9f3_Rx: ComBitPosition=30, ComBitSize=1, ComSignalType=BOOLEAN, ComHandleId=335, ComSystemTemplateSystemSignalRef=IBS_VDCActive
            IBS_AVHAvailable_oIBS_Status_02_oATOM_CANFD_Matrix_CH_V600_202502_e9505f9e_Rx: ComBitPosition=39, ComBitSize=1, ComSignalType=BOOLEAN, ComHandleId=322, ComSystemTemplateSystemSignalRef=IBS_AVHAvailable
            IBS_AWBAvailable_oIBS_Status_02_oATOM_CANFD_Matrix_CH_V600_202502_0d99f9f9_Rx: ComBitPosition=32, ComBitSize=1, ComSignalType=BOOLEAN, ComHandleId=324, ComSystemTemplateSystemSignalRef=IBS_AWBAvailable
            IBS_EPBFunctionLamp_oIBS_Status_02_oATOM_CANFD_Matrix_CH_V600_202502_947116d4_Rx: ComBitPosition=35, ComBitSize=2, ComSignalType=UINT8, ComHandleId=328, ComSystemTemplateSystemSignalRef=IBS_EPBFunctionLamp
            IBS_HHCActive_oIBS_Status_02_oATOM_CANFD_Matrix_CH_V600_202502_f453be85_Rx: ComBitPosition=25, ComBitSize=1, ComSignalType=BOOLEAN, ComHandleId=331, ComSystemTemplateSystemSignalRef=IBS_HHCActive
            MessageCounter_0B3_oIBS_Status_02_oATOM_CANFD_Matrix_CH_V600_202502_742aa999_Rx: ComBitPosition=11, ComBitSize=4, ComSignalType=UINT8, ComHandleId=336, ComSystemTemplateSystemSignalRef=MessageCounter_0B3
            IBS_BrakeLightRequest_oIBS_Status_02_oATOM_CANFD_Matrix_CH_V600_202502_a14297cf_Rx: ComBitPosition=21, ComBitSize=2, ComSignalType=UINT8, ComHandleId=325, ComSystemTemplateSystemSignalRef=IBS_BrakeLightRequest
            IBS_EPBControllerSts_oIBS_Status_02_oATOM_CANFD_Matrix_CH_V600_202502_65ed44e8_Rx: ComBitPosition=47, ComBitSize=2, ComSignalType=UINT8, ComHandleId=326, ComSystemTemplateSystemSignalRef=IBS_EPBControllerSts
            IBS_HazWarnReq_oIBS_Status_02_oATOM_CANFD_Matrix_CH_V600_202502_b191eb63_Rx: ComBitPosition=38, ComBitSize=2, ComSignalType=UINT8, ComHandleId=333, ComSystemTemplateSystemSignalRef=IBS_HazWarnReq
        SG_VCU_IBS_01_SigGroup_oVCU_IBS_01_oATOM_CANFD_Matrix_CH_V600_202502_f0f49d09_Tx: ComHandleId=18, ComSystemTemplateSignalGroupRef=SG_VCU_IBS_01_SigGroup
          7 x ComGroupSignal, all with ComSignalEndianness=BIG_ENDIAN, ComSignalInitValue=0, ComTransferProperty=PENDING, ComSignalAccess=ACCESS_UNCLEAR:
            VCU_WheelTrqACTValid_oVCU_IBS_01_oATOM_CANFD_Matrix_CH_V600_202502_0e2031fb_Tx: ComBitPosition=40, ComBitSize=1, ComSignalType=BOOLEAN, ComHandleId=205, ComSystemTemplateSystemSignalRef=VCU_WheelTrqACTValid
            VCU_MotorActualTorqueValid_oVCU_IBS_01_oATOM_CANFD_Matrix_CH_V600_202502_2709c7ef_Tx: ComBitPosition=14, ComBitSize=1, ComSignalType=BOOLEAN, ComHandleId=202, ComSystemTemplateSystemSignalRef=VCU_MotorActualTorqueValid
            MessageCounter_094_oVCU_IBS_01_oATOM_CANFD_Matrix_CH_V600_202502_804a7805_Tx: ComBitPosition=11, ComBitSize=4, ComSignalType=UINT8, ComHandleId=201, ComSystemTemplateSystemSignalRef=MessageCounter_094
            VCU_MotorActualTorque_oVCU_IBS_01_oATOM_CANFD_Matrix_CH_V600_202502_90c1c989_Tx: ComBitPosition=39, ComBitSize=11, ComSignalType=UINT16, ComHandleId=203, ComSystemTemplateSystemSignalRef=VCU_MotorActualTorque
            VCU_OPStandstillReq_oVCU_IBS_01_oATOM_CANFD_Matrix_CH_V600_202502_af773c24_Tx: ComBitPosition=42, ComBitSize=2, ComSignalType=UINT8, ComHandleId=204, ComSystemTemplateSystemSignalRef=VCU_OPStandstillReq
            VCU_WheelTrqACT_oVCU_IBS_01_oATOM_CANFD_Matrix_CH_V600_202502_722027bb_Tx: ComBitPosition=55, ComBitSize=16, ComSignalType=UINT16, ComHandleId=206, ComSystemTemplateSystemSignalRef=VCU_WheelTrqACT
            Checksum_094_oVCU_IBS_01_oATOM_CANFD_Matrix_CH_V600_202502_28a707e9_Tx: ComBitPosition=7, ComBitSize=8, ComSignalType=UINT8, ComHandleId=200, ComSystemTemplateSystemSignalRef=Checksum_094
        SG_ACU_info_SigGroup_oACU_info_oATOM_CANFD_Matrix_CH_V600_202502_5b63ef23_Rx: ComHandleId=2, ComSystemTemplateSignalGroupRef=SG_ACU_info_SigGroup
          19 x ComGroupSignal, all with ComSignalEndianness=BIG_ENDIAN, ComSignalAccess=ACCESS_UNCLEAR:
            ACU_DriverSeatBeltStsValid_oACU_info_oATOM_CANFD_Matrix_CH_V600_202502_2fcd0f16_Rx: ComBitPosition=30, ComBitSize=1, ComSignalInitValue=0, ComSignalType=BOOLEAN, ComHandleId=72, ComSystemTemplateSystemSignalRef=ACU_DriverSeatBeltStsValid
            ACU_RRSeatBeltStatusValid_oACU_info_oATOM_CANFD_Matrix_CH_V600_202502_8ba1e757_Rx: ComBitPosition=54, ComBitSize=1, ComSignalInitValue=0, ComSignalType=BOOLEAN, ComHandleId=81, ComSystemTemplateSystemSignalRef=ACU_RRSeatBeltStatusValid
            ACU_PassengerWarningLampSts_oACU_info_oATOM_CANFD_Matrix_CH_V600_202502_eaccbc6f_Rx: ComBitPosition=59, ComBitSize=2, ComSignalInitValue=0, ComSignalType=UINT8, ComHandleId=79, ComSystemTemplateSystemSignalRef=ACU_PassengerWarningLampSts
            ACU_PassengerAirbagSts_oACU_info_oATOM_CANFD_Matrix_CH_V600_202502_4a4cb1e6_Rx: ComBitPosition=63, ComBitSize=2, ComSignalInitValue=0, ComSignalType=UINT8, ComHandleId=75, ComSystemTemplateSystemSignalRef=ACU_PassengerAirbagSts
            ACU_CrashOutputStsValid_oACU_info_oATOM_CANFD_Matrix_CH_V600_202502_01645954_Rx: ComBitPosition=16, ComBitSize=1, ComSignalInitValue=1, ComSignalType=BOOLEAN, ComHandleId=70, ComSystemTemplateSystemSignalRef=ACU_CrashOutputStsValid
            ACU_PassengerSeatBeltSts_oACU_info_oATOM_CANFD_Matrix_CH_V600_202502_2c4c3734_Rx: ComBitPosition=27, ComBitSize=1, ComSignalInitValue=0, ComSignalType=BOOLEAN, ComHandleId=77, ComSystemTemplateSystemSignalRef=ACU_PassengerSeatBeltSts
            ACU_WarningLampSts_oACU_info_oATOM_CANFD_Matrix_CH_V600_202502_9c596fcb_Rx: ComBitPosition=57, ComBitSize=2, ComSignalInitValue=0, ComSignalType=UINT8, ComHandleId=86, ComSystemTemplateSystemSignalRef=ACU_WarningLampSts
            ACU_SecondLeftSts_oACU_info_oATOM_CANFD_Matrix_CH_V600_202502_4d0b3459_Rx: ComBitPosition=37, ComBitSize=1, ComSignalInitValue=0, ComSignalType=BOOLEAN, ComHandleId=83, ComSystemTemplateSystemSignalRef=ACU_SecondLeftSts
            ACU_PassengerSts_oACU_info_oATOM_CANFD_Matrix_CH_V600_202502_eb52bcb8_Rx: ComBitPosition=25, ComBitSize=1, ComSignalInitValue=0, ComSignalType=BOOLEAN, ComHandleId=78, ComSystemTemplateSystemSignalRef=ACU_PassengerSts
            Checksum_097_oACU_info_oATOM_CANFD_Matrix_CH_V600_202502_591da21b_Rx: ComBitPosition=7, ComBitSize=8, ComSignalInitValue=0, ComSignalType=UINT8, ComHandleId=87, ComSystemTemplateSystemSignalRef=Checksum_097
            MessageCounter_097_oACU_info_oATOM_CANFD_Matrix_CH_V600_202502_9c6de300_Rx: ComBitPosition=11, ComBitSize=4, ComSignalInitValue=0, ComSignalType=UINT8, ComHandleId=88, ComSystemTemplateSystemSignalRef=MessageCounter_097
            ACU_SecondRightSeatBeltSts_oACU_info_oATOM_CANFD_Matrix_CH_V600_202502_3170c946_Rx: ComBitPosition=55, ComBitSize=1, ComSignalInitValue=0, ComSignalType=BOOLEAN, ComHandleId=84, ComSystemTemplateSystemSignalRef=ACU_SecondRightSeatBeltSts
            ACU_CrashOutputSts_oACU_info_oATOM_CANFD_Matrix_CH_V600_202502_8aba12b9_Rx: ComBitPosition=23, ComBitSize=5, ComSignalInitValue=0, ComSignalType=UINT8, ComHandleId=71, ComSystemTemplateSystemSignalRef=ACU_CrashOutputSts
            ACU_SecondRightSts_oACU_info_oATOM_CANFD_Matrix_CH_V600_202502_19211d8e_Rx: ComBitPosition=53, ComBitSize=1, ComSignalInitValue=0, ComSignalType=BOOLEAN, ComHandleId=85, ComSystemTemplateSystemSignalRef=ACU_SecondRightSts
            ACU_DriverSeatBeltSts_oACU_info_oATOM_CANFD_Matrix_CH_V600_202502_4a79a099_Rx: ComBitPosition=31, ComBitSize=1, ComSignalInitValue=0, ComSignalType=BOOLEAN, ComHandleId=73, ComSystemTemplateSystemSignalRef=ACU_DriverSeatBeltSts
            ACU_PassengerSeatBeltStsValid_oACU_info_oATOM_CANFD_Matrix_CH_V600_202502_96ea6676_Rx: ComBitPosition=26, ComBitSize=1, ComSignalInitValue=0, ComSignalType=BOOLEAN, ComHandleId=76, ComSystemTemplateSystemSignalRef=ACU_PassengerSeatBeltStsValid
            ACU_SecondLeftSeatBeltSts_oACU_info_oATOM_CANFD_Matrix_CH_V600_202502_0c298557_Rx: ComBitPosition=39, ComBitSize=1, ComSignalInitValue=0, ComSignalType=BOOLEAN, ComHandleId=82, ComSystemTemplateSystemSignalRef=ACU_SecondLeftSeatBeltSts
            ACU_RLSeatBeltStatusValid_oACU_info_oATOM_CANFD_Matrix_CH_V600_202502_231d8b98_Rx: ComBitPosition=38, ComBitSize=1, ComSignalInitValue=0, ComSignalType=BOOLEAN, ComHandleId=80, ComSystemTemplateSystemSignalRef=ACU_RLSeatBeltStatusValid
            ACU_DriverWarningLampSts_oACU_info_oATOM_CANFD_Matrix_CH_V600_202502_53dfaac4_Rx: ComBitPosition=61, ComBitSize=2, ComSignalInitValue=0, ComSignalType=UINT8, ComHandleId=74, ComSystemTemplateSystemSignalRef=ACU_DriverWarningLampSts
        SG_IBS_Status_04_SigGroup_oIBS_Status_04_oATOM_CANFD_Matrix_CH_V600_202502_edfe62a4_Rx: ComHandleId=46, ComSystemTemplateSignalGroupRef=SG_IBS_Status_04_SigGroup
          5 x ComGroupSignal, all with ComSignalEndianness=BIG_ENDIAN, ComSignalInitValue=0, ComSignalAccess=ACCESS_UNCLEAR:
            Checksum_0BA_oIBS_Status_04_oATOM_CANFD_Matrix_CH_V600_202502_77cd2b4a_Rx: ComBitPosition=7, ComBitSize=8, ComSignalType=UINT8, ComHandleId=353, ComSystemTemplateSystemSignalRef=Checksum_0BA
            IBS_DTCActive_oIBS_Status_04_oATOM_CANFD_Matrix_CH_V600_202502_05637011_Rx: ComBitPosition=21, ComBitSize=1, ComSignalType=BOOLEAN, ComHandleId=356, ComSystemTemplateSystemSignalRef=IBS_DTCActive
            IBS_CDPActive_oIBS_Status_04_oATOM_CANFD_Matrix_CH_V600_202502_5f0477e0_Rx: ComBitPosition=23, ComBitSize=1, ComSignalType=BOOLEAN, ComHandleId=354, ComSystemTemplateSystemSignalRef=IBS_CDPActive
            IBS_CDPAvailable_oIBS_Status_04_oATOM_CANFD_Matrix_CH_V600_202502_551f17a8_Rx: ComBitPosition=22, ComBitSize=1, ComSignalType=BOOLEAN, ComHandleId=355, ComSystemTemplateSystemSignalRef=IBS_CDPAvailable
            MessageCounter_0BA_oIBS_Status_04_oATOM_CANFD_Matrix_CH_V600_202502_a129f9da_Rx: ComBitPosition=11, ComBitSize=4, ComSignalType=UINT8, ComHandleId=357, ComSystemTemplateSystemSignalRef=MessageCounter_0BA
        SG_ADCU_APS_02_SigGroup_oADCU_APS_02_oATOM_CANFD_Matrix_CH_V600_202502_67bc1f98_Rx: ComHandleId=6, ComSystemTemplateSignalGroupRef=SG_ADCU_APS_02_SigGroup
          ADCU_RemoteParkingMode_oADCU_APS_02_oATOM_CANFD_Matrix_CH_V600_202502_262c752a_Rx (ComGroupSignal):
            ComBitPosition = 23
            ComBitSize = 4
            ComSignalEndianness = BIG_ENDIAN
            ComSignalInitValue = 0
            ComSignalType = UINT8
            ComSignalAccess = ACCESS_UNCLEAR
            ComHandleId = 117
            ComSystemTemplateSystemSignalRef = ADCU_RemoteParkingMode
        SG_VCU_MCU_03_SigGroup_oVCU_MCU_03_oATOM_CANFD_Matrix_CH_V600_202502_c0057d9b_Tx: ComHandleId=20, ComSystemTemplateSignalGroupRef=SG_VCU_MCU_03_SigGroup
          11 x ComGroupSignal, all with ComSignalEndianness=BIG_ENDIAN, ComSignalInitValue=0, ComTransferProperty=PENDING, ComSignalAccess=ACCESS_UNCLEAR:
            VCU_BrakepedalStatus_oVCU_MCU_03_oATOM_CANFD_Matrix_CH_V600_202502_f285ec19_Tx: ComBitPosition=47, ComBitSize=2, ComSignalType=UINT8, ComHandleId=213, ComSystemTemplateSystemSignalRef=VCU_BrakepedalStatus
            VCU_MCUDesiredTorque_oVCU_MCU_03_oATOM_CANFD_Matrix_CH_V600_202502_a07350bb_Tx: ComBitPosition=23, ComBitSize=11, ComSignalType=UINT16, ComHandleId=215, ComSystemTemplateSystemSignalRef=VCU_MCUDesiredTorque
            VCU_RequestedModeMCU_oVCU_MCU_03_oATOM_CANFD_Matrix_CH_V600_202502_97cf52ed_Tx: ComBitPosition=43, ComBitSize=4, ComSignalType=UINT8, ComHandleId=218, ComSystemTemplateSystemSignalRef=VCU_RequestedModeMCU
            VCU_TrqThresholdDampgCtl_oVCU_MCU_03_oATOM_CANFD_Matrix_CH_V600_202502_86f61526_Tx: ComBitPosition=55, ComBitSize=8, ComSignalType=UINT8, ComHandleId=220, ComSystemTemplateSystemSignalRef=VCU_TrqThresholdDampgCtl
            VCU_MCUSurgeDamperState_oVCU_MCU_03_oATOM_CANFD_Matrix_CH_V600_202502_4b3e55ae_Tx: ComBitPosition=37, ComBitSize=2, ComSignalType=UINT8, ComHandleId=216, ComSystemTemplateSystemSignalRef=VCU_MCUSurgeDamperState
            VCU_TCSActive_oVCU_MCU_03_oATOM_CANFD_Matrix_CH_V600_202502_f7e15433_Tx: ComBitPosition=38, ComBitSize=1, ComSignalType=BOOLEAN, ComHandleId=219, ComSystemTemplateSystemSignalRef=VCU_TCSActive
            Checksum_095_oVCU_MCU_03_oATOM_CANFD_Matrix_CH_V600_202502_004b6de5_Tx: ComBitPosition=7, ComBitSize=8, ComSignalType=UINT8, ComHandleId=210, ComSystemTemplateSystemSignalRef=Checksum_095
            VCU_ActualGear_oVCU_MCU_03_oATOM_CANFD_Matrix_CH_V600_202502_adcf3745_Tx: ComBitPosition=34, ComBitSize=3, ComSignalType=UINT8, ComHandleId=212, ComSystemTemplateSystemSignalRef=VCU_ActualGear
            MessageCounter_095_oVCU_MCU_03_oATOM_CANFD_Matrix_CH_V600_202502_a8a61209_Tx: ComBitPosition=11, ComBitSize=4, ComSignalType=UINT8, ComHandleId=211, ComSystemTemplateSystemSignalRef=MessageCounter_095
            VCU_PWTErrorLevel_oVCU_MCU_03_oATOM_CANFD_Matrix_CH_V600_202502_4725a26e_Tx: ComBitPosition=15, ComBitSize=4, ComSignalType=UINT8, ComHandleId=217, ComSystemTemplateSystemSignalRef=VCU_PWTErrorLevel
            VCU_KL15eOn_oVCU_MCU_03_oATOM_CANFD_Matrix_CH_V600_202502_2306d930_Tx: ComBitPosition=39, ComBitSize=1, ComSignalType=BOOLEAN, ComHandleId=214, ComSystemTemplateSystemSignalRef=VCU_KL15eOn
        SG_IBS_Status_06_SigGroup_oIBS_Status_06_oATOM_CANFD_Matrix_CH_V600_202502_7b2b4097_Rx: ComHandleId=48, ComSystemTemplateSignalGroupRef=SG_IBS_Status_06_SigGroup
          20 x ComGroupSignal, all with ComSignalEndianness=BIG_ENDIAN, ComSignalAccess=ACCESS_UNCLEAR:
            IBS_TireMonSysSts_oIBS_Status_06_oATOM_CANFD_Matrix_CH_V600_202502_91ee3722_Rx: ComBitPosition=61, ComBitSize=1, ComSignalInitValue=1, ComSignalType=BOOLEAN, ComHandleId=377, ComSystemTemplateSystemSignalRef=IBS_TireMonSysSts
            IBS_ESClampdisplay_oIBS_Status_06_oATOM_CANFD_Matrix_CH_V600_202502_cffaf18c_Rx: ComBitPosition=53, ComBitSize=2, ComSignalInitValue=0, ComSignalType=UINT8, ComHandleId=368, ComSystemTemplateSystemSignalRef=IBS_ESClampdisplay
            IBS_TireWarnFrntRi_oIBS_Status_06_oATOM_CANFD_Matrix_CH_V600_202502_dbb01a62_Rx: ComBitPosition=56, ComBitSize=1, ComSignalInitValue=0, ComSignalType=BOOLEAN, ComHandleId=379, ComSystemTemplateSystemSignalRef=IBS_TireWarnFrntRi
            IBS_AVHSts_oIBS_Status_06_oATOM_CANFD_Matrix_CH_V600_202502_e3018ac7_Rx: ComBitPosition=55, ComBitSize=2, ComSignalInitValue=0, ComSignalType=UINT8, ComHandleId=364, ComSystemTemplateSystemSignalRef=IBS_AVHSts
            IBS_TPMS_ResetSts_oIBS_Status_06_oATOM_CANFD_Matrix_CH_V600_202502_ee7e0532_Rx: ComBitPosition=60, ComBitSize=1, ComSignalInitValue=0, ComSignalType=BOOLEAN, ComHandleId=376, ComSystemTemplateSystemSignalRef=IBS_TPMS_ResetSts
            IBS_TireWarnFrntLe_oIBS_Status_06_oATOM_CANFD_Matrix_CH_V600_202502_7fea0ce4_Rx: ComBitPosition=57, ComBitSize=1, ComSignalInitValue=0, ComSignalType=BOOLEAN, ComHandleId=378, ComSystemTemplateSystemSignalRef=IBS_TireWarnFrntLe
            IBS_EPBFailureStatus_oIBS_Status_06_oATOM_CANFD_Matrix_CH_V600_202502_2591769d_Rx: ComBitPosition=63, ComBitSize=2, ComSignalInitValue=0, ComSignalType=UINT8, ComHandleId=366, ComSystemTemplateSystemSignalRef=IBS_EPBFailureStatus
            IBS_RWUActive_oIBS_Status_06_oATOM_CANFD_Matrix_CH_V600_202502_353ab732_Rx: ComBitPosition=44, ComBitSize=1, ComSignalInitValue=0, ComSignalType=BOOLEAN, ComHandleId=373, ComSystemTemplateSystemSignalRef=IBS_RWUActive
            IBS_HBAActive_oIBS_Status_06_oATOM_CANFD_Matrix_CH_V600_202502_b3e0fd61_Rx: ComBitPosition=46, ComBitSize=1, ComSignalInitValue=0, ComSignalType=BOOLEAN, ComHandleId=370, ComSystemTemplateSystemSignalRef=IBS_HBAActive
            IBS_HDCSts_oIBS_Status_06_oATOM_CANFD_Matrix_CH_V600_202502_d0313153_Rx: ComBitPosition=51, ComBitSize=2, ComSignalInitValue=0, ComSignalType=UINT8, ComHandleId=371, ComSystemTemplateSystemSignalRef=IBS_HDCSts
            IBS_TireWarnReRi_oIBS_Status_06_oATOM_CANFD_Matrix_CH_V600_202502_ca07afb6_Rx: ComBitPosition=58, ComBitSize=1, ComSignalInitValue=0, ComSignalType=BOOLEAN, ComHandleId=381, ComSystemTemplateSystemSignalRef=IBS_TireWarnReRi
            IBS_TireWarnReLe_oIBS_Status_06_oATOM_CANFD_Matrix_CH_V600_202502_6e5db930_Rx: ComBitPosition=59, ComBitSize=1, ComSignalInitValue=0, ComSignalType=BOOLEAN, ComHandleId=380, ComSystemTemplateSystemSignalRef=IBS_TireWarnReLe
            Checksum_0BC_oIBS_Status_06_oATOM_CANFD_Matrix_CH_V600_202502_e0933738_Rx: ComBitPosition=7, ComBitSize=8, ComSignalInitValue=0, ComSignalType=UINT8, ComHandleId=363, ComSystemTemplateSystemSignalRef=Checksum_0BC
            IBS_BrakeFluidWarning_oIBS_Status_06_oATOM_CANFD_Matrix_CH_V600_202502_cf3bf9da_Rx: ComBitPosition=49, ComBitSize=2, ComSignalInitValue=0, ComSignalType=UINT8, ComHandleId=365, ComSystemTemplateSystemSignalRef=IBS_BrakeFluidWarning
            MessageCounter_0BC_oIBS_Status_06_oATOM_CANFD_Matrix_CH_V600_202502_3677e5a8_Rx: ComBitPosition=11, ComBitSize=4, ComSignalInitValue=0, ComSignalType=UINT8, ComHandleId=382, ComSystemTemplateSystemSignalRef=MessageCounter_0BC
            IBS_ESCOffSts_oIBS_Status_06_oATOM_CANFD_Matrix_CH_V600_202502_a7e250e7_Rx: ComBitPosition=45, ComBitSize=1, ComSignalInitValue=1, ComSignalType=BOOLEAN, ComHandleId=367, ComSystemTemplateSystemSignalRef=IBS_ESCOffSts
            IBS_FactoryMode_oIBS_Status_06_oATOM_CANFD_Matrix_CH_V600_202502_1f4b8984_Rx: ComBitPosition=40, ComBitSize=1, ComSignalInitValue=0, ComSignalType=BOOLEAN, ComHandleId=369, ComSystemTemplateSystemSignalRef=IBS_FactoryMode
            IBS_RWUAvailable_oIBS_Status_06_oATOM_CANFD_Matrix_CH_V600_202502_55a4e82d_Rx: ComBitPosition=43, ComBitSize=1, ComSignalInitValue=0, ComSignalType=BOOLEAN, ComHandleId=374, ComSystemTemplateSystemSignalRef=IBS_RWUAvailable
            IBS_MaintenaceMode_oIBS_Status_06_oATOM_CANFD_Matrix_CH_V600_202502_e1932fbc_Rx: ComBitPosition=42, ComBitSize=1, ComSignalInitValue=0, ComSignalType=BOOLEAN, ComHandleId=372, ComSystemTemplateSystemSignalRef=IBS_MaintenaceMode
            IBS_RollerbenchMode_oIBS_Status_06_oATOM_CANFD_Matrix_CH_V600_202502_7e2deccc_Rx: ComBitPosition=41, ComBitSize=1, ComSignalInitValue=0, ComSignalType=BOOLEAN, ComHandleId=375, ComSystemTemplateSystemSignalRef=IBS_RollerbenchMode
        SG_VCU_04_SigGroup_oVCU_04_oATOM_CANFD_Matrix_CH_V600_202502_4cce7c18_Tx: ComHandleId=4, ComSystemTemplateSignalGroupRef=SG_VCU_04_SigGroup
          VCU_ManuallyUnlockComment_oVCU_04_oATOM_CANFD_Matrix_CH_V600_202502_3223f100_Tx (ComGroupSignal):
            ComBitPosition = 14
            ComBitSize = 1
            ComSignalEndianness = BIG_ENDIAN
            ComSignalInitValue = 0
            ComSignalType = BOOLEAN
            ComTransferProperty = PENDING
            ComSignalAccess = ACCESS_UNCLEAR
            ComHandleId = 83
            ComSystemTemplateSystemSignalRef = VCU_ManuallyUnlockComment
          VCU_ForwardVmaxlimitStatus_oVCU_04_oATOM_CANFD_Matrix_CH_V600_202502_beba9b73_Tx (ComGroupSignal):
            ComBitPosition = 15
            ComBitSize = 1
            ComSignalEndianness = BIG_ENDIAN
            ComSignalInitValue = 0
            ComSignalType = BOOLEAN
            ComTransferProperty = PENDING
            ComSignalAccess = ACCESS_UNCLEAR
            ComHandleId = 82
            ComSystemTemplateSystemSignalRef = VCU_ForwardVmaxlimitStatus
      IBS_Status_06_oATOM_CANFD_Matrix_CH_V600_202502_b3201aef_Rx (ComIPdu):
        ComIPduDirection = RECEIVE
        ComIPduType = NORMAL
        ComIPduHandleId = 53
        ComIPduSignalProcessing = DEFERRED
        ComIPduCancellationSupport = false
        ComIPduGroupRef = VCU_oATOM_CANFD_Matrix_CH_V600_202502_Rx_5e4659c4
        ComIPduSignalGroupRef = SG_IBS_Status_06_SigGroup_oIBS_Status_06_oATOM_CANFD_Matrix_CH_V600_202502_7b2b4097_Rx
        ComPduIdRef = IBS_Status_06_oATOM_CANFD_Matrix_CH_V600_202502_b3201aef_Rx
        ComIPduMainFunctionRef = ComMainFunctionRx
      SG_IBS_WheelSpeed_02_SigGroup_oIBS_WheelSpeed_02_oATOM_CANFD_Matrix_CH_V600_202502_2d752b6e_Rx (ComSignalGroup): ComTransferProperty=PENDING, ComSignalGroupAccess=ACCESS_UNCLEAR, ComHandleId=52, ComSystemTemplateSignalGroupRef=SG_IBS_WheelSpeed_02_SigGroup
        10 x ComGroupSignal, all with ComSignalEndianness=BIG_ENDIAN, ComSignalInitValue=0, ComSignalAccess=ACCESS_UNCLEAR:
          IBS_RRWheelSpeed_Fault_oIBS_WheelSpeed_02_oATOM_CANFD_Matrix_CH_V600_202502_be453909_Rx: ComBitPosition=23, ComBitSize=1, ComSignalType=BOOLEAN, ComHandleId=415, ComSystemTemplateSystemSignalRef=IBS_RRWheelSpeed_Fault
          IBS_RRWheelSpeed_oIBS_WheelSpeed_02_oATOM_CANFD_Matrix_CH_V600_202502_fce5b0f5_Rx: ComBitPosition=20, ComBitSize=13, ComSignalType=UINT16, ComHandleId=416, ComSystemTemplateSystemSignalRef=IBS_RRWheelSpeed
          IBS_RRMovingDirection_oIBS_WheelSpeed_02_oATOM_CANFD_Matrix_CH_V600_202502_1d72c7d4_Rx: ComBitPosition=22, ComBitSize=2, ComSignalType=UINT8, ComHandleId=413, ComSystemTemplateSystemSignalRef=IBS_RRMovingDirection
          Checksum_0B1_oIBS_WheelSpeed_02_oATOM_CANFD_Matrix_CH_V600_202502_65c4b71d_Rx: ComBitPosition=7, ComBitSize=8, ComSignalType=UINT8, ComHandleId=408, ComSystemTemplateSystemSignalRef=Checksum_0B1
          IBS_RLWheelPulseCounter_oIBS_WheelSpeed_02_oATOM_CANFD_Matrix_CH_V600_202502_296e9e60_Rx: ComBitPosition=63, ComBitSize=8, ComSignalType=UINT8, ComHandleId=410, ComSystemTemplateSystemSignalRef=IBS_RLWheelPulseCounter
          IBS_RRWheelPulseCounter_oIBS_WheelSpeed_02_oATOM_CANFD_Matrix_CH_V600_202502_31e56adc_Rx: ComBitPosition=39, ComBitSize=8, ComSignalType=UINT8, ComHandleId=414, ComSystemTemplateSystemSignalRef=IBS_RRWheelPulseCounter
          IBS_RLMovingDirection_oIBS_WheelSpeed_02_oATOM_CANFD_Matrix_CH_V600_202502_ad5dc1f0_Rx: ComBitPosition=46, ComBitSize=2, ComSignalType=UINT8, ComHandleId=409, ComSystemTemplateSystemSignalRef=IBS_RLMovingDirection
          IBS_RLWheelSpeed_oIBS_WheelSpeed_02_oATOM_CANFD_Matrix_CH_V600_202502_5459dc3a_Rx: ComBitPosition=44, ComBitSize=13, ComSignalType=UINT16, ComHandleId=412, ComSystemTemplateSystemSignalRef=IBS_RLWheelSpeed
          IBS_RLWheelSpeed_Fault_oIBS_WheelSpeed_02_oATOM_CANFD_Matrix_CH_V600_202502_82f6f2de_Rx: ComBitPosition=47, ComBitSize=1, ComSignalType=BOOLEAN, ComHandleId=411, ComSystemTemplateSystemSignalRef=IBS_RLWheelSpeed_Fault
          MessageCounter_0B1_oIBS_WheelSpeed_02_oATOM_CANFD_Matrix_CH_V600_202502_032bf6ee_Rx: ComBitPosition=11, ComBitSize=4, ComSignalType=UINT8, ComHandleId=417, ComSystemTemplateSystemSignalRef=MessageCounter_0B1
      IBS_APS_oATOM_CANFD_Matrix_CH_V600_202502_25d77553_Rx (ComIPdu):
        ComIPduDirection = RECEIVE
        ComIPduType = NORMAL
        ComIPduHandleId = 47
        ComIPduSignalProcessing = DEFERRED
        ComIPduCancellationSupport = false
        ComIPduGroupRef = VCU_oATOM_CANFD_Matrix_CH_V600_202502_Rx_5e4659c4
        ComIPduSignalGroupRef = SG_IBS_APS_SigGroup_oIBS_APS_oATOM_CANFD_Matrix_CH_V600_202502_91bbe9ec_Rx
        ComPduIdRef = IBS_APS_oATOM_CANFD_Matrix_CH_V600_202502_25d77553_Rx
        ComIPduMainFunctionRef = ComMainFunctionRx
      SG_ADCU_AEB_01_SigGroup_oADCU_AEB_01_oATOM_CANFD_Matrix_CH_V600_202502_50a93e3a_Rx (ComSignalGroup): ComTransferProperty=PENDING, ComSignalGroupAccess=ACCESS_UNCLEAR, ComHandleId=4, ComSystemTemplateSignalGroupRef=SG_ADCU_AEB_01_SigGroup
        11 x ComGroupSignal, all with ComSignalEndianness=BIG_ENDIAN, ComSignalInitValue=0, ComSignalAccess=ACCESS_UNCLEAR:
          ADCU_AEB_AWB_Level_oADCU_AEB_01_oATOM_CANFD_Matrix_CH_V600_202502_16b7390a_Rx: ComBitPosition=43, ComBitSize=3, ComSignalType=UINT8, ComHandleId=96, ComSystemTemplateSystemSignalRef=ADCU_AEB_AWB_Level
          ADCU_AEB_Prefill_CMD_oADCU_AEB_01_oATOM_CANFD_Matrix_CH_V600_202502_935b0159_Rx: ComBitPosition=55, ComBitSize=1, ComSignalType=BOOLEAN, ComHandleId=99, ComSystemTemplateSystemSignalRef=ADCU_AEB_Prefill_CMD
          ADCU_AEB_Stop_Req_oADCU_AEB_01_oATOM_CANFD_Matrix_CH_V600_202502_edd96c77_Rx: ComBitPosition=53, ComBitSize=1, ComSignalType=BOOLEAN, ComHandleId=101, ComSystemTemplateSystemSignalRef=ADCU_AEB_Stop_Req
          MessageCounter_0E2_oADCU_AEB_01_oATOM_CANFD_Matrix_CH_V600_202502_9953fa4a_Rx: ComBitPosition=11, ComBitSize=4, ComSignalType=UINT8, ComHandleId=104, ComSystemTemplateSystemSignalRef=MessageCounter_0E2
          ADCU_AEBWarningSts_oADCU_AEB_01_oATOM_CANFD_Matrix_CH_V600_202502_ce5fed0e_Rx: ComBitPosition=50, ComBitSize=3, ComSignalType=UINT8, ComHandleId=95, ComSystemTemplateSystemSignalRef=ADCU_AEBWarningSts
          ADCU_AEB_State_oADCU_AEB_01_oATOM_CANFD_Matrix_CH_V600_202502_040d6d85_Rx: ComBitPosition=18, ComBitSize=2, ComSignalType=UINT8, ComHandleId=100, ComSystemTemplateSystemSignalRef=ADCU_AEB_State
          ADCU_AEB_Decel_Cmd_oADCU_AEB_01_oATOM_CANFD_Matrix_CH_V600_202502_e2026fd4_Rx: ComBitPosition=39, ComBitSize=10, ComSignalType=SINT16, ComHandleId=98, ComSystemTemplateSystemSignalRef=ADCU_AEB_Decel_Cmd
          ADCU_FCW_State_oADCU_AEB_01_oATOM_CANFD_Matrix_CH_V600_202502_858628ce_Rx: ComBitPosition=20, ComBitSize=2, ComSignalType=UINT8, ComHandleId=102, ComSystemTemplateSystemSignalRef=ADCU_FCW_State
          Checksum_0E2_oADCU_AEB_01_oATOM_CANFD_Matrix_CH_V600_202502_3047b966_Rx: ComBitPosition=7, ComBitSize=8, ComSignalType=UINT8, ComHandleId=103, ComSystemTemplateSystemSignalRef=Checksum_0E2
          ADCU_AEB_AWB_Req_oADCU_AEB_01_oATOM_CANFD_Matrix_CH_V600_202502_52a850e5_Rx: ComBitPosition=54, ComBitSize=1, ComSignalType=BOOLEAN, ComHandleId=97, ComSystemTemplateSystemSignalRef=ADCU_AEB_AWB_Req
          ADCU_AEBReq_oADCU_AEB_01_oATOM_CANFD_Matrix_CH_V600_202502_cfcc0419_Rx: ComBitPosition=15, ComBitSize=1, ComSignalType=BOOLEAN, ComHandleId=94, ComSystemTemplateSystemSignalRef=ADCU_AEBReq
      SG_IBS_Status_01_SigGroup_oIBS_Status_01_oATOM_CANFD_Matrix_CH_V600_202502_bdf732ba_Rx (ComSignalGroup): ComTransferProperty=PENDING, ComSignalGroupAccess=ACCESS_UNCLEAR, ComHandleId=43, ComSystemTemplateSignalGroupRef=SG_IBS_Status_01_SigGroup
        7 x ComGroupSignal, all with ComSignalEndianness=BIG_ENDIAN, ComSignalAccess=ACCESS_UNCLEAR:
          IBS_BrakePushrodStroke_oIBS_Status_01_oATOM_CANFD_Matrix_CH_V600_202502_b9911368_Rx: ComBitPosition=55, ComBitSize=12, ComSignalInitValue=0, ComSignalType=SINT16, ComHandleId=315, ComSystemTemplateSystemSignalRef=IBS_BrakePushrodStroke
          MessageCounter_0B2_oIBS_Status_01_oATOM_CANFD_Matrix_CH_V600_202502_7bc88e71_Rx: ComBitPosition=11, ComBitSize=4, ComSignalInitValue=0, ComSignalType=UINT8, ComHandleId=318, ComSystemTemplateSystemSignalRef=MessageCounter_0B2
          IBS_BrakePedalStatus_oIBS_Status_01_oATOM_CANFD_Matrix_CH_V600_202502_c14952d9_Rx: ComBitPosition=23, ComBitSize=2, ComSignalInitValue=0, ComSignalType=UINT8, ComHandleId=314, ComSystemTemplateSystemSignalRef=IBS_BrakePedalStatus
          IBS_MasterCylinderPressure_oIBS_Status_01_oATOM_CANFD_Matrix_CH_V600_202502_b339468a_Rx: ComBitPosition=19, ComBitSize=12, ComSignalInitValue=0, ComSignalType=UINT16, ComHandleId=316, ComSystemTemplateSystemSignalRef=IBS_MasterCylinderPressure
          IBS_PlungerPressure_oIBS_Status_01_oATOM_CANFD_Matrix_CH_V600_202502_1a29f19b_Rx: ComBitPosition=36, ComBitSize=12, ComSignalInitValue=0, ComSignalType=SINT16, ComHandleId=317, ComSystemTemplateSystemSignalRef=IBS_PlungerPressure
          Checksum_0B2_oIBS_Status_01_oATOM_CANFD_Matrix_CH_V600_202502_ad2c5ce1_Rx: ComBitPosition=7, ComBitSize=8, ComSignalInitValue=0, ComSignalType=UINT8, ComHandleId=312, ComSystemTemplateSystemSignalRef=Checksum_0B2
          IBS_BrakePedalStatusValid_oIBS_Status_01_oATOM_CANFD_Matrix_CH_V600_202502_ba3a564c_Rx: ComBitPosition=21, ComBitSize=1, ComSignalInitValue=1, ComSignalType=BOOLEAN, ComHandleId=313, ComSystemTemplateSystemSignalRef=IBS_BrakePedalStatusValid
      VCU_03_oATOM_CANFD_Matrix_CH_V600_202502_d824d0f9_Tx (ComIPdu):
        ComIPduDirection = SEND
        ComIPduType = NORMAL
        ComIPduHandleId = 6
        ComIPduSignalProcessing = DEFERRED
        ComIPduCancellationSupport = false
        ComIPduGroupRef = VCU_oATOM_CANFD_Matrix_CH_V600_202502_Tx_081cfe42
        ComIPduSignalGroupRef = SG_VCU_03_SigGroup_oVCU_03_oATOM_CANFD_Matrix_CH_V600_202502_8990e3c1_Tx
        ComPduIdRef = VCU_03_oATOM_CANFD_Matrix_CH_V600_202502_d824d0f9_Tx
        ComIPduMainFunctionRef = ComMainFunctionTx
        ComTxIPdu: ComMinimumDelayTime=0, ComTxIPduUnusedAreasDefault=0
          ComTxModeTrue
            ComTxMode: ComTxModeMode=PERIODIC, ComTxModeTimeOffset=0, ComTxModeTimePeriod=0.1
          ComTxModeFalse
            ComTxMode: ComTxModeMode=PERIODIC, ComTxModeTimeOffset=0, ComTxModeTimePeriod=0.1
      SGW_17_oATOM_CANFD_Matrix_CH_V600_202502_9b3e5336_Rx (ComIPdu):
        ComIPduDirection = RECEIVE
        ComIPduType = NORMAL
        ComIPduHandleId = 81
        ComIPduSignalProcessing = DEFERRED
        ComIPduCancellationSupport = false
        ComIPduGroupRef = VCU_oATOM_CANFD_Matrix_CH_V600_202502_Rx_5e4659c4
        ComIPduSignalGroupRef = SG_SGW_17_SigGroup_oSGW_17_oATOM_CANFD_Matrix_CH_V600_202502_804294b2_Rx
        ComPduIdRef = SGW_17_oATOM_CANFD_Matrix_CH_V600_202502_9b3e5336_Rx
        ComIPduMainFunctionRef = ComMainFunctionRx
      3 x ComSignalGroup, all with ComTransferProperty=PENDING, ComSignalGroupAccess=ACCESS_UNCLEAR:
        SG_IBS_WheelSpeed_01_SigGroup_oIBS_WheelSpeed_01_oATOM_CANFD_Matrix_CH_V600_202502_5773aa13_Rx: ComHandleId=51, ComSystemTemplateSignalGroupRef=SG_IBS_WheelSpeed_01_SigGroup
          10 x ComGroupSignal, all with ComSignalEndianness=BIG_ENDIAN, ComSignalInitValue=0, ComSignalAccess=ACCESS_UNCLEAR:
            IBS_FLWheelSpeed_oIBS_WheelSpeed_01_oATOM_CANFD_Matrix_CH_V600_202502_d228a055_Rx: ComBitPosition=44, ComBitSize=13, ComSignalType=UINT16, ComHandleId=402, ComSystemTemplateSystemSignalRef=IBS_FLWheelSpeed
            IBS_FRMovingDirection_oIBS_WheelSpeed_01_oATOM_CANFD_Matrix_CH_V600_202502_be7c8b57_Rx: ComBitPosition=22, ComBitSize=2, ComSignalType=UINT8, ComHandleId=403, ComSystemTemplateSystemSignalRef=IBS_FRMovingDirection
            Checksum_0B0_oIBS_WheelSpeed_01_oATOM_CANFD_Matrix_CH_V600_202502_efb220b2_Rx: ComBitPosition=7, ComBitSize=8, ComSignalType=UINT8, ComHandleId=398, ComSystemTemplateSystemSignalRef=Checksum_0B0
            IBS_FLMovingDirection_oIBS_WheelSpeed_01_oATOM_CANFD_Matrix_CH_V600_202502_0e538d73_Rx: ComBitPosition=46, ComBitSize=2, ComSignalType=UINT8, ComHandleId=399, ComSystemTemplateSystemSignalRef=IBS_FLMovingDirection
            IBS_FRWheelSpeed_oIBS_WheelSpeed_01_oATOM_CANFD_Matrix_CH_V600_202502_7a94cc9a_Rx: ComBitPosition=20, ComBitSize=13, ComSignalType=UINT16, ComHandleId=406, ComSystemTemplateSystemSignalRef=IBS_FRWheelSpeed
            MessageCounter_0B0_oIBS_WheelSpeed_01_oATOM_CANFD_Matrix_CH_V600_202502_895d6141_Rx: ComBitPosition=11, ComBitSize=4, ComSignalType=UINT8, ComHandleId=407, ComSystemTemplateSystemSignalRef=MessageCounter_0B0
            IBS_FLWheelSpeed_Fault_oIBS_WheelSpeed_01_oATOM_CANFD_Matrix_CH_V600_202502_19d76bef_Rx: ComBitPosition=47, ComBitSize=1, ComSignalType=BOOLEAN, ComHandleId=401, ComSystemTemplateSystemSignalRef=IBS_FLWheelSpeed_Fault
            IBS_FRWheelSpeed_Fault_oIBS_WheelSpeed_01_oATOM_CANFD_Matrix_CH_V600_202502_2564a038_Rx: ComBitPosition=15, ComBitSize=1, ComSignalType=BOOLEAN, ComHandleId=405, ComSystemTemplateSystemSignalRef=IBS_FRWheelSpeed_Fault
            IBS_FRWheelPulseCounter_oIBS_WheelSpeed_01_oATOM_CANFD_Matrix_CH_V600_202502_8f930e98_Rx: ComBitPosition=39, ComBitSize=8, ComSignalType=UINT8, ComHandleId=404, ComSystemTemplateSystemSignalRef=IBS_FRWheelPulseCounter
            IBS_FLWheelPulseCounter_oIBS_WheelSpeed_01_oATOM_CANFD_Matrix_CH_V600_202502_9718fa24_Rx: ComBitPosition=63, ComBitSize=8, ComSignalType=UINT8, ComHandleId=400, ComSystemTemplateSystemSignalRef=IBS_FLWheelPulseCounter
        SG_IBS_VCU_MotorControl_SigGroup_oIBS_VCU_MotorControl_oATOM_CANFD_Matrix_CH_V600_202502_9a811a5b_Rx: ComHandleId=50, ComSystemTemplateSignalGroupRef=SG_IBS_VCU_MotorControl_SigGroup
          6 x ComGroupSignal, all with ComSignalEndianness=BIG_ENDIAN, ComSignalInitValue=0, ComSignalAccess=ACCESS_UNCLEAR:
            MessageCounter_090_oIBS_VCU_MotorControl_oATOM_CANFD_Matrix_CH_V600_202502_db5c1277_Rx: ComBitPosition=11, ComBitSize=4, ComSignalType=UINT8, ComHandleId=397, ComSystemTemplateSystemSignalRef=MessageCounter_090
            IBS_WLTorqueRedReq_oIBS_VCU_MotorControl_oATOM_CANFD_Matrix_CH_V600_202502_79bc7664_Rx: ComBitPosition=39, ComBitSize=16, ComSignalType=UINT16, ComHandleId=396, ComSystemTemplateSystemSignalRef=IBS_WLTorqueRedReq
            IBS_WLTorqueIncrReq_oIBS_VCU_MotorControl_oATOM_CANFD_Matrix_CH_V600_202502_6e9d7a41_Rx: ComBitPosition=55, ComBitSize=16, ComSignalType=UINT16, ComHandleId=394, ComSystemTemplateSystemSignalRef=IBS_WLTorqueIncrReq
            Checksum_090_oIBS_VCU_MotorControl_oATOM_CANFD_Matrix_CH_V600_202502_b5095e35_Rx: ComBitPosition=7, ComBitSize=8, ComSignalType=UINT8, ComHandleId=392, ComSystemTemplateSystemSignalRef=Checksum_090
            IBS_WLTorqueIncrReqSts_oIBS_VCU_MotorControl_oATOM_CANFD_Matrix_CH_V600_202502_f80f3ab5_Rx: ComBitPosition=14, ComBitSize=1, ComSignalType=BOOLEAN, ComHandleId=393, ComSystemTemplateSystemSignalRef=IBS_WLTorqueIncrReqSts
            IBS_WLTorqueRedReqSts_oIBS_VCU_MotorControl_oATOM_CANFD_Matrix_CH_V600_202502_2655e1fb_Rx: ComBitPosition=12, ComBitSize=1, ComSignalType=BOOLEAN, ComHandleId=395, ComSystemTemplateSystemSignalRef=IBS_WLTorqueRedReqSts
        SG_VCU_HMIsignals_02_SigGroup_oVCU_HMIsignals_02_oATOM_CANFD_Matrix_CH_V600_202502_b90a0cf2_Tx: ComHandleId=15, ComSystemTemplateSignalGroupRef=SG_VCU_HMIsignals_02_SigGroup
          9 x ComGroupSignal, all with ComSignalEndianness=BIG_ENDIAN, ComTransferProperty=PENDING, ComSignalAccess=ACCESS_UNCLEAR:
            VCU_Display_Cur_oVCU_HMIsignals_02_oATOM_CANFD_Matrix_CH_V600_202502_629aba80_Tx: ComBitPosition=25, ComBitSize=10, ComSignalInitValue=0, ComSignalType=UINT16, ComHandleId=182, ComSystemTemplateSystemSignalRef=VCU_Display_Cur
            MessageCounter_318_oVCU_HMIsignals_02_oATOM_CANFD_Matrix_CH_V600_202502_9aee7a8b_Tx: ComBitPosition=11, ComBitSize=4, ComSignalInitValue=0, ComSignalType=UINT8, ComHandleId=180, ComSystemTemplateSystemSignalRef=MessageCounter_318
            VCU_Display_Power_oVCU_HMIsignals_02_oATOM_CANFD_Matrix_CH_V600_202502_1364d55f_Tx: ComBitPosition=23, ComBitSize=12, ComSignalInitValue=0, ComSignalType=UINT16, ComHandleId=183, ComSystemTemplateSystemSignalRef=VCU_Display_Power
            VCU_ForwardVmaxAllowed_oVCU_HMIsignals_02_oATOM_CANFD_Matrix_CH_V600_202502_631e19bb_Tx: ComBitPosition=63, ComBitSize=8, ComSignalInitValue=0, ComSignalType=UINT8, ComHandleId=184, ComSystemTemplateSystemSignalRef=VCU_ForwardVmaxAllowed
            VCU_maxChargeSOC_oVCU_HMIsignals_02_oATOM_CANFD_Matrix_CH_V600_202502_b7e91aff_Tx: ComBitPosition=47, ComBitSize=8, ComSignalInitValue=255, ComSignalType=UINT8, ComHandleId=187, ComSystemTemplateSystemSignalRef=VCU_maxChargeSOC
            VCU_MCU_FaultLampReq_oVCU_HMIsignals_02_oATOM_CANFD_Matrix_CH_V600_202502_b94ce354_Tx: ComBitPosition=15, ComBitSize=2, ComSignalInitValue=0, ComSignalType=UINT8, ComHandleId=185, ComSystemTemplateSystemSignalRef=VCU_MCU_FaultLampReq
            VCU_SystemReady_oVCU_HMIsignals_02_oATOM_CANFD_Matrix_CH_V600_202502_3baa5f6f_Tx: ComBitPosition=27, ComBitSize=1, ComSignalInitValue=0, ComSignalType=BOOLEAN, ComHandleId=186, ComSystemTemplateSystemSignalRef=VCU_SystemReady
            Checksum_318_oVCU_HMIsignals_02_oATOM_CANFD_Matrix_CH_V600_202502_fc013b78_Tx: ComBitPosition=7, ComBitSize=8, ComSignalInitValue=0, ComSignalType=UINT8, ComHandleId=179, ComSystemTemplateSystemSignalRef=Checksum_318
            VCU_DischargeEndSoc_oVCU_HMIsignals_02_oATOM_CANFD_Matrix_CH_V600_202502_a47f7a1f_Tx: ComBitPosition=55, ComBitSize=8, ComSignalInitValue=50, ComSignalType=UINT8, ComHandleId=181, ComSystemTemplateSystemSignalRef=VCU_DischargeEndSoc
      IBS_Status_02_oATOM_CANFD_Matrix_CH_V600_202502_3bba494d_Rx (ComIPdu):
        ComIPduDirection = RECEIVE
        ComIPduType = NORMAL
        ComIPduHandleId = 49
        ComIPduSignalProcessing = DEFERRED
        ComIPduCancellationSupport = false
        ComIPduGroupRef = VCU_oATOM_CANFD_Matrix_CH_V600_202502_Rx_5e4659c4
        ComIPduSignalGroupRef = SG_IBS_Status_02_SigGroup_oIBS_Status_02_oATOM_CANFD_Matrix_CH_V600_202502_8df002b0_Rx
        ComPduIdRef = IBS_Status_02_oATOM_CANFD_Matrix_CH_V600_202502_3bba494d_Rx
        ComIPduMainFunctionRef = ComMainFunctionRx
      IBS_Torque_oATOM_CANFD_Matrix_CH_V600_202502_e4106cfa_Rx (ComIPdu):
        ComIPduDirection = RECEIVE
        ComIPduType = NORMAL
        ComIPduHandleId = 54
        ComIPduSignalProcessing = DEFERRED
        ComIPduCancellationSupport = false
        ComIPduGroupRef = VCU_oATOM_CANFD_Matrix_CH_V600_202502_Rx_5e4659c4
        ComIPduSignalGroupRef = SG_IBS_Torque_SigGroup_oIBS_Torque_oATOM_CANFD_Matrix_CH_V600_202502_5a2dd5ad_Rx
        ComPduIdRef = IBS_Torque_oATOM_CANFD_Matrix_CH_V600_202502_e4106cfa_Rx
        ComIPduMainFunctionRef = ComMainFunctionRx
      SG_VCU_02_SigGroup_oVCU_02_oATOM_CANFD_Matrix_CH_V600_202502_2fc20804_Tx (ComSignalGroup): ComTransferProperty=PENDING, ComSignalGroupAccess=ACCESS_UNCLEAR, ComHandleId=1, ComSystemTemplateSignalGroupRef=SG_VCU_02_SigGroup
        5 x ComGroupSignal, all with ComSignalEndianness=BIG_ENDIAN, ComTransferProperty=PENDING, ComSignalAccess=ACCESS_UNCLEAR:
          VCU_BS_IndicatorSts_oVCU_02_oATOM_CANFD_Matrix_CH_V600_202502_0d3265cb_Tx: ComBitPosition=31, ComBitSize=1, ComSignalInitValue=0, ComSignalType=BOOLEAN, ComHandleId=69, ComSystemTemplateSystemSignalRef=VCU_BS_IndicatorSts
          VCU_WakeUpStatus_oVCU_02_oATOM_CANFD_Matrix_CH_V600_202502_091aaa11_Tx: ComBitPosition=63, ComBitSize=8, ComSignalInitValue=0, ComSignalType=UINT8, ComHandleId=71, ComSystemTemplateSystemSignalRef=VCU_WakeUpStatus
          VCU_BS_Current_oVCU_02_oATOM_CANFD_Matrix_CH_V600_202502_55d19f8e_Tx: ComBitPosition=15, ComBitSize=14, ComSignalInitValue=0, ComSignalType=UINT16, ComHandleId=67, ComSystemTemplateSystemSignalRef=VCU_BS_Current
          VCU_BS_IBSBatSOC_oVCU_02_oATOM_CANFD_Matrix_CH_V600_202502_34765b89_Tx: ComBitPosition=7, ComBitSize=8, ComSignalInitValue=80, ComSignalType=UINT8, ComHandleId=68, ComSystemTemplateSystemSignalRef=VCU_BS_IBSBatSOC
          VCU_BS_LV_Batt_oVCU_02_oATOM_CANFD_Matrix_CH_V600_202502_41d6d523_Tx: ComBitPosition=47, ComBitSize=15, ComSignalInitValue=0, ComSignalType=UINT16, ComHandleId=70, ComSystemTemplateSystemSignalRef=VCU_BS_LV_Batt
      ADCU_AEB_01_oATOM_CANFD_Matrix_CH_V600_202502_73fc26ce_Rx (ComIPdu):
        ComIPduDirection = RECEIVE
        ComIPduType = NORMAL
        ComIPduHandleId = 4
        ComIPduSignalProcessing = DEFERRED
        ComIPduCancellationSupport = false
        ComIPduGroupRef = VCU_oATOM_CANFD_Matrix_CH_V600_202502_Rx_5e4659c4
        ComIPduSignalGroupRef = SG_ADCU_AEB_01_SigGroup_oADCU_AEB_01_oATOM_CANFD_Matrix_CH_V600_202502_50a93e3a_Rx
        ComPduIdRef = ADCU_AEB_01_oATOM_CANFD_Matrix_CH_V600_202502_73fc26ce_Rx
        ComIPduMainFunctionRef = ComMainFunctionRx
      IBS_Status_04_oATOM_CANFD_Matrix_CH_V600_202502_f76d333e_Rx (ComIPdu):
        ComIPduDirection = RECEIVE
        ComIPduType = NORMAL
        ComIPduHandleId = 51
        ComIPduSignalProcessing = DEFERRED
        ComIPduCancellationSupport = false
        ComIPduGroupRef = VCU_oATOM_CANFD_Matrix_CH_V600_202502_Rx_5e4659c4
        ComIPduSignalGroupRef = SG_IBS_Status_04_SigGroup_oIBS_Status_04_oATOM_CANFD_Matrix_CH_V600_202502_edfe62a4_Rx
        ComPduIdRef = IBS_Status_04_oATOM_CANFD_Matrix_CH_V600_202502_f76d333e_Rx
        ComIPduMainFunctionRef = ComMainFunctionRx
      SG_ACU_01_SigGroup_oACU_01_oATOM_CANFD_Matrix_CH_V600_202502_0a16dd9e_Rx (ComSignalGroup): ComTransferProperty=PENDING, ComSignalGroupAccess=ACCESS_UNCLEAR, ComHandleId=0, ComSystemTemplateSignalGroupRef=SG_ACU_01_SigGroup
        4 x ComGroupSignal, all with ComSignalEndianness=BIG_ENDIAN, ComSignalAccess=ACCESS_UNCLEAR:
          MessageCounter_0F5_oACU_01_oATOM_CANFD_Matrix_CH_V600_202502_e1f37972_Rx: ComBitPosition=11, ComBitSize=4, ComSignalInitValue=0, ComSignalType=UINT8, ComHandleId=63, ComSystemTemplateSystemSignalRef=MessageCounter_0F5
          ACU_YawRate_oACU_01_oATOM_CANFD_Matrix_CH_V600_202502_35ce62e9_Rx: ComBitPosition=23, ComBitSize=16, ComSignalInitValue=30000, ComSignalType=UINT16, ComHandleId=61, ComSystemTemplateSystemSignalRef=ACU_YawRate
          ACU_YawRateStatus_oACU_01_oATOM_CANFD_Matrix_CH_V600_202502_a5dd4854_Rx: ComBitPosition=39, ComBitSize=2, ComSignalInitValue=0, ComSignalType=UINT8, ComHandleId=60, ComSystemTemplateSystemSignalRef=ACU_YawRateStatus
          Checksum_0F5_oACU_01_oATOM_CANFD_Matrix_CH_V600_202502_21944b83_Rx: ComBitPosition=7, ComBitSize=8, ComSignalInitValue=0, ComSignalType=UINT8, ComHandleId=62, ComSystemTemplateSystemSignalRef=Checksum_0F5
      VCU_Chassis_01_oATOM_CANFD_Matrix_CH_V600_202502_d7fdb34f_Tx (ComIPdu):
        ComIPduDirection = SEND
        ComIPduType = NORMAL
        ComIPduHandleId = 14
        ComIPduSignalProcessing = DEFERRED
        ComIPduCancellationSupport = false
        ComIPduGroupRef = VCU_oATOM_CANFD_Matrix_CH_V600_202502_Tx_081cfe42
        ComIPduSignalGroupRef = SG_VCU_Chassis_01_SigGroup_oVCU_Chassis_01_oATOM_CANFD_Matrix_CH_V600_202502_52963860_Tx
        ComPduIdRef = VCU_Chassis_01_oATOM_CANFD_Matrix_CH_V600_202502_d7fdb34f_Tx
        ComIPduMainFunctionRef = ComMainFunctionTx
        ComTxIPdu: ComMinimumDelayTime=0, ComTxIPduUnusedAreasDefault=0
          ComTxModeTrue
            ComTxMode: ComTxModeMode=PERIODIC, ComTxModeTimeOffset=0, ComTxModeTimePeriod=0.02
          ComTxModeFalse
            ComTxMode: ComTxModeMode=PERIODIC, ComTxModeTimeOffset=0, ComTxModeTimePeriod=0.02
      VCU_AccPedal_oATOM_CANFD_Matrix_CH_V600_202502_0d0df7a0_Tx (ComIPdu):
        ComIPduDirection = SEND
        ComIPduType = NORMAL
        ComIPduHandleId = 10
        ComIPduSignalProcessing = DEFERRED
        ComIPduCancellationSupport = false
        ComIPduGroupRef = VCU_oATOM_CANFD_Matrix_CH_V600_202502_Tx_081cfe42
        ComIPduSignalGroupRef = SG_VCU_AccPedal_SigGroup_oVCU_AccPedal_oATOM_CANFD_Matrix_CH_V600_202502_aa50ac8d_Tx
        ComPduIdRef = VCU_AccPedal_oATOM_CANFD_Matrix_CH_V600_202502_0d0df7a0_Tx
        ComIPduMainFunctionRef = ComMainFunctionTx
        ComTxIPdu: ComMinimumDelayTime=0, ComTxIPduUnusedAreasDefault=0
          ComTxModeTrue
            ComTxMode: ComTxModeMode=PERIODIC, ComTxModeTimeOffset=0, ComTxModeTimePeriod=0.02
          ComTxModeFalse
            ComTxMode: ComTxModeMode=PERIODIC, ComTxModeTimeOffset=0, ComTxModeTimePeriod=0.02
      SG_ADCU_ACC_02_SigGroup_oADCU_ACC_02_oATOM_CANFD_Matrix_CH_V600_202502_1e479296_Rx (ComSignalGroup): ComTransferProperty=PENDING, ComSignalGroupAccess=ACCESS_UNCLEAR, ComHandleId=3, ComSystemTemplateSignalGroupRef=SG_ADCU_ACC_02_SigGroup
        5 x ComGroupSignal, all with ComSignalEndianness=BIG_ENDIAN, ComSignalInitValue=0, ComSignalType=UINT8, ComSignalAccess=ACCESS_UNCLEAR:
          MessageCounter_0E0_oADCU_ACC_02_oATOM_CANFD_Matrix_CH_V600_202502_982cdfbe_Rx: ComBitPosition=11, ComBitSize=4, ComHandleId=93, ComSystemTemplateSystemSignalRef=MessageCounter_0E0
          ADCU_ACC_Mode_oADCU_ACC_02_oATOM_CANFD_Matrix_CH_V600_202502_4b80afee_Rx: ComBitPosition=21, ComBitSize=3, ComHandleId=91, ComSystemTemplateSystemSignalRef=ADCU_ACC_Mode
          Checksum_0E0_oADCU_ACC_02_oATOM_CANFD_Matrix_CH_V600_202502_31389c92_Rx: ComBitPosition=7, ComBitSize=8, ComHandleId=92, ComSystemTemplateSystemSignalRef=Checksum_0E0
          ADCU_ACCDA_SYS_Failure_oADCU_ACC_02_oATOM_CANFD_Matrix_CH_V600_202502_0c0a67d0_Rx: ComBitPosition=23, ComBitSize=2, ComHandleId=90, ComSystemTemplateSystemSignalRef=ADCU_ACCDA_SYS_Failure
          ADCU_ACCDA_HandsOFF_Warning_oADCU_ACC_02_oATOM_CANFD_Matrix_CH_V600_202502_cdbbce90_Rx: ComBitPosition=18, ComBitSize=3, ComHandleId=89, ComSystemTemplateSystemSignalRef=ADCU_ACCDA_HandsOFF_Warning
      VCU_oATOM_CANFD_Matrix_CH_V600_202502_Rx_5e4659c4 (ComIPduGroup): ComIPduGroupHandleId=0
      SG_VCU_Chassis_01_SigGroup_oVCU_Chassis_01_oATOM_CANFD_Matrix_CH_V600_202502_52963860_Tx (ComSignalGroup): ComTransferProperty=PENDING, ComSignalGroupAccess=ACCESS_UNCLEAR, ComHandleId=11, ComSystemTemplateSignalGroupRef=SG_VCU_Chassis_01_SigGroup
        15 x ComGroupSignal, all with ComSignalEndianness=BIG_ENDIAN, ComSignalInitValue=0, ComTransferProperty=PENDING, ComSignalAccess=ACCESS_UNCLEAR:
          VCU_ADASOverride_oVCU_Chassis_01_oATOM_CANFD_Matrix_CH_V600_202502_0c002a43_Tx: ComBitPosition=44, ComBitSize=1, ComSignalType=BOOLEAN, ComHandleId=148, ComSystemTemplateSystemSignalRef=VCU_ADASOverride
          VCU_TorqueRequestActive_oVCU_Chassis_01_oATOM_CANFD_Matrix_CH_V600_202502_24abcc5b_Tx: ComBitPosition=12, ComBitSize=1, ComSignalType=BOOLEAN, ComHandleId=159, ComSystemTemplateSystemSignalRef=VCU_TorqueRequestActive
          VCU_RegenTorqueCapValid_oVCU_Chassis_01_oATOM_CANFD_Matrix_CH_V600_202502_5eaff4d8_Tx: ComBitPosition=15, ComBitSize=1, ComSignalType=BOOLEAN, ComHandleId=157, ComSystemTemplateSystemSignalRef=VCU_RegenTorqueCapValid
          VCU_RegStatus_oVCU_Chassis_01_oATOM_CANFD_Matrix_CH_V600_202502_6d4e3983_Tx: ComBitPosition=63, ComBitSize=3, ComSignalType=UINT8, ComHandleId=156, ComSystemTemplateSystemSignalRef=VCU_RegStatus
          VCU_DecelerationReqactive_oVCU_Chassis_01_oATOM_CANFD_Matrix_CH_V600_202502_29147867_Tx: ComBitPosition=40, ComBitSize=1, ComSignalType=BOOLEAN, ComHandleId=153, ComSystemTemplateSystemSignalRef=VCU_DecelerationReqactive
          VCU_TorqueRequestAvailable_oVCU_Chassis_01_oATOM_CANFD_Matrix_CH_V600_202502_22997d3f_Tx: ComBitPosition=13, ComBitSize=1, ComSignalType=BOOLEAN, ComHandleId=160, ComSystemTemplateSystemSignalRef=VCU_TorqueRequestAvailable
          VCU_APSTorqueRequestActive_oVCU_Chassis_01_oATOM_CANFD_Matrix_CH_V600_202502_c8f21b10_Tx: ComBitPosition=43, ComBitSize=1, ComSignalType=BOOLEAN, ComHandleId=149, ComSystemTemplateSystemSignalRef=VCU_APSTorqueRequestActive
          VCU_EnergyManagementWarn_oVCU_Chassis_01_oATOM_CANFD_Matrix_CH_V600_202502_4b7de956_Tx: ComBitPosition=58, ComBitSize=2, ComSignalType=UINT8, ComHandleId=155, ComSystemTemplateSystemSignalRef=VCU_EnergyManagementWarn
          Checksum_0D3_oVCU_Chassis_01_oATOM_CANFD_Matrix_CH_V600_202502_090e4c9b_Tx: ComBitPosition=7, ComBitSize=8, ComSignalType=UINT8, ComHandleId=146, ComSystemTemplateSystemSignalRef=Checksum_0D3
          VCU_APSTorqueRequestAvailable_oVCU_Chassis_01_oATOM_CANFD_Matrix_CH_V600_202502_8298a57a_Tx: ComBitPosition=42, ComBitSize=1, ComSignalType=BOOLEAN, ComHandleId=150, ComSystemTemplateSystemSignalRef=VCU_APSTorqueRequestAvailable
          VCU_RegenTorqueCap_oVCU_Chassis_01_oATOM_CANFD_Matrix_CH_V600_202502_a5a4bebf_Tx: ComBitPosition=23, ComBitSize=16, ComSignalType=UINT16, ComHandleId=158, ComSystemTemplateSystemSignalRef=VCU_RegenTorqueCap
          MessageCounter_0D3_oVCU_Chassis_01_oATOM_CANFD_Matrix_CH_V600_202502_f9d73b0d_Tx: ComBitPosition=11, ComBitSize=4, ComSignalType=UINT8, ComHandleId=147, ComSystemTemplateSystemSignalRef=MessageCounter_0D3
          VCU_DriverTorqueRequest_oVCU_Chassis_01_oATOM_CANFD_Matrix_CH_V600_202502_f98385dc_Tx: ComBitPosition=39, ComBitSize=11, ComSignalType=UINT16, ComHandleId=154, ComSystemTemplateSystemSignalRef=VCU_DriverTorqueRequest
          VCU_BrakeCompensateWarn_oVCU_Chassis_01_oATOM_CANFD_Matrix_CH_V600_202502_8427f667_Tx: ComBitPosition=60, ComBitSize=2, ComSignalType=UINT8, ComHandleId=151, ComSystemTemplateSystemSignalRef=VCU_BrakeCompensateWarn
          VCU_DecelerationReq_oVCU_Chassis_01_oATOM_CANFD_Matrix_CH_V600_202502_22f1bc0a_Tx: ComBitPosition=55, ComBitSize=8, ComSignalType=UINT8, ComHandleId=152, ComSystemTemplateSystemSignalRef=VCU_DecelerationReq
      IBS_ACC_oATOM_CANFD_Matrix_CH_V600_202502_ef8c28ba_Rx (ComIPdu):
        ComIPduDirection = RECEIVE
        ComIPduType = NORMAL
        ComIPduHandleId = 46
        ComIPduSignalProcessing = DEFERRED
        ComIPduCancellationSupport = false
        ComIPduGroupRef = VCU_oATOM_CANFD_Matrix_CH_V600_202502_Rx_5e4659c4
        ComIPduSignalGroupRef = SG_IBS_ACC_SigGroup_oIBS_ACC_oATOM_CANFD_Matrix_CH_V600_202502_c31bc8ab_Rx
        ComPduIdRef = IBS_ACC_oATOM_CANFD_Matrix_CH_V600_202502_ef8c28ba_Rx
        ComIPduMainFunctionRef = ComMainFunctionRx
      SG_SGW_17_SigGroup_oSGW_17_oATOM_CANFD_Matrix_CH_V600_202502_804294b2_Rx (ComSignalGroup): ComTransferProperty=PENDING, ComSignalGroupAccess=ACCESS_UNCLEAR, ComHandleId=74, ComSystemTemplateSignalGroupRef=SG_SGW_17_SigGroup
        SGW_BLESystemReadyReq_oSGW_17_oATOM_CANFD_Matrix_CH_V600_202502_359ce2fd_Rx (ComGroupSignal):
          ComBitPosition = 3
          ComBitSize = 2
          ComSignalEndianness = BIG_ENDIAN
          ComSignalInitValue = 0
          ComSignalType = UINT8
          ComSignalAccess = ACCESS_UNCLEAR
          ComHandleId = 490
          ComSystemTemplateSystemSignalRef = SGW_BLESystemReadyReq
      VCU_IBS_01_oATOM_CANFD_Matrix_CH_V600_202502_4c086bc0_Tx (ComIPdu):
        ComIPduDirection = SEND
        ComIPduType = NORMAL
        ComIPduHandleId = 23
        ComIPduSignalProcessing = DEFERRED
        ComIPduCancellationSupport = false
        ComIPduGroupRef = VCU_oATOM_CANFD_Matrix_CH_V600_202502_Tx_081cfe42
        ComIPduSignalGroupRef = SG_VCU_IBS_01_SigGroup_oVCU_IBS_01_oATOM_CANFD_Matrix_CH_V600_202502_f0f49d09_Tx
        ComPduIdRef = VCU_IBS_01_oATOM_CANFD_Matrix_CH_V600_202502_4c086bc0_Tx
        ComIPduMainFunctionRef = ComMainFunctionTx
        ComTxIPdu: ComMinimumDelayTime=0, ComTxIPduUnusedAreasDefault=0
          ComTxModeTrue
            ComTxMode: ComTxModeMode=PERIODIC, ComTxModeTimeOffset=0, ComTxModeTimePeriod=0.01
          ComTxModeFalse
            ComTxMode: ComTxModeMode=PERIODIC, ComTxModeTimeOffset=0, ComTxModeTimePeriod=0.01
      SG_IBS_ACC_SigGroup_oIBS_ACC_oATOM_CANFD_Matrix_CH_V600_202502_c31bc8ab_Rx (ComSignalGroup): ComTransferProperty=PENDING, ComSignalGroupAccess=ACCESS_UNCLEAR, ComHandleId=41, ComSystemTemplateSignalGroupRef=SG_IBS_ACC_SigGroup
        12 x ComGroupSignal, all with ComSignalEndianness=BIG_ENDIAN, ComSignalInitValue=0, ComSignalAccess=ACCESS_UNCLEAR:
          IBS_VehicleStandstill_oIBS_ACC_oATOM_CANFD_Matrix_CH_V600_202502_e5c3fb2c_Rx: ComBitPosition=44, ComBitSize=2, ComSignalType=UINT8, ComHandleId=296, ComSystemTemplateSystemSignalRef=IBS_VehicleStandstill
          IBS_CddActive_oIBS_ACC_oATOM_CANFD_Matrix_CH_V600_202502_cd634808_Rx: ComBitPosition=45, ComBitSize=1, ComSignalType=BOOLEAN, ComHandleId=292, ComSystemTemplateSystemSignalRef=IBS_CddActive
          IBS_VlcActive_oIBS_ACC_oATOM_CANFD_Matrix_CH_V600_202502_3fa05f6d_Rx: ComBitPosition=40, ComBitSize=1, ComSignalType=BOOLEAN, ComHandleId=297, ComSystemTemplateSystemSignalRef=IBS_VlcActive
          IBS_VlcError_oIBS_ACC_oATOM_CANFD_Matrix_CH_V600_202502_b4ad3ada_Rx: ComBitPosition=41, ComBitSize=1, ComSignalType=BOOLEAN, ComHandleId=299, ComSystemTemplateSystemSignalRef=IBS_VlcError
          IBS_WLTorqueVLCReqValid_oIBS_ACC_oATOM_CANFD_Matrix_CH_V600_202502_d640a38d_Rx: ComBitPosition=31, ComBitSize=2, ComSignalType=UINT8, ComHandleId=300, ComSystemTemplateSystemSignalRef=IBS_WLTorqueVLCReqValid
          IBS_VehicleStandstill_Valid_oIBS_ACC_oATOM_CANFD_Matrix_CH_V600_202502_8e482947_Rx: ComBitPosition=23, ComBitSize=1, ComSignalType=BOOLEAN, ComHandleId=295, ComSystemTemplateSystemSignalRef=IBS_VehicleStandstill_Valid
          IBS_CddError_oIBS_ACC_oATOM_CANFD_Matrix_CH_V600_202502_15ba1189_Rx: ComBitPosition=46, ComBitSize=1, ComSignalType=BOOLEAN, ComHandleId=294, ComSystemTemplateSystemSignalRef=IBS_CddError
          Checksum_0B8_oIBS_ACC_oATOM_CANFD_Matrix_CH_V600_202502_ea42d99c_Rx: ComBitPosition=7, ComBitSize=8, ComSignalType=UINT8, ComHandleId=291, ComSystemTemplateSystemSignalRef=Checksum_0B8
          IBS_VlcAvalible_oIBS_ACC_oATOM_CANFD_Matrix_CH_V600_202502_5ec40897_Rx: ComBitPosition=42, ComBitSize=1, ComSignalType=BOOLEAN, ComHandleId=298, ComSystemTemplateSystemSignalRef=IBS_VlcAvalible
          IBS_CddAvailable_oIBS_ACC_oATOM_CANFD_Matrix_CH_V600_202502_694f6a44_Rx: ComBitPosition=47, ComBitSize=1, ComSignalType=BOOLEAN, ComHandleId=293, ComSystemTemplateSystemSignalRef=IBS_CddAvailable
          MessageCounter_0B8_oIBS_ACC_oATOM_CANFD_Matrix_CH_V600_202502_20387c24_Rx: ComBitPosition=11, ComBitSize=4, ComSignalType=UINT8, ComHandleId=302, ComSystemTemplateSystemSignalRef=MessageCounter_0B8
          IBS_WLTorqueVLCReq_oIBS_ACC_oATOM_CANFD_Matrix_CH_V600_202502_e5232329_Rx: ComBitPosition=55, ComBitSize=16, ComSignalType=SINT16, ComHandleId=301, ComSystemTemplateSystemSignalRef=IBS_WLTorqueVLCReq
      IBS_WheelSpeed_01_oATOM_CANFD_Matrix_CH_V600_202502_1c45b3ee_Rx (ComIPdu):
        ComIPduDirection = RECEIVE
        ComIPduType = NORMAL
        ComIPduHandleId = 56
        ComIPduSignalProcessing = DEFERRED
        ComIPduCancellationSupport = false
        ComIPduGroupRef = VCU_oATOM_CANFD_Matrix_CH_V600_202502_Rx_5e4659c4
        ComIPduSignalGroupRef = SG_IBS_WheelSpeed_01_SigGroup_oIBS_WheelSpeed_01_oATOM_CANFD_Matrix_CH_V600_202502_5773aa13_Rx
        ComPduIdRef = IBS_WheelSpeed_01_oATOM_CANFD_Matrix_CH_V600_202502_1c45b3ee_Rx
        ComIPduMainFunctionRef = ComMainFunctionRx
      SG_ACU_02_SigGroup_oACU_02_oATOM_CANFD_Matrix_CH_V600_202502_3b90e790_Rx (ComSignalGroup): ComTransferProperty=PENDING, ComSignalGroupAccess=ACCESS_UNCLEAR, ComHandleId=1, ComSystemTemplateSignalGroupRef=SG_ACU_02_SigGroup
        6 x ComGroupSignal, all with ComSignalEndianness=BIG_ENDIAN, ComSignalAccess=ACCESS_UNCLEAR:
          ACU_LgtA_oACU_02_oATOM_CANFD_Matrix_CH_V600_202502_7ce5ad57_Rx: ComBitPosition=37, ComBitSize=14, ComSignalInitValue=4905, ComSignalType=UINT16, ComHandleId=67, ComSystemTemplateSystemSignalRef=ACU_LgtA
          MessageCounter_0F6_oACU_02_oATOM_CANFD_Matrix_CH_V600_202502_a3145c66_Rx: ComBitPosition=11, ComBitSize=4, ComSignalInitValue=0, ComSignalType=UINT8, ComHandleId=69, ComSystemTemplateSystemSignalRef=MessageCounter_0F6
          ACU_LatAStatus_oACU_02_oATOM_CANFD_Matrix_CH_V600_202502_5faf7139_Rx: ComBitPosition=23, ComBitSize=2, ComSignalInitValue=0, ComSignalType=UINT8, ComHandleId=64, ComSystemTemplateSystemSignalRef=ACU_LatAStatus
          Checksum_0F6_oACU_02_oATOM_CANFD_Matrix_CH_V600_202502_63736e97_Rx: ComBitPosition=7, ComBitSize=8, ComSignalInitValue=0, ComSignalType=UINT8, ComHandleId=68, ComSystemTemplateSystemSignalRef=Checksum_0F6
          ACU_LatA_oACU_02_oATOM_CANFD_Matrix_CH_V600_202502_0373507d_Rx: ComBitPosition=21, ComBitSize=14, ComSignalInitValue=4905, ComSignalType=UINT16, ComHandleId=65, ComSystemTemplateSystemSignalRef=ACU_LatA
          ACU_LgtAStatus_oACU_02_oATOM_CANFD_Matrix_CH_V600_202502_8eba5290_Rx: ComBitPosition=39, ComBitSize=2, ComSignalInitValue=0, ComSignalType=UINT8, ComHandleId=66, ComSystemTemplateSystemSignalRef=ACU_LgtAStatus
      SG_IBS_Torque_SigGroup_oIBS_Torque_oATOM_CANFD_Matrix_CH_V600_202502_5a2dd5ad_Rx (ComSignalGroup): ComTransferProperty=PENDING, ComSignalGroupAccess=ACCESS_UNCLEAR, ComHandleId=49, ComSystemTemplateSignalGroupRef=SG_IBS_Torque_SigGroup
        9 x ComGroupSignal, all with ComSignalEndianness=BIG_ENDIAN, ComSignalInitValue=0, ComSignalAccess=ACCESS_UNCLEAR:
          IBS_RBSStatus_oIBS_Torque_oATOM_CANFD_Matrix_CH_V600_202502_dc8e16c0_Rx: ComBitPosition=13, ComBitSize=1, ComSignalType=BOOLEAN, ComHandleId=384, ComSystemTemplateSystemSignalRef=IBS_RBSStatus
          IBS_TargetGearReq_oIBS_Torque_oATOM_CANFD_Matrix_CH_V600_202502_35085f4b_Rx: ComBitPosition=23, ComBitSize=3, ComSignalType=UINT8, ComHandleId=385, ComSystemTemplateSystemSignalRef=IBS_TargetGearReq
          IBS_WLTorqueAPSReq_oIBS_Torque_oATOM_CANFD_Matrix_CH_V600_202502_1036d2a9_Rx: ComBitPosition=55, ComBitSize=16, ComSignalType=UINT16, ComHandleId=388, ComSystemTemplateSystemSignalRef=IBS_WLTorqueAPSReq
          Checksum_0B9_oIBS_Torque_oATOM_CANFD_Matrix_CH_V600_202502_c0d26283_Rx: ComBitPosition=7, ComBitSize=8, ComSignalType=UINT8, ComHandleId=383, ComSystemTemplateSystemSignalRef=Checksum_0B9
          IBS_VCU_DecelerationReqActive_oIBS_Torque_oATOM_CANFD_Matrix_CH_V600_202502_5138c66a_Rx: ComBitPosition=12, ComBitSize=1, ComSignalType=BOOLEAN, ComHandleId=386, ComSystemTemplateSystemSignalRef=IBS_VCU_DecelerationReqActive
          IBS_WLTorqueRBSReq_oIBS_Torque_oATOM_CANFD_Matrix_CH_V600_202502_dae1e9b7_Rx: ComBitPosition=31, ComBitSize=16, ComSignalType=UINT16, ComHandleId=390, ComSystemTemplateSystemSignalRef=IBS_WLTorqueRBSReq
          IBS_WLTorqueAPSReqValid_oIBS_Torque_oATOM_CANFD_Matrix_CH_V600_202502_406d9ee6_Rx: ComBitPosition=45, ComBitSize=2, ComSignalType=UINT8, ComHandleId=387, ComSystemTemplateSystemSignalRef=IBS_WLTorqueAPSReqValid
          MessageCounter_0B9_oIBS_Torque_oATOM_CANFD_Matrix_CH_V600_202502_683f1d6f_Rx: ComBitPosition=11, ComBitSize=4, ComSignalType=UINT8, ComHandleId=391, ComSystemTemplateSystemSignalRef=MessageCounter_0B9
          IBS_WLTorqueRBSReqValid_oIBS_Torque_oATOM_CANFD_Matrix_CH_V600_202502_0144d4d4_Rx: ComBitPosition=15, ComBitSize=2, ComSignalType=UINT8, ComHandleId=389, ComSystemTemplateSystemSignalRef=IBS_WLTorqueRBSReqValid
      VCU_HMIsignals_01_oATOM_CANFD_Matrix_CH_V600_202502_f29a9fcc_Tx (ComIPdu):
        ComIPduDirection = SEND
        ComIPduType = NORMAL
        ComIPduHandleId = 19
        ComIPduSignalProcessing = DEFERRED
        ComIPduCancellationSupport = false
        ComIPduGroupRef = VCU_oATOM_CANFD_Matrix_CH_V600_202502_Tx_081cfe42
        ComIPduSignalGroupRef = SG_VCU_HMIsignals_01_SigGroup_oVCU_HMIsignals_01_oATOM_CANFD_Matrix_CH_V600_202502_c30c8d8f_Tx
        ComPduIdRef = VCU_HMIsignals_01_oATOM_CANFD_Matrix_CH_V600_202502_f29a9fcc_Tx
        ComIPduMainFunctionRef = ComMainFunctionTx
        ComTxIPdu: ComMinimumDelayTime=0, ComTxIPduUnusedAreasDefault=0
          ComTxModeTrue
            ComTxMode: ComTxModeMode=PERIODIC, ComTxModeTimeOffset=0, ComTxModeTimePeriod=0.2
          ComTxModeFalse
            ComTxMode: ComTxModeMode=PERIODIC, ComTxModeTimeOffset=0, ComTxModeTimePeriod=0.2
      ADCU_DA_oATOM_CANFD_Matrix_CH_V600_202502_c19ff818_Rx (ComIPdu):
        ComIPduDirection = RECEIVE
        ComIPduType = NORMAL
        ComIPduHandleId = 7
        ComIPduSignalProcessing = DEFERRED
        ComIPduCancellationSupport = false
        ComIPduGroupRef = VCU_oATOM_CANFD_Matrix_CH_V600_202502_Rx_5e4659c4
        ComIPduSignalGroupRef = SG_ADCU_DA_SigGroup_oADCU_DA_oATOM_CANFD_Matrix_CH_V600_202502_4133b6dd_Rx
        ComPduIdRef = ADCU_DA_oATOM_CANFD_Matrix_CH_V600_202502_c19ff818_Rx
        ComIPduMainFunctionRef = ComMainFunctionRx
      SG_IBS_Status_03_SigGroup_oIBS_Status_03_oATOM_CANFD_Matrix_CH_V600_202502_2b221089_Rx (ComSignalGroup): ComTransferProperty=PENDING, ComSignalGroupAccess=ACCESS_UNCLEAR, ComHandleId=45, ComSystemTemplateSignalGroupRef=SG_IBS_Status_03_SigGroup
        16 x ComGroupSignal, all with ComSignalEndianness=BIG_ENDIAN, ComSignalInitValue=0, ComSignalAccess=ACCESS_UNCLEAR:
          IBS_EBDFault_oIBS_Status_03_oATOM_CANFD_Matrix_CH_V600_202502_dad1ab7b_Rx: ComBitPosition=36, ComBitSize=1, ComSignalType=BOOLEAN, ComHandleId=344, ComSystemTemplateSystemSignalRef=IBS_EBDFault
          IBS_EPBTextdisplay_oIBS_Status_03_oATOM_CANFD_Matrix_CH_V600_202502_e8354645_Rx: ComBitPosition=15, ComBitSize=3, ComSignalType=UINT8, ComHandleId=345, ComSystemTemplateSystemSignalRef=IBS_EPBTextdisplay
          IBS_VehicleSpeedValid_oIBS_Status_03_oATOM_CANFD_Matrix_CH_V600_202502_317a0a26_Rx: ComBitPosition=39, ComBitSize=1, ComSignalType=BOOLEAN, ComHandleId=350, ComSystemTemplateSystemSignalRef=IBS_VehicleSpeedValid
          IBS_ABSActive_oIBS_Status_03_oATOM_CANFD_Matrix_CH_V600_202502_bc82dc5c_Rx: ComBitPosition=33, ComBitSize=1, ComSignalType=BOOLEAN, ComHandleId=340, ComSystemTemplateSystemSignalRef=IBS_ABSActive
          IBS_VDCFault_oIBS_Status_03_oATOM_CANFD_Matrix_CH_V600_202502_01868c54_Rx: ComBitPosition=35, ComBitSize=1, ComSignalType=BOOLEAN, ComHandleId=349, ComSystemTemplateSystemSignalRef=IBS_VDCFault
          IBS_SystemStatus_oIBS_Status_03_oATOM_CANFD_Matrix_CH_V600_202502_306130d0_Rx: ComBitPosition=26, ComBitSize=3, ComSignalType=UINT8, ComHandleId=346, ComSystemTemplateSystemSignalRef=IBS_SystemStatus
          MessageCounter_0B4_oIBS_Status_03_oATOM_CANFD_Matrix_CH_V600_202502_91c1ff04_Rx: ComBitPosition=11, ComBitSize=4, ComSignalType=UINT8, ComHandleId=352, ComSystemTemplateSystemSignalRef=MessageCounter_0B4
          IBS_ABPActive_oIBS_Status_03_oATOM_CANFD_Matrix_CH_V600_202502_9a3de825_Rx: ComBitPosition=32, ComBitSize=1, ComSignalType=BOOLEAN, ComHandleId=338, ComSystemTemplateSystemSignalRef=IBS_ABPActive
          IBS_VehicleSpeed_oIBS_Status_03_oATOM_CANFD_Matrix_CH_V600_202502_5ce10c83_Rx: ComBitPosition=23, ComBitSize=13, ComSignalType=UINT16, ComHandleId=351, ComSystemTemplateSystemSignalRef=IBS_VehicleSpeed
          IBS_ABSFault_oIBS_Status_03_oATOM_CANFD_Matrix_CH_V600_202502_1bd8c058_Rx: ComBitPosition=38, ComBitSize=1, ComSignalType=BOOLEAN, ComHandleId=341, ComSystemTemplateSystemSignalRef=IBS_ABSFault
          Checksum_0B4_oIBS_Status_03_oATOM_CANFD_Matrix_CH_V600_202502_47252d94_Rx: ComBitPosition=7, ComBitSize=8, ComSignalType=UINT8, ComHandleId=337, ComSystemTemplateSystemSignalRef=Checksum_0B4
          IBS_EBDActive_oIBS_Status_03_oATOM_CANFD_Matrix_CH_V600_202502_1e24a445_Rx: ComBitPosition=37, ComBitSize=1, ComSignalType=BOOLEAN, ComHandleId=343, ComSystemTemplateSystemSignalRef=IBS_EBDActive
          IBS_VCU_DecelerationRequest_Available_oIBS_Status_03_oATOM_CANFD_Matrix_CH_V600_202502_227d55b1_Rx: ComBitPosition=45, ComBitSize=4, ComSignalType=UINT8, ComHandleId=348, ComSystemTemplateSystemSignalRef=IBS_VCU_DecelerationRequest_Available
          IBS_DTCFault_oIBS_Status_03_oATOM_CANFD_Matrix_CH_V600_202502_632f33ac_Rx: ComBitPosition=46, ComBitSize=1, ComSignalType=BOOLEAN, ComHandleId=342, ComSystemTemplateSystemSignalRef=IBS_DTCFault
          IBS_ABPAvailable_oIBS_Status_03_oATOM_CANFD_Matrix_CH_V600_202502_7eb6cd8c_Rx: ComBitPosition=47, ComBitSize=1, ComSignalType=BOOLEAN, ComHandleId=339, ComSystemTemplateSystemSignalRef=IBS_ABPAvailable
          IBS_TCSFault_oIBS_Status_03_oATOM_CANFD_Matrix_CH_V600_202502_2d90687a_Rx: ComBitPosition=34, ComBitSize=1, ComSignalType=BOOLEAN, ComHandleId=347, ComSystemTemplateSystemSignalRef=IBS_TCSFault
      3 x ComIPdu, all with ComIPduDirection=SEND, ComIPduType=NORMAL, ComIPduSignalProcessing=DEFERRED, ComIPduCancellationSupport=false, ComIPduGroupRef=VCU_oATOM_CANFD_Matrix_CH_V600_202502_Tx_081cfe42, ComIPduMainFunctionRef=ComMainFunctionTx:
        VCU_04_oATOM_CANFD_Matrix_CH_V600_202502_db6dbd42_Tx: ComIPduHandleId=7, ComIPduSignalGroupRef=SG_VCU_04_SigGroup_oVCU_04_oATOM_CANFD_Matrix_CH_V600_202502_4cce7c18_Tx, ComPduIdRef=VCU_04_oATOM_CANFD_Matrix_CH_V600_202502_db6dbd42_Tx
          ComTxIPdu: ComMinimumDelayTime=0, ComTxIPduUnusedAreasDefault=0
            ComTxModeTrue
              ComTxMode: ComTxModeMode=PERIODIC, ComTxModeTimeOffset=0, ComTxModeTimePeriod=0.1
            ComTxModeFalse
              ComTxMode: ComTxModeMode=PERIODIC, ComTxModeTimeOffset=0, ComTxModeTimePeriod=0.1
        VCU_02_oATOM_CANFD_Matrix_CH_V600_202502_17bac731_Tx: ComIPduHandleId=4, ComIPduSignalGroupRef=SG_VCU_02_SigGroup_oVCU_02_oATOM_CANFD_Matrix_CH_V600_202502_2fc20804_Tx, ComPduIdRef=VCU_02_oATOM_CANFD_Matrix_CH_V600_202502_17bac731_Tx
          ComTxIPdu: ComMinimumDelayTime=0, ComTxIPduUnusedAreasDefault=0
            ComTxModeTrue
              ComTxMode: ComTxModeMode=PERIODIC, ComTxModeTimeOffset=0, ComTxModeTimePeriod=0.2
            ComTxModeFalse
              ComTxMode: ComTxModeMode=PERIODIC, ComTxModeTimeOffset=0, ComTxModeTimePeriod=0.2
        VCU_HMIsignals_02_oATOM_CANFD_Matrix_CH_V600_202502_7949a1d5_Tx: ComIPduHandleId=20, ComIPduSignalGroupRef=SG_VCU_HMIsignals_02_SigGroup_oVCU_HMIsignals_02_oATOM_CANFD_Matrix_CH_V600_202502_b90a0cf2_Tx, ComPduIdRef=VCU_HMIsignals_02_oATOM_CANFD_Matrix_CH_V600_202502_7949a1d5_Tx
          ComTxIPdu: ComMinimumDelayTime=0, ComTxIPduUnusedAreasDefault=0
            ComTxModeTrue
              ComTxMode: ComTxModeMode=PERIODIC, ComTxModeTimeOffset=0, ComTxModeTimePeriod=0.2
            ComTxModeFalse
              ComTxMode: ComTxModeMode=PERIODIC, ComTxModeTimeOffset=0, ComTxModeTimePeriod=0.2
      SG_VCU_BMS_SigGroup_oVCU_BMS_oATOM_CANFD_Matrix_CH_V600_202502_d27feb30_Tx (ComSignalGroup): ComTransferProperty=PENDING, ComSignalGroupAccess=ACCESS_UNCLEAR, ComHandleId=9, ComSystemTemplateSignalGroupRef=SG_VCU_BMS_SigGroup
        13 x ComGroupSignal, all with ComSignalEndianness=BIG_ENDIAN, ComTransferProperty=PENDING, ComSignalAccess=ACCESS_UNCLEAR:
          VCU_BMSTargetThermLevel_oVCU_BMS_oATOM_CANFD_Matrix_CH_V600_202502_9ec34af1_Tx: ComBitPosition=55, ComBitSize=2, ComSignalInitValue=0, ComSignalType=UINT8, ComHandleId=123, ComSystemTemplateSystemSignalRef=VCU_BMSTargetThermLevel
          VCU_IsoMeasurementSwitch_oVCU_BMS_oATOM_CANFD_Matrix_CH_V600_202502_d7a76412_Tx: ComBitPosition=14, ComBitSize=1, ComSignalInitValue=1, ComSignalType=BOOLEAN, ComHandleId=128, ComSystemTemplateSystemSignalRef=VCU_IsoMeasurementSwitch
          VCU_HVStatus_oVCU_BMS_oATOM_CANFD_Matrix_CH_V600_202502_aebb67ba_Tx: ComBitPosition=31, ComBitSize=4, ComSignalInitValue=0, ComSignalType=UINT8, ComHandleId=127, ComSystemTemplateSystemSignalRef=VCU_HVStatus
          Checksum_0D1_oVCU_BMS_oATOM_CANFD_Matrix_CH_V600_202502_c848143c_Tx: ComBitPosition=7, ComBitSize=8, ComSignalInitValue=0, ComSignalType=UINT8, ComHandleId=120, ComSystemTemplateSystemSignalRef=Checksum_0D1
          VCU_ChargeStatus_oVCU_BMS_oATOM_CANFD_Matrix_CH_V600_202502_17f7901d_Tx: ComBitPosition=27, ComBitSize=4, ComSignalInitValue=0, ComSignalType=UINT8, ComHandleId=125, ComSystemTemplateSystemSignalRef=VCU_ChargeStatus
          VCU_RequestedModeBMS_oVCU_BMS_oATOM_CANFD_Matrix_CH_V600_202502_a3197c92_Tx: ComBitPosition=23, ComBitSize=3, ComSignalInitValue=0, ComSignalType=UINT8, ComHandleId=132, ComSystemTemplateSystemSignalRef=VCU_RequestedModeBMS
          VCU_BMS_Control_of_PosRelay_oVCU_BMS_oATOM_CANFD_Matrix_CH_V600_202502_cab9d256_Tx: ComBitPosition=53, ComBitSize=2, ComSignalInitValue=0, ComSignalType=UINT8, ComHandleId=124, ComSystemTemplateSystemSignalRef=VCU_BMS_Control_of_PosRelay
          VCU_RegenBrakeLightRequest_oVCU_BMS_oATOM_CANFD_Matrix_CH_V600_202502_9537c5ed_Tx: ComBitPosition=40, ComBitSize=1, ComSignalInitValue=0, ComSignalType=BOOLEAN, ComHandleId=131, ComSystemTemplateSystemSignalRef=VCU_RegenBrakeLightRequest
          VCU_ActDriveMode_oVCU_BMS_oATOM_CANFD_Matrix_CH_V600_202502_c1c6ace2_Tx: ComBitPosition=37, ComBitSize=3, ComSignalInitValue=0, ComSignalType=UINT8, ComHandleId=122, ComSystemTemplateSystemSignalRef=VCU_ActDriveMode
          VCU_LimitLevel_oVCU_BMS_oATOM_CANFD_Matrix_CH_V600_202502_944086eb_Tx: ComBitPosition=39, ComBitSize=2, ComSignalInitValue=0, ComSignalType=UINT8, ComHandleId=129, ComSystemTemplateSystemSignalRef=VCU_LimitLevel
          VCU_RegenBrakeLightReqVld_oVCU_BMS_oATOM_CANFD_Matrix_CH_V600_202502_b28083e9_Tx: ComBitPosition=41, ComBitSize=1, ComSignalInitValue=0, ComSignalType=BOOLEAN, ComHandleId=130, ComSystemTemplateSystemSignalRef=VCU_RegenBrakeLightReqVld
          MessageCounter_0D1_oVCU_BMS_oATOM_CANFD_Matrix_CH_V600_202502_0232b184_Tx: ComBitPosition=11, ComBitSize=4, ComSignalInitValue=0, ComSignalType=UINT8, ComHandleId=121, ComSystemTemplateSystemSignalRef=MessageCounter_0D1
          VCU_DrvModSwitchWarn_oVCU_BMS_oATOM_CANFD_Matrix_CH_V600_202502_8a817be7_Tx: ComBitPosition=34, ComBitSize=3, ComSignalInitValue=0, ComSignalType=UINT8, ComHandleId=126, ComSystemTemplateSystemSignalRef=VCU_DrvModSwitchWarn
      SG_VCU_03_SigGroup_oVCU_03_oATOM_CANFD_Matrix_CH_V600_202502_8990e3c1_Tx (ComSignalGroup): ComTransferProperty=PENDING, ComSignalGroupAccess=ACCESS_UNCLEAR, ComHandleId=3, ComSystemTemplateSignalGroupRef=SG_VCU_03_SigGroup
        5 x ComGroupSignal, all with ComSignalEndianness=BIG_ENDIAN, ComSignalInitValue=0, ComTransferProperty=PENDING, ComSignalAccess=ACCESS_UNCLEAR:
          VCU_ChargeProcessComment_oVCU_03_oATOM_CANFD_Matrix_CH_V600_202502_b076f405_Tx: ComBitPosition=25, ComBitSize=2, ComSignalType=UINT8, ComHandleId=78, ComSystemTemplateSystemSignalRef=VCU_ChargeProcessComment
          VCU_DCFCCurrent_oVCU_03_oATOM_CANFD_Matrix_CH_V600_202502_54508868_Tx: ComBitPosition=23, ComBitSize=10, ComSignalType=UINT16, ComHandleId=79, ComSystemTemplateSystemSignalRef=VCU_DCFCCurrent
          VCU_BrakeCompensateStatus_oVCU_03_oATOM_CANFD_Matrix_CH_V600_202502_aada4313_Tx: ComBitPosition=27, ComBitSize=2, ComSignalType=UINT8, ComHandleId=77, ComSystemTemplateSystemSignalRef=VCU_BrakeCompensateStatus
          VCU_MemoryChargeFault_oVCU_03_oATOM_CANFD_Matrix_CH_V600_202502_cb765ea4_Tx: ComBitPosition=59, ComBitSize=1, ComSignalType=BOOLEAN, ComHandleId=81, ComSystemTemplateSystemSignalRef=VCU_MemoryChargeFault
          VCU_EnergyV2L_oVCU_03_oATOM_CANFD_Matrix_CH_V600_202502_5ef6f2f0_Tx: ComBitPosition=55, ComBitSize=12, ComSignalType=UINT16, ComHandleId=80, ComSystemTemplateSystemSignalRef=VCU_EnergyV2L
      ACU_02_oATOM_CANFD_Matrix_CH_V600_202502_19603798_Rx (ComIPdu):
        ComIPduDirection = RECEIVE
        ComIPduType = NORMAL
        ComIPduHandleId = 1
        ComIPduSignalProcessing = DEFERRED
        ComIPduCancellationSupport = false
        ComIPduGroupRef = VCU_oATOM_CANFD_Matrix_CH_V600_202502_Rx_5e4659c4
        ComIPduSignalGroupRef = SG_ACU_02_SigGroup_oACU_02_oATOM_CANFD_Matrix_CH_V600_202502_3b90e790_Rx
        ComPduIdRef = ACU_02_oATOM_CANFD_Matrix_CH_V600_202502_19603798_Rx
        ComIPduMainFunctionRef = ComMainFunctionRx
      IBS_Status_03_oATOM_CANFD_Matrix_CH_V600_202502_f4245e85_Rx (ComIPdu):
        ComIPduDirection = RECEIVE
        ComIPduType = NORMAL
        ComIPduHandleId = 50
        ComIPduSignalProcessing = DEFERRED
        ComIPduCancellationSupport = false
        ComIPduGroupRef = VCU_oATOM_CANFD_Matrix_CH_V600_202502_Rx_5e4659c4
        ComIPduSignalGroupRef = SG_IBS_Status_03_SigGroup_oIBS_Status_03_oATOM_CANFD_Matrix_CH_V600_202502_2b221089_Rx
        ComPduIdRef = IBS_Status_03_oATOM_CANFD_Matrix_CH_V600_202502_f4245e85_Rx
        ComIPduMainFunctionRef = ComMainFunctionRx
      SG_ADCU_APS_01_SigGroup_oADCU_APS_01_oATOM_CANFD_Matrix_CH_V600_202502_c590572d_Rx (ComSignalGroup): ComTransferProperty=PENDING, ComSignalGroupAccess=ACCESS_UNCLEAR, ComHandleId=5, ComSystemTemplateSignalGroupRef=SG_ADCU_APS_01_SigGroup
        12 x ComGroupSignal, all with ComSignalEndianness=BIG_ENDIAN, ComSignalInitValue=0, ComSignalAccess=ACCESS_UNCLEAR:
          ADCU_APS_Stop_Req_oADCU_APS_01_oATOM_CANFD_Matrix_CH_V600_202502_cd03c7ef_Rx: ComBitPosition=33, ComBitSize=2, ComSignalType=UINT8, ComHandleId=111, ComSystemTemplateSystemSignalRef=ADCU_APS_Stop_Req
          ADCU_Parking_Mode_oADCU_APS_01_oATOM_CANFD_Matrix_CH_V600_202502_c6e9f3f9_Rx: ComBitPosition=55, ComBitSize=4, ComSignalType=UINT8, ComHandleId=113, ComSystemTemplateSystemSignalRef=ADCU_Parking_Mode
          ADCU_APSCrlModeReq_oADCU_APS_01_oATOM_CANFD_Matrix_CH_V600_202502_589f1c09_Rx: ComBitPosition=15, ComBitSize=2, ComSignalType=UINT8, ComHandleId=106, ComSystemTemplateSystemSignalRef=ADCU_APSCrlModeReq
          ADCU_APSCrlReq_oADCU_APS_01_oATOM_CANFD_Matrix_CH_V600_202502_da787726_Rx: ComBitPosition=23, ComBitSize=2, ComSignalType=UINT8, ComHandleId=107, ComSystemTemplateSystemSignalRef=ADCU_APSCrlReq
          MessageCounter_0E4_oADCU_APS_01_oATOM_CANFD_Matrix_CH_V600_202502_b0a71257_Rx: ComBitPosition=11, ComBitSize=4, ComSignalType=UINT8, ComHandleId=116, ComSystemTemplateSystemSignalRef=MessageCounter_0E4
          Checksum_0E4_oADCU_APS_01_oATOM_CANFD_Matrix_CH_V600_202502_19b3517b_Rx: ComBitPosition=7, ComBitSize=8, ComSignalType=UINT8, ComHandleId=115, ComSystemTemplateSystemSignalRef=Checksum_0E4
          ADCU_APSComfBrkReq_oADCU_APS_01_oATOM_CANFD_Matrix_CH_V600_202502_b25663d8_Rx: ComBitPosition=42, ComBitSize=2, ComSignalType=UINT8, ComHandleId=105, ComSystemTemplateSystemSignalRef=ADCU_APSComfBrkReq
          ADCU_APSCrlTypReq_oADCU_APS_01_oATOM_CANFD_Matrix_CH_V600_202502_25dd00be_Rx: ComBitPosition=13, ComBitSize=2, ComSignalType=UINT8, ComHandleId=108, ComSystemTemplateSystemSignalRef=ADCU_APSCrlTypReq
          ADCU_TargetGear_oADCU_APS_01_oATOM_CANFD_Matrix_CH_V600_202502_dbe43087_Rx: ComBitPosition=39, ComBitSize=3, ComSignalType=UINT8, ComHandleId=114, ComSystemTemplateSystemSignalRef=ADCU_TargetGear
          ADCU_APSDistanceStop_oADCU_APS_01_oATOM_CANFD_Matrix_CH_V600_202502_5af9bfc0_Rx: ComBitPosition=19, ComBitSize=12, ComSignalType=UINT16, ComHandleId=109, ComSystemTemplateSystemSignalRef=ADCU_APSDistanceStop
          ADCU_APSMaxSpeedReq_oADCU_APS_01_oATOM_CANFD_Matrix_CH_V600_202502_afdb21bd_Rx: ComBitPosition=47, ComBitSize=5, ComSignalType=UINT8, ComHandleId=110, ComSystemTemplateSystemSignalRef=ADCU_APSMaxSpeedReq
          ADCU_Parking_CtrlSts_oADCU_APS_01_oATOM_CANFD_Matrix_CH_V600_202502_c95774a6_Rx: ComBitPosition=35, ComBitSize=2, ComSignalType=UINT8, ComHandleId=112, ComSystemTemplateSystemSignalRef=ADCU_Parking_CtrlSts
      ADCU_ACC_02_oATOM_CANFD_Matrix_CH_V600_202502_09e0da82_Rx (ComIPdu):
        ComIPduDirection = RECEIVE
        ComIPduType = NORMAL
        ComIPduHandleId = 3
        ComIPduSignalProcessing = DEFERRED
        ComIPduCancellationSupport = false
        ComIPduGroupRef = VCU_oATOM_CANFD_Matrix_CH_V600_202502_Rx_5e4659c4
        ComIPduSignalGroupRef = SG_ADCU_ACC_02_SigGroup_oADCU_ACC_02_oATOM_CANFD_Matrix_CH_V600_202502_1e479296_Rx
        ComPduIdRef = ADCU_ACC_02_oATOM_CANFD_Matrix_CH_V600_202502_09e0da82_Rx
        ComIPduMainFunctionRef = ComMainFunctionRx
      SG_VCU_PlugInChrgInfo_SigGroup_oVCU_PlugInChrgInfo_oATOM_CANFD_Matrix_CH_V600_202502_c285d340_Tx (ComSignalGroup): ComTransferProperty=PENDING, ComSignalGroupAccess=ACCESS_UNCLEAR, ComHandleId=24, ComSystemTemplateSignalGroupRef=SG_VCU_PlugInChrgInfo_SigGroup
        4 x ComGroupSignal, all with ComSignalEndianness=BIG_ENDIAN, ComSignalInitValue=0, ComTransferProperty=PENDING, ComSignalAccess=ACCESS_UNCLEAR:
          VCU_ChargeEndReason_oVCU_PlugInChrgInfo_oATOM_CANFD_Matrix_CH_V600_202502_86604033_Tx: ComBitPosition=36, ComBitSize=2, ComSignalType=UINT8, ComHandleId=242, ComSystemTemplateSystemSignalRef=VCU_ChargeEndReason
          VCU_HVConnectFault_oVCU_PlugInChrgInfo_oATOM_CANFD_Matrix_CH_V600_202502_ad3614da_Tx: ComBitPosition=37, ComBitSize=1, ComSignalType=BOOLEAN, ComHandleId=244, ComSystemTemplateSystemSignalRef=VCU_HVConnectFault
          VCU_DischargeEndReason_oVCU_PlugInChrgInfo_oATOM_CANFD_Matrix_CH_V600_202502_a9c41ef6_Tx: ComBitPosition=34, ComBitSize=2, ComSignalType=UINT8, ComHandleId=243, ComSystemTemplateSystemSignalRef=VCU_DischargeEndReason
          VCU_RemainChrgTime_oVCU_PlugInChrgInfo_oATOM_CANFD_Matrix_CH_V600_202502_deed3006_Tx: ComBitPosition=7, ComBitSize=12, ComSignalType=UINT16, ComHandleId=245, ComSystemTemplateSystemSignalRef=VCU_RemainChrgTime
      4 x ComIPdu, all with ComIPduType=NORMAL, ComIPduSignalProcessing=DEFERRED, ComIPduCancellationSupport=false:
        IBS_VCU_MotorControl_oATOM_CANFD_Matrix_CH_V600_202502_d229d0d9_Rx: ComIPduDirection=RECEIVE, ComIPduHandleId=55, ComIPduGroupRef=VCU_oATOM_CANFD_Matrix_CH_V600_202502_Rx_5e4659c4, ComIPduSignalGroupRef=SG_IBS_VCU_MotorControl_SigGroup_oIBS_VCU_MotorControl_oATOM_CANFD_Matrix_CH_V600_202502_9a811a5b_Rx, ComPduIdRef=IBS_VCU_MotorControl_oATOM_CANFD_Matrix_CH_V600_202502_d229d0d9_Rx, ComIPduMainFunctionRef=ComMainFunctionRx
        IBS_Status_01_oATOM_CANFD_Matrix_CH_V600_202502_b0697754_Rx: ComIPduDirection=RECEIVE, ComIPduHandleId=48, ComIPduGroupRef=VCU_oATOM_CANFD_Matrix_CH_V600_202502_Rx_5e4659c4, ComIPduSignalGroupRef=SG_IBS_Status_01_SigGroup_oIBS_Status_01_oATOM_CANFD_Matrix_CH_V600_202502_bdf732ba_Rx, ComPduIdRef=IBS_Status_01_oATOM_CANFD_Matrix_CH_V600_202502_b0697754_Rx, ComIPduMainFunctionRef=ComMainFunctionRx
        VCU_MCU_03_oATOM_CANFD_Matrix_CH_V600_202502_0d9d0aa9_Tx: ComIPduDirection=SEND, ComIPduHandleId=25, ComIPduGroupRef=VCU_oATOM_CANFD_Matrix_CH_V600_202502_Tx_081cfe42, ComIPduSignalGroupRef=SG_VCU_MCU_03_SigGroup_oVCU_MCU_03_oATOM_CANFD_Matrix_CH_V600_202502_c0057d9b_Tx, ComPduIdRef=VCU_MCU_03_oATOM_CANFD_Matrix_CH_V600_202502_0d9d0aa9_Tx, ComIPduMainFunctionRef=ComMainFunctionTx
          ComTxIPdu: ComMinimumDelayTime=0, ComTxIPduUnusedAreasDefault=0
            ComTxModeTrue
              ComTxMode: ComTxModeMode=PERIODIC, ComTxModeTimeOffset=0, ComTxModeTimePeriod=0.01
            ComTxModeFalse
              ComTxMode: ComTxModeMode=PERIODIC, ComTxModeTimeOffset=0, ComTxModeTimePeriod=0.01
        ACU_01_oATOM_CANFD_Matrix_CH_V600_202502_92b30981_Rx: ComIPduDirection=RECEIVE, ComIPduHandleId=0, ComIPduGroupRef=VCU_oATOM_CANFD_Matrix_CH_V600_202502_Rx_5e4659c4, ComIPduSignalGroupRef=SG_ACU_01_SigGroup_oACU_01_oATOM_CANFD_Matrix_CH_V600_202502_0a16dd9e_Rx, ComPduIdRef=ACU_01_oATOM_CANFD_Matrix_CH_V600_202502_92b30981_Rx, ComIPduMainFunctionRef=ComMainFunctionRx
      SG_ADCU_DA_SigGroup_oADCU_DA_oATOM_CANFD_Matrix_CH_V600_202502_4133b6dd_Rx (ComSignalGroup): ComTransferProperty=PENDING, ComSignalGroupAccess=ACCESS_UNCLEAR, ComHandleId=7, ComSystemTemplateSignalGroupRef=SG_ADCU_DA_SigGroup
        3 x ComGroupSignal, all with ComSignalEndianness=BIG_ENDIAN, ComSignalInitValue=0, ComSignalType=UINT8, ComSignalAccess=ACCESS_UNCLEAR:
          Checksum_0E6_oADCU_DA_oATOM_CANFD_Matrix_CH_V600_202502_6e918845_Rx: ComBitPosition=7, ComBitSize=8, ComHandleId=119, ComSystemTemplateSystemSignalRef=Checksum_0E6
          ADCU_DA_Mode_oADCU_DA_oATOM_CANFD_Matrix_CH_V600_202502_98abcb34_Rx: ComBitPosition=23, ComBitSize=3, ComHandleId=118, ComSystemTemplateSystemSignalRef=ADCU_DA_Mode
          MessageCounter_0E6_oADCU_DA_oATOM_CANFD_Matrix_CH_V600_202502_a4eb2dfd_Rx: ComBitPosition=11, ComBitSize=4, ComHandleId=120, ComSystemTemplateSystemSignalRef=MessageCounter_0E6
      ADCU_APS_01_oATOM_CANFD_Matrix_CH_V600_202502_d7aca41b_Rx (ComIPdu):
        ComIPduDirection = RECEIVE
        ComIPduType = NORMAL
        ComIPduHandleId = 5
        ComIPduSignalProcessing = DEFERRED
        ComIPduCancellationSupport = false
        ComIPduGroupRef = VCU_oATOM_CANFD_Matrix_CH_V600_202502_Rx_5e4659c4
        ComIPduSignalGroupRef = SG_ADCU_APS_01_SigGroup_oADCU_APS_01_oATOM_CANFD_Matrix_CH_V600_202502_c590572d_Rx
        ComPduIdRef = ADCU_APS_01_oATOM_CANFD_Matrix_CH_V600_202502_d7aca41b_Rx
        ComIPduMainFunctionRef = ComMainFunctionRx
      ACU_info_oATOM_CANFD_Matrix_CH_V600_202502_c3757d77_Rx (ComIPdu):
        ComIPduDirection = RECEIVE
        ComIPduType = NORMAL
        ComIPduHandleId = 2
        ComIPduSignalProcessing = DEFERRED
        ComIPduCancellationSupport = false
        ComIPduGroupRef = VCU_oATOM_CANFD_Matrix_CH_V600_202502_Rx_5e4659c4
        ComIPduSignalGroupRef = SG_ACU_info_SigGroup_oACU_info_oATOM_CANFD_Matrix_CH_V600_202502_5b63ef23_Rx
        ComPduIdRef = ACU_info_oATOM_CANFD_Matrix_CH_V600_202502_c3757d77_Rx
        ComIPduMainFunctionRef = ComMainFunctionRx
      VCU_oATOM_CANFD_Matrix_CH_V600_202502_Tx_081cfe42 (ComIPduGroup): ComIPduGroupHandleId=1
      4 x ComIPdu, all with ComIPduType=NORMAL, ComIPduSignalProcessing=DEFERRED, ComIPduCancellationSupport=false:
        ADCU_APS_02_oATOM_CANFD_Matrix_CH_V600_202502_5c7f9a02_Rx: ComIPduDirection=RECEIVE, ComIPduHandleId=6, ComIPduGroupRef=VCU_oATOM_CANFD_Matrix_CH_V600_202502_Rx_5e4659c4, ComIPduSignalGroupRef=SG_ADCU_APS_02_SigGroup_oADCU_APS_02_oATOM_CANFD_Matrix_CH_V600_202502_67bc1f98_Rx, ComPduIdRef=ADCU_APS_02_oATOM_CANFD_Matrix_CH_V600_202502_5c7f9a02_Rx, ComIPduMainFunctionRef=ComMainFunctionRx
        IBS_WheelSpeed_02_oATOM_CANFD_Matrix_CH_V600_202502_97968df7_Rx: ComIPduDirection=RECEIVE, ComIPduHandleId=57, ComIPduGroupRef=VCU_oATOM_CANFD_Matrix_CH_V600_202502_Rx_5e4659c4, ComIPduSignalGroupRef=SG_IBS_WheelSpeed_02_SigGroup_oIBS_WheelSpeed_02_oATOM_CANFD_Matrix_CH_V600_202502_2d752b6e_Rx, ComPduIdRef=IBS_WheelSpeed_02_oATOM_CANFD_Matrix_CH_V600_202502_97968df7_Rx, ComIPduMainFunctionRef=ComMainFunctionRx
        VCU_PlugInChrgInfo_oATOM_CANFD_Matrix_CH_V600_202502_20405e82_Tx: ComIPduDirection=SEND, ComIPduHandleId=29, ComIPduGroupRef=VCU_oATOM_CANFD_Matrix_CH_V600_202502_Tx_081cfe42, ComIPduSignalGroupRef=SG_VCU_PlugInChrgInfo_SigGroup_oVCU_PlugInChrgInfo_oATOM_CANFD_Matrix_CH_V600_202502_c285d340_Tx, ComPduIdRef=VCU_PlugInChrgInfo_oATOM_CANFD_Matrix_CH_V600_202502_20405e82_Tx, ComIPduMainFunctionRef=ComMainFunctionTx
          ComTxIPdu: ComMinimumDelayTime=0, ComTxIPduUnusedAreasDefault=0
            ComTxModeTrue
              ComTxMode: ComTxModeMode=PERIODIC, ComTxModeTimeOffset=0, ComTxModeTimePeriod=0.2
            ComTxModeFalse
              ComTxMode: ComTxModeMode=PERIODIC, ComTxModeTimeOffset=0, ComTxModeTimePeriod=0.2
        VCU_BMS_oATOM_CANFD_Matrix_CH_V600_202502_1208e503_Tx: ComIPduDirection=SEND, ComIPduHandleId=12, ComIPduGroupRef=VCU_oATOM_CANFD_Matrix_CH_V600_202502_Tx_081cfe42, ComIPduSignalGroupRef=SG_VCU_BMS_SigGroup_oVCU_BMS_oATOM_CANFD_Matrix_CH_V600_202502_d27feb30_Tx, ComPduIdRef=VCU_BMS_oATOM_CANFD_Matrix_CH_V600_202502_1208e503_Tx, ComIPduMainFunctionRef=ComMainFunctionTx
          ComTxIPdu: ComMinimumDelayTime=0, ComTxIPduUnusedAreasDefault=0
            ComTxModeTrue
              ComTxMode: ComTxModeMode=PERIODIC, ComTxModeTimeOffset=0, ComTxModeTimePeriod=0.02
            ComTxModeFalse
              ComTxMode: ComTxModeMode=PERIODIC, ComTxModeTimeOffset=0, ComTxModeTimePeriod=0.02
      SG_IBS_APS_SigGroup_oIBS_APS_oATOM_CANFD_Matrix_CH_V600_202502_91bbe9ec_Rx (ComSignalGroup): ComTransferProperty=PENDING, ComSignalGroupAccess=ACCESS_UNCLEAR, ComHandleId=42, ComSystemTemplateSignalGroupRef=SG_IBS_APS_SigGroup
        9 x ComGroupSignal, all with ComSignalEndianness=BIG_ENDIAN, ComSignalInitValue=0, ComSignalType=UINT8, ComSignalAccess=ACCESS_UNCLEAR:
          IBS_APSCrlReqEcho_oIBS_APS_oATOM_CANFD_Matrix_CH_V600_202502_7e0dcab4_Rx: ComBitPosition=19, ComBitSize=2, ComHandleId=305, ComSystemTemplateSystemSignalRef=IBS_APSCrlReqEcho
          IBS_APSTrqReqActive_oIBS_APS_oATOM_CANFD_Matrix_CH_V600_202502_95892cb5_Rx: ComBitPosition=27, ComBitSize=2, ComHandleId=308, ComSystemTemplateSystemSignalRef=IBS_APSTrqReqActive
          IBS_APSEmergenyAvl_oIBS_APS_oATOM_CANFD_Matrix_CH_V600_202502_98e19592_Rx: ComBitPosition=29, ComBitSize=2, ComHandleId=306, ComSystemTemplateSystemSignalRef=IBS_APSEmergenyAvl
          MessageCounter_0B7_oIBS_APS_oATOM_CANFD_Matrix_CH_V600_202502_b68b4db2_Rx: ComBitPosition=11, ComBitSize=4, ComHandleId=311, ComSystemTemplateSystemSignalRef=MessageCounter_0B7
          IBS_APSModeEcho_oIBS_APS_oATOM_CANFD_Matrix_CH_V600_202502_b13c14e1_Rx: ComBitPosition=17, ComBitSize=2, ComHandleId=307, ComSystemTemplateSystemSignalRef=IBS_APSModeEcho
          IBS_APS_Avl_oIBS_APS_oATOM_CANFD_Matrix_CH_V600_202502_912b9c67_Rx: ComBitPosition=23, ComBitSize=2, ComHandleId=309, ComSystemTemplateSystemSignalRef=IBS_APS_Avl
          IBS_APSComfortAvl_oIBS_APS_oATOM_CANFD_Matrix_CH_V600_202502_761e7ded_Rx: ComBitPosition=31, ComBitSize=2, ComHandleId=304, ComSystemTemplateSystemSignalRef=IBS_APSComfortAvl
          Checksum_0B7_oIBS_APS_oATOM_CANFD_Matrix_CH_V600_202502_7cf1e80a_Rx: ComBitPosition=7, ComBitSize=8, ComHandleId=303, ComSystemTemplateSystemSignalRef=Checksum_0B7
          IBS_BrakeTypEcho_oIBS_APS_oATOM_CANFD_Matrix_CH_V600_202502_efa1b54d_Rx: ComBitPosition=21, ComBitSize=2, ComHandleId=310, ComSystemTemplateSystemSignalRef=IBS_BrakeTypEcho
      8 x ComSignal, all with ComBitSize=16, ComSignalEndianness=LITTLE_ENDIAN, ComSignalInitValue=0, ComSignalType=SINT16, ComTimeout=0, ComTransferProperty=PENDING, ComSignalAccess=ACCESS_UNCLEAR:
        AN47_oVcuAdcTxG8Msg3_oTC37X_VCU_CAN01_0b796cfb_Tx: ComBitPosition=48, ComHandleId=47, ComSystemTemplateSystemSignalRef=AN47
        AN30_oVcuAdcTxG3Msg1_oTC37X_VCU_CAN01_72505601_Tx: ComBitPosition=32, ComHandleId=30, ComSystemTemplateSystemSignalRef=AN30
        AN12_oVcuAdcTxG1Msg1_oTC37X_VCU_CAN01_5149143c_Tx: ComBitPosition=0, ComHandleId=12, ComSystemTemplateSystemSignalRef=AN12
        AN7_oVcuAdcTxG0Msg1_oTC37X_VCU_CAN01_762c0b63_Tx: ComBitPosition=48, ComHandleId=7, ComSystemTemplateSystemSignalRef=AN7
        AN11_oVcuAdcTxG1Msg0_oTC37X_VCU_CAN01_d39d5187_Tx: ComBitPosition=48, ComHandleId=11, ComSystemTemplateSystemSignalRef=AN11
        AN0_oVcuAdcTxG0Msg0_oTC37X_VCU_CAN01_66f10a00_Tx: ComBitPosition=0, ComHandleId=0, ComSystemTemplateSystemSignalRef=AN0
        AN31_oVcuAdcTxG3Msg1_oTC37X_VCU_CAN01_56d20737_Tx: ComBitPosition=48, ComHandleId=31, ComSystemTemplateSystemSignalRef=AN31
        AN34_oVcuAdcTxG8Msg0_oTC37X_VCU_CAN01_8f302f78_Tx: ComBitPosition=32, ComHandleId=34, ComSystemTemplateSystemSignalRef=AN34
      VcuAdcTxG2Msg0_oTC37X_VCU_CAN01_79c816e8_Tx (ComIPdu):
        ComIPduDirection = SEND
        ComIPduType = NORMAL
        ComIPduHandleId = 37
        ComIPduSignalProcessing = DEFERRED
        ComIPduCancellationSupport = false
        ComIPduGroupRef = VCU_oTC37X_VCU_CAN01_Tx_4e6d6cda
        ComIPduSignalRef = AN16_oVcuAdcTxG2Msg0_oTC37X_VCU_CAN01_156a4b45_Tx
        ComIPduSignalRef = AN17_oVcuAdcTxG2Msg0_oTC37X_VCU_CAN01_31e81a73_Tx
        ComIPduSignalRef = AN18_oVcuAdcTxG2Msg0_oTC37X_VCU_CAN01_31042200_Tx
        ComIPduSignalRef = AN19_oVcuAdcTxG2Msg0_oTC37X_VCU_CAN01_15867336_Tx
        ComPduIdRef = VcuAdcTxG2Msg0_oTC37X_VCU_CAN01_79c816e8_Tx
        ComIPduMainFunctionRef = ComMainFunctionTx
        ComTxIPdu: ComMinimumDelayTime=0, ComTxIPduUnusedAreasDefault=0
          ComTxModeTrue
            ComTxMode: ComTxModeMode=PERIODIC, ComTxModeTimeOffset=0, ComTxModeTimePeriod=0.5
          ComTxModeFalse
            ComTxMode: ComTxModeMode=PERIODIC, ComTxModeTimeOffset=0, ComTxModeTimePeriod=0.5
      AN23_oVcuAdcTxG2Msg1_oTC37X_VCU_CAN01_c760d653_Tx (ComSignal):
        ComBitPosition = 48
        ComBitSize = 16
        ComSignalEndianness = LITTLE_ENDIAN
        ComSignalInitValue = 0
        ComSignalType = SINT16
        ComTimeout = 0
        ComTransferProperty = PENDING
        ComSignalAccess = ACCESS_UNCLEAR
        ComHandleId = 23
        ComSystemTemplateSystemSignalRef = AN23
      VcuAdcTxG3Msg1_oTC37X_VCU_CAN01_81b2c4c9_Tx (ComIPdu):
        ComIPduDirection = SEND
        ComIPduType = NORMAL
        ComIPduHandleId = 40
        ComIPduSignalProcessing = DEFERRED
        ComIPduCancellationSupport = false
        ComIPduGroupRef = VCU_oTC37X_VCU_CAN01_Tx_4e6d6cda
        ComIPduSignalRef = AN28_oVcuAdcTxG3Msg1_oTC37X_VCU_CAN01_42adce38_Tx
        ComIPduSignalRef = AN29_oVcuAdcTxG3Msg1_oTC37X_VCU_CAN01_662f9f0e_Tx
        ComIPduSignalRef = AN30_oVcuAdcTxG3Msg1_oTC37X_VCU_CAN01_72505601_Tx
        ComIPduSignalRef = AN31_oVcuAdcTxG3Msg1_oTC37X_VCU_CAN01_56d20737_Tx
        ComPduIdRef = VcuAdcTxG3Msg1_oTC37X_VCU_CAN01_81b2c4c9_Tx
        ComIPduMainFunctionRef = ComMainFunctionTx
        ComTxIPdu: ComMinimumDelayTime=0, ComTxIPduUnusedAreasDefault=0
          ComTxModeTrue
            ComTxMode: ComTxModeMode=PERIODIC, ComTxModeTimeOffset=0, ComTxModeTimePeriod=0.5
          ComTxModeFalse
            ComTxMode: ComTxModeMode=PERIODIC, ComTxModeTimeOffset=0, ComTxModeTimePeriod=0.5
      4 x ComSignal, all with ComBitSize=16, ComSignalEndianness=LITTLE_ENDIAN, ComSignalInitValue=0, ComSignalType=SINT16, ComTimeout=0, ComTransferProperty=PENDING, ComSignalAccess=ACCESS_UNCLEAR:
        AN40_oVcuAdcTxG8Msg2_oTC37X_VCU_CAN01_1ba46d98_Tx: ComBitPosition=0, ComHandleId=40, ComSystemTemplateSystemSignalRef=AN40
        AN15_oVcuAdcTxG1Msg1_oTC37X_VCU_CAN01_aec6a3be_Tx: ComBitPosition=48, ComHandleId=15, ComSystemTemplateSystemSignalRef=AN15
        AN32_oVcuAdcTxG8Msg0_oTC37X_VCU_CAN01_543dc9cc_Tx: ComBitPosition=0, ComHandleId=32, ComSystemTemplateSystemSignalRef=AN32
        AN44_oVcuAdcTxG8Msg3_oTC37X_VCU_CAN01_66ff9fa1_Tx: ComBitPosition=0, ComHandleId=44, ComSystemTemplateSystemSignalRef=AN44
      VcuAdcTxG0Msg0_oTC37X_VCU_CAN01_5798df68_Tx (ComIPdu):
        ComIPduDirection = SEND
        ComIPduType = NORMAL
        ComIPduHandleId = 33
        ComIPduSignalProcessing = DEFERRED
        ComIPduCancellationSupport = false
        ComIPduGroupRef = VCU_oTC37X_VCU_CAN01_Tx_4e6d6cda
        ComIPduSignalRef = AN0_oVcuAdcTxG0Msg0_oTC37X_VCU_CAN01_66f10a00_Tx
        ComIPduSignalRef = AN1_oVcuAdcTxG0Msg0_oTC37X_VCU_CAN01_42735b36_Tx
        ComIPduSignalRef = AN2_oVcuAdcTxG0Msg0_oTC37X_VCU_CAN01_2ff5a86c_Tx
        ComIPduSignalRef = AN3_oVcuAdcTxG0Msg0_oTC37X_VCU_CAN01_0b77f95a_Tx
        ComPduIdRef = VcuAdcTxG0Msg0_oTC37X_VCU_CAN01_5798df68_Tx
        ComIPduMainFunctionRef = ComMainFunctionTx
        ComTxIPdu: ComMinimumDelayTime=0, ComTxIPduUnusedAreasDefault=0
          ComTxModeTrue
            ComTxMode: ComTxModeMode=PERIODIC, ComTxModeTimeOffset=0, ComTxModeTimePeriod=0.5
          ComTxModeFalse
            ComTxMode: ComTxModeMode=PERIODIC, ComTxModeTimeOffset=0, ComTxModeTimePeriod=0.5
      3 x ComSignal, all with ComBitSize=16, ComSignalEndianness=LITTLE_ENDIAN, ComSignalInitValue=0, ComSignalType=SINT16, ComTimeout=0, ComTransferProperty=PENDING, ComSignalAccess=ACCESS_UNCLEAR:
        AN29_oVcuAdcTxG3Msg1_oTC37X_VCU_CAN01_662f9f0e_Tx: ComBitPosition=16, ComHandleId=29, ComSystemTemplateSystemSignalRef=AN29
        AN24_oVcuAdcTxG3Msg0_oTC37X_VCU_CAN01_c095b3f0_Tx: ComBitPosition=0, ComHandleId=24, ComSystemTemplateSystemSignalRef=AN24
        AN22_oVcuAdcTxG2Msg1_oTC37X_VCU_CAN01_e3e28765_Tx: ComBitPosition=32, ComHandleId=22, ComSystemTemplateSystemSignalRef=AN22
      VcuAdcTxG3Msg0_oTC37X_VCU_CAN01_6ee07228_Tx (ComIPdu):
        ComIPduDirection = SEND
        ComIPduType = NORMAL
        ComIPduHandleId = 39
        ComIPduSignalProcessing = DEFERRED
        ComIPduCancellationSupport = false
        ComIPduGroupRef = VCU_oTC37X_VCU_CAN01_Tx_4e6d6cda
        ComIPduSignalRef = AN24_oVcuAdcTxG3Msg0_oTC37X_VCU_CAN01_c095b3f0_Tx
        ComIPduSignalRef = AN25_oVcuAdcTxG3Msg0_oTC37X_VCU_CAN01_e417e2c6_Tx
        ComIPduSignalRef = AN26_oVcuAdcTxG3Msg0_oTC37X_VCU_CAN01_8991119c_Tx
        ComIPduSignalRef = AN27_oVcuAdcTxG3Msg0_oTC37X_VCU_CAN01_ad1340aa_Tx
        ComPduIdRef = VcuAdcTxG3Msg0_oTC37X_VCU_CAN01_6ee07228_Tx
        ComIPduMainFunctionRef = ComMainFunctionTx
        ComTxIPdu: ComMinimumDelayTime=0, ComTxIPduUnusedAreasDefault=0
          ComTxModeTrue
            ComTxMode: ComTxModeMode=PERIODIC, ComTxModeTimeOffset=0, ComTxModeTimePeriod=0.5
          ComTxModeFalse
            ComTxMode: ComTxModeMode=PERIODIC, ComTxModeTimeOffset=0, ComTxModeTimePeriod=0.5
      4 x ComSignal, all with ComBitSize=16, ComSignalEndianness=LITTLE_ENDIAN, ComSignalInitValue=0, ComSignalType=SINT16, ComTimeout=0, ComTransferProperty=PENDING, ComSignalAccess=ACCESS_UNCLEAR:
        AN27_oVcuAdcTxG3Msg0_oTC37X_VCU_CAN01_ad1340aa_Tx: ComBitPosition=48, ComHandleId=27, ComSystemTemplateSystemSignalRef=AN27
        AN8_oVcuAdcTxG1Msg0_oTC37X_VCU_CAN01_8ebae131_Tx: ComBitPosition=0, ComHandleId=8, ComSystemTemplateSystemSignalRef=AN8
        AN5_oVcuAdcTxG0Msg1_oTC37X_VCU_CAN01_3f28a90f_Tx: ComBitPosition=16, ComHandleId=5, ComSystemTemplateSystemSignalRef=AN5
        AN18_oVcuAdcTxG2Msg0_oTC37X_VCU_CAN01_31042200_Tx: ComBitPosition=32, ComHandleId=18, ComSystemTemplateSystemSignalRef=AN18
      VcuAdcTxG0Msg1_oTC37X_VCU_CAN01_b8ca6989_Tx (ComIPdu):
        ComIPduDirection = SEND
        ComIPduType = NORMAL
        ComIPduHandleId = 34
        ComIPduSignalProcessing = DEFERRED
        ComIPduCancellationSupport = false
        ComIPduGroupRef = VCU_oTC37X_VCU_CAN01_Tx_4e6d6cda
        ComIPduSignalRef = AN4_oVcuAdcTxG0Msg1_oTC37X_VCU_CAN01_1baaf839_Tx
        ComIPduSignalRef = AN5_oVcuAdcTxG0Msg1_oTC37X_VCU_CAN01_3f28a90f_Tx
        ComIPduSignalRef = AN6_oVcuAdcTxG0Msg1_oTC37X_VCU_CAN01_52ae5a55_Tx
        ComIPduSignalRef = AN7_oVcuAdcTxG0Msg1_oTC37X_VCU_CAN01_762c0b63_Tx
        ComPduIdRef = VcuAdcTxG0Msg1_oTC37X_VCU_CAN01_b8ca6989_Tx
        ComIPduMainFunctionRef = ComMainFunctionTx
        ComTxIPdu: ComMinimumDelayTime=0, ComTxIPduUnusedAreasDefault=0
          ComTxModeTrue
            ComTxMode: ComTxModeMode=PERIODIC, ComTxModeTimeOffset=0, ComTxModeTimePeriod=0.5
          ComTxModeFalse
            ComTxMode: ComTxModeMode=PERIODIC, ComTxModeTimeOffset=0, ComTxModeTimePeriod=0.5
      5 x ComSignal, all with ComBitSize=16, ComSignalEndianness=LITTLE_ENDIAN, ComSignalInitValue=0, ComSignalType=SINT16, ComTimeout=0, ComTransferProperty=PENDING, ComSignalAccess=ACCESS_UNCLEAR:
        AN38_oVcuAdcTxG8Msg1_oTC37X_VCU_CAN01_0d0852b0_Tx: ComBitPosition=32, ComHandleId=38, ComSystemTemplateSystemSignalRef=AN38
        AN26_oVcuAdcTxG3Msg0_oTC37X_VCU_CAN01_8991119c_Tx: ComBitPosition=32, ComHandleId=26, ComSystemTemplateSystemSignalRef=AN26
        AN16_oVcuAdcTxG2Msg0_oTC37X_VCU_CAN01_156a4b45_Tx: ComBitPosition=0, ComHandleId=16, ComSystemTemplateSystemSignalRef=AN16
        AN21_oVcuAdcTxG2Msg1_oTC37X_VCU_CAN01_8e64743f_Tx: ComBitPosition=16, ComHandleId=21, ComSystemTemplateSystemSignalRef=AN21
        AN1_oVcuAdcTxG0Msg0_oTC37X_VCU_CAN01_42735b36_Tx: ComBitPosition=16, ComHandleId=1, ComSystemTemplateSystemSignalRef=AN1
      VcuAdcTxG8Msg0_oTC37X_VCU_CAN01_eedbf968_Tx (ComIPdu):
        ComIPduDirection = SEND
        ComIPduType = NORMAL
        ComIPduHandleId = 41
        ComIPduSignalProcessing = DEFERRED
        ComIPduCancellationSupport = false
        ComIPduGroupRef = VCU_oTC37X_VCU_CAN01_Tx_4e6d6cda
        ComIPduSignalRef = AN32_oVcuAdcTxG8Msg0_oTC37X_VCU_CAN01_543dc9cc_Tx
        ComIPduSignalRef = AN33_oVcuAdcTxG8Msg0_oTC37X_VCU_CAN01_70bf98fa_Tx
        ComIPduSignalRef = AN34_oVcuAdcTxG8Msg0_oTC37X_VCU_CAN01_8f302f78_Tx
        ComIPduSignalRef = AN35_oVcuAdcTxG8Msg0_oTC37X_VCU_CAN01_abb27e4e_Tx
        ComPduIdRef = VcuAdcTxG8Msg0_oTC37X_VCU_CAN01_eedbf968_Tx
        ComIPduMainFunctionRef = ComMainFunctionTx
        ComTxIPdu: ComMinimumDelayTime=0, ComTxIPduUnusedAreasDefault=0
          ComTxModeTrue
            ComTxMode: ComTxModeMode=PERIODIC, ComTxModeTimeOffset=0, ComTxModeTimePeriod=0.5
          ComTxModeFalse
            ComTxMode: ComTxModeMode=PERIODIC, ComTxModeTimeOffset=0, ComTxModeTimePeriod=0.5
      AN35_oVcuAdcTxG8Msg0_oTC37X_VCU_CAN01_abb27e4e_Tx (ComSignal):
        ComBitPosition = 48
        ComBitSize = 16
        ComSignalEndianness = LITTLE_ENDIAN
        ComSignalInitValue = 0
        ComSignalType = SINT16
        ComTimeout = 0
        ComTransferProperty = PENDING
        ComSignalAccess = ACCESS_UNCLEAR
        ComHandleId = 35
        ComSystemTemplateSystemSignalRef = AN35
      VcuAdcTxG1Msg0_oTC37X_VCU_CAN01_40b0bba8_Tx (ComIPdu):
        ComIPduDirection = SEND
        ComIPduType = NORMAL
        ComIPduHandleId = 35
        ComIPduSignalProcessing = DEFERRED
        ComIPduCancellationSupport = false
        ComIPduGroupRef = VCU_oTC37X_VCU_CAN01_Tx_4e6d6cda
        ComIPduSignalRef = AN10_oVcuAdcTxG1Msg0_oTC37X_VCU_CAN01_f71f00b1_Tx
        ComIPduSignalRef = AN11_oVcuAdcTxG1Msg0_oTC37X_VCU_CAN01_d39d5187_Tx
        ComIPduSignalRef = AN8_oVcuAdcTxG1Msg0_oTC37X_VCU_CAN01_8ebae131_Tx
        ComIPduSignalRef = AN9_oVcuAdcTxG1Msg0_oTC37X_VCU_CAN01_aa38b007_Tx
        ComPduIdRef = VcuAdcTxG1Msg0_oTC37X_VCU_CAN01_40b0bba8_Tx
        ComIPduMainFunctionRef = ComMainFunctionTx
        ComTxIPdu: ComMinimumDelayTime=0, ComTxIPduUnusedAreasDefault=0
          ComTxModeTrue
            ComTxMode: ComTxModeMode=PERIODIC, ComTxModeTimeOffset=0, ComTxModeTimePeriod=0.5
          ComTxModeFalse
            ComTxMode: ComTxModeMode=PERIODIC, ComTxModeTimeOffset=0, ComTxModeTimePeriod=0.5
      3 x ComSignal, all with ComBitSize=16, ComSignalEndianness=LITTLE_ENDIAN, ComSignalInitValue=0, ComSignalType=SINT16, ComTimeout=0, ComTransferProperty=PENDING, ComSignalAccess=ACCESS_UNCLEAR:
        AN36_oVcuAdcTxG8Msg1_oTC37X_VCU_CAN01_29663bf5_Tx: ComBitPosition=0, ComHandleId=36, ComSystemTemplateSystemSignalRef=AN36
        AN20_oVcuAdcTxG2Msg1_oTC37X_VCU_CAN01_aae62509_Tx: ComBitPosition=0, ComHandleId=20, ComSystemTemplateSystemSignalRef=AN20
        AN10_oVcuAdcTxG1Msg0_oTC37X_VCU_CAN01_f71f00b1_Tx: ComBitPosition=32, ComHandleId=10, ComSystemTemplateSystemSignalRef=AN10
      VcuAdcTxG2Msg1_oTC37X_VCU_CAN01_969aa009_Tx (ComIPdu):
        ComIPduDirection = SEND
        ComIPduType = NORMAL
        ComIPduHandleId = 38
        ComIPduSignalProcessing = DEFERRED
        ComIPduCancellationSupport = false
        ComIPduGroupRef = VCU_oTC37X_VCU_CAN01_Tx_4e6d6cda
        ComIPduSignalRef = AN20_oVcuAdcTxG2Msg1_oTC37X_VCU_CAN01_aae62509_Tx
        ComIPduSignalRef = AN21_oVcuAdcTxG2Msg1_oTC37X_VCU_CAN01_8e64743f_Tx
        ComIPduSignalRef = AN22_oVcuAdcTxG2Msg1_oTC37X_VCU_CAN01_e3e28765_Tx
        ComIPduSignalRef = AN23_oVcuAdcTxG2Msg1_oTC37X_VCU_CAN01_c760d653_Tx
        ComPduIdRef = VcuAdcTxG2Msg1_oTC37X_VCU_CAN01_969aa009_Tx
        ComIPduMainFunctionRef = ComMainFunctionTx
        ComTxIPdu: ComMinimumDelayTime=0, ComTxIPduUnusedAreasDefault=0
          ComTxModeTrue
            ComTxMode: ComTxModeMode=PERIODIC, ComTxModeTimeOffset=0, ComTxModeTimePeriod=0.5
          ComTxModeFalse
            ComTxMode: ComTxModeMode=PERIODIC, ComTxModeTimeOffset=0, ComTxModeTimePeriod=0.5
      AN28_oVcuAdcTxG3Msg1_oTC37X_VCU_CAN01_42adce38_Tx (ComSignal):
        ComBitPosition = 0
        ComBitSize = 16
        ComSignalEndianness = LITTLE_ENDIAN
        ComSignalInitValue = 0
        ComSignalType = SINT16
        ComTimeout = 0
        ComTransferProperty = PENDING
        ComSignalAccess = ACCESS_UNCLEAR
        ComHandleId = 28
        ComSystemTemplateSystemSignalRef = AN28
      AN43_oVcuAdcTxG8Msg2_oTC37X_VCU_CAN01_76229ec2_Tx (ComSignal):
        ComBitPosition = 48
        ComBitSize = 16
        ComSignalEndianness = LITTLE_ENDIAN
        ComSignalInitValue = 0
        ComSignalType = SINT16
        ComTimeout = 0
        ComTransferProperty = PENDING
        ComSignalAccess = ACCESS_UNCLEAR
        ComHandleId = 43
        ComSystemTemplateSystemSignalRef = AN43
      VcuAdcTxG8Msg1_oTC37X_VCU_CAN01_01894f89_Tx (ComIPdu):
        ComIPduDirection = SEND
        ComIPduType = NORMAL
        ComIPduHandleId = 42
        ComIPduSignalProcessing = DEFERRED
        ComIPduCancellationSupport = false
        ComIPduGroupRef = VCU_oTC37X_VCU_CAN01_Tx_4e6d6cda
        ComIPduSignalRef = AN36_oVcuAdcTxG8Msg1_oTC37X_VCU_CAN01_29663bf5_Tx
        ComIPduSignalRef = AN37_oVcuAdcTxG8Msg1_oTC37X_VCU_CAN01_0de46ac3_Tx
        ComIPduSignalRef = AN38_oVcuAdcTxG8Msg1_oTC37X_VCU_CAN01_0d0852b0_Tx
        ComIPduSignalRef = AN39_oVcuAdcTxG8Msg1_oTC37X_VCU_CAN01_298a0386_Tx
        ComPduIdRef = VcuAdcTxG8Msg1_oTC37X_VCU_CAN01_01894f89_Tx
        ComIPduMainFunctionRef = ComMainFunctionTx
        ComTxIPdu: ComMinimumDelayTime=0, ComTxIPduUnusedAreasDefault=0
          ComTxModeTrue
            ComTxMode: ComTxModeMode=PERIODIC, ComTxModeTimeOffset=0, ComTxModeTimePeriod=0.5
          ComTxModeFalse
            ComTxMode: ComTxModeMode=PERIODIC, ComTxModeTimeOffset=0, ComTxModeTimePeriod=0.5
      3 x ComSignal, all with ComBitSize=16, ComSignalEndianness=LITTLE_ENDIAN, ComSignalInitValue=0, ComSignalType=SINT16, ComTimeout=0, ComTransferProperty=PENDING, ComSignalAccess=ACCESS_UNCLEAR:
        AN33_oVcuAdcTxG8Msg0_oTC37X_VCU_CAN01_70bf98fa_Tx: ComBitPosition=16, ComHandleId=33, ComSystemTemplateSystemSignalRef=AN33
        AN25_oVcuAdcTxG3Msg0_oTC37X_VCU_CAN01_e417e2c6_Tx: ComBitPosition=16, ComHandleId=25, ComSystemTemplateSystemSignalRef=AN25
        AN3_oVcuAdcTxG0Msg0_oTC37X_VCU_CAN01_0b77f95a_Tx: ComBitPosition=48, ComHandleId=3, ComSystemTemplateSystemSignalRef=AN3
      VcuAdcTxG8Msg2_oTC37X_VCU_CAN01_eb0f92eb_Tx (ComIPdu):
        ComIPduDirection = SEND
        ComIPduType = NORMAL
        ComIPduHandleId = 43
        ComIPduSignalProcessing = DEFERRED
        ComIPduCancellationSupport = false
        ComIPduGroupRef = VCU_oTC37X_VCU_CAN01_Tx_4e6d6cda
        ComIPduSignalRef = AN40_oVcuAdcTxG8Msg2_oTC37X_VCU_CAN01_1ba46d98_Tx
        ComIPduSignalRef = AN41_oVcuAdcTxG8Msg2_oTC37X_VCU_CAN01_3f263cae_Tx
        ComIPduSignalRef = AN42_oVcuAdcTxG8Msg2_oTC37X_VCU_CAN01_52a0cff4_Tx
        ComIPduSignalRef = AN43_oVcuAdcTxG8Msg2_oTC37X_VCU_CAN01_76229ec2_Tx
        ComPduIdRef = VcuAdcTxG8Msg2_oTC37X_VCU_CAN01_eb0f92eb_Tx
        ComIPduMainFunctionRef = ComMainFunctionTx
        ComTxIPdu: ComMinimumDelayTime=0, ComTxIPduUnusedAreasDefault=0
          ComTxModeTrue
            ComTxMode: ComTxModeMode=PERIODIC, ComTxModeTimeOffset=0, ComTxModeTimePeriod=0.5
          ComTxModeFalse
            ComTxMode: ComTxModeMode=PERIODIC, ComTxModeTimeOffset=0, ComTxModeTimePeriod=0.5
      6 x ComSignal, all with ComBitSize=16, ComSignalEndianness=LITTLE_ENDIAN, ComSignalInitValue=0, ComSignalType=SINT16, ComTimeout=0, ComTransferProperty=PENDING, ComSignalAccess=ACCESS_UNCLEAR:
        AN6_oVcuAdcTxG0Msg1_oTC37X_VCU_CAN01_52ae5a55_Tx: ComBitPosition=32, ComHandleId=6, ComSystemTemplateSystemSignalRef=AN6
        AN19_oVcuAdcTxG2Msg0_oTC37X_VCU_CAN01_15867336_Tx: ComBitPosition=48, ComHandleId=19, ComSystemTemplateSystemSignalRef=AN19
        AN45_oVcuAdcTxG8Msg3_oTC37X_VCU_CAN01_427dce97_Tx: ComBitPosition=16, ComHandleId=45, ComSystemTemplateSystemSignalRef=AN45
        AN46_oVcuAdcTxG8Msg3_oTC37X_VCU_CAN01_2ffb3dcd_Tx: ComBitPosition=32, ComHandleId=46, ComSystemTemplateSystemSignalRef=AN46
        AN39_oVcuAdcTxG8Msg1_oTC37X_VCU_CAN01_298a0386_Tx: ComBitPosition=48, ComHandleId=39, ComSystemTemplateSystemSignalRef=AN39
        AN37_oVcuAdcTxG8Msg1_oTC37X_VCU_CAN01_0de46ac3_Tx: ComBitPosition=16, ComHandleId=37, ComSystemTemplateSystemSignalRef=AN37
      VcuAdcTxG8Msg3_oTC37X_VCU_CAN01_045d240a_Tx (ComIPdu):
        ComIPduDirection = SEND
        ComIPduType = NORMAL
        ComIPduHandleId = 44
        ComIPduSignalProcessing = DEFERRED
        ComIPduCancellationSupport = false
        ComIPduGroupRef = VCU_oTC37X_VCU_CAN01_Tx_4e6d6cda
        ComIPduSignalRef = AN44_oVcuAdcTxG8Msg3_oTC37X_VCU_CAN01_66ff9fa1_Tx
        ComIPduSignalRef = AN45_oVcuAdcTxG8Msg3_oTC37X_VCU_CAN01_427dce97_Tx
        ComIPduSignalRef = AN46_oVcuAdcTxG8Msg3_oTC37X_VCU_CAN01_2ffb3dcd_Tx
        ComIPduSignalRef = AN47_oVcuAdcTxG8Msg3_oTC37X_VCU_CAN01_0b796cfb_Tx
        ComPduIdRef = VcuAdcTxG8Msg3_oTC37X_VCU_CAN01_045d240a_Tx
        ComIPduMainFunctionRef = ComMainFunctionTx
        ComTxIPdu: ComMinimumDelayTime=0, ComTxIPduUnusedAreasDefault=0
          ComTxModeTrue
            ComTxMode: ComTxModeMode=PERIODIC, ComTxModeTimeOffset=0, ComTxModeTimePeriod=0.5
          ComTxModeFalse
            ComTxMode: ComTxModeMode=PERIODIC, ComTxModeTimeOffset=0, ComTxModeTimePeriod=0.5
      6 x ComSignal, all with ComBitSize=16, ComSignalEndianness=LITTLE_ENDIAN, ComSignalInitValue=0, ComSignalType=SINT16, ComTimeout=0, ComTransferProperty=PENDING, ComSignalAccess=ACCESS_UNCLEAR:
        AN17_oVcuAdcTxG2Msg0_oTC37X_VCU_CAN01_31e81a73_Tx: ComBitPosition=16, ComHandleId=17, ComSystemTemplateSystemSignalRef=AN17
        AN2_oVcuAdcTxG0Msg0_oTC37X_VCU_CAN01_2ff5a86c_Tx: ComBitPosition=32, ComHandleId=2, ComSystemTemplateSystemSignalRef=AN2
        AN14_oVcuAdcTxG1Msg1_oTC37X_VCU_CAN01_8a44f288_Tx: ComBitPosition=32, ComHandleId=14, ComSystemTemplateSystemSignalRef=AN14
        AN4_oVcuAdcTxG0Msg1_oTC37X_VCU_CAN01_1baaf839_Tx: ComBitPosition=0, ComHandleId=4, ComSystemTemplateSystemSignalRef=AN4
        AN9_oVcuAdcTxG1Msg0_oTC37X_VCU_CAN01_aa38b007_Tx: ComBitPosition=16, ComHandleId=9, ComSystemTemplateSystemSignalRef=AN9
        AN41_oVcuAdcTxG8Msg2_oTC37X_VCU_CAN01_3f263cae_Tx: ComBitPosition=16, ComHandleId=41, ComSystemTemplateSystemSignalRef=AN41
      VcuAdcTxG1Msg1_oTC37X_VCU_CAN01_afe20d49_Tx (ComIPdu):
        ComIPduDirection = SEND
        ComIPduType = NORMAL
        ComIPduHandleId = 36
        ComIPduSignalProcessing = DEFERRED
        ComIPduCancellationSupport = false
        ComIPduGroupRef = VCU_oTC37X_VCU_CAN01_Tx_4e6d6cda
        ComIPduSignalRef = AN12_oVcuAdcTxG1Msg1_oTC37X_VCU_CAN01_5149143c_Tx
        ComIPduSignalRef = AN13_oVcuAdcTxG1Msg1_oTC37X_VCU_CAN01_75cb450a_Tx
        ComIPduSignalRef = AN14_oVcuAdcTxG1Msg1_oTC37X_VCU_CAN01_8a44f288_Tx
        ComIPduSignalRef = AN15_oVcuAdcTxG1Msg1_oTC37X_VCU_CAN01_aec6a3be_Tx
        ComPduIdRef = VcuAdcTxG1Msg1_oTC37X_VCU_CAN01_afe20d49_Tx
        ComIPduMainFunctionRef = ComMainFunctionTx
        ComTxIPdu: ComMinimumDelayTime=0, ComTxIPduUnusedAreasDefault=0
          ComTxModeTrue
            ComTxMode: ComTxModeMode=PERIODIC, ComTxModeTimeOffset=0, ComTxModeTimePeriod=0.5
          ComTxModeFalse
            ComTxMode: ComTxModeMode=PERIODIC, ComTxModeTimeOffset=0, ComTxModeTimePeriod=0.5
      AN42_oVcuAdcTxG8Msg2_oTC37X_VCU_CAN01_52a0cff4_Tx (ComSignal):
        ComBitPosition = 32
        ComBitSize = 16
        ComSignalEndianness = LITTLE_ENDIAN
        ComSignalInitValue = 0
        ComSignalType = SINT16
        ComTimeout = 0
        ComTransferProperty = PENDING
        ComSignalAccess = ACCESS_UNCLEAR
        ComHandleId = 42
        ComSystemTemplateSystemSignalRef = AN42
      AN13_oVcuAdcTxG1Msg1_oTC37X_VCU_CAN01_75cb450a_Tx (ComSignal):
        ComBitPosition = 16
        ComBitSize = 16
        ComSignalEndianness = LITTLE_ENDIAN
        ComSignalInitValue = 0
        ComSignalType = SINT16
        ComTimeout = 0
        ComTransferProperty = PENDING
        ComSignalAccess = ACCESS_UNCLEAR
        ComHandleId = 13
        ComSystemTemplateSystemSignalRef = AN13
      VcuRxCtrlMsg0_oTC37X_VCU_CAN01_b24a2ab4_Rx (ComIPdu):
        ComIPduDirection = RECEIVE
        ComIPduType = NORMAL
        ComIPduHandleId = 93
        ComIPduSignalProcessing = DEFERRED
        ComIPduCancellationSupport = false
        ComIPduGroupRef = VCU_oTC37X_VCU_CAN01_Rx_1837cb5c
        ComIPduSignalRef = Tle888qk_Out21BriCfg_oVcuRxCtrlMsg0_oTC37X_VCU_CAN01_f4735e02_Rx
        ComIPduSignalRef = Tle888qk_Out21_En_oVcuRxCtrlMsg0_oTC37X_VCU_CAN01_fce8b2a9_Rx
        ComIPduSignalRef = Tle888qk_Out22BriCfg_oVcuRxCtrlMsg0_oTC37X_VCU_CAN01_27e842f9_Rx
        ComIPduSignalRef = Tle888qk_Out22_En_oVcuRxCtrlMsg0_oTC37X_VCU_CAN01_9808c957_Rx
        ComIPduSignalRef = Tle888qk_Out23BriCfg_oVcuRxCtrlMsg0_oTC37X_VCU_CAN01_69614950_Rx
        ComIPduSignalRef = Tle888qk_Out23_En_oVcuRxCtrlMsg0_oTC37X_VCU_CAN01_0d781dc2_Rx
        ComIPduSignalRef = Tle888qk_Out24BriCfg_oVcuRxCtrlMsg0_oTC37X_VCU_CAN01_5baf7d4e_Rx
        ComIPduSignalRef = Tle888qk_Out24_En_oVcuRxCtrlMsg0_oTC37X_VCU_CAN01_51c83eab_Rx
        ComPduIdRef = VcuRxCtrlMsg0_oTC37X_VCU_CAN01_b24a2ab4_Rx
        ComIPduMainFunctionRef = ComMainFunctionRx
      16 x ComSignal, all with ComBitSize=8, ComSignalEndianness=LITTLE_ENDIAN, ComSignalInitValue=0, ComSignalType=SINT8, ComTimeout=0, ComSignalAccess=ACCESS_UNCLEAR:
        Tle888qk_Out24_En_oVcuRxCtrlMsg0_oTC37X_VCU_CAN01_51c83eab_Rx: ComBitPosition=24, ComHandleId=532, ComSystemTemplateSystemSignalRef=Tle888qk_Out24_En
        Tle888qk_Out23_En_oVcuRxCtrlMsg0_oTC37X_VCU_CAN01_0d781dc2_Rx: ComBitPosition=16, ComHandleId=530, ComSystemTemplateSystemSignalRef=Tle888qk_Out23_En
        Tle888qk_Out22_En_oVcuRxCtrlMsg0_oTC37X_VCU_CAN01_9808c957_Rx: ComBitPosition=8, ComHandleId=528, ComSystemTemplateSystemSignalRef=Tle888qk_Out22_En
        Tle888qk_Out21_En_oVcuRxCtrlMsg0_oTC37X_VCU_CAN01_fce8b2a9_Rx: ComBitPosition=0, ComHandleId=526, ComNotification=Rte_COMCbk_Tle888qk_Out21_En_oVcuRxCtrlMsg0_oTC37X_VCU_CAN01_fce8b2a9_Rx, ComSystemTemplateSystemSignalRef=Tle888qk_Out21_En
        Bts7xx_HS3_En_oVcuRxCtrlMsg1_oTC37X_VCU_CAN01_21f98557_Rx: ComBitPosition=48, ComHandleId=5, ComSystemTemplateSystemSignalRef=Bts7xx_HS3_En
        Bts7xx_HS1_En_oVcuRxCtrlMsg1_oTC37X_VCU_CAN01_d0692a3c_Rx: ComBitPosition=32, ComHandleId=3, ComNotification=Rte_COMCbk_Bts7xx_HS1_En_oVcuRxCtrlMsg1_oTC37X_VCU_CAN01_d0692a3c_Rx, ComSystemTemplateSystemSignalRef=Bts7xx_HS1_En
        Tle888qk_Out22BriCfg_oVcuRxCtrlMsg0_oTC37X_VCU_CAN01_27e842f9_Rx: ComBitPosition=40, ComHandleId=527, ComSystemTemplateSystemSignalRef=Tle888qk_Out22BriCfg
        Bts7xx_HS4_En_oVcuRxCtrlMsg1_oTC37X_VCU_CAN01_7d49a63e_Rx: ComBitPosition=56, ComHandleId=6, ComSystemTemplateSystemSignalRef=Bts7xx_HS4_En
        Tle888qk_Out21BriCfg_oVcuRxCtrlMsg0_oTC37X_VCU_CAN01_f4735e02_Rx: ComBitPosition=32, ComHandleId=525, ComSystemTemplateSystemSignalRef=Tle888qk_Out21BriCfg
        Tle888qk_Out23BriCfg_oVcuRxCtrlMsg0_oTC37X_VCU_CAN01_69614950_Rx: ComBitPosition=48, ComHandleId=529, ComSystemTemplateSystemSignalRef=Tle888qk_Out23BriCfg
        Bts7xx_HS2_En_oVcuRxCtrlMsg1_oTC37X_VCU_CAN01_b48951c2_Rx: ComBitPosition=40, ComHandleId=4, ComSystemTemplateSystemSignalRef=Bts7xx_HS2_En
        Tle9201_Dir_oVcuRxCtrlMsg1_oTC37X_VCU_CAN01_4c38edaa_Rx: ComBitPosition=24, ComHandleId=534, ComSystemTemplateSystemSignalRef=Tle9201_Dir
        Tle4252d_en_oVcuRxCtrlMsg1_oTC37X_VCU_CAN01_24c739a8_Rx: ComBitPosition=0, ComHandleId=533, ComSystemTemplateSystemSignalRef=Tle4252d_en
        Tle9201_Pwm_oVcuRxCtrlMsg1_oTC37X_VCU_CAN01_bf73fa17_Rx: ComBitPosition=16, ComHandleId=536, ComSystemTemplateSystemSignalRef=Tle9201_Pwm
        Tle888qk_Out24BriCfg_oVcuRxCtrlMsg0_oTC37X_VCU_CAN01_5baf7d4e_Rx: ComBitPosition=56, ComHandleId=531, ComSystemTemplateSystemSignalRef=Tle888qk_Out24BriCfg
        Tle9201_Dis_oVcuRxCtrlMsg1_oTC37X_VCU_CAN01_7aca7d59_Rx: ComBitPosition=8, ComHandleId=535, ComSystemTemplateSystemSignalRef=Tle9201_Dis
      VcuRxCtrlMsg1_oTC37X_VCU_CAN01_5d189c55_Rx (ComIPdu):
        ComIPduDirection = RECEIVE
        ComIPduType = NORMAL
        ComIPduHandleId = 94
        ComIPduSignalProcessing = DEFERRED
        ComIPduCancellationSupport = false
        ComIPduGroupRef = VCU_oTC37X_VCU_CAN01_Rx_1837cb5c
        ComIPduSignalRef = Bts7xx_HS1_En_oVcuRxCtrlMsg1_oTC37X_VCU_CAN01_d0692a3c_Rx
        ComIPduSignalRef = Bts7xx_HS2_En_oVcuRxCtrlMsg1_oTC37X_VCU_CAN01_b48951c2_Rx
        ComIPduSignalRef = Bts7xx_HS3_En_oVcuRxCtrlMsg1_oTC37X_VCU_CAN01_21f98557_Rx
        ComIPduSignalRef = Bts7xx_HS4_En_oVcuRxCtrlMsg1_oTC37X_VCU_CAN01_7d49a63e_Rx
        ComIPduSignalRef = Tle4252d_en_oVcuRxCtrlMsg1_oTC37X_VCU_CAN01_24c739a8_Rx
        ComIPduSignalRef = Tle9201_Dir_oVcuRxCtrlMsg1_oTC37X_VCU_CAN01_4c38edaa_Rx
        ComIPduSignalRef = Tle9201_Dis_oVcuRxCtrlMsg1_oTC37X_VCU_CAN01_7aca7d59_Rx
        ComIPduSignalRef = Tle9201_Pwm_oVcuRxCtrlMsg1_oTC37X_VCU_CAN01_bf73fa17_Rx
        ComPduIdRef = VcuRxCtrlMsg1_oTC37X_VCU_CAN01_5d189c55_Rx
        ComIPduMainFunctionRef = ComMainFunctionRx
      Tle888qk_Lout14_En_oVcuRxCtrlMsg2_oTC37X_VCU_CAN01_a11e1e88_Rx (ComSignal):
        ComBitPosition = 16
        ComBitSize = 8
        ComSignalEndianness = LITTLE_ENDIAN
        ComSignalInitValue = 0
        ComSignalType = SINT8
        ComTimeout = 0
        ComSignalAccess = ACCESS_UNCLEAR
        ComHandleId = 523
        ComSystemTemplateSystemSignalRef = Tle888qk_Lout14_En
      EXT_PWM_IN2_Period_oVcuMeasurementMsg0_oTC37X_VCU_CAN01_fba12e71_Tx (ComSignal):
        ComBitPosition = 24
        ComBitSize = 16
        ComSignalEndianness = LITTLE_ENDIAN
        ComSignalInitValue = 0
        ComSignalType = SINT16
        ComTimeout = 0
        ComTransferProperty = PENDING
        ComSignalAccess = ACCESS_UNCLEAR
        ComHandleId = 57
        ComSystemTemplateSystemSignalRef = EXT_PWM_IN2_Period
