[part 1 of 2: package /ActiveEcuC]
AUTOSAR XML (schema 00048)
package /ActiveEcuC
  module config Com: implementation-config-variant=VARIANT-PRE-COMPILE, module-description=Com_Impl
    ComGeneration:
      ComOutOfBoundsWriteProtectionStrategy = NONE
      ComOutOfBoundsWriteSanitizer = false
      ComOutOfBoundsReadSanitizer = false
      ComReduceConstantData2Define = false
      ComBoolDataInArrayOfStructStrategy = BOOLEAN
      ComDeduplicateIndirectedData = true
      ComDataDeduplicationStrategy = WITH_CAST
      ComReduceBoolDataByNegationThreshold = 2
      ComReduceBoolDataByNumericalComparisonThreshold = 2
      ComReduceBoolDataByNumericalRelationThreshold = 2
      ComReduceBoolDataByNumericalOperandStrategy = WITH_ANY_VALUE
      ComReduceNumericalDataByOffsetThreshold = 2
      ComReduceNumericalDataByArraySubtractionThreshold = 2
      ComReduceDataByStreaming = false
      ComShortSymbols = false
      ComInterfacesForDeactivatedData = false
      ComReferringKeysInComments = false
    ComOptimization:
      ComTxProcessingISRLockThreshold = 1
      ComRxProcessingISRLockThreshold = 1
      ComGatewayProcessingISRLockThreshold = 1
      ComGatewayDescriptionProcessingISRLockThreshold = 1
      ComIPduGroupISRLockThreshold = 1
    ComConfig: ComConfigurationId=0, ComRxDeferredNotificationCacheSize=1, ComRxImmediateNotificationCacheSize=0
      VCU_oTC37X_VCU_CAN00_Tx_f6d10bbf (ComIPduGroup): ComIPduGroupHandleId=9
      10 x ComSignal, all with ComBitSize=16, ComSignalEndianness=LITTLE_ENDIAN, ComSignalInitValue=0, ComSignalType=SINT16:
        VcuRxMsg2_Sig3_oVcuRxMsg2_oTC37X_VCU_CAN00_31c6b130_Rx: ComBitPosition=48, ComTimeout=2, ComSignalAccess=ACCESS_NEEDED_BY_SWC_OR_COM, ComHandleId=275, ComNotification=Rte_COMCbk_VcuRxMsg2_Sig3_oVcuRxMsg2_oTC37X_VCU_CAN00_31c6b130_Rx, ComTimeoutNotification=Rte_COMCbkRxTOut_VcuRxMsg2_Sig3_oVcuRxMsg2_oTC37X_VCU_CAN00_31c6b130_Rx, ComSystemTemplateSystemSignalRef=VcuRxMsg2_Sig3
        VcuTxMsg2_Sig3_oVcuTxMsg2_oTC37X_VCU_CAN00_a04bfcfd_Tx: ComBitPosition=48, ComTimeout=0, ComTransferProperty=PENDING, ComSignalAccess=ACCESS_UNCLEAR, ComHandleId=223, ComSystemTemplateSystemSignalRef=VcuTxMsg2_Sig3
        VcuRxMsg2_Sig0_oVcuRxMsg2_oTC37X_VCU_CAN00_94ceda5c_Rx: ComBitPosition=0, ComTimeout=2, ComSignalAccess=ACCESS_NEEDED_BY_SWC_OR_COM, ComHandleId=272, ComNotification=Rte_COMCbk_VcuRxMsg2_Sig0_oVcuRxMsg2_oTC37X_VCU_CAN00_94ceda5c_Rx, ComTimeoutNotification=Com_Msg201h_Timeout_Notification, ComFirstTimeout=2, ComSystemTemplateSystemSignalRef=VcuRxMsg2_Sig0
        VcuRxMsg2_Sig2_oVcuRxMsg2_oTC37X_VCU_CAN00_52c16814_Rx: ComBitPosition=32, ComTimeout=2, ComSignalAccess=ACCESS_UNCLEAR, ComHandleId=274, ComNotification=Rte_COMCbk_VcuRxMsg2_Sig2_oVcuRxMsg2_oTC37X_VCU_CAN00_52c16814_Rx, ComTimeoutNotification=Rte_COMCbkRxTOut_VcuRxMsg2_Sig2_oVcuRxMsg2_oTC37X_VCU_CAN00_52c16814_Rx, ComSystemTemplateSystemSignalRef=VcuRxMsg2_Sig2
        VcuTxMsg1_Sig1_oVcuTxMsg1_oTC37X_VCU_CAN00_e144608d_Tx: ComBitPosition=16, ComTimeout=0, ComTransferProperty=PENDING, ComSignalAccess=ACCESS_UNCLEAR, ComHandleId=217, ComSystemTemplateSystemSignalRef=VcuTxMsg1_Sig1
        VcuTxMsg2_Sig0_oVcuTxMsg2_oTC37X_VCU_CAN00_05439791_Tx: ComBitPosition=0, ComTimeout=0, ComTransferProperty=PENDING, ComSignalAccess=ACCESS_UNCLEAR, ComHandleId=220, ComSystemTemplateSystemSignalRef=VcuTxMsg2_Sig0
        VcuRxMsg1_Sig2_oVcuRxMsg1_oTC37X_VCU_CAN00_d5c1462c_Rx: ComBitPosition=32, ComTimeout=2, ComSignalAccess=ACCESS_UNCLEAR, ComHandleId=270, ComNotification=Rte_COMCbk_VcuRxMsg1_Sig2_oVcuRxMsg1_oTC37X_VCU_CAN00_d5c1462c_Rx, ComTimeoutNotification=Rte_COMCbkRxTOut_VcuRxMsg1_Sig2_oVcuRxMsg1_oTC37X_VCU_CAN00_d5c1462c_Rx, ComSystemTemplateSystemSignalRef=VcuRxMsg1_Sig2
        VcuTxMsg1_Sig2_oVcuTxMsg1_oTC37X_VCU_CAN00_444c0be1_Tx: ComBitPosition=32, ComTimeout=0, ComTransferProperty=PENDING, ComSignalAccess=ACCESS_UNCLEAR, ComHandleId=218, ComSystemTemplateSystemSignalRef=VcuTxMsg1_Sig2
        VcuRxMsg2_Sig1_oVcuRxMsg2_oTC37X_VCU_CAN00_f7c90378_Rx: ComBitPosition=16, ComTimeout=2, ComSignalAccess=ACCESS_UNCLEAR, ComHandleId=273, ComNotification=Rte_COMCbk_VcuRxMsg2_Sig1_oVcuRxMsg2_oTC37X_VCU_CAN00_f7c90378_Rx, ComTimeoutNotification=Rte_COMCbkRxTOut_VcuRxMsg2_Sig1_oVcuRxMsg2_oTC37X_VCU_CAN00_f7c90378_Rx, ComSystemTemplateSystemSignalRef=VcuRxMsg2_Sig1
        VcuTxMsg2_Sig2_oVcuTxMsg2_oTC37X_VCU_CAN00_c34c25d9_Tx: ComBitPosition=32, ComTimeout=0, ComTransferProperty=PENDING, ComSignalAccess=ACCESS_UNCLEAR, ComHandleId=222, ComSystemTemplateSystemSignalRef=VcuTxMsg2_Sig2
      VcuTxMsg1_oTC37X_VCU_CAN00_954a27ee_Tx (ComIPdu):
        ComIPduDirection = SEND
        ComIPduType = NORMAL
        ComIPduHandleId = 42
        ComIPduSignalProcessing = DEFERRED
        ComIPduCancellationSupport = false
        ComIPduGroupRef = VCU_oTC37X_VCU_CAN00_Tx_f6d10bbf
        ComIPduSignalRef = VcuTxMsg1_Sig0_oVcuTxMsg1_oTC37X_VCU_CAN00_8243b9a9_Tx
        ComIPduSignalRef = VcuTxMsg1_Sig1_oVcuTxMsg1_oTC37X_VCU_CAN00_e144608d_Tx
        ComIPduSignalRef = VcuTxMsg1_Sig2_oVcuTxMsg1_oTC37X_VCU_CAN00_444c0be1_Tx
        ComIPduSignalRef = VcuTxMsg1_Sig3_oVcuTxMsg1_oTC37X_VCU_CAN00_274bd2c5_Tx
        ComPduIdRef = VcuTxMsg1_oTC37X_VCU_CAN00_954a27ee_Tx
        ComIPduMainFunctionRef = ComMainFunctionTx
        ComTxIPdu: ComMinimumDelayTime=0, ComTxIPduUnusedAreasDefault=0
          ComTxModeTrue
            ComTxMode: ComTxModeMode=PERIODIC, ComTxModeTimeOffset=0.1, ComTxModeTimePeriod=0.5
          ComTxModeFalse
            ComTxMode: ComTxModeMode=PERIODIC, ComTxModeTimeOffset=0, ComTxModeTimePeriod=0.5
      3 x ComSignal, all with ComBitSize=16, ComSignalEndianness=LITTLE_ENDIAN, ComSignalInitValue=0, ComSignalType=SINT16, ComSignalAccess=ACCESS_UNCLEAR:
        VcuRxMsg1_Sig1_oVcuRxMsg1_oTC37X_VCU_CAN00_70c92d40_Rx: ComBitPosition=16, ComTimeout=2, ComHandleId=269, ComNotification=Rte_COMCbk_VcuRxMsg1_Sig1_oVcuRxMsg1_oTC37X_VCU_CAN00_70c92d40_Rx, ComTimeoutNotification=Rte_COMCbkRxTOut_VcuRxMsg1_Sig1_oVcuRxMsg1_oTC37X_VCU_CAN00_70c92d40_Rx, ComSystemTemplateSystemSignalRef=VcuRxMsg1_Sig1
        VcuRxMsg1_Sig0_oVcuRxMsg1_oTC37X_VCU_CAN00_13cef464_Rx: ComBitPosition=0, ComTimeout=2, ComHandleId=268, ComNotification=Rte_COMCbk_VcuRxMsg1_Sig0_oVcuRxMsg1_oTC37X_VCU_CAN00_13cef464_Rx, ComTimeoutNotification=Com_Msg200h_Timeout_Notification, ComFirstTimeout=2, ComSystemTemplateSystemSignalRef=VcuRxMsg1_Sig0
        VcuTxMsg1_Sig3_oVcuTxMsg1_oTC37X_VCU_CAN00_274bd2c5_Tx: ComBitPosition=48, ComTimeout=0, ComTransferProperty=PENDING, ComHandleId=219, ComSystemTemplateSystemSignalRef=VcuTxMsg1_Sig3
      VCU_oTC37X_VCU_CAN00_Rx_a08bac39 (ComIPduGroup): ComIPduGroupHandleId=8
      VcuTxMsg2_Sig1_oVcuTxMsg2_oTC37X_VCU_CAN00_66444eb5_Tx (ComSignal):
        ComBitPosition = 16
        ComBitSize = 16
        ComSignalEndianness = LITTLE_ENDIAN
        ComSignalInitValue = 0
        ComSignalType = SINT16
        ComTimeout = 0
        ComTransferProperty = PENDING
        ComSignalAccess = ACCESS_UNCLEAR
        ComHandleId = 221
        ComSystemTemplateSystemSignalRef = VcuTxMsg2_Sig1
      3 x ComIPdu, all with ComIPduType=NORMAL, ComIPduSignalProcessing=DEFERRED, ComIPduCancellationSupport=false:
        VcuRxMsg1_oTC37X_VCU_CAN00_78805594_Rx: ComIPduDirection=RECEIVE, ComIPduHandleId=35, ComIPduGroupRef=VCU_oTC37X_VCU_CAN00_Rx_a08bac39, ComIPduSignalRef=VcuRxMsg1_Sig0_oVcuRxMsg1_oTC37X_VCU_CAN00_13cef464_Rx, ComIPduSignalRef=VcuRxMsg1_Sig1_oVcuRxMsg1_oTC37X_VCU_CAN00_70c92d40_Rx, ComIPduSignalRef=VcuRxMsg1_Sig2_oVcuRxMsg1_oTC37X_VCU_CAN00_d5c1462c_Rx, ComIPduSignalRef=VcuRxMsg1_Sig3_oVcuRxMsg1_oTC37X_VCU_CAN00_b6c69f08_Rx, ComPduIdRef=VcuRxMsg1_oTC37X_VCU_CAN00_78805594_Rx, ComIPduMainFunctionRef=ComMainFunctionRx
        VcuTxMsg2_oTC37X_VCU_CAN00_7fccfa8c_Tx: ComIPduDirection=SEND, ComIPduHandleId=43, ComIPduGroupRef=VCU_oTC37X_VCU_CAN00_Tx_f6d10bbf, ComIPduSignalRef=VcuTxMsg2_Sig0_oVcuTxMsg2_oTC37X_VCU_CAN00_05439791_Tx, ComIPduSignalRef=VcuTxMsg2_Sig1_oVcuTxMsg2_oTC37X_VCU_CAN00_66444eb5_Tx, ComIPduSignalRef=VcuTxMsg2_Sig2_oVcuTxMsg2_oTC37X_VCU_CAN00_c34c25d9_Tx, ComIPduSignalRef=VcuTxMsg2_Sig3_oVcuTxMsg2_oTC37X_VCU_CAN00_a04bfcfd_Tx, ComPduIdRef=VcuTxMsg2_oTC37X_VCU_CAN00_7fccfa8c_Tx, ComIPduMainFunctionRef=ComMainFunctionTx
          ComTxIPdu: ComMinimumDelayTime=0, ComTxIPduUnusedAreasDefault=0
            ComTxModeTrue
              ComTxMode: ComTxModeMode=PERIODIC, ComTxModeTimeOffset=0.1, ComTxModeTimePeriod=0.5
            ComTxModeFalse
              ComTxMode: ComTxModeMode=PERIODIC, ComTxModeTimeOffset=0, ComTxModeTimePeriod=0.5
        VcuRxMsg2_oTC37X_VCU_CAN00_920688f6_Rx: ComIPduDirection=RECEIVE, ComIPduHandleId=36, ComIPduGroupRef=VCU_oTC37X_VCU_CAN00_Rx_a08bac39, ComIPduSignalRef=VcuRxMsg2_Sig0_oVcuRxMsg2_oTC37X_VCU_CAN00_94ceda5c_Rx, ComIPduSignalRef=VcuRxMsg2_Sig1_oVcuRxMsg2_oTC37X_VCU_CAN00_f7c90378_Rx, ComIPduSignalRef=VcuRxMsg2_Sig2_oVcuRxMsg2_oTC37X_VCU_CAN00_52c16814_Rx, ComIPduSignalRef=VcuRxMsg2_Sig3_oVcuRxMsg2_oTC37X_VCU_CAN00_31c6b130_Rx, ComPduIdRef=VcuRxMsg2_oTC37X_VCU_CAN00_920688f6_Rx, ComIPduMainFunctionRef=ComMainFunctionRx
      VcuTxMsg1_Sig0_oVcuTxMsg1_oTC37X_VCU_CAN00_8243b9a9_Tx (ComSignal):
        ComBitPosition = 0
        ComBitSize = 16
        ComSignalEndianness = LITTLE_ENDIAN
        ComSignalInitValue = 0
        ComSignalType = SINT16
        ComTimeout = 0
        ComTransferProperty = PENDING
        ComSignalAccess = ACCESS_UNCLEAR
        ComHandleId = 216
        ComSystemTemplateSystemSignalRef = VcuTxMsg1_Sig0
      VcuRxMsg1_Sig3_oVcuRxMsg1_oTC37X_VCU_CAN00_b6c69f08_Rx (ComSignal):
        ComBitPosition = 48
        ComBitSize = 16
        ComSignalEndianness = LITTLE_ENDIAN
        ComSignalInitValue = 0
        ComSignalType = SINT16
        ComTimeout = 2
        ComSignalAccess = ACCESS_UNCLEAR
        ComHandleId = 271
        ComNotification = Rte_COMCbk_VcuRxMsg1_Sig3_oVcuRxMsg1_oTC37X_VCU_CAN00_b6c69f08_Rx
        ComTimeoutNotification = Rte_COMCbkRxTOut_VcuRxMsg1_Sig3_oVcuRxMsg1_oTC37X_VCU_CAN00_b6c69f08_Rx
        ComSystemTemplateSystemSignalRef = VcuRxMsg1_Sig3
      ComMainFunctionRx: ComMainRxTimeBase=0.01
      ComMainFunctionTx: ComMainTxTimeBase=0.01
      VCU_oTC37X_VCU_CAN01_Rx_1837cb5c (ComIPduGroup): ComIPduGroupHandleId=10
      VCU_oTC37X_VCU_CAN01_Tx_4e6d6cda (ComIPduGroup): ComIPduGroupHandleId=11
      6 x ComSignal, all with ComBitSize=16, ComSignalEndianness=LITTLE_ENDIAN, ComSignalInitValue=0, ComSignalType=SINT16, ComTimeout=0, ComSignalAccess=ACCESS_UNCLEAR:
        VcuRxMsg4_Sig3_oVcuRxMsg4_oTC37X_VCU_CAN01_93b0db97_Rx: ComBitPosition=48, ComHandleId=291, ComSystemTemplateSystemSignalRef=VcuRxMsg4_Sig3
        VcuRxMsg3_Sig1_oVcuRxMsg3_oTC37X_VCU_CAN01_4b1ed439_Rx: ComBitPosition=16, ComHandleId=279, ComSystemTemplateSystemSignalRef=VcuRxMsg3_Sig1
        VcuRxMsg3_Sig3_oVcuRxMsg3_oTC37X_VCU_CAN01_8d116671_Rx: ComBitPosition=48, ComHandleId=283, ComSystemTemplateSystemSignalRef=VcuRxMsg3_Sig3
        VcuRxMsg4_Sig1_oVcuRxMsg4_oTC37X_VCU_CAN01_55bf69df_Rx: ComBitPosition=16, ComHandleId=287, ComSystemTemplateSystemSignalRef=VcuRxMsg4_Sig1
        VcuRxMsg3_Sig2_oVcuRxMsg3_oTC37X_VCU_CAN01_ee16bf55_Rx: ComBitPosition=32, ComHandleId=281, ComSystemTemplateSystemSignalRef=VcuRxMsg3_Sig2
        VcuRxMsg4_Sig2_oVcuRxMsg4_oTC37X_VCU_CAN01_f0b702b3_Rx: ComBitPosition=32, ComHandleId=289, ComSystemTemplateSystemSignalRef=VcuRxMsg4_Sig2
      VcuRxMsg3_oTC37X_VCU_CAN01_0a530e81_Rx (ComIPdu):
        ComIPduDirection = RECEIVE
        ComIPduType = NORMAL
        ComIPduHandleId = 37
        ComIPduSignalProcessing = DEFERRED
        ComIPduCancellationSupport = false
        ComIPduGroupRef = VCU_oTC37X_VCU_CAN01_Rx_1837cb5c
        ComIPduSignalRef = VcuRxMsg3_Sig0_oVcuRxMsg3_oTC37X_VCU_CAN01_28190d1d_Rx
        ComIPduSignalRef = VcuRxMsg3_Sig1_oVcuRxMsg3_oTC37X_VCU_CAN01_4b1ed439_Rx
        ComIPduSignalRef = VcuRxMsg3_Sig2_oVcuRxMsg3_oTC37X_VCU_CAN01_ee16bf55_Rx
        ComIPduSignalRef = VcuRxMsg3_Sig3_oVcuRxMsg3_oTC37X_VCU_CAN01_8d116671_Rx
        ComPduIdRef = VcuRxMsg3_oTC37X_VCU_CAN01_0a530e81_Rx
        ComIPduMainFunctionRef = ComMainFunctionRx
      VcuRxMsg3_Sig0_oVcuRxMsg3_oTC37X_VCU_CAN01_28190d1d_Rx (ComSignal):
        ComBitPosition = 0
        ComBitSize = 16
        ComSignalEndianness = LITTLE_ENDIAN
        ComSignalInitValue = 0
        ComSignalType = SINT16
        ComTimeout = 0
        ComSignalAccess = ACCESS_UNCLEAR
        ComHandleId = 277
        ComSystemTemplateSystemSignalRef = VcuRxMsg3_Sig0
      VcuRxMsg4_Sig0_oVcuRxMsg4_oTC37X_VCU_CAN01_36b8b0fb_Rx (ComSignal):
        ComBitPosition = 0
        ComBitSize = 16
        ComSignalEndianness = LITTLE_ENDIAN
        ComSignalInitValue = 0
        ComSignalType = SINT16
        ComTimeout = 0
        ComSignalAccess = ACCESS_UNCLEAR
        ComHandleId = 285
        ComSystemTemplateSystemSignalRef = VcuRxMsg4_Sig0
      VcuRxMsg4_oTC37X_VCU_CAN01_eb7d04e5_Rx (ComIPdu):
        ComIPduDirection = RECEIVE
        ComIPduType = NORMAL
        ComIPduHandleId = 38
        ComIPduSignalProcessing = DEFERRED
        ComIPduCancellationSupport = false
        ComIPduGroupRef = VCU_oTC37X_VCU_CAN01_Rx_1837cb5c
        ComIPduSignalRef = VcuRxMsg4_Sig0_oVcuRxMsg4_oTC37X_VCU_CAN01_36b8b0fb_Rx
        ComIPduSignalRef = VcuRxMsg4_Sig1_oVcuRxMsg4_oTC37X_VCU_CAN01_55bf69df_Rx
        ComIPduSignalRef = VcuRxMsg4_Sig2_oVcuRxMsg4_oTC37X_VCU_CAN01_f0b702b3_Rx
        ComIPduSignalRef = VcuRxMsg4_Sig3_oVcuRxMsg4_oTC37X_VCU_CAN01_93b0db97_Rx
        ComPduIdRef = VcuRxMsg4_oTC37X_VCU_CAN01_eb7d04e5_Rx
        ComIPduMainFunctionRef = ComMainFunctionRx
      VCU_oLIN00_Rx_4b9dfc53 (ComIPduGroup): ComIPduGroupHandleId=2
      VCU_oLIN00_Tx_1dc75bd5 (ComIPduGroup): ComIPduGroupHandleId=3
      EXT4_Valid_oVcuTxIoMsg2_oTC37X_VCU_CAN00_ced21b28_Tx (ComSignal):
        ComBitPosition = 48
        ComBitSize = 16
        ComSignalEndianness = LITTLE_ENDIAN
        ComSignalInitValue = 0
        ComSignalType = UINT16
        ComTimeout = 0
        ComTransferProperty = PENDING
        ComSignalAccess = ACCESS_UNCLEAR
        ComHandleId = 57
        ComSystemTemplateSystemSignalRef = EXT4_Valid
      EXT_A_IN2_oVcuTxIoMsg1_oTC37X_VCU_CAN00_241cb78c_Tx (ComSignal):
        ComBitPosition = 32
        ComBitSize = 16
        ComSignalEndianness = LITTLE_ENDIAN
        ComSignalInitValue = 0
        ComSignalType = SINT16
        ComTimeout = 0
        ComTransferProperty = PENDING
        ComSignalAccess = ACCESS_UNCLEAR
        ComHandleId = 71
        ComSystemTemplateSystemSignalRef = EXT_A_IN2
      VcuTxIoMsg1_oTC37X_VCU_CAN00_54884add_Tx (ComIPdu):
        ComIPduDirection = SEND
        ComIPduType = NORMAL
        ComIPduHandleId = 34
        ComIPduSignalProcessing = DEFERRED
        ComIPduCancellationSupport = false
        ComIPduGroupRef = VCU_oTC37X_VCU_CAN00_Tx_f6d10bbf
        ComIPduSignalRef = EXT1_Valid_oVcuTxIoMsg1_oTC37X_VCU_CAN00_caf787ea_Tx
        ComIPduSignalRef = EXT2_Valid_oVcuTxIoMsg1_oTC37X_VCU_CAN00_9096b88a_Tx
        ComIPduSignalRef = EXT_A_IN1_oVcuTxIoMsg1_oTC37X_VCU_CAN00_37348eff_Tx
        ComIPduSignalRef = EXT_A_IN2_oVcuTxIoMsg1_oTC37X_VCU_CAN00_241cb78c_Tx
        ComPduIdRef = VcuTxIoMsg1_oTC37X_VCU_CAN00_54884add_Tx
        ComIPduMainFunctionRef = ComMainFunctionTx
        ComTxIPdu: ComMinimumDelayTime=0, ComTxIPduUnusedAreasDefault=0
          ComTxModeTrue
            ComTxMode: ComTxModeMode=PERIODIC, ComTxModeTimeOffset=0, ComTxModeTimePeriod=0.5
          ComTxModeFalse
            ComTxMode: ComTxModeMode=PERIODIC, ComTxModeTimeOffset=0, ComTxModeTimePeriod=0.5
      4 x ComSignal, all with ComBitSize=16, ComSignalEndianness=LITTLE_ENDIAN, ComSignalInitValue=0, ComTimeout=0, ComTransferProperty=PENDING, ComSignalAccess=ACCESS_UNCLEAR:
        EXT_A_IN1_oVcuTxIoMsg1_oTC37X_VCU_CAN00_37348eff_Tx: ComBitPosition=0, ComSignalType=SINT16, ComHandleId=70, ComSystemTemplateSystemSignalRef=EXT_A_IN1
        EXT1_Valid_oVcuTxIoMsg1_oTC37X_VCU_CAN00_caf787ea_Tx: ComBitPosition=16, ComSignalType=UINT16, ComHandleId=54, ComSystemTemplateSystemSignalRef=EXT1_Valid
        EXT_A_IN3_oVcuTxIoMsg2_oTC37X_VCU_CAN00_c07d823f_Tx: ComBitPosition=0, ComSignalType=SINT16, ComHandleId=72, ComSystemTemplateSystemSignalRef=EXT_A_IN3
        EXT2_Valid_oVcuTxIoMsg1_oTC37X_VCU_CAN00_9096b88a_Tx: ComBitPosition=48, ComSignalType=UINT16, ComHandleId=55, ComSystemTemplateSystemSignalRef=EXT2_Valid
      VcuTxIoMsg2_oTC37X_VCU_CAN00_be0e97bf_Tx (ComIPdu):
        ComIPduDirection = SEND
        ComIPduType = NORMAL
        ComIPduHandleId = 35
        ComIPduSignalProcessing = DEFERRED
        ComIPduCancellationSupport = false
        ComIPduGroupRef = VCU_oTC37X_VCU_CAN00_Tx_f6d10bbf
        ComIPduSignalRef = EXT3_Valid_oVcuTxIoMsg2_oTC37X_VCU_CAN00_fae072f7_Tx
        ComIPduSignalRef = EXT4_Valid_oVcuTxIoMsg2_oTC37X_VCU_CAN00_ced21b28_Tx
        ComIPduSignalRef = EXT_A_IN3_oVcuTxIoMsg2_oTC37X_VCU_CAN00_c07d823f_Tx
        ComIPduSignalRef = EXT_A_IN4_oVcuTxIoMsg2_oTC37X_VCU_CAN00_e8ca1808_Tx
        ComPduIdRef = VcuTxIoMsg2_oTC37X_VCU_CAN00_be0e97bf_Tx
        ComIPduMainFunctionRef = ComMainFunctionTx
        ComTxIPdu: ComMinimumDelayTime=0, ComTxIPduUnusedAreasDefault=0
          ComTxModeTrue
            ComTxMode: ComTxModeMode=PERIODIC, ComTxModeTimeOffset=0, ComTxModeTimePeriod=0.5
          ComTxModeFalse
            ComTxMode: ComTxModeMode=PERIODIC, ComTxModeTimeOffset=0, ComTxModeTimePeriod=0.5
      7 x ComSignal, all with ComBitSize=16, ComSignalEndianness=LITTLE_ENDIAN, ComSignalInitValue=0, ComTimeout=0, ComTransferProperty=PENDING, ComSignalAccess=ACCESS_UNCLEAR:
        EXT3_Valid_oVcuTxIoMsg2_oTC37X_VCU_CAN00_fae072f7_Tx: ComBitPosition=16, ComSignalType=UINT16, ComHandleId=56, ComSystemTemplateSystemSignalRef=EXT3_Valid
        EXT_A_IN4_oVcuTxIoMsg2_oTC37X_VCU_CAN00_e8ca1808_Tx: ComBitPosition=32, ComSignalType=SINT16, ComHandleId=73, ComSystemTemplateSystemSignalRef=EXT_A_IN4
        EXT6_Valid_oVcuTxIoMsg3_oTC37X_VCU_CAN00_fb1185b6_Tx: ComBitPosition=48, ComSignalType=UINT16, ComHandleId=59, ComSystemTemplateSystemSignalRef=EXT6_Valid
        EXT16_Valid_oVcuTxIoMsg8_oTC37X_VCU_CAN00_fd3a983d_Tx: ComBitPosition=48, ComSignalType=UINT16, ComHandleId=69, ComSystemTemplateSystemSignalRef=EXT16_Valid
        EXT11_Valid_oVcuTxIoMsg6_oTC37X_VCU_CAN00_d025e36b_Tx: ComBitPosition=16, ComSignalType=UINT16, ComHandleId=64, ComSystemTemplateSystemSignalRef=EXT11_Valid
        EXT_A_IN10_oVcuTxIoMsg5_oTC37X_VCU_CAN00_83e5b725_Tx: ComBitPosition=32, ComSignalType=SINT16, ComHandleId=79, ComSystemTemplateSystemSignalRef=EXT_A_IN10
        EXT5_Valid_oVcuTxIoMsg3_oTC37X_VCU_CAN00_a170bad6_Tx: ComBitPosition=16, ComSignalType=UINT16, ComHandleId=58, ComSystemTemplateSystemSignalRef=EXT5_Valid
      VcuTxIoMsg4_oTC37X_VCU_CAN00_b0722b3a_Tx (ComIPdu):
        ComIPduDirection = SEND
        ComIPduType = NORMAL
        ComIPduHandleId = 37
        ComIPduSignalProcessing = DEFERRED
        ComIPduCancellationSupport = false
        ComIPduGroupRef = VCU_oTC37X_VCU_CAN00_Tx_f6d10bbf
        ComIPduSignalRef = EXT7_Valid_oVcuTxIoMsg4_oTC37X_VCU_CAN00_9acf98cd_Tx
        ComIPduSignalRef = EXT8_Valid_oVcuTxIoMsg4_oTC37X_VCU_CAN00_725b5c6c_Tx
        ComIPduSignalRef = EXT_A_IN7_oVcuTxIoMsg4_oTC37X_VCU_CAN00_f59e9dfe_Tx
        ComIPduSignalRef = EXT_A_IN8_oVcuTxIoMsg4_oTC37X_VCU_CAN00_aa164141_Tx
        ComPduIdRef = VcuTxIoMsg4_oTC37X_VCU_CAN00_b0722b3a_Tx
        ComIPduMainFunctionRef = ComMainFunctionTx
        ComTxIPdu: ComMinimumDelayTime=0, ComTxIPduUnusedAreasDefault=0
          ComTxModeTrue
            ComTxMode: ComTxModeMode=PERIODIC, ComTxModeTimeOffset=0, ComTxModeTimePeriod=0.5
          ComTxModeFalse
            ComTxMode: ComTxModeMode=PERIODIC, ComTxModeTimeOffset=0, ComTxModeTimePeriod=0.5
      EXT13_Valid_oVcuTxIoMsg7_oTC37X_VCU_CAN00_e5e67df5_Tx (ComSignal):
        ComBitPosition = 16
        ComBitSize = 16
        ComSignalEndianness = LITTLE_ENDIAN
        ComSignalInitValue = 0
        ComSignalType = UINT16
        ComTimeout = 0
        ComTransferProperty = PENDING
        ComSignalAccess = ACCESS_UNCLEAR
        ComHandleId = 66
        ComSystemTemplateSystemSignalRef = EXT13_Valid
      VcuTxIoMsg8_oTC37X_VCU_CAN00_ac8b5230_Tx (ComIPdu):
        ComIPduDirection = SEND
        ComIPduType = NORMAL
        ComIPduHandleId = 41
        ComIPduSignalProcessing = DEFERRED
        ComIPduCancellationSupport = false
        ComIPduGroupRef = VCU_oTC37X_VCU_CAN00_Tx_f6d10bbf
        ComIPduSignalRef = EXT15_Valid_oVcuTxIoMsg8_oTC37X_VCU_CAN00_a75ba75d_Tx
        ComIPduSignalRef = EXT16_Valid_oVcuTxIoMsg8_oTC37X_VCU_CAN00_fd3a983d_Tx
        ComIPduSignalRef = EXT_A_IN15_oVcuTxIoMsg8_oTC37X_VCU_CAN00_4536335b_Tx
        ComIPduSignalRef = EXT_A_IN16_oVcuTxIoMsg8_oTC37X_VCU_CAN00_561e0a28_Tx
        ComPduIdRef = VcuTxIoMsg8_oTC37X_VCU_CAN00_ac8b5230_Tx
        ComIPduMainFunctionRef = ComMainFunctionTx
        ComTxIPdu: ComMinimumDelayTime=0, ComTxIPduUnusedAreasDefault=0
          ComTxModeTrue
            ComTxMode: ComTxModeMode=PERIODIC, ComTxModeTimeOffset=0, ComTxModeTimePeriod=0.5
          ComTxModeFalse
            ComTxMode: ComTxModeMode=PERIODIC, ComTxModeTimeOffset=0, ComTxModeTimePeriod=0.5
      9 x ComSignal, all with ComBitSize=16, ComSignalEndianness=LITTLE_ENDIAN, ComSignalInitValue=0, ComTimeout=0, ComTransferProperty=PENDING, ComSignalAccess=ACCESS_UNCLEAR:
        EXT10_Valid_oVcuTxIoMsg5_oTC37X_VCU_CAN00_ba532916_Tx: ComBitPosition=48, ComSignalType=UINT16, ComHandleId=63, ComSystemTemplateSystemSignalRef=EXT10_Valid
        EXT_A_IN6_oVcuTxIoMsg3_oTC37X_VCU_CAN00_1a577f4b_Tx: ComBitPosition=32, ComSignalType=SINT16, ComHandleId=75, ComSystemTemplateSystemSignalRef=EXT_A_IN6
        EXT12_Valid_oVcuTxIoMsg6_oTC37X_VCU_CAN00_8a44dc0b_Tx: ComBitPosition=48, ComSignalType=UINT16, ComHandleId=65, ComSystemTemplateSystemSignalRef=EXT12_Valid
        EXT9_Valid_oVcuTxIoMsg5_oTC37X_VCU_CAN00_1df9fd92_Tx: ComBitPosition=16, ComSignalType=UINT16, ComHandleId=62, ComSystemTemplateSystemSignalRef=EXT9_Valid
        EXT_A_IN12_oVcuTxIoMsg6_oTC37X_VCU_CAN00_74acbbe5_Tx: ComBitPosition=32, ComSignalType=SINT16, ComHandleId=81, ComSystemTemplateSystemSignalRef=EXT_A_IN12
        EXT_A_IN7_oVcuTxIoMsg4_oTC37X_VCU_CAN00_f59e9dfe_Tx: ComBitPosition=0, ComSignalType=SINT16, ComHandleId=76, ComSystemTemplateSystemSignalRef=EXT_A_IN7
        EXT_A_IN13_oVcuTxIoMsg7_oTC37X_VCU_CAN00_9519e5d5_Tx: ComBitPosition=0, ComSignalType=SINT16, ComHandleId=82, ComSystemTemplateSystemSignalRef=EXT_A_IN13
        EXT_A_IN9_oVcuTxIoMsg5_oTC37X_VCU_CAN00_4ba31f71_Tx: ComBitPosition=0, ComSignalType=SINT16, ComHandleId=78, ComSystemTemplateSystemSignalRef=EXT_A_IN9
        EXT7_Valid_oVcuTxIoMsg4_oTC37X_VCU_CAN00_9acf98cd_Tx: ComBitPosition=16, ComSignalType=UINT16, ComHandleId=60, ComSystemTemplateSystemSignalRef=EXT7_Valid
      VcuTxIoMsg5_oTC37X_VCU_CAN00_5f209ddb_Tx (ComIPdu):
        ComIPduDirection = SEND
        ComIPduType = NORMAL
        ComIPduHandleId = 38
        ComIPduSignalProcessing = DEFERRED
        ComIPduCancellationSupport = false
        ComIPduGroupRef = VCU_oTC37X_VCU_CAN00_Tx_f6d10bbf
        ComIPduSignalRef = EXT10_Valid_oVcuTxIoMsg5_oTC37X_VCU_CAN00_ba532916_Tx
        ComIPduSignalRef = EXT9_Valid_oVcuTxIoMsg5_oTC37X_VCU_CAN00_1df9fd92_Tx
        ComIPduSignalRef = EXT_A_IN10_oVcuTxIoMsg5_oTC37X_VCU_CAN00_83e5b725_Tx
        ComIPduSignalRef = EXT_A_IN9_oVcuTxIoMsg5_oTC37X_VCU_CAN00_4ba31f71_Tx
        ComPduIdRef = VcuTxIoMsg5_oTC37X_VCU_CAN00_5f209ddb_Tx
        ComIPduMainFunctionRef = ComMainFunctionTx
        ComTxIPdu: ComMinimumDelayTime=0, ComTxIPduUnusedAreasDefault=0
          ComTxModeTrue
            ComTxMode: ComTxModeMode=PERIODIC, ComTxModeTimeOffset=0, ComTxModeTimePeriod=0.5
          ComTxModeFalse
            ComTxMode: ComTxModeMode=PERIODIC, ComTxModeTimeOffset=0, ComTxModeTimePeriod=0.5
      EXT_A_IN11_oVcuTxIoMsg6_oTC37X_VCU_CAN00_67848296_Tx (ComSignal):
        ComBitPosition = 0
        ComBitSize = 16
        ComSignalEndianness = LITTLE_ENDIAN
        ComSignalInitValue = 0
        ComSignalType = SINT16
        ComTimeout = 0
        ComTransferProperty = PENDING
        ComSignalAccess = ACCESS_UNCLEAR
        ComHandleId = 80
        ComSystemTemplateSystemSignalRef = EXT_A_IN11
      EXT_A_IN14_oVcuTxIoMsg7_oTC37X_VCU_CAN00_bdae7fe2_Tx (ComSignal):
        ComBitPosition = 32
        ComBitSize = 16
        ComSignalEndianness = LITTLE_ENDIAN
        ComSignalInitValue = 0
        ComSignalType = SINT16
        ComTimeout = 0
        ComTransferProperty = PENDING
        ComSignalAccess = ACCESS_UNCLEAR
        ComHandleId = 83
        ComSystemTemplateSystemSignalRef = EXT_A_IN14
      VcuTxIoMsg3_oTC37X_VCU_CAN00_515c215e_Tx (ComIPdu):
        ComIPduDirection = SEND
        ComIPduType = NORMAL
        ComIPduHandleId = 36
        ComIPduSignalProcessing = DEFERRED
        ComIPduCancellationSupport = false
        ComIPduGroupRef = VCU_oTC37X_VCU_CAN00_Tx_f6d10bbf
        ComIPduSignalRef = EXT5_Valid_oVcuTxIoMsg3_oTC37X_VCU_CAN00_a170bad6_Tx
        ComIPduSignalRef = EXT6_Valid_oVcuTxIoMsg3_oTC37X_VCU_CAN00_fb1185b6_Tx
        ComIPduSignalRef = EXT_A_IN5_oVcuTxIoMsg3_oTC37X_VCU_CAN00_097f4638_Tx
        ComIPduSignalRef = EXT_A_IN6_oVcuTxIoMsg3_oTC37X_VCU_CAN00_1a577f4b_Tx
        ComPduIdRef = VcuTxIoMsg3_oTC37X_VCU_CAN00_515c215e_Tx
        ComIPduMainFunctionRef = ComMainFunctionTx
        ComTxIPdu: ComMinimumDelayTime=0, ComTxIPduUnusedAreasDefault=0
          ComTxModeTrue
            ComTxMode: ComTxModeMode=PERIODIC, ComTxModeTimeOffset=0, ComTxModeTimePeriod=0.5
          ComTxModeFalse
            ComTxMode: ComTxModeMode=PERIODIC, ComTxModeTimeOffset=0, ComTxModeTimePeriod=0.5
      7 x ComSignal, all with ComBitSize=16, ComSignalEndianness=LITTLE_ENDIAN, ComSignalInitValue=0, ComTimeout=0, ComTransferProperty=PENDING, ComSignalAccess=ACCESS_UNCLEAR:
        EXT14_Valid_oVcuTxIoMsg7_oTC37X_VCU_CAN00_d1d4142a_Tx: ComBitPosition=48, ComSignalType=UINT16, ComHandleId=67, ComSystemTemplateSystemSignalRef=EXT14_Valid
        EXT15_Valid_oVcuTxIoMsg8_oTC37X_VCU_CAN00_a75ba75d_Tx: ComBitPosition=16, ComSignalType=UINT16, ComHandleId=68, ComSystemTemplateSystemSignalRef=EXT15_Valid
        EXT_A_IN5_oVcuTxIoMsg3_oTC37X_VCU_CAN00_097f4638_Tx: ComBitPosition=0, ComSignalType=SINT16, ComHandleId=74, ComSystemTemplateSystemSignalRef=EXT_A_IN5
        EXT_A_IN8_oVcuTxIoMsg4_oTC37X_VCU_CAN00_aa164141_Tx: ComBitPosition=32, ComSignalType=SINT16, ComHandleId=77, ComSystemTemplateSystemSignalRef=EXT_A_IN8
        EXT_A_IN16_oVcuTxIoMsg8_oTC37X_VCU_CAN00_561e0a28_Tx: ComBitPosition=32, ComSignalType=SINT16, ComHandleId=85, ComSystemTemplateSystemSignalRef=EXT_A_IN16
        EXT8_Valid_oVcuTxIoMsg4_oTC37X_VCU_CAN00_725b5c6c_Tx: ComBitPosition=48, ComSignalType=UINT16, ComHandleId=61, ComSystemTemplateSystemSignalRef=EXT8_Valid
        EXT_A_IN15_oVcuTxIoMsg8_oTC37X_VCU_CAN00_4536335b_Tx: ComBitPosition=0, ComSignalType=SINT16, ComHandleId=84, ComSystemTemplateSystemSignalRef=EXT_A_IN15
      VcuTxIoMsg7_oTC37X_VCU_CAN00_5af4f658_Tx (ComIPdu):
        ComIPduDirection = SEND
        ComIPduType = NORMAL
        ComIPduHandleId = 40
        ComIPduSignalProcessing = DEFERRED
        ComIPduCancellationSupport = false
        ComIPduGroupRef = VCU_oTC37X_VCU_CAN00_Tx_f6d10bbf
        ComIPduSignalRef = EXT13_Valid_oVcuTxIoMsg7_oTC37X_VCU_CAN00_e5e67df5_Tx
        ComIPduSignalRef = EXT14_Valid_oVcuTxIoMsg7_oTC37X_VCU_CAN00_d1d4142a_Tx
        ComIPduSignalRef = EXT_A_IN13_oVcuTxIoMsg7_oTC37X_VCU_CAN00_9519e5d5_Tx
        ComIPduSignalRef = EXT_A_IN14_oVcuTxIoMsg7_oTC37X_VCU_CAN00_bdae7fe2_Tx
        ComPduIdRef = VcuTxIoMsg7_oTC37X_VCU_CAN00_5af4f658_Tx
        ComIPduMainFunctionRef = ComMainFunctionTx
        ComTxIPdu: ComMinimumDelayTime=0, ComTxIPduUnusedAreasDefault=0
          ComTxModeTrue
            ComTxMode: ComTxModeMode=PERIODIC, ComTxModeTimeOffset=0, ComTxModeTimePeriod=0.5
          ComTxModeFalse
            ComTxMode: ComTxModeMode=PERIODIC, ComTxModeTimeOffset=0, ComTxModeTimePeriod=0.5
      VcuTxIoMsg6_oTC37X_VCU_CAN00_b5a640b9_Tx (ComIPdu):
        ComIPduDirection = SEND
        ComIPduType = NORMAL
        ComIPduHandleId = 39
        ComIPduSignalProcessing = DEFERRED
        ComIPduCancellationSupport = false
        ComIPduGroupRef = VCU_oTC37X_VCU_CAN00_Tx_f6d10bbf
        ComIPduSignalRef = EXT11_Valid_oVcuTxIoMsg6_oTC37X_VCU_CAN00_d025e36b_Tx
        ComIPduSignalRef = EXT12_Valid_oVcuTxIoMsg6_oTC37X_VCU_CAN00_8a44dc0b_Tx
        ComIPduSignalRef = EXT_A_IN11_oVcuTxIoMsg6_oTC37X_VCU_CAN00_67848296_Tx
        ComIPduSignalRef = EXT_A_IN12_oVcuTxIoMsg6_oTC37X_VCU_CAN00_74acbbe5_Tx
        ComPduIdRef = VcuTxIoMsg6_oTC37X_VCU_CAN00_b5a640b9_Tx
        ComIPduMainFunctionRef = ComMainFunctionTx
        ComTxIPdu: ComMinimumDelayTime=0, ComTxIPduUnusedAreasDefault=0
          ComTxModeTrue
            ComTxMode: ComTxModeMode=PERIODIC, ComTxModeTimeOffset=0, ComTxModeTimePeriod=0.5
          ComTxModeFalse
            ComTxMode: ComTxModeMode=PERIODIC, ComTxModeTimeOffset=0, ComTxModeTimePeriod=0.5
      TCU_HVCH_heating_rq_oTCU_HVCH_Cmd_oLIN00_5e3a32b2_Tx (ComSignal):
        ComBitPosition = 0
        ComBitSize = 7
        ComSignalEndianness = LITTLE_ENDIAN
        ComSignalInitValue = 0
        ComSignalType = UINT8
        ComSignalAccess = ACCESS_UNCLEAR
        ComHandleId = 192
        ComTransferProperty = PENDING
        ComSystemTemplateSystemSignalRef = TCU_HVCH_heating_rq
      VCU_EXV_1_oLIN00_50eec975_Tx (ComIPdu):
        ComIPduDirection = SEND
        ComIPduType = NORMAL
        ComIPduHandleId = 9
        ComIPduSignalProcessing = DEFERRED
        ComIPduCancellationSupport = false
        ComIPduGroupRef = VCU_oLIN00_Tx_1dc75bd5
        ComIPduSignalRef = TMM_EXV1_EnableRequest_oVCU_EXV_1_oLIN00_d988d266_Tx
        ComIPduSignalRef = TMM_EXV1_PositionRequest_oVCU_EXV_1_oLIN00_cbd2de27_Tx
        ComIPduSignalRef = TMM_EXV1_initRequest_oVCU_EXV_1_oLIN00_082350ea_Tx
        ComPduIdRef = VCU_EXV_1_oLIN00_50eec975_Tx
        ComIPduMainFunctionRef = ComMainFunctionTx
        ComTxIPdu: ComTxIPduUnusedAreasDefault=255, ComMinimumDelayTime=0
          ComTxModeTrue
            ComTxMode: ComTxModeMode=NONE
          ComTxModeFalse
            ComTxMode: ComTxModeMode=NONE
      HVCH_LIN_Flt_oHVCH_Rsp01_oLIN00_9aaa25bf_Rx (ComSignal):
        ComBitPosition = 44
        ComBitSize = 1
        ComSignalEndianness = LITTLE_ENDIAN
        ComSignalInitValue = 0
        ComSignalType = BOOLEAN
        ComSignalAccess = ACCESS_UNCLEAR
        ComHandleId = 36
        ComSystemTemplateSystemSignalRef = HVCH_LIN_Flt
      TCU_HVCH_Cmd_oLIN00_385d5651_Tx (ComIPdu):
        ComIPduDirection = SEND
        ComIPduType = NORMAL
        ComIPduHandleId = 2
        ComIPduSignalProcessing = DEFERRED
        ComIPduCancellationSupport = false
        ComIPduGroupRef = VCU_oLIN00_Tx_1dc75bd5
        ComIPduSignalRef = TCU_HVCHMaxPowerLimit_oTCU_HVCH_Cmd_oLIN00_4bc53e0b_Tx
        ComIPduSignalRef = TCU_HVCH_On_Rq_oTCU_HVCH_Cmd_oLIN00_9f442eaf_Tx
        ComIPduSignalRef = TCU_HVCH_TmaxLim_output_oTCU_HVCH_Cmd_oLIN00_5e45d521_Tx
        ComIPduSignalRef = TCU_HVCH_heating_rq_oTCU_HVCH_Cmd_oLIN00_5e3a32b2_Tx
        ComPduIdRef = TCU_HVCH_Cmd_oLIN00_385d5651_Tx
        ComIPduMainFunctionRef = ComMainFunctionTx
        ComTxIPdu: ComTxIPduUnusedAreasDefault=255, ComMinimumDelayTime=0
          ComTxModeTrue
            ComTxMode: ComTxModeMode=NONE
          ComTxModeFalse
            ComTxMode: ComTxModeMode=NONE
      EXV_2_VCU_oLIN00_1e4a3daf_Rx (ComIPdu):
        ComIPduDirection = RECEIVE
        ComIPduType = NORMAL
        ComIPduHandleId = 10
        ComIPduSignalProcessing = DEFERRED
        ComIPduCancellationSupport = false
        ComIPduGroupRef = VCU_oLIN00_Rx_4b9dfc53
        ComIPduSignalRef = EXV2_CurrentInitState_oEXV_2_VCU_oLIN00_adb498ec_Rx
        ComIPduSignalRef = EXV2_CurrentPosition_oEXV_2_VCU_oLIN00_91e32486_Rx
        ComIPduSignalRef = EXV2_FaultState_oEXV_2_VCU_oLIN00_41c0e318_Rx
        ComIPduSignalRef = EXV2_ResponseError_oEXV_2_VCU_oLIN00_e747f934_Rx
        ComIPduSignalRef = EXV2_RunState_oEXV_2_VCU_oLIN00_859c8088_Rx
        ComIPduSignalRef = EXV2_TemperatureWarn_oEXV_2_VCU_oLIN00_5f7c92a2_Rx
        ComIPduSignalRef = EXV2_VoltageState_oEXV_2_VCU_oLIN00_8f3a2738_Rx
        ComPduIdRef = EXV_2_VCU_oLIN00_1e4a3daf_Rx
        ComIPduMainFunctionRef = ComMainFunctionRx
      13 x ComSignal, all with ComSignalEndianness=LITTLE_ENDIAN, ComSignalAccess=ACCESS_UNCLEAR:
        HVCH_Status_oHVCH_Rsp01_oLIN00_60afdc75_Rx: ComBitPosition=32, ComBitSize=3, ComSignalInitValue=0, ComSignalType=UINT8, ComHandleId=40, ComSystemTemplateSystemSignalRef=HVCH_Status
        EXV2_Fault_Stat_oEXV2_Status_oLIN00_ab6350b6_Rx: ComBitPosition=8, ComBitSize=4, ComSignalInitValue=0, ComSignalType=UINT8, ComHandleId=18, ComSystemTemplateSystemSignalRef=EXV2_Fault_Stat
        HVCH_DutyCycle_oHVCH_Rsp01_oLIN00_ad1e6a22_Rx: ComBitPosition=24, ComBitSize=8, ComSignalInitValue=50, ComSignalType=UINT8, ComHandleId=29, ComSystemTemplateSystemSignalRef=HVCH_DutyCycle
        Breakage_Fault_STA_oSVA_VCU_STD_oLIN00_a3ac9cf8_Rx: ComBitPosition=3, ComBitSize=1, ComSignalInitValue=0, ComSignalType=BOOLEAN, ComHandleId=2, ComSystemTemplateSystemSignalRef=Breakage_Fault_STA
        PMP3_PumpPowerSta_oPMP3_Sts_oLIN00_884db7a7_Rx: ComBitPosition=4, ComBitSize=2, ComSignalInitValue=0, ComSignalType=UINT8, ComHandleId=55, ComSystemTemplateSystemSignalRef=PMP3_PumpPowerSta
        Act_Pos_sta_oSVA_VCU_STD_oLIN00_642c9ffa_Rx: ComBitPosition=8, ComBitSize=12, ComSignalInitValue=0, ComSignalType=UINT16, ComHandleId=0, ComSystemTemplateSystemSignalRef=Act_Pos_sta
        EXV2_RunState_oEXV_2_VCU_oLIN00_859c8088_Rx: ComBitPosition=3, ComBitSize=1, ComSignalInitValue=0, ComSignalType=BOOLEAN, ComHandleId=22, ComSystemTemplateSystemSignalRef=EXV2_RunState
        PMP2_PumpMotorSta_oPMP2_Sts_oLIN00_d6d3ab88_Rx: ComBitPosition=1, ComBitSize=2, ComSignalInitValue=0, ComSignalType=UINT8, ComHandleId=47, ComSystemTemplateSystemSignalRef=PMP2_PumpMotorSta
        Target_Pos_cmd_oVCU_SVA_CMD_oLIN00_b87f26ef_Tx: ComBitPosition=16, ComBitSize=12, ComSignalInitValue=0, ComSignalType=UINT16, ComHandleId=199, ComTransferProperty=PENDING, ComSystemTemplateSystemSignalRef=Target_Pos_cmd
        PMP2_PumpTempSta_oPMP2_Sts_oLIN00_81f2fa55_Rx: ComBitPosition=6, ComBitSize=2, ComSignalInitValue=0, ComSignalType=UINT8, ComHandleId=49, ComSystemTemplateSystemSignalRef=PMP2_PumpTempSta
        TMM_EXV1_PositionRequest_oVCU_EXV_1_oLIN00_cbd2de27_Tx: ComBitPosition=0, ComBitSize=16, ComSignalInitValue=0, ComSignalType=UINT16, ComHandleId=194, ComTransferProperty=PENDING, ComSystemTemplateSystemSignalRef=TMM_EXV1_PositionRequest
        EXV2_CurrentInitState_oEXV_2_VCU_oLIN00_adb498ec_Rx: ComBitPosition=1, ComBitSize=2, ComSignalInitValue=0, ComSignalType=UINT8, ComHandleId=15, ComSystemTemplateSystemSignalRef=EXV2_CurrentInitState
        EXV1_ResponseError_oEXV_1_VCU_oLIN00_cbce9ad1_Rx: ComBitPosition=0, ComBitSize=1, ComSignalInitValue=0, ComSignalType=BOOLEAN, ComHandleId=11, ComSystemTemplateSystemSignalRef=EXV1_ResponseError
      PMP_Cmd_oLIN00_3912b28b_Tx (ComIPdu):
        ComIPduDirection = SEND
        ComIPduType = NORMAL
        ComIPduHandleId = 1
        ComIPduSignalProcessing = DEFERRED
        ComIPduCancellationSupport = false
        ComIPduGroupRef = VCU_oLIN00_Tx_1dc75bd5
        ComIPduSignalRef = ECC_PMP2_SpdSet_oPMP_Cmd_oLIN00_8cabc4b7_Tx
        ComIPduSignalRef = ECC_PMP3_SpdSet_oPMP_Cmd_oLIN00_0d8ea190_Tx
        ComPduIdRef = PMP_Cmd_oLIN00_3912b28b_Tx
        ComIPduMainFunctionRef = ComMainFunctionTx
        ComTxIPdu: ComTxIPduUnusedAreasDefault=255, ComMinimumDelayTime=0
          ComTxModeTrue
            ComTxMode: ComTxModeMode=NONE
          ComTxModeFalse
            ComTxMode: ComTxModeMode=NONE
      4 x ComSignal, all with ComSignalEndianness=LITTLE_ENDIAN, ComSignalInitValue=0, ComSignalType=UINT8, ComSignalAccess=ACCESS_UNCLEAR:
        HVCH_CurrSens_Flt_oHVCH_Rsp01_oLIN00_09f7bc74_Rx: ComBitPosition=56, ComBitSize=5, ComHandleId=28, ComSystemTemplateSystemSignalRef=HVCH_CurrSens_Flt
        ECC_PMP2_SpdSet_oPMP_Cmd_oLIN00_8cabc4b7_Tx: ComBitPosition=8, ComBitSize=8, ComHandleId=49, ComTransferProperty=PENDING, ComSystemTemplateSystemSignalRef=ECC_PMP2_SpdSet
        Calibration_sta_oSVA_VCU_STD_oLIN00_dcb4af08_Rx: ComBitPosition=0, ComBitSize=2, ComHandleId=7, ComSystemTemplateSystemSignalRef=Calibration_sta
        EXV1_FaultState_oEXV_1_VCU_oLIN00_72ff14f0_Rx: ComBitPosition=4, ComBitSize=4, ComHandleId=10, ComSystemTemplateSystemSignalRef=EXV1_FaultState
      EDCU_EXV2_oLIN00_1f8750a5_Tx (ComIPdu):
        ComIPduDirection = SEND
        ComIPduType = NORMAL
        ComIPduHandleId = 0
        ComIPduSignalProcessing = DEFERRED
        ComIPduCancellationSupport = false
        ComIPduGroupRef = VCU_oLIN00_Tx_1dc75bd5
        ComIPduSignalRef = EDCU_EXV2_Cmd_Init_Rq_oEDCU_EXV2_oLIN00_0144aec9_Tx
        ComIPduSignalRef = EDCU_EXV2_Cmd_Move_Enbl_oEDCU_EXV2_oLIN00_d6797517_Tx
        ComIPduSignalRef = EDCU_EXV2_Cmd_Set_Rq_oEDCU_EXV2_oLIN00_66e5876a_Tx
        ComPduIdRef = EDCU_EXV2_oLIN00_1f8750a5_Tx
        ComIPduMainFunctionRef = ComMainFunctionTx
        ComTxIPdu: ComTxIPduUnusedAreasDefault=255, ComMinimumDelayTime=0
          ComTxModeTrue
            ComTxMode: ComTxModeMode=NONE
          ComTxModeFalse
            ComTxMode: ComTxModeMode=NONE
      4 x ComSignal, all with ComSignalEndianness=LITTLE_ENDIAN, ComSignalInitValue=0, ComSignalAccess=ACCESS_UNCLEAR:
        HVCH_defectHeaterCircuits_oHVCH_Rsp01_oLIN00_61948e74_Rx: ComBitPosition=35, ComBitSize=3, ComSignalType=UINT8, ComHandleId=43, ComSystemTemplateSystemSignalRef=HVCH_defectHeaterCircuits
        RsErr_EXV2_oEXV2_Status_oLIN00_5c35655a_Rx: ComBitPosition=0, ComBitSize=1, ComSignalType=BOOLEAN, ComHandleId=59, ComSystemTemplateSystemSignalRef=RsErr_EXV2
        HVCH_HV_Voltage_Valid_oHVCH_Rsp01_oLIN00_2914831e_Rx: ComBitPosition=40, ComBitSize=2, ComSignalType=UINT8, ComHandleId=32, ComSystemTemplateSystemSignalRef=HVCH_HV_Voltage_Valid
        PMP2_PumpDryRunningSta_oPMP2_Sts_oLIN00_3e217a22_Rx: ComBitPosition=3, ComBitSize=1, ComSignalType=BOOLEAN, ComHandleId=45, ComSystemTemplateSystemSignalRef=PMP2_PumpDryRunningSta
      VCU_EXV_2_oLIN00_de61ce96_Tx (ComIPdu):
        ComIPduDirection = SEND
        ComIPduType = NORMAL
        ComIPduHandleId = 10
        ComIPduSignalProcessing = DEFERRED
        ComIPduCancellationSupport = false
        ComIPduGroupRef = VCU_oLIN00_Tx_1dc75bd5
        ComIPduSignalRef = TMM_EXV2_EnableRequest_oVCU_EXV_2_oLIN00_0c106490_Tx
        ComIPduSignalRef = TMM_EXV2_PositionRequest_oVCU_EXV_2_oLIN00_ce8ee7dd_Tx
        ComIPduSignalRef = TMM_EXV2_initRequest_oVCU_EXV_2_oLIN00_95846e7a_Tx
        ComPduIdRef = VCU_EXV_2_oLIN00_de61ce96_Tx
        ComIPduMainFunctionRef = ComMainFunctionTx
        ComTxIPdu: ComTxIPduUnusedAreasDefault=255, ComMinimumDelayTime=0
          ComTxModeTrue
            ComTxMode: ComTxModeMode=NONE
          ComTxModeFalse
            ComTxMode: ComTxModeMode=NONE
      5 x ComSignal, all with ComSignalEndianness=LITTLE_ENDIAN, ComSignalInitValue=0, ComSignalAccess=ACCESS_UNCLEAR:
        EXV2_TemperatureWarn_oEXV_2_VCU_oLIN00_5f7c92a2_Rx: ComBitPosition=10, ComBitSize=2, ComSignalType=UINT8, ComHandleId=24, ComSystemTemplateSystemSignalRef=EXV2_TemperatureWarn
        HVCH_Off_ShrtCurr_oHVCH_Rsp01_oLIN00_bf58ab45_Rx: ComBitPosition=46, ComBitSize=1, ComSignalType=BOOLEAN, ComHandleId=38, ComSystemTemplateSystemSignalRef=HVCH_Off_ShrtCurr
        LIN_Resp_Error_sta_oSVA_VCU_STD_oLIN00_47f7ca93_Rx: ComBitPosition=32, ComBitSize=1, ComSignalType=BOOLEAN, ComHandleId=44, ComSystemTemplateSystemSignalRef=LIN_Resp_Error_sta
        EXV1_CurrentInitState_oEXV_1_VCU_oLIN00_beca31e2_Rx: ComBitPosition=1, ComBitSize=2, ComSignalType=UINT8, ComHandleId=8, ComSystemTemplateSystemSignalRef=EXV1_CurrentInitState
        HVCH_TempSens_Flt_oHVCH_Rsp01_oLIN00_66cb2c71_Rx: ComBitPosition=42, ComBitSize=1, ComSignalType=BOOLEAN, ComHandleId=42, ComSystemTemplateSystemSignalRef=HVCH_TempSens_Flt
      EXV2_Status_oLIN00_d5e93929_Rx (ComIPdu):
        ComIPduDirection = RECEIVE
        ComIPduType = NORMAL
        ComIPduHandleId = 8
        ComIPduSignalProcessing = DEFERRED
        ComIPduCancellationSupport = false
        ComIPduGroupRef = VCU_oLIN00_Rx_4b9dfc53
        ComIPduSignalRef = EXV2_Fault_Stat_oEXV2_Status_oLIN00_ab6350b6_Rx
        ComIPduSignalRef = EXV2_OvrTemp_Warn_oEXV2_Status_oLIN00_ba77659e_Rx
        ComIPduSignalRef = EXV2_Pos_oEXV2_Status_oLIN00_da80603b_Rx
        ComIPduSignalRef = EXV2_Run_Stat_oEXV2_Status_oLIN00_0e992e12_Rx
        ComIPduSignalRef = EXV2_Volt_Stat_oEXV2_Status_oLIN00_c8727eb0_Rx
        ComIPduSignalRef = EXV2_curInit_Stat_oEXV2_Status_oLIN00_b0ace0f5_Rx
        ComIPduSignalRef = RsErr_EXV2_oEXV2_Status_oLIN00_5c35655a_Rx
        ComPduIdRef = EXV2_Status_oLIN00_d5e93929_Rx
        ComIPduMainFunctionRef = ComMainFunctionRx
      3 x ComSignal, all with ComSignalEndianness=LITTLE_ENDIAN, ComSignalInitValue=0, ComSignalAccess=ACCESS_UNCLEAR:
        TMM_EXV2_initRequest_oVCU_EXV_2_oLIN00_95846e7a_Tx: ComBitPosition=24, ComBitSize=3, ComSignalType=UINT8, ComHandleId=198, ComTransferProperty=PENDING, ComSystemTemplateSystemSignalRef=TMM_EXV2_initRequest
        EXV2_VoltageState_oEXV_2_VCU_oLIN00_8f3a2738_Rx: ComBitPosition=8, ComBitSize=2, ComSignalType=UINT8, ComHandleId=26, ComSystemTemplateSystemSignalRef=EXV2_VoltageState
        EXV2_Run_Stat_oEXV2_Status_oLIN00_0e992e12_Rx: ComBitPosition=4, ComBitSize=1, ComSignalType=BOOLEAN, ComHandleId=23, ComSystemTemplateSystemSignalRef=EXV2_Run_Stat
      EXV_1_VCU_oLIN00_69d4ef5f_Rx (ComIPdu):
        ComIPduDirection = RECEIVE
        ComIPduType = NORMAL
        ComIPduHandleId = 9
        ComIPduSignalProcessing = DEFERRED
        ComIPduCancellationSupport = false
        ComIPduGroupRef = VCU_oLIN00_Rx_4b9dfc53
        ComIPduSignalRef = EXV1_CurrentInitState_oEXV_1_VCU_oLIN00_beca31e2_Rx
        ComIPduSignalRef = EXV1_CurrentPosition_oEXV_1_VCU_oLIN00_6daec86f_Rx
        ComIPduSignalRef = EXV1_FaultState_oEXV_1_VCU_oLIN00_72ff14f0_Rx
        ComIPduSignalRef = EXV1_ResponseError_oEXV_1_VCU_oLIN00_cbce9ad1_Rx
        ComIPduSignalRef = EXV1_RunState_oEXV_1_VCU_oLIN00_f0dc555f_Rx
        ComIPduSignalRef = EXV1_TemperatureWarn_oEXV_1_VCU_oLIN00_a3317e4b_Rx
        ComIPduSignalRef = EXV1_VoltageState_oEXV_1_VCU_oLIN00_31bbfd77_Rx
        ComPduIdRef = EXV_1_VCU_oLIN00_69d4ef5f_Rx
        ComIPduMainFunctionRef = ComMainFunctionRx
      6 x ComSignal, all with ComSignalEndianness=LITTLE_ENDIAN, ComSignalInitValue=0, ComSignalAccess=ACCESS_UNCLEAR:
        HVCH_TempLim_oHVCH_Rsp01_oLIN00_d22e6add_Rx: ComBitPosition=43, ComBitSize=1, ComSignalType=BOOLEAN, ComHandleId=41, ComSystemTemplateSystemSignalRef=HVCH_TempLim
        EDCU_EXV2_Cmd_Move_Enbl_oEDCU_EXV2_oLIN00_d6797517_Tx: ComBitPosition=16, ComBitSize=1, ComSignalType=BOOLEAN, ComHandleId=52, ComTransferProperty=PENDING, ComSystemTemplateSystemSignalRef=EDCU_EXV2_Cmd_Move_Enbl
        TCU_HVCH_TmaxLim_output_oTCU_HVCH_Cmd_oLIN00_5e45d521_Tx: ComBitPosition=24, ComBitSize=8, ComSignalType=UINT8, ComHandleId=191, ComTransferProperty=PENDING, ComSystemTemplateSystemSignalRef=TCU_HVCH_TmaxLim_output
        EXV1_CurrentPosition_oEXV_1_VCU_oLIN00_6daec86f_Rx: ComBitPosition=16, ComBitSize=16, ComSignalType=UINT16, ComHandleId=9, ComSystemTemplateSystemSignalRef=EXV1_CurrentPosition
        PMP3_PumpInputVolt_oPMP3_Sts_oLIN00_75dfecf6_Rx: ComBitPosition=8, ComBitSize=8, ComSignalType=UINT8, ComHandleId=53, ComSystemTemplateSystemSignalRef=PMP3_PumpInputVolt
        EXV1_VoltageState_oEXV_1_VCU_oLIN00_31bbfd77_Rx: ComBitPosition=8, ComBitSize=2, ComSignalType=UINT8, ComHandleId=14, ComSystemTemplateSystemSignalRef=EXV1_VoltageState
      PMP3_Sts_oLIN00_511c4704_Rx (ComIPdu):
        ComIPduDirection = RECEIVE
        ComIPduType = NORMAL
        ComIPduHandleId = 25
        ComIPduSignalProcessing = DEFERRED
        ComIPduCancellationSupport = false
        ComIPduGroupRef = VCU_oLIN00_Rx_4b9dfc53
        ComIPduSignalRef = PMP3_PumpDryRunningSta_oPMP3_Sts_oLIN00_30f4e2d8_Rx
        ComIPduSignalRef = PMP3_PumpInputVolt_oPMP3_Sts_oLIN00_75dfecf6_Rx
        ComIPduSignalRef = PMP3_PumpMotorSta_oPMP3_Sts_oLIN00_43910f36_Rx
        ComIPduSignalRef = PMP3_PumpPowerSta_oPMP3_Sts_oLIN00_884db7a7_Rx
        ComIPduSignalRef = PMP3_PumpTempSta_oPMP3_Sts_oLIN00_26375532_Rx
        ComIPduSignalRef = PMP3_RESP_ERROR_oPMP3_Sts_oLIN00_9f14f3a0_Rx
        ComIPduSignalRef = PMP3_RealRPM_oPMP3_Sts_oLIN00_fa6fbf8a_Rx
        ComPduIdRef = PMP3_Sts_oLIN00_511c4704_Rx
        ComIPduMainFunctionRef = ComMainFunctionRx
      9 x ComSignal, all with ComSignalEndianness=LITTLE_ENDIAN, ComSignalInitValue=0, ComSignalAccess=ACCESS_UNCLEAR:
        TCU_HVCHMaxPowerLimit_oTCU_HVCH_Cmd_oLIN00_4bc53e0b_Tx: ComBitPosition=16, ComBitSize=8, ComSignalType=UINT8, ComHandleId=189, ComTransferProperty=PENDING, ComSystemTemplateSystemSignalRef=TCU_HVCHMaxPowerLimit
        ECC_PMP3_SpdSet_oPMP_Cmd_oLIN00_0d8ea190_Tx: ComBitPosition=16, ComBitSize=8, ComSignalType=UINT8, ComHandleId=50, ComTransferProperty=PENDING, ComSystemTemplateSystemSignalRef=ECC_PMP3_SpdSet
        TCU_HVCH_On_Rq_oTCU_HVCH_Cmd_oLIN00_9f442eaf_Tx: ComBitPosition=8, ComBitSize=2, ComSignalDataInvalidValue=3, ComSignalType=UINT8, ComHandleId=190, ComTransferProperty=PENDING, ComSystemTemplateSystemSignalRef=TCU_HVCH_On_Rq
        TMM_EXV2_PositionRequest_oVCU_EXV_2_oLIN00_ce8ee7dd_Tx: ComBitPosition=0, ComBitSize=16, ComSignalType=UINT16, ComHandleId=197, ComTransferProperty=PENDING, ComSystemTemplateSystemSignalRef=TMM_EXV2_PositionRequest
        EXV2_curInit_Stat_oEXV2_Status_oLIN00_b0ace0f5_Rx: ComBitPosition=2, ComBitSize=2, ComSignalType=UINT8, ComHandleId=27, ComSystemTemplateSystemSignalRef=EXV2_curInit_Stat
        EDCU_EXV2_Cmd_Init_Rq_oEDCU_EXV2_oLIN00_0144aec9_Tx: ComBitPosition=24, ComBitSize=3, ComSignalType=UINT8, ComHandleId=51, ComTransferProperty=PENDING, ComSystemTemplateSystemSignalRef=EDCU_EXV2_Cmd_Init_Rq
        TMM_EXV1_initRequest_oVCU_EXV_1_oLIN00_082350ea_Tx: ComBitPosition=24, ComBitSize=3, ComSignalType=UINT8, ComHandleId=195, ComTransferProperty=PENDING, ComSystemTemplateSystemSignalRef=TMM_EXV1_initRequest
        EXV1_RunState_oEXV_1_VCU_oLIN00_f0dc555f_Rx: ComBitPosition=3, ComBitSize=1, ComSignalType=BOOLEAN, ComHandleId=12, ComSystemTemplateSystemSignalRef=EXV1_RunState
        HVCH_IntelTemp_oHVCH_Rsp02_oLIN00_2b487110_Rx: ComBitPosition=0, ComBitSize=8, ComSignalType=UINT8, ComHandleId=34, ComSystemTemplateSystemSignalRef=HVCH_IntelTemp
      SVA_VCU_STD_oLIN00_4526aa1c_Rx (ComIPdu):
        ComIPduDirection = RECEIVE
        ComIPduType = NORMAL
        ComIPduHandleId = 27
        ComIPduSignalProcessing = DEFERRED
        ComIPduCancellationSupport = false
        ComIPduGroupRef = VCU_oLIN00_Rx_4b9dfc53
        ComIPduSignalRef = Act_Pos_sta_oSVA_VCU_STD_oLIN00_642c9ffa_Rx
        ComIPduSignalRef = Blockage_Fault_STA_oSVA_VCU_STD_oLIN00_6c89246f_Rx
        ComIPduSignalRef = Breakage_Fault_STA_oSVA_VCU_STD_oLIN00_a3ac9cf8_Rx
        ComIPduSignalRef = Calibration_sta_oSVA_VCU_STD_oLIN00_dcb4af08_Rx
        ComIPduSignalRef = LIN_Resp_Error_sta_oSVA_VCU_STD_oLIN00_47f7ca93_Rx
        ComPduIdRef = SVA_VCU_STD_oLIN00_4526aa1c_Rx
        ComIPduMainFunctionRef = ComMainFunctionRx
      EXV2_Volt_Stat_oEXV2_Status_oLIN00_c8727eb0_Rx (ComSignal):
        ComBitPosition = 12
        ComBitSize = 2
        ComSignalEndianness = LITTLE_ENDIAN
        ComSignalInitValue = 0
        ComSignalType = UINT8
        ComSignalAccess = ACCESS_UNCLEAR
        ComHandleId = 25
        ComSystemTemplateSystemSignalRef = EXV2_Volt_Stat
      HVCH_Rsp02_oLIN00_286c390c_Rx (ComIPdu):
        ComIPduDirection = RECEIVE
        ComIPduType = NORMAL
        ComIPduHandleId = 12
        ComIPduSignalProcessing = DEFERRED
        ComIPduCancellationSupport = false
        ComIPduGroupRef = VCU_oLIN00_Rx_4b9dfc53
        ComIPduSignalRef = HVCH_IntelTemp_oHVCH_Rsp02_oLIN00_2b487110_Rx
        ComPduIdRef = HVCH_Rsp02_oLIN00_286c390c_Rx
        ComIPduMainFunctionRef = ComMainFunctionRx
      HVCH_Rsp01_oLIN00_a6e33eef_Rx (ComIPdu):
        ComIPduDirection = RECEIVE
        ComIPduType = NORMAL
        ComIPduHandleId = 11
        ComIPduSignalProcessing = DEFERRED
        ComIPduCancellationSupport = false
        ComIPduGroupRef = VCU_oLIN00_Rx_4b9dfc53
        ComIPduSignalRef = HVCH_CurrSens_Flt_oHVCH_Rsp01_oLIN00_09f7bc74_Rx
        ComIPduSignalRef = HVCH_DutyCycle_oHVCH_Rsp01_oLIN00_ad1e6a22_Rx
        ComIPduSignalRef = HVCH_ExtPwrSup_Flt_oHVCH_Rsp01_oLIN00_28926933_Rx
        ComIPduSignalRef = HVCH_HV_DC_curr_oHVCH_Rsp01_oLIN00_f613e39d_Rx
        ComIPduSignalRef = HVCH_HV_Voltage_Valid_oHVCH_Rsp01_oLIN00_2914831e_Rx
        ComIPduSignalRef = HVCH_HV_voltage_oHVCH_Rsp01_oLIN00_3d3da318_Rx
        ComIPduSignalRef = HVCH_InternalPCBTemp_oHVCH_Rsp01_oLIN00_398b53e8_Rx
        ComIPduSignalRef = HVCH_LIN_Flt_oHVCH_Rsp01_oLIN00_9aaa25bf_Rx
        ComIPduSignalRef = HVCH_MediumTemp_oHVCH_Rsp01_oLIN00_a3387de4_Rx
        ComIPduSignalRef = HVCH_Off_ShrtCurr_oHVCH_Rsp01_oLIN00_bf58ab45_Rx
        ComIPduSignalRef = HVCH_RsErr_oHVCH_Rsp01_oLIN00_527b0f8f_Rx
        ComIPduSignalRef = HVCH_Status_oHVCH_Rsp01_oLIN00_60afdc75_Rx
        ComIPduSignalRef = HVCH_TempLim_oHVCH_Rsp01_oLIN00_d22e6add_Rx
        ComIPduSignalRef = HVCH_TempSens_Flt_oHVCH_Rsp01_oLIN00_66cb2c71_Rx
        ComIPduSignalRef = HVCH_defectHeaterCircuits_oHVCH_Rsp01_oLIN00_61948e74_Rx
        ComPduIdRef = HVCH_Rsp01_oLIN00_a6e33eef_Rx
        ComIPduMainFunctionRef = ComMainFunctionRx
      3 x ComSignal, all with ComSignalEndianness=LITTLE_ENDIAN, ComSignalInitValue=0, ComSignalType=UINT8, ComSignalAccess=ACCESS_UNCLEAR:
        HVCH_HV_voltage_oHVCH_Rsp01_oLIN00_3d3da318_Rx: ComBitPosition=8, ComBitSize=8, ComHandleId=33, ComSystemTemplateSystemSignalRef=HVCH_HV_voltage
        PMP2_PumpInputVolt_oPMP2_Sts_oLIN00_1fa0a533_Rx: ComBitPosition=8, ComBitSize=8, ComHandleId=46, ComSystemTemplateSystemSignalRef=PMP2_PumpInputVolt
        PMP2_PumpPowerSta_oPMP2_Sts_oLIN00_1d0f1319_Rx: ComBitPosition=4, ComBitSize=2, ComHandleId=48, ComSystemTemplateSystemSignalRef=PMP2_PumpPowerSta
      PMP2_Sts_oLIN00_cab90b6b_Rx (ComIPdu):
        ComIPduDirection = RECEIVE
        ComIPduType = NORMAL
        ComIPduHandleId = 24
        ComIPduSignalProcessing = DEFERRED
        ComIPduCancellationSupport = false
        ComIPduGroupRef = VCU_oLIN00_Rx_4b9dfc53
        ComIPduSignalRef = PMP2_PumpDryRunningSta_oPMP2_Sts_oLIN00_3e217a22_Rx
        ComIPduSignalRef = PMP2_PumpInputVolt_oPMP2_Sts_oLIN00_1fa0a533_Rx
        ComIPduSignalRef = PMP2_PumpMotorSta_oPMP2_Sts_oLIN00_d6d3ab88_Rx
        ComIPduSignalRef = PMP2_PumpPowerSta_oPMP2_Sts_oLIN00_1d0f1319_Rx
        ComIPduSignalRef = PMP2_PumpTempSta_oPMP2_Sts_oLIN00_81f2fa55_Rx
        ComIPduSignalRef = PMP2_RESP_ERROR_oPMP2_Sts_oLIN00_67b666eb_Rx
        ComIPduSignalRef = PMP2_RealRPM_oPMP2_Sts_oLIN00_86d75572_Rx
        ComPduIdRef = PMP2_Sts_oLIN00_cab90b6b_Rx
        ComIPduMainFunctionRef = ComMainFunctionRx
      23 x ComSignal, all with ComSignalEndianness=LITTLE_ENDIAN, ComSignalInitValue=0, ComSignalAccess=ACCESS_UNCLEAR:
        PMP3_RESP_ERROR_oPMP3_Sts_oLIN00_9f14f3a0_Rx: ComBitPosition=0, ComBitSize=1, ComSignalType=BOOLEAN, ComHandleId=57, ComSystemTemplateSystemSignalRef=PMP3_RESP_ERROR
        TMM_EXV2_EnableRequest_oVCU_EXV_2_oLIN00_0c106490_Tx: ComBitPosition=16, ComBitSize=1, ComSignalType=BOOLEAN, ComHandleId=196, ComTransferProperty=PENDING, ComSystemTemplateSystemSignalRef=TMM_EXV2_EnableRequest
        EXV2_ResponseError_oEXV_2_VCU_oLIN00_e747f934_Rx: ComBitPosition=0, ComBitSize=1, ComSignalType=BOOLEAN, ComHandleId=21, ComSystemTemplateSystemSignalRef=EXV2_ResponseError
        HVCH_ExtPwrSup_Flt_oHVCH_Rsp01_oLIN00_28926933_Rx: ComBitPosition=45, ComBitSize=1, ComSignalType=BOOLEAN, ComHandleId=30, ComSystemTemplateSystemSignalRef=HVCH_ExtPwrSup_Flt
        HVCH_MediumTemp_oHVCH_Rsp01_oLIN00_a3387de4_Rx: ComBitPosition=16, ComBitSize=8, ComSignalType=UINT8, ComHandleId=37, ComSystemTemplateSystemSignalRef=HVCH_MediumTemp
        PMP3_PumpDryRunningSta_oPMP3_Sts_oLIN00_30f4e2d8_Rx: ComBitPosition=3, ComBitSize=1, ComSignalType=BOOLEAN, ComHandleId=52, ComSystemTemplateSystemSignalRef=PMP3_PumpDryRunningSta
        HVCH_InternalPCBTemp_oHVCH_Rsp01_oLIN00_398b53e8_Rx: ComBitPosition=48, ComBitSize=8, ComSignalType=UINT8, ComHandleId=35, ComSystemTemplateSystemSignalRef=HVCH_InternalPCBTemp
        Calibration_cmd_oVCU_SVA_CMD_oLIN00_6732180a_Tx: ComBitPosition=8, ComBitSize=1, ComSignalType=BOOLEAN, ComHandleId=48, ComTransferProperty=PENDING, ComSystemTemplateSystemSignalRef=Calibration_cmd
        PMP2_RealRPM_oPMP2_Sts_oLIN00_86d75572_Rx: ComBitPosition=24, ComBitSize=8, ComSignalType=UINT8, ComHandleId=51, ComSystemTemplateSystemSignalRef=PMP2_RealRPM
        EXV2_CurrentPosition_oEXV_2_VCU_oLIN00_91e32486_Rx: ComBitPosition=16, ComBitSize=16, ComSignalType=UINT16, ComHandleId=16, ComSystemTemplateSystemSignalRef=EXV2_CurrentPosition
        Blockage_Fault_STA_oSVA_VCU_STD_oLIN00_6c89246f_Rx: ComBitPosition=2, ComBitSize=1, ComSignalType=BOOLEAN, ComHandleId=1, ComSystemTemplateSystemSignalRef=Blockage_Fault_STA
        PMP3_RealRPM_oPMP3_Sts_oLIN00_fa6fbf8a_Rx: ComBitPosition=24, ComBitSize=8, ComSignalType=UINT8, ComHandleId=58, ComSystemTemplateSystemSignalRef=PMP3_RealRPM
        EXV2_OvrTemp_Warn_oEXV2_Status_oLIN00_ba77659e_Rx: ComBitPosition=14, ComBitSize=2, ComSignalType=UINT8, ComHandleId=19, ComSystemTemplateSystemSignalRef=EXV2_OvrTemp_Warn
        PMP3_PumpTempSta_oPMP3_Sts_oLIN00_26375532_Rx: ComBitPosition=6, ComBitSize=2, ComSignalType=UINT8, ComHandleId=56, ComSystemTemplateSystemSignalRef=PMP3_PumpTempSta
        HVCH_HV_DC_curr_oHVCH_Rsp01_oLIN00_f613e39d_Rx: ComBitPosition=0, ComBitSize=8, ComSignalType=UINT8, ComHandleId=31, ComSystemTemplateSystemSignalRef=HVCH_HV_DC_curr
        EXV1_TemperatureWarn_oEXV_1_VCU_oLIN00_a3317e4b_Rx: ComBitPosition=10, ComBitSize=2, ComSignalType=UINT8, ComHandleId=13, ComSystemTemplateSystemSignalRef=EXV1_TemperatureWarn
        EXV2_FaultState_oEXV_2_VCU_oLIN00_41c0e318_Rx: ComBitPosition=4, ComBitSize=4, ComSignalType=UINT8, ComHandleId=17, ComSystemTemplateSystemSignalRef=EXV2_FaultState
        EDCU_EXV2_Cmd_Set_Rq_oEDCU_EXV2_oLIN00_66e5876a_Tx: ComBitPosition=0, ComBitSize=16, ComSignalType=UINT16, ComHandleId=53, ComTransferProperty=PENDING, ComSystemTemplateSystemSignalRef=EDCU_EXV2_Cmd_Set_Rq
        HVCH_RsErr_oHVCH_Rsp01_oLIN00_527b0f8f_Rx: ComBitPosition=61, ComBitSize=1, ComSignalType=BOOLEAN, ComHandleId=39, ComSystemTemplateSystemSignalRef=HVCH_RsErr
        EXV2_Pos_oEXV2_Status_oLIN00_da80603b_Rx: ComBitPosition=16, ComBitSize=16, ComSignalType=UINT16, ComHandleId=20, ComSystemTemplateSystemSignalRef=EXV2_Pos
        TMM_EXV1_EnableRequest_oVCU_EXV_1_oLIN00_d988d266_Tx: ComBitPosition=16, ComBitSize=1, ComSignalType=BOOLEAN, ComHandleId=193, ComTransferProperty=PENDING, ComSystemTemplateSystemSignalRef=TMM_EXV1_EnableRequest
        PMP2_RESP_ERROR_oPMP2_Sts_oLIN00_67b666eb_Rx: ComBitPosition=0, ComBitSize=1, ComSignalType=BOOLEAN, ComHandleId=50, ComSystemTemplateSystemSignalRef=PMP2_RESP_ERROR
        PMP3_PumpMotorSta_oPMP3_Sts_oLIN00_43910f36_Rx: ComBitPosition=1, ComBitSize=2, ComSignalType=UINT8, ComHandleId=54, ComSystemTemplateSystemSignalRef=PMP3_PumpMotorSta
      VCU_SVA_CMD_oLIN00_756d14f6_Tx (ComIPdu):
        ComIPduDirection = SEND
        ComIPduType = NORMAL
        ComIPduHandleId = 16
        ComIPduSignalProcessing = DEFERRED
        ComIPduCancellationSupport = false
        ComIPduGroupRef = VCU_oLIN00_Tx_1dc75bd5
        ComIPduSignalRef = Calibration_cmd_oVCU_SVA_CMD_oLIN00_6732180a_Tx
        ComIPduSignalRef = Target_Pos_cmd_oVCU_SVA_CMD_oLIN00_b87f26ef_Tx
        ComPduIdRef = VCU_SVA_CMD_oLIN00_756d14f6_Tx
        ComIPduMainFunctionRef = ComMainFunctionTx
        ComTxIPdu: ComTxIPduUnusedAreasDefault=255, ComMinimumDelayTime=0
          ComTxModeTrue
            ComTxMode: ComTxModeMode=NONE
          ComTxModeFalse
            ComTxMode: ComTxModeMode=NONE
      VCU_oTC37X_VCU_CAN12_Rx_37e24d02 (ComIPduGroup): ComIPduGroupHandleId=14
      3 x ComSignal, all with ComBitSize=16, ComSignalEndianness=LITTLE_ENDIAN, ComSignalInitValue=0, ComSignalType=SINT16, ComTimeout=0, ComSignalAccess=ACCESS_UNCLEAR:
        VcuCan12TxMsg2_Sig2_oVcuCan12TxMsg2_oTC37X_VCU_CAN12_a3805b6d_Tx: ComBitPosition=32, ComTransferProperty=PENDING, ComHandleId=214, ComSystemTemplateSystemSignalRef=VcuCan12TxMsg2_Sig2
        VcuCan12TxMsg1_Sig3_oVcuCan12TxMsg1_oTC37X_VCU_CAN12_be1fcbc2_Tx: ComBitPosition=48, ComTransferProperty=PENDING, ComHandleId=211, ComSystemTemplateSystemSignalRef=VcuCan12TxMsg1_Sig3
        VcuCan12RxMsg3_Sig0_oVcuCan12RxMsg3_oTC37X_VCU_CAN12_5a65a77f_Rx: ComBitPosition=0, ComHandleId=260, ComSystemTemplateSystemSignalRef=VcuCan12RxMsg3_Sig0
      VcuCan12RxMsg4_oTC37X_VCU_CAN12_d9ab3246_Rx (ComIPdu):
        ComIPduDirection = RECEIVE
        ComIPduType = NORMAL
        ComIPduHandleId = 31
        ComIPduSignalProcessing = DEFERRED
        ComIPduCancellationSupport = false
        ComIPduGroupRef = VCU_oTC37X_VCU_CAN12_Rx_37e24d02
        ComIPduSignalRef = VcuCan12RxMsg4_Sig0_oVcuCan12RxMsg4_oTC37X_VCU_CAN12_89859905_Rx
        ComIPduSignalRef = VcuCan12RxMsg4_Sig1_oVcuCan12RxMsg4_oTC37X_VCU_CAN12_ad07c833_Rx
        ComIPduSignalRef = VcuCan12RxMsg4_Sig2_oVcuCan12RxMsg4_oTC37X_VCU_CAN12_c0813b69_Rx
        ComIPduSignalRef = VcuCan12RxMsg4_Sig3_oVcuCan12RxMsg4_oTC37X_VCU_CAN12_e4036a5f_Rx
        ComPduIdRef = VcuCan12RxMsg4_oTC37X_VCU_CAN12_d9ab3246_Rx
        ComIPduMainFunctionRef = ComMainFunctionRx
      7 x ComSignal, all with ComBitSize=16, ComSignalEndianness=LITTLE_ENDIAN, ComSignalInitValue=0, ComSignalType=SINT16, ComTimeout=0, ComSignalAccess=ACCESS_UNCLEAR:
        VcuCan12RxMsg4_Sig0_oVcuCan12RxMsg4_oTC37X_VCU_CAN12_89859905_Rx: ComBitPosition=0, ComHandleId=264, ComSystemTemplateSystemSignalRef=VcuCan12RxMsg4_Sig0
        VcuCan12RxMsg3_Sig2_oVcuCan12RxMsg3_oTC37X_VCU_CAN12_13610513_Rx: ComBitPosition=32, ComHandleId=262, ComSystemTemplateSystemSignalRef=VcuCan12RxMsg3_Sig2
        VcuCan12RxMsg3_Sig1_oVcuCan12RxMsg3_oTC37X_VCU_CAN12_7ee7f649_Rx: ComBitPosition=16, ComHandleId=261, ComSystemTemplateSystemSignalRef=VcuCan12RxMsg3_Sig1
        VcuCan12TxMsg2_Sig1_oVcuCan12TxMsg2_oTC37X_VCU_CAN12_ce06a837_Tx: ComBitPosition=16, ComTransferProperty=PENDING, ComHandleId=213, ComSystemTemplateSystemSignalRef=VcuCan12TxMsg2_Sig1
        VcuCan12TxMsg2_Sig3_oVcuCan12TxMsg2_oTC37X_VCU_CAN12_87020a5b_Tx: ComBitPosition=48, ComTransferProperty=PENDING, ComHandleId=215, ComSystemTemplateSystemSignalRef=VcuCan12TxMsg2_Sig3
        VcuCan12TxMsg1_Sig2_oVcuCan12TxMsg1_oTC37X_VCU_CAN12_9a9d9af4_Tx: ComBitPosition=32, ComTransferProperty=PENDING, ComHandleId=210, ComSystemTemplateSystemSignalRef=VcuCan12TxMsg1_Sig2
        VcuCan12RxMsg4_Sig2_oVcuCan12RxMsg4_oTC37X_VCU_CAN12_c0813b69_Rx: ComBitPosition=32, ComHandleId=266, ComSystemTemplateSystemSignalRef=VcuCan12RxMsg4_Sig2
      VcuCan12RxMsg3_oTC37X_VCU_CAN12_38853822_Rx (ComIPdu):
        ComIPduDirection = RECEIVE
        ComIPduType = NORMAL
        ComIPduHandleId = 30
        ComIPduSignalProcessing = DEFERRED
        ComIPduCancellationSupport = false
        ComIPduGroupRef = VCU_oTC37X_VCU_CAN12_Rx_37e24d02
        ComIPduSignalRef = VcuCan12RxMsg3_Sig0_oVcuCan12RxMsg3_oTC37X_VCU_CAN12_5a65a77f_Rx
        ComIPduSignalRef = VcuCan12RxMsg3_Sig1_oVcuCan12RxMsg3_oTC37X_VCU_CAN12_7ee7f649_Rx
        ComIPduSignalRef = VcuCan12RxMsg3_Sig2_oVcuCan12RxMsg3_oTC37X_VCU_CAN12_13610513_Rx
        ComIPduSignalRef = VcuCan12RxMsg3_Sig3_oVcuCan12RxMsg3_oTC37X_VCU_CAN12_37e35425_Rx
        ComPduIdRef = VcuCan12RxMsg3_oTC37X_VCU_CAN12_38853822_Rx
        ComIPduMainFunctionRef = ComMainFunctionRx
      3 x ComSignal, all with ComBitSize=16, ComSignalEndianness=LITTLE_ENDIAN, ComSignalInitValue=0, ComSignalType=SINT16, ComTimeout=0, ComSignalAccess=ACCESS_UNCLEAR:
        VcuCan12RxMsg4_Sig1_oVcuCan12RxMsg4_oTC37X_VCU_CAN12_ad07c833_Rx: ComBitPosition=16, ComHandleId=265, ComSystemTemplateSystemSignalRef=VcuCan12RxMsg4_Sig1
        VcuCan12TxMsg1_Sig0_oVcuCan12TxMsg1_oTC37X_VCU_CAN12_d3993898_Tx: ComBitPosition=0, ComTransferProperty=PENDING, ComHandleId=208, ComSystemTemplateSystemSignalRef=VcuCan12TxMsg1_Sig0
        VcuCan12RxMsg3_Sig3_oVcuCan12RxMsg3_oTC37X_VCU_CAN12_37e35425_Rx: ComBitPosition=48, ComHandleId=263, ComSystemTemplateSystemSignalRef=VcuCan12RxMsg3_Sig3
      VCU_oTC37X_VCU_CAN12_Tx_61b8ea84 (ComIPduGroup): ComIPduGroupHandleId=15
      VcuCan12RxMsg4_Sig3_oVcuCan12RxMsg4_oTC37X_VCU_CAN12_e4036a5f_Rx (ComSignal):
        ComBitPosition = 48
        ComBitSize = 16
        ComSignalEndianness = LITTLE_ENDIAN
        ComSignalInitValue = 0
        ComSignalType = SINT16
        ComTimeout = 0
        ComSignalAccess = ACCESS_UNCLEAR
        ComHandleId = 267
        ComSystemTemplateSystemSignalRef = VcuCan12RxMsg4_Sig3
      VcuCan12TxMsg2_oTC37X_VCU_CAN12_3a1dfcb9_Tx (ComIPdu):
        ComIPduDirection = SEND
        ComIPduType = NORMAL
        ComIPduHandleId = 32
        ComIPduSignalProcessing = DEFERRED
        ComIPduCancellationSupport = false
        ComIPduGroupRef = VCU_oTC37X_VCU_CAN12_Tx_61b8ea84
        ComIPduSignalRef = VcuCan12TxMsg2_Sig0_oVcuCan12TxMsg2_oTC37X_VCU_CAN12_ea84f901_Tx
        ComIPduSignalRef = VcuCan12TxMsg2_Sig1_oVcuCan12TxMsg2_oTC37X_VCU_CAN12_ce06a837_Tx
        ComIPduSignalRef = VcuCan12TxMsg2_Sig2_oVcuCan12TxMsg2_oTC37X_VCU_CAN12_a3805b6d_Tx
        ComIPduSignalRef = VcuCan12TxMsg2_Sig3_oVcuCan12TxMsg2_oTC37X_VCU_CAN12_87020a5b_Tx
        ComPduIdRef = VcuCan12TxMsg2_oTC37X_VCU_CAN12_3a1dfcb9_Tx
        ComIPduMainFunctionRef = ComMainFunctionTx
        ComTxIPdu: ComMinimumDelayTime=0, ComTxIPduUnusedAreasDefault=0
          ComTxModeTrue
            ComTxMode: ComTxModeMode=PERIODIC, ComTxModeTimeOffset=0, ComTxModeTimePeriod=0.5
          ComTxModeFalse
            ComTxMode: ComTxModeMode=PERIODIC, ComTxModeTimeOffset=0, ComTxModeTimePeriod=0.5
      VcuCan12TxMsg1_oTC37X_VCU_CAN12_d09b21db_Tx (ComIPdu):
        ComIPduDirection = SEND
        ComIPduType = NORMAL
        ComIPduHandleId = 31
        ComIPduSignalProcessing = DEFERRED
        ComIPduCancellationSupport = false
        ComIPduGroupRef = VCU_oTC37X_VCU_CAN12_Tx_61b8ea84
        ComIPduSignalRef = VcuCan12TxMsg1_Sig0_oVcuCan12TxMsg1_oTC37X_VCU_CAN12_d3993898_Tx
        ComIPduSignalRef = VcuCan12TxMsg1_Sig1_oVcuCan12TxMsg1_oTC37X_VCU_CAN12_f71b69ae_Tx
        ComIPduSignalRef = VcuCan12TxMsg1_Sig2_oVcuCan12TxMsg1_oTC37X_VCU_CAN12_9a9d9af4_Tx
        ComIPduSignalRef = VcuCan12TxMsg1_Sig3_oVcuCan12TxMsg1_oTC37X_VCU_CAN12_be1fcbc2_Tx
        ComPduIdRef = VcuCan12TxMsg1_oTC37X_VCU_CAN12_d09b21db_Tx
        ComIPduMainFunctionRef = ComMainFunctionTx
        ComTxIPdu: ComMinimumDelayTime=0, ComTxIPduUnusedAreasDefault=0
          ComTxModeTrue
            ComTxMode: ComTxModeMode=PERIODIC, ComTxModeTimeOffset=0, ComTxModeTimePeriod=0.5
          ComTxModeFalse
            ComTxMode: ComTxModeMode=PERIODIC, ComTxModeTimeOffset=0, ComTxModeTimePeriod=0.5
      4 x ComSignal, all with ComBitSize=16, ComSignalEndianness=LITTLE_ENDIAN, ComSignalInitValue=0, ComSignalType=SINT16, ComTimeout=0, ComTransferProperty=PENDING, ComSignalAccess=ACCESS_UNCLEAR:
        VcuCan12TxMsg2_Sig0_oVcuCan12TxMsg2_oTC37X_VCU_CAN12_ea84f901_Tx: ComBitPosition=0, ComHandleId=212, ComSystemTemplateSystemSignalRef=VcuCan12TxMsg2_Sig0
        VcuCan12TxMsg1_Sig1_oVcuCan12TxMsg1_oTC37X_VCU_CAN12_f71b69ae_Tx: ComBitPosition=16, ComHandleId=209, ComSystemTemplateSystemSignalRef=VcuCan12TxMsg1_Sig1
        VcuAdcTxMsg2_Sig1_oVcuCan03TxMsg2_oTC37X_VCU_CAN03_0a1d7eaa_Tx: ComBitPosition=16, ComHandleId=205, ComSystemTemplateSystemSignalRef=VcuAdcTxMsg2_Sig1
        VcuAdcTxMsg1_Sig0_oVcuCan03TxMsg1_oTC37X_VCU_CAN03_1782ee05_Tx: ComBitPosition=0, ComHandleId=200, ComSystemTemplateSystemSignalRef=VcuAdcTxMsg1_Sig0
      VCU_oTC37X_VCU_CAN03_Rx_b23e03d7 (ComIPduGroup): ComIPduGroupHandleId=12
      3 x ComSignal, all with ComBitSize=16, ComSignalEndianness=LITTLE_ENDIAN, ComSignalInitValue=0, ComSignalType=SINT16, ComTimeout=0, ComSignalAccess=ACCESS_UNCLEAR:
        VcuAdcTxMsg1_Sig1_oVcuCan03TxMsg1_oTC37X_VCU_CAN03_3300bf33_Tx: ComBitPosition=16, ComTransferProperty=PENDING, ComHandleId=201, ComSystemTemplateSystemSignalRef=VcuAdcTxMsg1_Sig1
        VcuRxMsg3_Sig1_oVcuCan03RxMsg1_oTC37X_VCU_CAN03_8f9ddda0_Rx: ComBitPosition=16, ComHandleId=278, ComSystemTemplateSystemSignalRef=VcuRxMsg3_Sig1
        VcuRxMsg4_Sig2_oVcuCan03RxMsg2_oTC37X_VCU_CAN03_3a53c786_Rx: ComBitPosition=32, ComHandleId=288, ComSystemTemplateSystemSignalRef=VcuRxMsg4_Sig2
      VcuCan03RxMsg2_oTC37X_VCU_CAN03_9d657a3d_Rx (ComIPdu):
        ComIPduDirection = RECEIVE
        ComIPduType = NORMAL
        ComIPduHandleId = 29
        ComIPduSignalProcessing = DEFERRED
        ComIPduCancellationSupport = false
        ComIPduGroupRef = VCU_oTC37X_VCU_CAN03_Rx_b23e03d7
        ComIPduSignalRef = VcuRxMsg4_Sig0_oVcuCan03RxMsg2_oTC37X_VCU_CAN03_735765ea_Rx
        ComIPduSignalRef = VcuRxMsg4_Sig1_oVcuCan03RxMsg2_oTC37X_VCU_CAN03_57d534dc_Rx
        ComIPduSignalRef = VcuRxMsg4_Sig2_oVcuCan03RxMsg2_oTC37X_VCU_CAN03_3a53c786_Rx
        ComIPduSignalRef = VcuRxMsg4_Sig3_oVcuCan03RxMsg2_oTC37X_VCU_CAN03_1ed196b0_Rx
        ComPduIdRef = VcuCan03RxMsg2_oTC37X_VCU_CAN03_9d657a3d_Rx
        ComIPduMainFunctionRef = ComMainFunctionRx
      6 x ComSignal, all with ComBitSize=16, ComSignalEndianness=LITTLE_ENDIAN, ComSignalInitValue=0, ComSignalType=SINT16, ComTimeout=0, ComSignalAccess=ACCESS_UNCLEAR:
        VcuAdcTxMsg2_Sig2_oVcuCan03TxMsg2_oTC37X_VCU_CAN03_679b8df0_Tx: ComBitPosition=32, ComTransferProperty=PENDING, ComHandleId=206, ComSystemTemplateSystemSignalRef=VcuAdcTxMsg2_Sig2
        VcuRxMsg4_Sig0_oVcuCan03RxMsg2_oTC37X_VCU_CAN03_735765ea_Rx: ComBitPosition=0, ComHandleId=284, ComSystemTemplateSystemSignalRef=VcuRxMsg4_Sig0
        VcuRxMsg4_Sig1_oVcuCan03RxMsg2_oTC37X_VCU_CAN03_57d534dc_Rx: ComBitPosition=16, ComHandleId=286, ComSystemTemplateSystemSignalRef=VcuRxMsg4_Sig1
        VcuRxMsg3_Sig0_oVcuCan03RxMsg1_oTC37X_VCU_CAN03_ab1f8c96_Rx: ComBitPosition=0, ComHandleId=276, ComSystemTemplateSystemSignalRef=VcuRxMsg3_Sig0
        VcuRxMsg4_Sig3_oVcuCan03RxMsg2_oTC37X_VCU_CAN03_1ed196b0_Rx: ComBitPosition=48, ComHandleId=290, ComSystemTemplateSystemSignalRef=VcuRxMsg4_Sig3
        VcuAdcTxMsg1_Sig3_oVcuCan03TxMsg1_oTC37X_VCU_CAN03_7a041d5f_Tx: ComBitPosition=48, ComTransferProperty=PENDING, ComHandleId=203, ComSystemTemplateSystemSignalRef=VcuAdcTxMsg1_Sig3
      VcuCan03RxMsg1_oTC37X_VCU_CAN03_77e3a75f_Rx (ComIPdu):
        ComIPduDirection = RECEIVE
        ComIPduType = NORMAL
        ComIPduHandleId = 28
        ComIPduSignalProcessing = DEFERRED
        ComIPduCancellationSupport = false
        ComIPduGroupRef = VCU_oTC37X_VCU_CAN03_Rx_b23e03d7
        ComIPduSignalRef = VcuRxMsg3_Sig0_oVcuCan03RxMsg1_oTC37X_VCU_CAN03_ab1f8c96_Rx
        ComIPduSignalRef = VcuRxMsg3_Sig1_oVcuCan03RxMsg1_oTC37X_VCU_CAN03_8f9ddda0_Rx
        ComIPduSignalRef = VcuRxMsg3_Sig2_oVcuCan03RxMsg1_oTC37X_VCU_CAN03_e21b2efa_Rx
        ComIPduSignalRef = VcuRxMsg3_Sig3_oVcuCan03RxMsg1_oTC37X_VCU_CAN03_c6997fcc_Rx
        ComPduIdRef = VcuCan03RxMsg1_oTC37X_VCU_CAN03_77e3a75f_Rx
        ComIPduMainFunctionRef = ComMainFunctionRx
      3 x ComSignal, all with ComBitSize=16, ComSignalEndianness=LITTLE_ENDIAN, ComSignalInitValue=0, ComSignalType=SINT16, ComTimeout=0, ComSignalAccess=ACCESS_UNCLEAR:
        VcuAdcTxMsg2_Sig0_oVcuCan03TxMsg2_oTC37X_VCU_CAN03_2e9f2f9c_Tx: ComBitPosition=0, ComTransferProperty=PENDING, ComHandleId=204, ComSystemTemplateSystemSignalRef=VcuAdcTxMsg2_Sig0
        VcuAdcTxMsg1_Sig2_oVcuCan03TxMsg1_oTC37X_VCU_CAN03_5e864c69_Tx: ComBitPosition=32, ComTransferProperty=PENDING, ComHandleId=202, ComSystemTemplateSystemSignalRef=VcuAdcTxMsg1_Sig2
        VcuRxMsg3_Sig3_oVcuCan03RxMsg1_oTC37X_VCU_CAN03_c6997fcc_Rx: ComBitPosition=48, ComHandleId=282, ComSystemTemplateSystemSignalRef=VcuRxMsg3_Sig3
      VcuCan03TxMsg1_oTC37X_VCU_CAN03_9a29d525_Tx (ComIPdu):
        ComIPduDirection = SEND
        ComIPduType = NORMAL
        ComIPduHandleId = 29
        ComIPduSignalProcessing = DEFERRED
        ComIPduCancellationSupport = false
        ComIPduGroupRef = VCU_oTC37X_VCU_CAN03_Tx_e464a451
        ComIPduSignalRef = VcuAdcTxMsg1_Sig0_oVcuCan03TxMsg1_oTC37X_VCU_CAN03_1782ee05_Tx
        ComIPduSignalRef = VcuAdcTxMsg1_Sig1_oVcuCan03TxMsg1_oTC37X_VCU_CAN03_3300bf33_Tx
        ComIPduSignalRef = VcuAdcTxMsg1_Sig2_oVcuCan03TxMsg1_oTC37X_VCU_CAN03_5e864c69_Tx
        ComIPduSignalRef = VcuAdcTxMsg1_Sig3_oVcuCan03TxMsg1_oTC37X_VCU_CAN03_7a041d5f_Tx
        ComPduIdRef = VcuCan03TxMsg1_oTC37X_VCU_CAN03_9a29d525_Tx
        ComIPduMainFunctionRef = ComMainFunctionTx
        ComTxIPdu: ComMinimumDelayTime=0, ComTxIPduUnusedAreasDefault=0
          ComTxModeTrue
            ComTxMode: ComTxModeMode=PERIODIC, ComTxModeTimeOffset=0, ComTxModeTimePeriod=0.5
          ComTxModeFalse
            ComTxMode: ComTxModeMode=PERIODIC, ComTxModeTimeOffset=0, ComTxModeTimePeriod=0.5
      VcuRxMsg3_Sig2_oVcuCan03RxMsg1_oTC37X_VCU_CAN03_e21b2efa_Rx (ComSignal):
        ComBitPosition = 32
        ComBitSize = 16
        ComSignalEndianness = LITTLE_ENDIAN
        ComSignalInitValue = 0
        ComSignalType = SINT16
        ComTimeout = 0
        ComSignalAccess = ACCESS_UNCLEAR
        ComHandleId = 280
        ComSystemTemplateSystemSignalRef = VcuRxMsg3_Sig2
      VcuCan03TxMsg2_oTC37X_VCU_CAN03_70af0847_Tx (ComIPdu):
        ComIPduDirection = SEND
        ComIPduType = NORMAL
        ComIPduHandleId = 30
        ComIPduSignalProcessing = DEFERRED
        ComIPduCancellationSupport = false
        ComIPduGroupRef = VCU_oTC37X_VCU_CAN03_Tx_e464a451
        ComIPduSignalRef = VcuAdcTxMsg2_Sig0_oVcuCan03TxMsg2_oTC37X_VCU_CAN03_2e9f2f9c_Tx
        ComIPduSignalRef = VcuAdcTxMsg2_Sig1_oVcuCan03TxMsg2_oTC37X_VCU_CAN03_0a1d7eaa_Tx
        ComIPduSignalRef = VcuAdcTxMsg2_Sig2_oVcuCan03TxMsg2_oTC37X_VCU_CAN03_679b8df0_Tx
        ComIPduSignalRef = VcuAdcTxMsg2_Sig3_oVcuCan03TxMsg2_oTC37X_VCU_CAN03_4319dcc6_Tx
        ComPduIdRef = VcuCan03TxMsg2_oTC37X_VCU_CAN03_70af0847_Tx
        ComIPduMainFunctionRef = ComMainFunctionTx
        ComTxIPdu: ComMinimumDelayTime=0, ComTxIPduUnusedAreasDefault=0
          ComTxModeTrue
            ComTxMode: ComTxModeMode=PERIODIC, ComTxModeTimeOffset=0, ComTxModeTimePeriod=0.5
          ComTxModeFalse
            ComTxMode: ComTxModeMode=PERIODIC, ComTxModeTimeOffset=0, ComTxModeTimePeriod=0.5
      VCU_oTC37X_VCU_CAN03_Tx_e464a451 (ComIPduGroup): ComIPduGroupHandleId=13
      VcuAdcTxMsg2_Sig3_oVcuCan03TxMsg2_oTC37X_VCU_CAN03_4319dcc6_Tx (ComSignal):
        ComBitPosition = 48
        ComBitSize = 16
        ComSignalEndianness = LITTLE_ENDIAN
        ComSignalInitValue = 0
        ComSignalType = SINT16
        ComTimeout = 0
        ComTransferProperty = PENDING
        ComSignalAccess = ACCESS_UNCLEAR
        ComHandleId = 207
        ComSystemTemplateSystemSignalRef = VcuAdcTxMsg2_Sig3
      VCU_oLIN01_Rx_f3219b36 (ComIPduGroup): ComIPduGroupHandleId=4
      Vcu_Lin0_TxMsg2_oLIN01_0a12d45a_Tx (ComIPdu):
        ComIPduDirection = SEND
        ComIPduType = NORMAL
        ComIPduHandleId = 45
        ComIPduSignalProcessing = DEFERRED
        ComIPduCancellationSupport = false
        ComIPduGroupRef = VCU_oLIN01_Tx_a57b3cb0
        ComIPduSignalRef = Vcu_Lin0_TxMsg2_Sig0_oVcu_Lin0_TxMsg2_oLIN01_ca2bd13d_Tx
        ComIPduSignalRef = Vcu_Lin0_TxMsg2_Sig1_oVcu_Lin0_TxMsg2_oLIN01_6fa04133_Tx
        ComIPduSignalRef = Vcu_Lin0_TxMsg2_Sig2_oVcu_Lin0_TxMsg2_oLIN01_5a4df760_Tx
        ComIPduSignalRef = Vcu_Lin0_TxMsg2_Sig3_oVcu_Lin0_TxMsg2_oLIN01_ffc6676e_Tx
        ComPduIdRef = Vcu_Lin0_TxMsg2_oLIN01_0a12d45a_Tx
        ComIPduMainFunctionRef = ComMainFunctionTx
        ComTxIPdu: ComTxIPduUnusedAreasDefault=255, ComMinimumDelayTime=0
          ComTxModeTrue
            ComTxMode: ComTxModeMode=NONE
          ComTxModeFalse
            ComTxMode: ComTxModeMode=NONE
      VCU_oLIN01_Tx_a57b3cb0 (ComIPduGroup): ComIPduGroupHandleId=5
      Vcu_Lin0_TxMsg1_Sig1_oVcu_Lin0_TxMsg1_oLIN01_a58e63c8_Tx (ComSignal):
        ComBitPosition = 8
        ComBitSize = 8
        ComSignalEndianness = LITTLE_ENDIAN
        ComSignalInitValue = 0
        ComSignalType = UINT8
        ComSignalAccess = ACCESS_UNCLEAR
        ComHandleId = 225
        ComTransferProperty = PENDING
        ComSystemTemplateSystemSignalRef = Vcu_Lin0_TxMsg1_Sig1
      Vcu_Lin0_RxMsg2_oLIN01_aaf70b87_Rx (ComIPdu):
        ComIPduDirection = RECEIVE
        ComIPduType = NORMAL
        ComIPduHandleId = 40
        ComIPduSignalProcessing = DEFERRED
        ComIPduCancellationSupport = false
        ComIPduGroupRef = VCU_oLIN01_Rx_f3219b36
        ComIPduSignalRef = Vcu_Lin0_RxMsg2_Sig0_oVcu_Lin0_RxMsg2_oLIN01_a6197493_Rx
        ComIPduSignalRef = Vcu_Lin0_RxMsg2_Sig1_oVcu_Lin0_RxMsg2_oLIN01_0392e49d_Rx
        ComIPduSignalRef = Vcu_Lin0_RxMsg2_Sig2_oVcu_Lin0_RxMsg2_oLIN01_367f52ce_Rx
        ComIPduSignalRef = Vcu_Lin0_RxMsg2_Sig3_oVcu_Lin0_RxMsg2_oLIN01_93f4c2c0_Rx
        ComPduIdRef = Vcu_Lin0_RxMsg2_oLIN01_aaf70b87_Rx
        ComIPduMainFunctionRef = ComMainFunctionRx
      4 x ComSignal, all with ComBitSize=8, ComSignalEndianness=LITTLE_ENDIAN, ComSignalInitValue=0, ComSignalType=UINT8, ComSignalAccess=ACCESS_UNCLEAR:
        Vcu_Lin0_RxMsg2_Sig0_oVcu_Lin0_RxMsg2_oLIN01_a6197493_Rx: ComBitPosition=0, ComHandleId=294, ComSystemTemplateSystemSignalRef=Vcu_Lin0_RxMsg2_Sig0
        Vcu_Lin0_RxMsg2_Sig2_oVcu_Lin0_RxMsg2_oLIN01_367f52ce_Rx: ComBitPosition=16, ComHandleId=297, ComSystemTemplateSystemSignalRef=Vcu_Lin0_RxMsg2_Sig2
        Vcu_Lin0_TxMsg1_Sig0_oVcu_Lin0_TxMsg1_oLIN01_0005f3c6_Tx: ComBitPosition=0, ComHandleId=224, ComTransferProperty=PENDING, ComSystemTemplateSystemSignalRef=Vcu_Lin0_TxMsg1_Sig0
        Vcu_Lin0_TxMsg1_Sig3_oVcu_Lin0_TxMsg1_oLIN01_35e84595_Tx: ComBitPosition=24, ComHandleId=227, ComTransferProperty=PENDING, ComSystemTemplateSystemSignalRef=Vcu_Lin0_TxMsg1_Sig3
      Vcu_Lin0_RxMsg1_oLIN01_24780c64_Rx (ComIPdu):
        ComIPduDirection = RECEIVE
        ComIPduType = NORMAL
        ComIPduHandleId = 39
        ComIPduSignalProcessing = DEFERRED
        ComIPduCancellationSupport = false
        ComIPduGroupRef = VCU_oLIN01_Rx_f3219b36
        ComIPduSignalRef = Vcu_Lin0_RxMsg1_Sig0_oVcu_Lin0_RxMsg1_oLIN01_6c375668_Rx
        ComIPduSignalRef = Vcu_Lin0_RxMsg1_Sig1_oVcu_Lin0_RxMsg1_oLIN01_c9bcc666_Rx
        ComIPduSignalRef = Vcu_Lin0_RxMsg2_Sig2_oVcu_Lin0_RxMsg1_oLIN01_b8f0552d_Rx
        ComIPduSignalRef = Vcu_Lin0_RxMsg2_Sig3_oVcu_Lin0_RxMsg1_oLIN01_1d7bc523_Rx
        ComPduIdRef = Vcu_Lin0_RxMsg1_oLIN01_24780c64_Rx
        ComIPduMainFunctionRef = ComMainFunctionRx
      9 x ComSignal, all with ComBitSize=8, ComSignalEndianness=LITTLE_ENDIAN, ComSignalInitValue=0, ComSignalType=UINT8, ComSignalAccess=ACCESS_UNCLEAR:
        Vcu_Lin0_RxMsg2_Sig3_oVcu_Lin0_RxMsg2_oLIN01_93f4c2c0_Rx: ComBitPosition=32, ComHandleId=299, ComSystemTemplateSystemSignalRef=Vcu_Lin0_RxMsg2_Sig3
        Vcu_Lin0_TxMsg2_Sig1_oVcu_Lin0_TxMsg2_oLIN01_6fa04133_Tx: ComBitPosition=8, ComHandleId=229, ComTransferProperty=PENDING, ComSystemTemplateSystemSignalRef=Vcu_Lin0_TxMsg2_Sig1
        Vcu_Lin0_TxMsg2_Sig3_oVcu_Lin0_TxMsg2_oLIN01_ffc6676e_Tx: ComBitPosition=24, ComHandleId=231, ComTransferProperty=PENDING, ComSystemTemplateSystemSignalRef=Vcu_Lin0_TxMsg2_Sig3
        Vcu_Lin0_RxMsg1_Sig1_oVcu_Lin0_RxMsg1_oLIN01_c9bcc666_Rx: ComBitPosition=0, ComHandleId=293, ComSystemTemplateSystemSignalRef=Vcu_Lin0_RxMsg1_Sig1
        Vcu_Lin0_RxMsg2_Sig3_oVcu_Lin0_RxMsg1_oLIN01_1d7bc523_Rx: ComBitPosition=24, ComHandleId=298, ComSystemTemplateSystemSignalRef=Vcu_Lin0_RxMsg2_Sig3
        Vcu_Lin0_TxMsg1_Sig2_oVcu_Lin0_TxMsg1_oLIN01_9063d59b_Tx: ComBitPosition=16, ComHandleId=226, ComTransferProperty=PENDING, ComSystemTemplateSystemSignalRef=Vcu_Lin0_TxMsg1_Sig2
        Vcu_Lin0_TxMsg2_Sig2_oVcu_Lin0_TxMsg2_oLIN01_5a4df760_Tx: ComBitPosition=16, ComHandleId=230, ComTransferProperty=PENDING, ComSystemTemplateSystemSignalRef=Vcu_Lin0_TxMsg2_Sig2
        Vcu_Lin0_RxMsg2_Sig2_oVcu_Lin0_RxMsg1_oLIN01_b8f0552d_Rx: ComBitPosition=16, ComHandleId=296, ComSystemTemplateSystemSignalRef=Vcu_Lin0_RxMsg2_Sig2
        Vcu_Lin0_TxMsg2_Sig0_oVcu_Lin0_TxMsg2_oLIN01_ca2bd13d_Tx: ComBitPosition=0, ComHandleId=228, ComTransferProperty=PENDING, ComSystemTemplateSystemSignalRef=Vcu_Lin0_TxMsg2_Sig0
      Vcu_Lin0_TxMsg1_oLIN01_849dd3b9_Tx (ComIPdu):
        ComIPduDirection = SEND
        ComIPduType = NORMAL
        ComIPduHandleId = 44
        ComIPduSignalProcessing = DEFERRED
        ComIPduCancellationSupport = false
        ComIPduGroupRef = VCU_oLIN01_Tx_a57b3cb0
        ComIPduSignalRef = Vcu_Lin0_TxMsg1_Sig0_oVcu_Lin0_TxMsg1_oLIN01_0005f3c6_Tx
        ComIPduSignalRef = Vcu_Lin0_TxMsg1_Sig1_oVcu_Lin0_TxMsg1_oLIN01_a58e63c8_Tx
        ComIPduSignalRef = Vcu_Lin0_TxMsg1_Sig2_oVcu_Lin0_TxMsg1_oLIN01_9063d59b_Tx
        ComIPduSignalRef = Vcu_Lin0_TxMsg1_Sig3_oVcu_Lin0_TxMsg1_oLIN01_35e84595_Tx
        ComPduIdRef = Vcu_Lin0_TxMsg1_oLIN01_849dd3b9_Tx
        ComIPduMainFunctionRef = ComMainFunctionTx
        ComTxIPdu: ComTxIPduUnusedAreasDefault=255, ComMinimumDelayTime=0
          ComTxModeTrue
            ComTxMode: ComTxModeMode=NONE
          ComTxModeFalse
            ComTxMode: ComTxModeMode=NONE
      Vcu_Lin0_RxMsg1_Sig0_oVcu_Lin0_RxMsg1_oLIN01_6c375668_Rx (ComSignal):
        ComBitPosition = 8
        ComBitSize = 8
        ComSignalEndianness = LITTLE_ENDIAN
        ComSignalInitValue = 0
        ComSignalType = UINT8
        ComSignalAccess = ACCESS_UNCLEAR
        ComHandleId = 292
        ComSystemTemplateSystemSignalRef = Vcu_Lin0_RxMsg1_Sig0
      Vcu_Lin0_RxMsg2_Sig1_oVcu_Lin0_RxMsg2_oLIN01_0392e49d_Rx (ComSignal):
        ComBitPosition = 8
        ComBitSize = 8
        ComSignalEndianness = LITTLE_ENDIAN
        ComSignalInitValue = 0
        ComSignalType = UINT8
        ComSignalAccess = ACCESS_UNCLEAR
        ComHandleId = 295
        ComSystemTemplateSystemSignalRef = Vcu_Lin0_RxMsg2_Sig1
      10 x ComSignalGroup, all with ComTransferProperty=PENDING, ComSignalGroupAccess=ACCESS_UNCLEAR:
        SG_VCU_AccPedal_SigGroup_oVCU_AccPedal_oATOM_CANFD_Matrix_CH_V600_202502_aa50ac8d_Tx: ComHandleId=3, ComSystemTemplateSignalGroupRef=SG_VCU_AccPedal_SigGroup
          13 x ComGroupSignal, all with ComSignalEndianness=BIG_ENDIAN, ComSignalInitValue=0, ComTransferProperty=PENDING, ComSignalAccess=ACCESS_UNCLEAR:
            VCU_TargetGear_oVCU_AccPedal_oATOM_CANFD_Matrix_CH_V600_202502_d928d8b4_Tx: ComBitPosition=43, ComBitSize=3, ComSignalType=UINT8, ComHandleId=109, ComSystemTemplateSystemSignalRef=VCU_TargetGear
            VCU_VehicleSpeedValid_oVCU_AccPedal_oATOM_CANFD_Matrix_CH_V600_202502_70135d30_Tx: ComBitPosition=15, ComBitSize=1, ComSignalType=BOOLEAN, ComHandleId=112, ComSystemTemplateSystemSignalRef=VCU_VehicleSpeedValid
            VCU_VirtualACPedal_oVCU_AccPedal_oATOM_CANFD_Matrix_CH_V600_202502_03ae7390_Tx: ComBitPosition=25, ComBitSize=10, ComSignalType=UINT16, ComHandleId=115, ComSystemTemplateSystemSignalRef=VCU_VirtualACPedal
            VCU_Kickdown_oVCU_AccPedal_oATOM_CANFD_Matrix_CH_V600_202502_17d4134b_Tx: ComBitPosition=56, ComBitSize=1, ComSignalType=BOOLEAN, ComHandleId=108, ComSystemTemplateSystemSignalRef=VCU_Kickdown
            VCU_VehicleSpeed_oVCU_AccPedal_oATOM_CANFD_Matrix_CH_V600_202502_da00c229_Tx: ComBitPosition=55, ComBitSize=13, ComSignalType=UINT16, ComHandleId=113, ComSystemTemplateSystemSignalRef=VCU_VehicleSpeed
            VCU_VLCTorqueRequestAvailable_oVCU_AccPedal_oATOM_CANFD_Matrix_CH_V600_202502_d00cfa4f_Tx: ComBitPosition=58, ComBitSize=1, ComSignalType=BOOLEAN, ComHandleId=111, ComSystemTemplateSystemSignalRef=VCU_VLCTorqueRequestAvailable
            VCU_VirtualACPedalValid_oVCU_AccPedal_oATOM_CANFD_Matrix_CH_V600_202502_4b161096_Tx: ComBitPosition=26, ComBitSize=1, ComSignalType=BOOLEAN, ComHandleId=114, ComSystemTemplateSystemSignalRef=VCU_VirtualACPedalValid
            MessageCounter_0D2_oVCU_AccPedal_oATOM_CANFD_Matrix_CH_V600_202502_630306b4_Tx: ComBitPosition=11, ComBitSize=4, ComSignalType=UINT8, ComHandleId=104, ComSystemTemplateSystemSignalRef=MessageCounter_0D2
            VCU_AccelerationPedalValid_oVCU_AccPedal_oATOM_CANFD_Matrix_CH_V600_202502_365d9f08_Tx: ComBitPosition=29, ComBitSize=1, ComSignalType=BOOLEAN, ComHandleId=105, ComSystemTemplateSystemSignalRef=VCU_AccelerationPedalValid
            VCU_AccelerationPedal_oVCU_AccPedal_oATOM_CANFD_Matrix_CH_V600_202502_f84e7cef_Tx: ComBitPosition=23, ComBitSize=10, ComSignalType=UINT16, ComHandleId=106, ComSystemTemplateSystemSignalRef=VCU_AccelerationPedal
            VCU_EPBReq_oVCU_AccPedal_oATOM_CANFD_Matrix_CH_V600_202502_4a2bfea4_Tx: ComBitPosition=14, ComBitSize=2, ComSignalType=UINT8, ComHandleId=107, ComSystemTemplateSystemSignalRef=VCU_EPBReq
            VCU_VLCTorqueRequestActive_oVCU_AccPedal_oATOM_CANFD_Matrix_CH_V600_202502_a1329f5d_Tx: ComBitPosition=57, ComBitSize=1, ComSignalType=BOOLEAN, ComHandleId=110, ComSystemTemplateSystemSignalRef=VCU_VLCTorqueRequestActive
            Checksum_0D2_oVCU_AccPedal_oATOM_CANFD_Matrix_CH_V600_202502_51727e14_Tx: ComBitPosition=7, ComBitSize=8, ComSignalType=UINT8, ComHandleId=103, ComSystemTemplateSystemSignalRef=Checksum_0D2
        SG_VCU_HMIsignals_01_SigGroup_oVCU_HMIsignals_01_oATOM_CANFD_Matrix_CH_V600_202502_c30c8d8f_Tx: ComHandleId=6, ComSystemTemplateSignalGroupRef=SG_VCU_HMIsignals_01_SigGroup
          14 x ComGroupSignal, all with ComSignalEndianness=BIG_ENDIAN, ComSignalInitValue=0, ComTransferProperty=PENDING, ComSignalAccess=ACCESS_UNCLEAR:
            VCU_DCDCFail_oVCU_HMIsignals_01_oATOM_CANFD_Matrix_CH_V600_202502_8211651e_Tx: ComBitPosition=21, ComBitSize=1, ComSignalType=BOOLEAN, ComHandleId=147, ComSystemTemplateSystemSignalRef=VCU_DCDCFail
            VCU_HVBatCriFail_oVCU_HMIsignals_01_oATOM_CANFD_Matrix_CH_V600_202502_05faf04f_Tx: ComBitPosition=29, ComBitSize=2, ComSignalType=UINT8, ComHandleId=149, ComSystemTemplateSystemSignalRef=VCU_HVBatCriFail
            VCU_HVILError_oVCU_HMIsignals_01_oATOM_CANFD_Matrix_CH_V600_202502_f1e2e871_Tx: ComBitPosition=18, ComBitSize=1, ComSignalType=BOOLEAN, ComHandleId=151, ComSystemTemplateSystemSignalRef=VCU_HVILError
            VCU_InvldGearSel_oVCU_HMIsignals_01_oATOM_CANFD_Matrix_CH_V600_202502_773f11d0_Tx: ComBitPosition=51, ComBitSize=4, ComSignalType=UINT8, ComHandleId=153, ComSystemTemplateSystemSignalRef=VCU_InvldGearSel
            VCU_ReachLimitStd_oVCU_HMIsignals_01_oATOM_CANFD_Matrix_CH_V600_202502_5cd2e319_Tx: ComBitPosition=15, ComBitSize=1, ComSignalType=BOOLEAN, ComHandleId=157, ComSystemTemplateSystemSignalRef=VCU_ReachLimitStd
            MessageCounter_317_oVCU_HMIsignals_01_oATOM_CANFD_Matrix_CH_V600_202502_18685520_Tx: ComBitPosition=11, ComBitSize=4, ComSignalType=UINT8, ComHandleId=145, ComSystemTemplateSystemSignalRef=MessageCounter_317
            VCU_HVBatOvrTemp_oVCU_HMIsignals_01_oATOM_CANFD_Matrix_CH_V600_202502_1ab841cc_Tx: ComBitPosition=19, ComBitSize=1, ComSignalType=BOOLEAN, ComHandleId=150, ComSystemTemplateSystemSignalRef=VCU_HVBatOvrTemp
            Checksum_317_oVCU_HMIsignals_01_oATOM_CANFD_Matrix_CH_V600_202502_7e8714d3_Tx: ComBitPosition=7, ComBitSize=8, ComSignalType=UINT8, ComHandleId=144, ComSystemTemplateSystemSignalRef=Checksum_317
            VCU_DriveMotOvrTemp_oVCU_HMIsignals_01_oATOM_CANFD_Matrix_CH_V600_202502_2b850699_Tx: ComBitPosition=22, ComBitSize=1, ComSignalType=BOOLEAN, ComHandleId=148, ComSystemTemplateSystemSignalRef=VCU_DriveMotOvrTemp
            VCU_LimpHome_oVCU_HMIsignals_01_oATOM_CANFD_Matrix_CH_V600_202502_664ff33a_Tx: ComBitPosition=16, ComBitSize=1, ComSignalType=BOOLEAN, ComHandleId=154, ComSystemTemplateSystemSignalRef=VCU_LimpHome
            VCU_HVInsulResFault_oVCU_HMIsignals_01_oATOM_CANFD_Matrix_CH_V600_202502_e6836204_Tx: ComBitPosition=17, ComBitSize=1, ComSignalType=BOOLEAN, ComHandleId=152, ComSystemTemplateSystemSignalRef=VCU_HVInsulResFault
            VCU_MileagelowRemind_oVCU_HMIsignals_01_oATOM_CANFD_Matrix_CH_V600_202502_1b14b376_Tx: ComBitPosition=61, ComBitSize=1, ComSignalType=BOOLEAN, ComHandleId=155, ComSystemTemplateSystemSignalRef=VCU_MileagelowRemind
            VCU_CriSysFailure_oVCU_HMIsignals_01_oATOM_CANFD_Matrix_CH_V600_202502_13fa69e3_Tx: ComBitPosition=25, ComBitSize=2, ComSignalType=UINT8, ComHandleId=146, ComSystemTemplateSystemSignalRef=VCU_CriSysFailure
            VCU_PlugStatus_oVCU_HMIsignals_01_oATOM_CANFD_Matrix_CH_V600_202502_250fa71e_Tx: ComBitPosition=55, ComBitSize=3, ComSignalType=UINT8, ComHandleId=156, ComSystemTemplateSystemSignalRef=VCU_PlugStatus
        SG_IBS_Status_02_SigGroup_oIBS_Status_02_oATOM_CANFD_Matrix_CH_V600_202502_8df002b0_Rx: ComHandleId=11, ComSystemTemplateSignalGroupRef=SG_IBS_Status_02_SigGroup
          18 x ComGroupSignal, all with ComSignalEndianness=BIG_ENDIAN, ComSignalInitValue=0, ComSignalAccess=ACCESS_UNCLEAR:
            IBS_AEBActive_oIBS_Status_02_oATOM_CANFD_Matrix_CH_V600_202502_27fddc4e_Rx: ComBitPosition=26, ComBitSize=1, ComSignalType=BOOLEAN, ComHandleId=150, ComSystemTemplateSystemSignalRef=IBS_AEBActive
            IBS_EPBworkingSts_oIBS_Status_02_oATOM_CANFD_Matrix_CH_V600_202502_fc06f35e_Rx: ComBitPosition=19, ComBitSize=3, ComSignalType=UINT8, ComHandleId=159, ComSystemTemplateSystemSignalRef=IBS_EPBworkingSts
            IBS_AEBAvailable_oIBS_Status_02_oATOM_CANFD_Matrix_CH_V600_202502_586c329d_Rx: ComBitPosition=33, ComBitSize=1, ComSignalType=BOOLEAN, ComHandleId=151, ComSystemTemplateSystemSignalRef=IBS_AEBAvailable
            Checksum_0B3_oIBS_Status_02_oATOM_CANFD_Matrix_CH_V600_202502_a2ce7b09_Rx: ComBitPosition=7, ComBitSize=8, ComSignalType=UINT8, ComHandleId=149, ComSystemTemplateSystemSignalRef=Checksum_0B3
            IBS_HHCAvailable_oIBS_Status_02_oATOM_CANFD_Matrix_CH_V600_202502_a333cc25_Rx: ComBitPosition=24, ComBitSize=1, ComSignalType=BOOLEAN, ComHandleId=162, ComSystemTemplateSystemSignalRef=IBS_HHCAvailable
            IBS_AWBActive_oIBS_Status_02_oATOM_CANFD_Matrix_CH_V600_202502_47745887_Rx: ComBitPosition=36, ComBitSize=1, ComSignalType=BOOLEAN, ComHandleId=153, ComSystemTemplateSystemSignalRef=IBS_AWBActive
            IBS_TCSActive_oIBS_Status_02_oATOM_CANFD_Matrix_CH_V600_202502_a64ac2d8_Rx: ComBitPosition=31, ComBitSize=1, ComSignalType=BOOLEAN, ComHandleId=164, ComSystemTemplateSystemSignalRef=IBS_TCSActive
            IBS_HDCAvailable_oIBS_Status_02_oATOM_CANFD_Matrix_CH_V600_202502_deb691a6_Rx: ComBitPosition=27, ComBitSize=1, ComSignalType=BOOLEAN, ComHandleId=160, ComSystemTemplateSystemSignalRef=IBS_HDCAvailable
            IBS_EPBFailureLamp_oIBS_Status_02_oATOM_CANFD_Matrix_CH_V600_202502_94ade1a4_Rx: ComBitPosition=23, ComBitSize=2, ComSignalType=UINT8, ComHandleId=157, ComSystemTemplateSystemSignalRef=IBS_EPBFailureLamp
            IBS_VDCActive_oIBS_Status_02_oATOM_CANFD_Matrix_CH_V600_202502_7ab0d9f3_Rx: ComBitPosition=30, ComBitSize=1, ComSignalType=BOOLEAN, ComHandleId=165, ComSystemTemplateSystemSignalRef=IBS_VDCActive
            IBS_AVHAvailable_oIBS_Status_02_oATOM_CANFD_Matrix_CH_V600_202502_e9505f9e_Rx: ComBitPosition=39, ComBitSize=1, ComSignalType=BOOLEAN, ComHandleId=152, ComSystemTemplateSystemSignalRef=IBS_AVHAvailable
            IBS_AWBAvailable_oIBS_Status_02_oATOM_CANFD_Matrix_CH_V600_202502_0d99f9f9_Rx: ComBitPosition=32, ComBitSize=1, ComSignalType=BOOLEAN, ComHandleId=154, ComSystemTemplateSystemSignalRef=IBS_AWBAvailable
            IBS_EPBFunctionLamp_oIBS_Status_02_oATOM_CANFD_Matrix_CH_V600_202502_947116d4_Rx: ComBitPosition=35, ComBitSize=2, ComSignalType=UINT8, ComHandleId=158, ComSystemTemplateSystemSignalRef=IBS_EPBFunctionLamp
            IBS_HHCActive_oIBS_Status_02_oATOM_CANFD_Matrix_CH_V600_202502_f453be85_Rx: ComBitPosition=25, ComBitSize=1, ComSignalType=BOOLEAN, ComHandleId=161, ComSystemTemplateSystemSignalRef=IBS_HHCActive
            MessageCounter_0B3_oIBS_Status_02_oATOM_CANFD_Matrix_CH_V600_202502_742aa999_Rx: ComBitPosition=11, ComBitSize=4, ComSignalType=UINT8, ComHandleId=166, ComSystemTemplateSystemSignalRef=MessageCounter_0B3
            IBS_BrakeLightRequest_oIBS_Status_02_oATOM_CANFD_Matrix_CH_V600_202502_a14297cf_Rx: ComBitPosition=21, ComBitSize=2, ComSignalType=UINT8, ComHandleId=155, ComSystemTemplateSystemSignalRef=IBS_BrakeLightRequest
            IBS_EPBControllerSts_oIBS_Status_02_oATOM_CANFD_Matrix_CH_V600_202502_65ed44e8_Rx: ComBitPosition=47, ComBitSize=2, ComSignalType=UINT8, ComHandleId=156, ComSystemTemplateSystemSignalRef=IBS_EPBControllerSts
            IBS_HazWarnReq_oIBS_Status_02_oATOM_CANFD_Matrix_CH_V600_202502_b191eb63_Rx: ComBitPosition=38, ComBitSize=2, ComSignalType=UINT8, ComHandleId=163, ComSystemTemplateSystemSignalRef=IBS_HazWarnReq
        SG_VCU_IBS_01_SigGroup_oVCU_IBS_01_oATOM_CANFD_Matrix_CH_V600_202502_f0f49d09_Tx: ComHandleId=8, ComSystemTemplateSignalGroupRef=SG_VCU_IBS_01_SigGroup
          7 x ComGroupSignal, all with ComSignalEndianness=BIG_ENDIAN, ComSignalInitValue=0, ComTransferProperty=PENDING, ComSignalAccess=ACCESS_UNCLEAR:
            VCU_WheelTrqACTValid_oVCU_IBS_01_oATOM_CANFD_Matrix_CH_V600_202502_0e2031fb_Tx: ComBitPosition=40, ComBitSize=1, ComSignalType=BOOLEAN, ComHandleId=172, ComSystemTemplateSystemSignalRef=VCU_WheelTrqACTValid
            VCU_MotorActualTorqueValid_oVCU_IBS_01_oATOM_CANFD_Matrix_CH_V600_202502_2709c7ef_Tx: ComBitPosition=14, ComBitSize=1, ComSignalType=BOOLEAN, ComHandleId=169, ComSystemTemplateSystemSignalRef=VCU_MotorActualTorqueValid
            MessageCounter_094_oVCU_IBS_01_oATOM_CANFD_Matrix_CH_V600_202502_804a7805_Tx: ComBitPosition=11, ComBitSize=4, ComSignalType=UINT8, ComHandleId=168, ComSystemTemplateSystemSignalRef=MessageCounter_094
            VCU_MotorActualTorque_oVCU_IBS_01_oATOM_CANFD_Matrix_CH_V600_202502_90c1c989_Tx: ComBitPosition=39, ComBitSize=11, ComSignalType=UINT16, ComHandleId=170, ComSystemTemplateSystemSignalRef=VCU_MotorActualTorque
            VCU_OPStandstillReq_oVCU_IBS_01_oATOM_CANFD_Matrix_CH_V600_202502_af773c24_Tx: ComBitPosition=42, ComBitSize=2, ComSignalType=UINT8, ComHandleId=171, ComSystemTemplateSystemSignalRef=VCU_OPStandstillReq
            VCU_WheelTrqACT_oVCU_IBS_01_oATOM_CANFD_Matrix_CH_V600_202502_722027bb_Tx: ComBitPosition=55, ComBitSize=16, ComSignalType=UINT16, ComHandleId=173, ComSystemTemplateSystemSignalRef=VCU_WheelTrqACT
            Checksum_094_oVCU_IBS_01_oATOM_CANFD_Matrix_CH_V600_202502_28a707e9_Tx: ComBitPosition=7, ComBitSize=8, ComSignalType=UINT8, ComHandleId=167, ComSystemTemplateSystemSignalRef=Checksum_094
        SG_ACU_info_SigGroup_oACU_info_oATOM_CANFD_Matrix_CH_V600_202502_5b63ef23_Rx: ComHandleId=2, ComSystemTemplateSignalGroupRef=SG_ACU_info_SigGroup
          19 x ComGroupSignal, all with ComSignalEndianness=BIG_ENDIAN, ComSignalAccess=ACCESS_UNCLEAR:
            ACU_DriverSeatBeltStsValid_oACU_info_oATOM_CANFD_Matrix_CH_V600_202502_2fcd0f16_Rx: ComBitPosition=30, ComBitSize=1, ComSignalInitValue=0, ComSignalType=BOOLEAN, ComHandleId=72, ComSystemTemplateSystemSignalRef=ACU_DriverSeatBeltStsValid
            ACU_RRSeatBeltStatusValid_oACU_info_oATOM_CANFD_Matrix_CH_V600_202502_8ba1e757_Rx: ComBitPosition=54, ComBitSize=1, ComSignalInitValue=0, ComSignalType=BOOLEAN, ComHandleId=81, ComSystemTemplateSystemSignalRef=ACU_RRSeatBeltStatusValid
            ACU_PassengerWarningLampSts_oACU_info_oATOM_CANFD_Matrix_CH_V600_202502_eaccbc6f_Rx: ComBitPosition=59, ComBitSize=2, ComSignalInitValue=0, ComSignalType=UINT8, ComHandleId=79, ComSystemTemplateSystemSignalRef=ACU_PassengerWarningLampSts
            ACU_PassengerAirbagSts_oACU_info_oATOM_CANFD_Matrix_CH_V600_202502_4a4cb1e6_Rx: ComBitPosition=63, ComBitSize=2, ComSignalInitValue=0, ComSignalType=UINT8, ComHandleId=75, ComSystemTemplateSystemSignalRef=ACU_PassengerAirbagSts
            ACU_CrashOutputStsValid_oACU_info_oATOM_CANFD_Matrix_CH_V600_202502_01645954_Rx: ComBitPosition=16, ComBitSize=1, ComSignalInitValue=1, ComSignalType=BOOLEAN, ComHandleId=70, ComSystemTemplateSystemSignalRef=ACU_CrashOutputStsValid
            ACU_PassengerSeatBeltSts_oACU_info_oATOM_CANFD_Matrix_CH_V600_202502_2c4c3734_Rx: ComBitPosition=27, ComBitSize=1, ComSignalInitValue=0, ComSignalType=BOOLEAN, ComHandleId=77, ComSystemTemplateSystemSignalRef=ACU_PassengerSeatBeltSts
            ACU_WarningLampSts_oACU_info_oATOM_CANFD_Matrix_CH_V600_202502_9c596fcb_Rx: ComBitPosition=57, ComBitSize=2, ComSignalInitValue=0, ComSignalType=UINT8, ComHandleId=86, ComSystemTemplateSystemSignalRef=ACU_WarningLampSts
            ACU_SecondLeftSts_oACU_info_oATOM_CANFD_Matrix_CH_V600_202502_4d0b3459_Rx: ComBitPosition=37, ComBitSize=1, ComSignalInitValue=0, ComSignalType=BOOLEAN, ComHandleId=83, ComSystemTemplateSystemSignalRef=ACU_SecondLeftSts
            ACU_PassengerSts_oACU_info_oATOM_CANFD_Matrix_CH_V600_202502_eb52bcb8_Rx: ComBitPosition=25, ComBitSize=1, ComSignalInitValue=0, ComSignalType=BOOLEAN, ComHandleId=78, ComSystemTemplateSystemSignalRef=ACU_PassengerSts
            Checksum_097_oACU_info_oATOM_CANFD_Matrix_CH_V600_202502_591da21b_Rx: ComBitPosition=7, ComBitSize=8, ComSignalInitValue=0, ComSignalType=UINT8, ComHandleId=87, ComSystemTemplateSystemSignalRef=Checksum_097
            MessageCounter_097_oACU_info_oATOM_CANFD_Matrix_CH_V600_202502_9c6de300_Rx: ComBitPosition=11, ComBitSize=4, ComSignalInitValue=0, ComSignalType=UINT8, ComHandleId=88, ComSystemTemplateSystemSignalRef=MessageCounter_097
            ACU_SecondRightSeatBeltSts_oACU_info_oATOM_CANFD_Matrix_CH_V600_202502_3170c946_Rx: ComBitPosition=55, ComBitSize=1, ComSignalInitValue=0, ComSignalType=BOOLEAN, ComHandleId=84, ComSystemTemplateSystemSignalRef=ACU_SecondRightSeatBeltSts
            ACU_CrashOutputSts_oACU_info_oATOM_CANFD_Matrix_CH_V600_202502_8aba12b9_Rx: ComBitPosition=23, ComBitSize=5, ComSignalInitValue=0, ComSignalType=UINT8, ComHandleId=71, ComSystemTemplateSystemSignalRef=ACU_CrashOutputSts
            ACU_SecondRightSts_oACU_info_oATOM_CANFD_Matrix_CH_V600_202502_19211d8e_Rx: ComBitPosition=53, ComBitSize=1, ComSignalInitValue=0, ComSignalType=BOOLEAN, ComHandleId=85, ComSystemTemplateSystemSignalRef=ACU_SecondRightSts
            ACU_DriverSeatBeltSts_oACU_info_oATOM_CANFD_Matrix_CH_V600_202502_4a79a099_Rx: ComBitPosition=31, ComBitSize=1, ComSignalInitValue=0, ComSignalType=BOOLEAN, ComHandleId=73, ComSystemTemplateSystemSignalRef=ACU_DriverSeatBeltSts
            ACU_PassengerSeatBeltStsValid_oACU_info_oATOM_CANFD_Matrix_CH_V600_202502_96ea6676_Rx: ComBitPosition=26, ComBitSize=1, ComSignalInitValue=0, ComSignalType=BOOLEAN, ComHandleId=76, ComSystemTemplateSystemSignalRef=ACU_PassengerSeatBeltStsValid
            ACU_SecondLeftSeatBeltSts_oACU_info_oATOM_CANFD_Matrix_CH_V600_202502_0c298557_Rx: ComBitPosition=39, ComBitSize=1, ComSignalInitValue=0, ComSignalType=BOOLEAN, ComHandleId=82, ComSystemTemplateSystemSignalRef=ACU_SecondLeftSeatBeltSts
            ACU_RLSeatBeltStatusValid_oACU_info_oATOM_CANFD_Matrix_CH_V600_202502_231d8b98_Rx: ComBitPosition=38, ComBitSize=1, ComSignalInitValue=0, ComSignalType=BOOLEAN, ComHandleId=80, ComSystemTemplateSystemSignalRef=ACU_RLSeatBeltStatusValid
            ACU_DriverWarningLampSts_oACU_info_oATOM_CANFD_Matrix_CH_V600_202502_53dfaac4_Rx: ComBitPosition=61, ComBitSize=2, ComSignalInitValue=0, ComSignalType=UINT8, ComHandleId=74, ComSystemTemplateSystemSignalRef=ACU_DriverWarningLampSts
        SG_IBS_Status_04_SigGroup_oIBS_Status_04_oATOM_CANFD_Matrix_CH_V600_202502_edfe62a4_Rx: ComHandleId=13, ComSystemTemplateSignalGroupRef=SG_IBS_Status_04_SigGroup
          5 x ComGroupSignal, all with ComSignalEndianness=BIG_ENDIAN, ComSignalInitValue=0, ComSignalAccess=ACCESS_UNCLEAR:
            Checksum_0BA_oIBS_Status_04_oATOM_CANFD_Matrix_CH_V600_202502_77cd2b4a_Rx: ComBitPosition=7, ComBitSize=8, ComSignalType=UINT8, ComHandleId=183, ComSystemTemplateSystemSignalRef=Checksum_0BA
            IBS_DTCActive_oIBS_Status_04_oATOM_CANFD_Matrix_CH_V600_202502_05637011_Rx: ComBitPosition=21, ComBitSize=1, ComSignalType=BOOLEAN, ComHandleId=186, ComSystemTemplateSystemSignalRef=IBS_DTCActive
            IBS_CDPActive_oIBS_Status_04_oATOM_CANFD_Matrix_CH_V600_202502_5f0477e0_Rx: ComBitPosition=23, ComBitSize=1, ComSignalType=BOOLEAN, ComHandleId=184, ComSystemTemplateSystemSignalRef=IBS_CDPActive
            IBS_CDPAvailable_oIBS_Status_04_oATOM_CANFD_Matrix_CH_V600_202502_551f17a8_Rx: ComBitPosition=22, ComBitSize=1, ComSignalType=BOOLEAN, ComHandleId=185, ComSystemTemplateSystemSignalRef=IBS_CDPAvailable
            MessageCounter_0BA_oIBS_Status_04_oATOM_CANFD_Matrix_CH_V600_202502_a129f9da_Rx: ComBitPosition=11, ComBitSize=4, ComSignalType=UINT8, ComHandleId=187, ComSystemTemplateSystemSignalRef=MessageCounter_0BA
        SG_ADCU_APS_02_SigGroup_oADCU_APS_02_oATOM_CANFD_Matrix_CH_V600_202502_67bc1f98_Rx: ComHandleId=6, ComSystemTemplateSignalGroupRef=SG_ADCU_APS_02_SigGroup
          ADCU_RemoteParkingMode_oADCU_APS_02_oATOM_CANFD_Matrix_CH_V600_202502_262c752a_Rx (ComGroupSignal):
            ComBitPosition = 23
            ComBitSize = 4
            ComSignalEndianness = BIG_ENDIAN
            ComSignalInitValue = 0
            ComSignalType = UINT8
            ComSignalAccess = ACCESS_UNCLEAR
            ComHandleId = 117
            ComSystemTemplateSystemSignalRef = ADCU_RemoteParkingMode
        SG_VCU_MCU_03_SigGroup_oVCU_MCU_03_oATOM_CANFD_Matrix_CH_V600_202502_c0057d9b_Tx: ComHandleId=9, ComSystemTemplateSignalGroupRef=SG_VCU_MCU_03_SigGroup
          11 x ComGroupSignal, all with ComSignalEndianness=BIG_ENDIAN, ComSignalInitValue=0, ComTransferProperty=PENDING, ComSignalAccess=ACCESS_UNCLEAR:
            VCU_BrakepedalStatus_oVCU_MCU_03_oATOM_CANFD_Matrix_CH_V600_202502_f285ec19_Tx: ComBitPosition=47, ComBitSize=2, ComSignalType=UINT8, ComHandleId=177, ComSystemTemplateSystemSignalRef=VCU_BrakepedalStatus
            VCU_MCUDesiredTorque_oVCU_MCU_03_oATOM_CANFD_Matrix_CH_V600_202502_a07350bb_Tx: ComBitPosition=23, ComBitSize=11, ComSignalType=UINT16, ComHandleId=179, ComSystemTemplateSystemSignalRef=VCU_MCUDesiredTorque
            VCU_RequestedModeMCU_oVCU_MCU_03_oATOM_CANFD_Matrix_CH_V600_202502_97cf52ed_Tx: ComBitPosition=43, ComBitSize=4, ComSignalType=UINT8, ComHandleId=182, ComSystemTemplateSystemSignalRef=VCU_RequestedModeMCU
            VCU_TrqThresholdDampgCtl_oVCU_MCU_03_oATOM_CANFD_Matrix_CH_V600_202502_86f61526_Tx: ComBitPosition=55, ComBitSize=8, ComSignalType=UINT8, ComHandleId=184, ComSystemTemplateSystemSignalRef=VCU_TrqThresholdDampgCtl
            VCU_MCUSurgeDamperState_oVCU_MCU_03_oATOM_CANFD_Matrix_CH_V600_202502_4b3e55ae_Tx: ComBitPosition=37, ComBitSize=2, ComSignalType=UINT8, ComHandleId=180, ComSystemTemplateSystemSignalRef=VCU_MCUSurgeDamperState
            VCU_TCSActive_oVCU_MCU_03_oATOM_CANFD_Matrix_CH_V600_202502_f7e15433_Tx: ComBitPosition=38, ComBitSize=1, ComSignalType=BOOLEAN, ComHandleId=183, ComSystemTemplateSystemSignalRef=VCU_TCSActive
            Checksum_095_oVCU_MCU_03_oATOM_CANFD_Matrix_CH_V600_202502_004b6de5_Tx: ComBitPosition=7, ComBitSize=8, ComSignalType=UINT8, ComHandleId=174, ComSystemTemplateSystemSignalRef=Checksum_095
            VCU_ActualGear_oVCU_MCU_03_oATOM_CANFD_Matrix_CH_V600_202502_adcf3745_Tx: ComBitPosition=34, ComBitSize=3, ComSignalType=UINT8, ComHandleId=176, ComSystemTemplateSystemSignalRef=VCU_ActualGear
            MessageCounter_095_oVCU_MCU_03_oATOM_CANFD_Matrix_CH_V600_202502_a8a61209_Tx: ComBitPosition=11, ComBitSize=4, ComSignalType=UINT8, ComHandleId=175, ComSystemTemplateSystemSignalRef=MessageCounter_095
            VCU_PWTErrorLevel_oVCU_MCU_03_oATOM_CANFD_Matrix_CH_V600_202502_4725a26e_Tx: ComBitPosition=15, ComBitSize=4, ComSignalType=UINT8, ComHandleId=181, ComSystemTemplateSystemSignalRef=VCU_PWTErrorLevel
            VCU_KL15eOn_oVCU_MCU_03_oATOM_CANFD_Matrix_CH_V600_202502_2306d930_Tx: ComBitPosition=39, ComBitSize=1, ComSignalType=BOOLEAN, ComHandleId=178, ComSystemTemplateSystemSignalRef=VCU_KL15eOn
        SG_IBS_Status_06_SigGroup_oIBS_Status_06_oATOM_CANFD_Matrix_CH_V600_202502_7b2b4097_Rx: ComHandleId=14, ComSystemTemplateSignalGroupRef=SG_IBS_Status_06_SigGroup
          20 x ComGroupSignal, all with ComSignalEndianness=BIG_ENDIAN, ComSignalAccess=ACCESS_UNCLEAR:
            IBS_TireMonSysSts_oIBS_Status_06_oATOM_CANFD_Matrix_CH_V600_202502_91ee3722_Rx: ComBitPosition=61, ComBitSize=1, ComSignalInitValue=1, ComSignalType=BOOLEAN, ComHandleId=202, ComSystemTemplateSystemSignalRef=IBS_TireMonSysSts
            IBS_ESClampdisplay_oIBS_Status_06_oATOM_CANFD_Matrix_CH_V600_202502_cffaf18c_Rx: ComBitPosition=53, ComBitSize=2, ComSignalInitValue=0, ComSignalType=UINT8, ComHandleId=193, ComSystemTemplateSystemSignalRef=IBS_ESClampdisplay
            IBS_TireWarnFrntRi_oIBS_Status_06_oATOM_CANFD_Matrix_CH_V600_202502_dbb01a62_Rx: ComBitPosition=56, ComBitSize=1, ComSignalInitValue=0, ComSignalType=BOOLEAN, ComHandleId=204, ComSystemTemplateSystemSignalRef=IBS_TireWarnFrntRi
            IBS_AVHSts_oIBS_Status_06_oATOM_CANFD_Matrix_CH_V600_202502_e3018ac7_Rx: ComBitPosition=55, ComBitSize=2, ComSignalInitValue=0, ComSignalType=UINT8, ComHandleId=189, ComSystemTemplateSystemSignalRef=IBS_AVHSts
            IBS_TPMS_ResetSts_oIBS_Status_06_oATOM_CANFD_Matrix_CH_V600_202502_ee7e0532_Rx: ComBitPosition=60, ComBitSize=1, ComSignalInitValue=0, ComSignalType=BOOLEAN, ComHandleId=201, ComSystemTemplateSystemSignalRef=IBS_TPMS_ResetSts
            IBS_TireWarnFrntLe_oIBS_Status_06_oATOM_CANFD_Matrix_CH_V600_202502_7fea0ce4_Rx: ComBitPosition=57, ComBitSize=1, ComSignalInitValue=0, ComSignalType=BOOLEAN, ComHandleId=203, ComSystemTemplateSystemSignalRef=IBS_TireWarnFrntLe
            IBS_EPBFailureStatus_oIBS_Status_06_oATOM_CANFD_Matrix_CH_V600_202502_2591769d_Rx: ComBitPosition=63, ComBitSize=2, ComSignalInitValue=0, ComSignalType=UINT8, ComHandleId=191, ComSystemTemplateSystemSignalRef=IBS_EPBFailureStatus
            IBS_RWUActive_oIBS_Status_06_oATOM_CANFD_Matrix_CH_V600_202502_353ab732_Rx: ComBitPosition=44, ComBitSize=1, ComSignalInitValue=0, ComSignalType=BOOLEAN, ComHandleId=198, ComSystemTemplateSystemSignalRef=IBS_RWUActive
            IBS_HBAActive_oIBS_Status_06_oATOM_CANFD_Matrix_CH_V600_202502_b3e0fd61_Rx: ComBitPosition=46, ComBitSize=1, ComSignalInitValue=0, ComSignalType=BOOLEAN, ComHandleId=195, ComSystemTemplateSystemSignalRef=IBS_HBAActive
            IBS_HDCSts_oIBS_Status_06_oATOM_CANFD_Matrix_CH_V600_202502_d0313153_Rx: ComBitPosition=51, ComBitSize=2, ComSignalInitValue=0, ComSignalType=UINT8, ComHandleId=196, ComSystemTemplateSystemSignalRef=IBS_HDCSts
            IBS_TireWarnReRi_oIBS_Status_06_oATOM_CANFD_Matrix_CH_V600_202502_ca07afb6_Rx: ComBitPosition=58, ComBitSize=1, ComSignalInitValue=0, ComSignalType=BOOLEAN, ComHandleId=206, ComSystemTemplateSystemSignalRef=IBS_TireWarnReRi
            IBS_TireWarnReLe_oIBS_Status_06_oATOM_CANFD_Matrix_CH_V600_202502_6e5db930_Rx: ComBitPosition=59, ComBitSize=1, ComSignalInitValue=0, ComSignalType=BOOLEAN, ComHandleId=205, ComSystemTemplateSystemSignalRef=IBS_TireWarnReLe
            Checksum_0BC_oIBS_Status_06_oATOM_CANFD_Matrix_CH_V600_202502_e0933738_Rx: ComBitPosition=7, ComBitSize=8, ComSignalInitValue=0, ComSignalType=UINT8, ComHandleId=188, ComSystemTemplateSystemSignalRef=Checksum_0BC
            IBS_BrakeFluidWarning_oIBS_Status_06_oATOM_CANFD_Matrix_CH_V600_202502_cf3bf9da_Rx: ComBitPosition=49, ComBitSize=2, ComSignalInitValue=0, ComSignalType=UINT8, ComHandleId=190, ComSystemTemplateSystemSignalRef=IBS_BrakeFluidWarning
            MessageCounter_0BC_oIBS_Status_06_oATOM_CANFD_Matrix_CH_V600_202502_3677e5a8_Rx: ComBitPosition=11, ComBitSize=4, ComSignalInitValue=0, ComSignalType=UINT8, ComHandleId=207, ComSystemTemplateSystemSignalRef=MessageCounter_0BC
            IBS_ESCOffSts_oIBS_Status_06_oATOM_CANFD_Matrix_CH_V600_202502_a7e250e7_Rx: ComBitPosition=45, ComBitSize=1, ComSignalInitValue=1, ComSignalType=BOOLEAN, ComHandleId=192, ComSystemTemplateSystemSignalRef=IBS_ESCOffSts
            IBS_FactoryMode_oIBS_Status_06_oATOM_CANFD_Matrix_CH_V600_202502_1f4b8984_Rx: ComBitPosition=40, ComBitSize=1, ComSignalInitValue=0, ComSignalType=BOOLEAN, ComHandleId=194, ComSystemTemplateSystemSignalRef=IBS_FactoryMode
            IBS_RWUAvailable_oIBS_Status_06_oATOM_CANFD_Matrix_CH_V600_202502_55a4e82d_Rx: ComBitPosition=43, ComBitSize=1, ComSignalInitValue=0, ComSignalType=BOOLEAN, ComHandleId=199, ComSystemTemplateSystemSignalRef=IBS_RWUAvailable
            IBS_MaintenaceMode_oIBS_Status_06_oATOM_CANFD_Matrix_CH_V600_202502_e1932fbc_Rx: ComBitPosition=42, ComBitSize=1, ComSignalInitValue=0, ComSignalType=BOOLEAN, ComHandleId=197, ComSystemTemplateSystemSignalRef=IBS_MaintenaceMode
            IBS_RollerbenchMode_oIBS_Status_06_oATOM_CANFD_Matrix_CH_V600_202502_7e2deccc_Rx: ComBitPosition=41, ComBitSize=1, ComSignalInitValue=0, ComSignalType=BOOLEAN, ComHandleId=200, ComSystemTemplateSystemSignalRef=IBS_RollerbenchMode
        SG_VCU_04_SigGroup_oVCU_04_oATOM_CANFD_Matrix_CH_V600_202502_4cce7c18_Tx: ComHandleId=2, ComSystemTemplateSignalGroupRef=SG_VCU_04_SigGroup
          VCU_ManuallyUnlockComment_oVCU_04_oATOM_CANFD_Matrix_CH_V600_202502_3223f100_Tx (ComGroupSignal):
            ComBitPosition = 14
            ComBitSize = 1
            ComSignalEndianness = BIG_ENDIAN
            ComSignalInitValue = 0
            ComSignalType = BOOLEAN
            ComTransferProperty = PENDING
            ComSignalAccess = ACCESS_UNCLEAR
            ComHandleId = 102
            ComSystemTemplateSystemSignalRef = VCU_ManuallyUnlockComment
          VCU_ForwardVmaxlimitStatus_oVCU_04_oATOM_CANFD_Matrix_CH_V600_202502_beba9b73_Tx (ComGroupSignal):
            ComBitPosition = 15
            ComBitSize = 1
            ComSignalEndianness = BIG_ENDIAN
            ComSignalInitValue = 0
            ComSignalType = BOOLEAN
            ComTransferProperty = PENDING
            ComSignalAccess = ACCESS_UNCLEAR
            ComHandleId = 101
            ComSystemTemplateSystemSignalRef = VCU_ForwardVmaxlimitStatus
