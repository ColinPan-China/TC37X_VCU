AUTOSAR XML (schema 00048)
package /ActiveEcuC
  module config Com: implementation-config-variant=VARIANT-PRE-COMPILE, module-description=Com_Impl
    ComGeneration:
      ComOutOfBoundsWriteProtectionStrategy = NONE
      ComOutOfBoundsWriteSanitizer = false
      ComOutOfBoundsReadSanitizer = false
      ComReduceConstantData2Define = false
      ComBoolDataInArrayOfStructStrategy = BOOLEAN
      ComDeduplicateIndirectedData = true
      ComDataDeduplicationStrategy = WITH_CAST
      ComReduceBoolDataByNegationThreshold = 2
      ComReduceBoolDataByNumericalComparisonThreshold = 2
      ComReduceBoolDataByNumericalRelationThreshold = 2
      ComReduceBoolDataByNumericalOperandStrategy = WITH_ANY_VALUE
      ComReduceNumericalDataByOffsetThreshold = 2
      ComReduceNumericalDataByArraySubtractionThreshold = 2
      ComReduceDataByStreaming = false
      ComShortSymbols = false
      ComInterfacesForDeactivatedData = false
      ComReferringKeysInComments = false
    ComOptimization:
      ComTxProcessingISRLockThreshold = 1
      ComRxProcessingISRLockThreshold = 1
      ComGatewayProcessingISRLockThreshold = 1
      ComGatewayDescriptionProcessingISRLockThreshold = 1
      ComIPduGroupISRLockThreshold = 1
    ComConfig: ComConfigurationId=0, ComRxDeferredNotificationCacheSize=1, ComRxImmediateNotificationCacheSize=0
      VCU_oTC37X_VCU_CAN00_Tx_f6d10bbf (ComIPduGroup): ComIPduGroupHandleId=3
      10 x ComSignal, all with ComBitSize=16, ComSignalEndianness=LITTLE_ENDIAN, ComSignalInitValue=0, ComSignalType=SINT16:
        VcuRxMsg2_Sig3_oVcuRxMsg2_oTC37X_VCU_CAN00_31c6b130_Rx: ComBitPosition=48, ComTimeout=2, ComSignalAccess=ACCESS_NEEDED_BY_SWC_OR_COM, ComHandleId=7, ComNotification=Rte_COMCbk_VcuRxMsg2_Sig3_oVcuRxMsg2_oTC37X_VCU_CAN00_31c6b130_Rx, ComTimeoutNotification=Rte_COMCbkRxTOut_VcuRxMsg2_Sig3_oVcuRxMsg2_oTC37X_VCU_CAN00_31c6b130_Rx, ComSystemTemplateSystemSignalRef=VcuRxMsg2_Sig3
        VcuTxMsg2_Sig3_oVcuTxMsg2_oTC37X_VCU_CAN00_a04bfcfd_Tx: ComBitPosition=48, ComTimeout=0, ComTransferProperty=PENDING, ComSignalAccess=ACCESS_UNCLEAR, ComHandleId=47, ComSystemTemplateSystemSignalRef=VcuTxMsg2_Sig3
        VcuRxMsg2_Sig0_oVcuRxMsg2_oTC37X_VCU_CAN00_94ceda5c_Rx: ComBitPosition=0, ComTimeout=2, ComSignalAccess=ACCESS_NEEDED_BY_SWC_OR_COM, ComHandleId=4, ComNotification=Rte_COMCbk_VcuRxMsg2_Sig0_oVcuRxMsg2_oTC37X_VCU_CAN00_94ceda5c_Rx, ComTimeoutNotification=Com_Msg201h_Timeout_Notification, ComFirstTimeout=2, ComSystemTemplateSystemSignalRef=VcuRxMsg2_Sig0
        VcuRxMsg2_Sig2_oVcuRxMsg2_oTC37X_VCU_CAN00_52c16814_Rx: ComBitPosition=32, ComTimeout=2, ComSignalAccess=ACCESS_UNCLEAR, ComHandleId=6, ComNotification=Rte_COMCbk_VcuRxMsg2_Sig2_oVcuRxMsg2_oTC37X_VCU_CAN00_52c16814_Rx, ComTimeoutNotification=Rte_COMCbkRxTOut_VcuRxMsg2_Sig2_oVcuRxMsg2_oTC37X_VCU_CAN00_52c16814_Rx, ComSystemTemplateSystemSignalRef=VcuRxMsg2_Sig2
        VcuTxMsg1_Sig1_oVcuTxMsg1_oTC37X_VCU_CAN00_e144608d_Tx: ComBitPosition=16, ComTimeout=0, ComTransferProperty=PENDING, ComSignalAccess=ACCESS_UNCLEAR, ComHandleId=41, ComSystemTemplateSystemSignalRef=VcuTxMsg1_Sig1
        VcuTxMsg2_Sig0_oVcuTxMsg2_oTC37X_VCU_CAN00_05439791_Tx: ComBitPosition=0, ComTimeout=0, ComTransferProperty=PENDING, ComSignalAccess=ACCESS_UNCLEAR, ComHandleId=44, ComSystemTemplateSystemSignalRef=VcuTxMsg2_Sig0
        VcuRxMsg1_Sig2_oVcuRxMsg1_oTC37X_VCU_CAN00_d5c1462c_Rx: ComBitPosition=32, ComTimeout=2, ComSignalAccess=ACCESS_UNCLEAR, ComHandleId=2, ComNotification=Rte_COMCbk_VcuRxMsg1_Sig2_oVcuRxMsg1_oTC37X_VCU_CAN00_d5c1462c_Rx, ComTimeoutNotification=Rte_COMCbkRxTOut_VcuRxMsg1_Sig2_oVcuRxMsg1_oTC37X_VCU_CAN00_d5c1462c_Rx, ComSystemTemplateSystemSignalRef=VcuRxMsg1_Sig2
        VcuTxMsg1_Sig2_oVcuTxMsg1_oTC37X_VCU_CAN00_444c0be1_Tx: ComBitPosition=32, ComTimeout=0, ComTransferProperty=PENDING, ComSignalAccess=ACCESS_UNCLEAR, ComHandleId=42, ComSystemTemplateSystemSignalRef=VcuTxMsg1_Sig2
        VcuRxMsg2_Sig1_oVcuRxMsg2_oTC37X_VCU_CAN00_f7c90378_Rx: ComBitPosition=16, ComTimeout=2, ComSignalAccess=ACCESS_UNCLEAR, ComHandleId=5, ComNotification=Rte_COMCbk_VcuRxMsg2_Sig1_oVcuRxMsg2_oTC37X_VCU_CAN00_f7c90378_Rx, ComTimeoutNotification=Rte_COMCbkRxTOut_VcuRxMsg2_Sig1_oVcuRxMsg2_oTC37X_VCU_CAN00_f7c90378_Rx, ComSystemTemplateSystemSignalRef=VcuRxMsg2_Sig1
        VcuTxMsg2_Sig2_oVcuTxMsg2_oTC37X_VCU_CAN00_c34c25d9_Tx: ComBitPosition=32, ComTimeout=0, ComTransferProperty=PENDING, ComSignalAccess=ACCESS_UNCLEAR, ComHandleId=46, ComSystemTemplateSystemSignalRef=VcuTxMsg2_Sig2
      VcuTxMsg1_oTC37X_VCU_CAN00_954a27ee_Tx (ComIPdu):
        ComIPduDirection = SEND
        ComIPduType = NORMAL
        ComIPduHandleId = 10
        ComIPduSignalProcessing = DEFERRED
        ComIPduCancellationSupport = false
        ComIPduGroupRef = VCU_oTC37X_VCU_CAN00_Tx_f6d10bbf
        ComIPduSignalRef = VcuTxMsg1_Sig0_oVcuTxMsg1_oTC37X_VCU_CAN00_8243b9a9_Tx
        ComIPduSignalRef = VcuTxMsg1_Sig1_oVcuTxMsg1_oTC37X_VCU_CAN00_e144608d_Tx
        ComIPduSignalRef = VcuTxMsg1_Sig2_oVcuTxMsg1_oTC37X_VCU_CAN00_444c0be1_Tx
        ComIPduSignalRef = VcuTxMsg1_Sig3_oVcuTxMsg1_oTC37X_VCU_CAN00_274bd2c5_Tx
        ComPduIdRef = VcuTxMsg1_oTC37X_VCU_CAN00_954a27ee_Tx
        ComIPduMainFunctionRef = ComMainFunctionTx
        ComTxIPdu: ComMinimumDelayTime=0, ComTxIPduUnusedAreasDefault=0
          ComTxModeTrue
            ComTxMode: ComTxModeMode=PERIODIC, ComTxModeTimeOffset=0.1, ComTxModeTimePeriod=0.5
          ComTxModeFalse
            ComTxMode: ComTxModeMode=PERIODIC, ComTxModeTimeOffset=0, ComTxModeTimePeriod=0.5
      3 x ComSignal, all with ComBitSize=16, ComSignalEndianness=LITTLE_ENDIAN, ComSignalInitValue=0, ComSignalType=SINT16, ComSignalAccess=ACCESS_UNCLEAR:
        VcuRxMsg1_Sig1_oVcuRxMsg1_oTC37X_VCU_CAN00_70c92d40_Rx: ComBitPosition=16, ComTimeout=2, ComHandleId=1, ComNotification=Rte_COMCbk_VcuRxMsg1_Sig1_oVcuRxMsg1_oTC37X_VCU_CAN00_70c92d40_Rx, ComTimeoutNotification=Rte_COMCbkRxTOut_VcuRxMsg1_Sig1_oVcuRxMsg1_oTC37X_VCU_CAN00_70c92d40_Rx, ComSystemTemplateSystemSignalRef=VcuRxMsg1_Sig1
        VcuRxMsg1_Sig0_oVcuRxMsg1_oTC37X_VCU_CAN00_13cef464_Rx: ComBitPosition=0, ComTimeout=2, ComHandleId=0, ComNotification=Rte_COMCbk_VcuRxMsg1_Sig0_oVcuRxMsg1_oTC37X_VCU_CAN00_13cef464_Rx, ComTimeoutNotification=Com_Msg200h_Timeout_Notification, ComFirstTimeout=2, ComSystemTemplateSystemSignalRef=VcuRxMsg1_Sig0
        VcuTxMsg1_Sig3_oVcuTxMsg1_oTC37X_VCU_CAN00_274bd2c5_Tx: ComBitPosition=48, ComTimeout=0, ComTransferProperty=PENDING, ComHandleId=43, ComSystemTemplateSystemSignalRef=VcuTxMsg1_Sig3
      VCU_oTC37X_VCU_CAN00_Rx_a08bac39 (ComIPduGroup): ComIPduGroupHandleId=2
      VcuTxMsg2_Sig1_oVcuTxMsg2_oTC37X_VCU_CAN00_66444eb5_Tx (ComSignal):
        ComBitPosition = 16
        ComBitSize = 16
        ComSignalEndianness = LITTLE_ENDIAN
        ComSignalInitValue = 0
        ComSignalType = SINT16
        ComTimeout = 0
        ComTransferProperty = PENDING
        ComSignalAccess = ACCESS_UNCLEAR
        ComHandleId = 45
        ComSystemTemplateSystemSignalRef = VcuTxMsg2_Sig1
      3 x ComIPdu, all with ComIPduType=NORMAL, ComIPduSignalProcessing=DEFERRED, ComIPduCancellationSupport=false:
        VcuRxMsg1_oTC37X_VCU_CAN00_78805594_Rx: ComIPduDirection=RECEIVE, ComIPduHandleId=0, ComIPduGroupRef=VCU_oTC37X_VCU_CAN00_Rx_a08bac39, ComIPduSignalRef=VcuRxMsg1_Sig0_oVcuRxMsg1_oTC37X_VCU_CAN00_13cef464_Rx, ComIPduSignalRef=VcuRxMsg1_Sig1_oVcuRxMsg1_oTC37X_VCU_CAN00_70c92d40_Rx, ComIPduSignalRef=VcuRxMsg1_Sig2_oVcuRxMsg1_oTC37X_VCU_CAN00_d5c1462c_Rx, ComIPduSignalRef=VcuRxMsg1_Sig3_oVcuRxMsg1_oTC37X_VCU_CAN00_b6c69f08_Rx, ComPduIdRef=VcuRxMsg1_oTC37X_VCU_CAN00_78805594_Rx, ComIPduMainFunctionRef=ComMainFunctionRx
        VcuTxMsg2_oTC37X_VCU_CAN00_7fccfa8c_Tx: ComIPduDirection=SEND, ComIPduHandleId=11, ComIPduGroupRef=VCU_oTC37X_VCU_CAN00_Tx_f6d10bbf, ComIPduSignalRef=VcuTxMsg2_Sig0_oVcuTxMsg2_oTC37X_VCU_CAN00_05439791_Tx, ComIPduSignalRef=VcuTxMsg2_Sig1_oVcuTxMsg2_oTC37X_VCU_CAN00_66444eb5_Tx, ComIPduSignalRef=VcuTxMsg2_Sig2_oVcuTxMsg2_oTC37X_VCU_CAN00_c34c25d9_Tx, ComIPduSignalRef=VcuTxMsg2_Sig3_oVcuTxMsg2_oTC37X_VCU_CAN00_a04bfcfd_Tx, ComPduIdRef=VcuTxMsg2_oTC37X_VCU_CAN00_7fccfa8c_Tx, ComIPduMainFunctionRef=ComMainFunctionTx
          ComTxIPdu: ComMinimumDelayTime=0, ComTxIPduUnusedAreasDefault=0
            ComTxModeTrue
              ComTxMode: ComTxModeMode=PERIODIC, ComTxModeTimeOffset=0.1, ComTxModeTimePeriod=0.5
            ComTxModeFalse
              ComTxMode: ComTxModeMode=PERIODIC, ComTxModeTimeOffset=0, ComTxModeTimePeriod=0.5
        VcuRxMsg2_oTC37X_VCU_CAN00_920688f6_Rx: ComIPduDirection=RECEIVE, ComIPduHandleId=1, ComIPduGroupRef=VCU_oTC37X_VCU_CAN00_Rx_a08bac39, ComIPduSignalRef=VcuRxMsg2_Sig0_oVcuRxMsg2_oTC37X_VCU_CAN00_94ceda5c_Rx, ComIPduSignalRef=VcuRxMsg2_Sig1_oVcuRxMsg2_oTC37X_VCU_CAN00_f7c90378_Rx, ComIPduSignalRef=VcuRxMsg2_Sig2_oVcuRxMsg2_oTC37X_VCU_CAN00_52c16814_Rx, ComIPduSignalRef=VcuRxMsg2_Sig3_oVcuRxMsg2_oTC37X_VCU_CAN00_31c6b130_Rx, ComPduIdRef=VcuRxMsg2_oTC37X_VCU_CAN00_920688f6_Rx, ComIPduMainFunctionRef=ComMainFunctionRx
      VcuTxMsg1_Sig0_oVcuTxMsg1_oTC37X_VCU_CAN00_8243b9a9_Tx (ComSignal):
        ComBitPosition = 0
        ComBitSize = 16
        ComSignalEndianness = LITTLE_ENDIAN
        ComSignalInitValue = 0
        ComSignalType = SINT16
        ComTimeout = 0
        ComTransferProperty = PENDING
        ComSignalAccess = ACCESS_UNCLEAR
        ComHandleId = 40
        ComSystemTemplateSystemSignalRef = VcuTxMsg1_Sig0
      VcuRxMsg1_Sig3_oVcuRxMsg1_oTC37X_VCU_CAN00_b6c69f08_Rx (ComSignal):
        ComBitPosition = 48
        ComBitSize = 16
        ComSignalEndianness = LITTLE_ENDIAN
        ComSignalInitValue = 0
        ComSignalType = SINT16
        ComTimeout = 2
        ComSignalAccess = ACCESS_UNCLEAR
        ComHandleId = 3
        ComNotification = Rte_COMCbk_VcuRxMsg1_Sig3_oVcuRxMsg1_oTC37X_VCU_CAN00_b6c69f08_Rx
        ComTimeoutNotification = Rte_COMCbkRxTOut_VcuRxMsg1_Sig3_oVcuRxMsg1_oTC37X_VCU_CAN00_b6c69f08_Rx
        ComSystemTemplateSystemSignalRef = VcuRxMsg1_Sig3
      ComMainFunctionRx: ComMainRxTimeBase=0.01
      ComMainFunctionTx: ComMainTxTimeBase=0.01
      VCU_oTC37X_VCU_CAN01_Rx_1837cb5c (ComIPduGroup): ComIPduGroupHandleId=4
      VCU_oTC37X_VCU_CAN01_Tx_4e6d6cda (ComIPduGroup): ComIPduGroupHandleId=5
      9 x ComSignal, all with ComBitSize=16, ComSignalEndianness=LITTLE_ENDIAN, ComSignalInitValue=0, ComSignalType=SINT16, ComTimeout=0, ComSignalAccess=ACCESS_UNCLEAR:
        VcuRxMsg4_Sig3_oVcuRxMsg4_oTC37X_VCU_CAN01_93b0db97_Rx: ComBitPosition=48, ComHandleId=15, ComSystemTemplateSystemSignalRef=VcuRxMsg4_Sig3
        VcuAdcTxMsg1_Sig3_oVcuAdcTxMsg1_oTC37X_VCU_CAN01_be6f7633_Tx: ComBitPosition=48, ComTransferProperty=PENDING, ComHandleId=35, ComSystemTemplateSystemSignalRef=VcuAdcTxMsg1_Sig3
        VcuAdcTxMsg2_Sig0_oVcuAdcTxMsg2_oTC37X_VCU_CAN01_c7979c8e_Tx: ComBitPosition=0, ComTransferProperty=PENDING, ComHandleId=36, ComSystemTemplateSystemSignalRef=VcuAdcTxMsg2_Sig0
        VcuRxMsg3_Sig1_oVcuRxMsg3_oTC37X_VCU_CAN01_4b1ed439_Rx: ComBitPosition=16, ComHandleId=9, ComSystemTemplateSystemSignalRef=VcuRxMsg3_Sig1
        VcuRxMsg3_Sig3_oVcuRxMsg3_oTC37X_VCU_CAN01_8d116671_Rx: ComBitPosition=48, ComHandleId=11, ComSystemTemplateSystemSignalRef=VcuRxMsg3_Sig3
        VcuAdcTxMsg2_Sig1_oVcuAdcTxMsg2_oTC37X_VCU_CAN01_364d9924_Tx: ComBitPosition=16, ComTransferProperty=PENDING, ComHandleId=37, ComSystemTemplateSystemSignalRef=VcuAdcTxMsg2_Sig1
        VcuAdcTxMsg2_Sig3_oVcuAdcTxMsg2_oTC37X_VCU_CAN01_0e889431_Tx: ComBitPosition=48, ComTransferProperty=PENDING, ComHandleId=39, ComSystemTemplateSystemSignalRef=VcuAdcTxMsg2_Sig3
        VcuAdcTxMsg1_Sig1_oVcuAdcTxMsg1_oTC37X_VCU_CAN01_86aa7b26_Tx: ComBitPosition=16, ComTransferProperty=PENDING, ComHandleId=33, ComSystemTemplateSystemSignalRef=VcuAdcTxMsg1_Sig1
        VcuRxMsg4_Sig1_oVcuRxMsg4_oTC37X_VCU_CAN01_55bf69df_Rx: ComBitPosition=16, ComHandleId=13, ComSystemTemplateSystemSignalRef=VcuRxMsg4_Sig1
      VcuAdcTxMsg2_oTC37X_VCU_CAN01_1723c88c_Tx (ComIPdu):
        ComIPduDirection = SEND
        ComIPduType = NORMAL
        ComIPduHandleId = 1
        ComIPduSignalProcessing = DEFERRED
        ComIPduCancellationSupport = false
        ComIPduGroupRef = VCU_oTC37X_VCU_CAN01_Tx_4e6d6cda
        ComIPduSignalRef = VcuAdcTxMsg2_Sig0_oVcuAdcTxMsg2_oTC37X_VCU_CAN01_c7979c8e_Tx
        ComIPduSignalRef = VcuAdcTxMsg2_Sig1_oVcuAdcTxMsg2_oTC37X_VCU_CAN01_364d9924_Tx
        ComIPduSignalRef = VcuAdcTxMsg2_Sig2_oVcuAdcTxMsg2_oTC37X_VCU_CAN01_ff52919b_Tx
        ComIPduSignalRef = VcuAdcTxMsg2_Sig3_oVcuAdcTxMsg2_oTC37X_VCU_CAN01_0e889431_Tx
        ComPduIdRef = VcuAdcTxMsg2_oTC37X_VCU_CAN01_1723c88c_Tx
        ComIPduMainFunctionRef = ComMainFunctionTx
        ComTxIPdu: ComMinimumDelayTime=0, ComTxIPduUnusedAreasDefault=0
          ComTxModeTrue
            ComTxMode: ComTxModeMode=PERIODIC, ComTxModeTimeOffset=0, ComTxModeTimePeriod=0.5
          ComTxModeFalse
            ComTxMode: ComTxModeMode=PERIODIC, ComTxModeTimeOffset=0, ComTxModeTimePeriod=0.5
      VcuRxMsg3_Sig2_oVcuRxMsg3_oTC37X_VCU_CAN01_ee16bf55_Rx (ComSignal):
        ComBitPosition = 32
        ComBitSize = 16
        ComSignalEndianness = LITTLE_ENDIAN
        ComSignalInitValue = 0
        ComSignalType = SINT16
        ComTimeout = 0
        ComSignalAccess = ACCESS_UNCLEAR
        ComHandleId = 10
        ComSystemTemplateSystemSignalRef = VcuRxMsg3_Sig2
      VcuRxMsg4_Sig2_oVcuRxMsg4_oTC37X_VCU_CAN01_f0b702b3_Rx (ComSignal):
        ComBitPosition = 32
        ComBitSize = 16
        ComSignalEndianness = LITTLE_ENDIAN
        ComSignalInitValue = 0
        ComSignalType = SINT16
        ComTimeout = 0
        ComSignalAccess = ACCESS_UNCLEAR
        ComHandleId = 14
        ComSystemTemplateSystemSignalRef = VcuRxMsg4_Sig2
      VcuAdcTxMsg1_oTC37X_VCU_CAN01_fda515ee_Tx (ComIPdu):
        ComIPduDirection = SEND
        ComIPduType = NORMAL
        ComIPduHandleId = 0
        ComIPduSignalProcessing = DEFERRED
        ComIPduCancellationSupport = false
        ComIPduGroupRef = VCU_oTC37X_VCU_CAN01_Tx_4e6d6cda
        ComIPduSignalRef = VcuAdcTxMsg1_Sig0_oVcuAdcTxMsg1_oTC37X_VCU_CAN01_77707e8c_Tx
        ComIPduSignalRef = VcuAdcTxMsg1_Sig1_oVcuAdcTxMsg1_oTC37X_VCU_CAN01_86aa7b26_Tx
        ComIPduSignalRef = VcuAdcTxMsg1_Sig2_oVcuAdcTxMsg1_oTC37X_VCU_CAN01_4fb57399_Tx
        ComIPduSignalRef = VcuAdcTxMsg1_Sig3_oVcuAdcTxMsg1_oTC37X_VCU_CAN01_be6f7633_Tx
        ComPduIdRef = VcuAdcTxMsg1_oTC37X_VCU_CAN01_fda515ee_Tx
        ComIPduMainFunctionRef = ComMainFunctionTx
        ComTxIPdu: ComMinimumDelayTime=0, ComTxIPduUnusedAreasDefault=0
          ComTxModeTrue
            ComTxMode: ComTxModeMode=PERIODIC, ComTxModeTimeOffset=0, ComTxModeTimePeriod=0.5
          ComTxModeFalse
            ComTxMode: ComTxModeMode=PERIODIC, ComTxModeTimeOffset=0, ComTxModeTimePeriod=0.5
      VcuRxMsg3_oTC37X_VCU_CAN01_0a530e81_Rx (ComIPdu):
        ComIPduDirection = RECEIVE
        ComIPduType = NORMAL
        ComIPduHandleId = 2
        ComIPduSignalProcessing = DEFERRED
        ComIPduCancellationSupport = false
        ComIPduGroupRef = VCU_oTC37X_VCU_CAN01_Rx_1837cb5c
        ComIPduSignalRef = VcuRxMsg3_Sig0_oVcuRxMsg3_oTC37X_VCU_CAN01_28190d1d_Rx
        ComIPduSignalRef = VcuRxMsg3_Sig1_oVcuRxMsg3_oTC37X_VCU_CAN01_4b1ed439_Rx
        ComIPduSignalRef = VcuRxMsg3_Sig2_oVcuRxMsg3_oTC37X_VCU_CAN01_ee16bf55_Rx
        ComIPduSignalRef = VcuRxMsg3_Sig3_oVcuRxMsg3_oTC37X_VCU_CAN01_8d116671_Rx
        ComPduIdRef = VcuRxMsg3_oTC37X_VCU_CAN01_0a530e81_Rx
        ComIPduMainFunctionRef = ComMainFunctionRx
      4 x ComSignal, all with ComBitSize=16, ComSignalEndianness=LITTLE_ENDIAN, ComSignalInitValue=0, ComSignalType=SINT16, ComTimeout=0, ComSignalAccess=ACCESS_UNCLEAR:
        VcuAdcTxMsg1_Sig2_oVcuAdcTxMsg1_oTC37X_VCU_CAN01_4fb57399_Tx: ComBitPosition=32, ComTransferProperty=PENDING, ComHandleId=34, ComSystemTemplateSystemSignalRef=VcuAdcTxMsg1_Sig2
        VcuRxMsg3_Sig0_oVcuRxMsg3_oTC37X_VCU_CAN01_28190d1d_Rx: ComBitPosition=0, ComHandleId=8, ComSystemTemplateSystemSignalRef=VcuRxMsg3_Sig0
        VcuAdcTxMsg1_Sig0_oVcuAdcTxMsg1_oTC37X_VCU_CAN01_77707e8c_Tx: ComBitPosition=0, ComTransferProperty=PENDING, ComHandleId=32, ComSystemTemplateSystemSignalRef=VcuAdcTxMsg1_Sig0
        VcuRxMsg4_Sig0_oVcuRxMsg4_oTC37X_VCU_CAN01_36b8b0fb_Rx: ComBitPosition=0, ComHandleId=12, ComSystemTemplateSystemSignalRef=VcuRxMsg4_Sig0
      VcuRxMsg4_oTC37X_VCU_CAN01_eb7d04e5_Rx (ComIPdu):
        ComIPduDirection = RECEIVE
        ComIPduType = NORMAL
        ComIPduHandleId = 3
        ComIPduSignalProcessing = DEFERRED
        ComIPduCancellationSupport = false
        ComIPduGroupRef = VCU_oTC37X_VCU_CAN01_Rx_1837cb5c
        ComIPduSignalRef = VcuRxMsg4_Sig0_oVcuRxMsg4_oTC37X_VCU_CAN01_36b8b0fb_Rx
        ComIPduSignalRef = VcuRxMsg4_Sig1_oVcuRxMsg4_oTC37X_VCU_CAN01_55bf69df_Rx
        ComIPduSignalRef = VcuRxMsg4_Sig2_oVcuRxMsg4_oTC37X_VCU_CAN01_f0b702b3_Rx
        ComIPduSignalRef = VcuRxMsg4_Sig3_oVcuRxMsg4_oTC37X_VCU_CAN01_93b0db97_Rx
        ComPduIdRef = VcuRxMsg4_oTC37X_VCU_CAN01_eb7d04e5_Rx
        ComIPduMainFunctionRef = ComMainFunctionRx
      VcuAdcTxMsg2_Sig2_oVcuAdcTxMsg2_oTC37X_VCU_CAN01_ff52919b_Tx (ComSignal):
        ComBitPosition = 32
        ComBitSize = 16
        ComSignalEndianness = LITTLE_ENDIAN
        ComSignalInitValue = 0
        ComSignalType = SINT16
        ComTimeout = 0
        ComTransferProperty = PENDING
        ComSignalAccess = ACCESS_UNCLEAR
        ComHandleId = 38
        ComSystemTemplateSystemSignalRef = VcuAdcTxMsg2_Sig2
      Vcu_Lin0_RxMsg2_oLIN00_ddf03b11_Rx (ComIPdu):
        ComIPduDirection = RECEIVE
        ComIPduType = NORMAL
        ComIPduHandleId = 5
        ComIPduSignalProcessing = DEFERRED
        ComIPduCancellationSupport = false
        ComIPduGroupRef = VCU_oLIN00_Rx_4b9dfc53
        ComIPduSignalRef = Vcu_Lin0_RxMsg2_Sig0_oVcu_Lin0_RxMsg2_oLIN00_d11e4405_Rx
        ComIPduSignalRef = Vcu_Lin0_RxMsg2_Sig1_oVcu_Lin0_RxMsg2_oLIN00_7495d40b_Rx
        ComIPduSignalRef = Vcu_Lin0_RxMsg2_Sig2_oVcu_Lin0_RxMsg2_oLIN00_41786258_Rx
        ComIPduSignalRef = Vcu_Lin0_RxMsg2_Sig3_oVcu_Lin0_RxMsg2_oLIN00_e4f3f256_Rx
        ComPduIdRef = Vcu_Lin0_RxMsg2_oLIN00_ddf03b11_Rx
        ComIPduMainFunctionRef = ComMainFunctionRx
      Vcu_Lin0_TxMsg2_Sig3_oVcu_Lin0_TxMsg2_oLIN00_88c157f8_Tx (ComSignal):
        ComBitPosition = 24
        ComBitSize = 8
        ComSignalEndianness = LITTLE_ENDIAN
        ComSignalInitValue = 0
        ComSignalType = UINT8
        ComSignalAccess = ACCESS_UNCLEAR
        ComHandleId = 55
        ComTransferProperty = PENDING
        ComSystemTemplateSystemSignalRef = Vcu_Lin0_TxMsg2_Sig3
      Vcu_Lin0_TxMsg1_Sig2_oVcu_Lin0_TxMsg1_oLIN00_e764e50d_Tx (ComSignal):
        ComBitPosition = 16
        ComBitSize = 8
        ComSignalEndianness = LITTLE_ENDIAN
        ComSignalInitValue = 0
        ComSignalType = UINT8
        ComSignalAccess = ACCESS_UNCLEAR
        ComHandleId = 50
        ComTransferProperty = PENDING
        ComSystemTemplateSystemSignalRef = Vcu_Lin0_TxMsg1_Sig2
      VCU_oLIN00_Rx_4b9dfc53 (ComIPduGroup): ComIPduGroupHandleId=0
      9 x ComSignal, all with ComBitSize=8, ComSignalEndianness=LITTLE_ENDIAN, ComSignalInitValue=0, ComSignalType=UINT8, ComSignalAccess=ACCESS_UNCLEAR:
        Vcu_Lin0_TxMsg2_Sig1_oVcu_Lin0_TxMsg2_oLIN00_18a771a5_Tx: ComBitPosition=8, ComHandleId=53, ComTransferProperty=PENDING, ComSystemTemplateSystemSignalRef=Vcu_Lin0_TxMsg2_Sig1
        Vcu_Lin0_TxMsg1_Sig1_oVcu_Lin0_TxMsg1_oLIN00_d289535e_Tx: ComBitPosition=8, ComHandleId=49, ComTransferProperty=PENDING, ComSystemTemplateSystemSignalRef=Vcu_Lin0_TxMsg1_Sig1
        Vcu_Lin0_RxMsg2_Sig1_oVcu_Lin0_RxMsg2_oLIN00_7495d40b_Rx: ComBitPosition=8, ComHandleId=19, ComSystemTemplateSystemSignalRef=Vcu_Lin0_RxMsg2_Sig1
        Vcu_Lin0_TxMsg1_Sig0_oVcu_Lin0_TxMsg1_oLIN00_7702c350_Tx: ComBitPosition=0, ComHandleId=48, ComTransferProperty=PENDING, ComSystemTemplateSystemSignalRef=Vcu_Lin0_TxMsg1_Sig0
        Vcu_Lin0_TxMsg2_Sig0_oVcu_Lin0_TxMsg2_oLIN00_bd2ce1ab_Tx: ComBitPosition=0, ComHandleId=52, ComTransferProperty=PENDING, ComSystemTemplateSystemSignalRef=Vcu_Lin0_TxMsg2_Sig0
        Vcu_Lin0_RxMsg2_Sig0_oVcu_Lin0_RxMsg2_oLIN00_d11e4405_Rx: ComBitPosition=0, ComHandleId=18, ComSystemTemplateSystemSignalRef=Vcu_Lin0_RxMsg2_Sig0
        Vcu_Lin0_RxMsg2_Sig2_oVcu_Lin0_RxMsg1_oLIN00_cff765bb_Rx: ComBitPosition=16, ComHandleId=20, ComSystemTemplateSystemSignalRef=Vcu_Lin0_RxMsg2_Sig2
        Vcu_Lin0_RxMsg1_Sig0_oVcu_Lin0_RxMsg1_oLIN00_1b3066fe_Rx: ComBitPosition=8, ComHandleId=16, ComSystemTemplateSystemSignalRef=Vcu_Lin0_RxMsg1_Sig0
        Vcu_Lin0_TxMsg2_Sig2_oVcu_Lin0_TxMsg2_oLIN00_2d4ac7f6_Tx: ComBitPosition=16, ComHandleId=54, ComTransferProperty=PENDING, ComSystemTemplateSystemSignalRef=Vcu_Lin0_TxMsg2_Sig2
      Vcu_Lin0_TxMsg1_oLIN00_f39ae32f_Tx (ComIPdu):
        ComIPduDirection = SEND
        ComIPduType = NORMAL
        ComIPduHandleId = 12
        ComIPduSignalProcessing = DEFERRED
        ComIPduCancellationSupport = false
        ComIPduGroupRef = VCU_oLIN00_Tx_1dc75bd5
        ComIPduSignalRef = Vcu_Lin0_TxMsg1_Sig0_oVcu_Lin0_TxMsg1_oLIN00_7702c350_Tx
        ComIPduSignalRef = Vcu_Lin0_TxMsg1_Sig1_oVcu_Lin0_TxMsg1_oLIN00_d289535e_Tx
        ComIPduSignalRef = Vcu_Lin0_TxMsg1_Sig2_oVcu_Lin0_TxMsg1_oLIN00_e764e50d_Tx
        ComIPduSignalRef = Vcu_Lin0_TxMsg1_Sig3_oVcu_Lin0_TxMsg1_oLIN00_42ef7503_Tx
        ComPduIdRef = Vcu_Lin0_TxMsg1_oLIN00_f39ae32f_Tx
        ComIPduMainFunctionRef = ComMainFunctionTx
        ComTxIPdu: ComTxIPduUnusedAreasDefault=255, ComMinimumDelayTime=0
          ComTxModeTrue
            ComTxMode: ComTxModeMode=NONE
          ComTxModeFalse
            ComTxMode: ComTxModeMode=NONE
      Vcu_Lin0_RxMsg2_Sig2_oVcu_Lin0_RxMsg2_oLIN00_41786258_Rx (ComSignal):
        ComBitPosition = 16
        ComBitSize = 8
        ComSignalEndianness = LITTLE_ENDIAN
        ComSignalInitValue = 0
        ComSignalType = UINT8
        ComSignalAccess = ACCESS_UNCLEAR
        ComHandleId = 21
        ComSystemTemplateSystemSignalRef = Vcu_Lin0_RxMsg2_Sig2
      Vcu_Lin0_TxMsg2_oLIN00_7d15e4cc_Tx (ComIPdu):
        ComIPduDirection = SEND
        ComIPduType = NORMAL
        ComIPduHandleId = 13
        ComIPduSignalProcessing = DEFERRED
        ComIPduCancellationSupport = false
        ComIPduGroupRef = VCU_oLIN00_Tx_1dc75bd5
        ComIPduSignalRef = Vcu_Lin0_TxMsg2_Sig0_oVcu_Lin0_TxMsg2_oLIN00_bd2ce1ab_Tx
        ComIPduSignalRef = Vcu_Lin0_TxMsg2_Sig1_oVcu_Lin0_TxMsg2_oLIN00_18a771a5_Tx
        ComIPduSignalRef = Vcu_Lin0_TxMsg2_Sig2_oVcu_Lin0_TxMsg2_oLIN00_2d4ac7f6_Tx
        ComIPduSignalRef = Vcu_Lin0_TxMsg2_Sig3_oVcu_Lin0_TxMsg2_oLIN00_88c157f8_Tx
        ComPduIdRef = Vcu_Lin0_TxMsg2_oLIN00_7d15e4cc_Tx
        ComIPduMainFunctionRef = ComMainFunctionTx
        ComTxIPdu: ComTxIPduUnusedAreasDefault=255, ComMinimumDelayTime=0
          ComTxModeTrue
            ComTxMode: ComTxModeMode=NONE
          ComTxModeFalse
            ComTxMode: ComTxModeMode=NONE
      3 x ComSignal, all with ComBitSize=8, ComSignalEndianness=LITTLE_ENDIAN, ComSignalInitValue=0, ComSignalType=UINT8, ComSignalAccess=ACCESS_UNCLEAR:
        Vcu_Lin0_RxMsg1_Sig1_oVcu_Lin0_RxMsg1_oLIN00_bebbf6f0_Rx: ComBitPosition=0, ComHandleId=17, ComSystemTemplateSystemSignalRef=Vcu_Lin0_RxMsg1_Sig1
        Vcu_Lin0_TxMsg1_Sig3_oVcu_Lin0_TxMsg1_oLIN00_42ef7503_Tx: ComBitPosition=24, ComHandleId=51, ComTransferProperty=PENDING, ComSystemTemplateSystemSignalRef=Vcu_Lin0_TxMsg1_Sig3
        Vcu_Lin0_RxMsg2_Sig3_oVcu_Lin0_RxMsg2_oLIN00_e4f3f256_Rx: ComBitPosition=32, ComHandleId=23, ComSystemTemplateSystemSignalRef=Vcu_Lin0_RxMsg2_Sig3
      Vcu_Lin0_RxMsg1_oLIN00_537f3cf2_Rx (ComIPdu):
        ComIPduDirection = RECEIVE
        ComIPduType = NORMAL
        ComIPduHandleId = 4
        ComIPduSignalProcessing = DEFERRED
        ComIPduCancellationSupport = false
        ComIPduGroupRef = VCU_oLIN00_Rx_4b9dfc53
        ComIPduSignalRef = Vcu_Lin0_RxMsg1_Sig0_oVcu_Lin0_RxMsg1_oLIN00_1b3066fe_Rx
        ComIPduSignalRef = Vcu_Lin0_RxMsg1_Sig1_oVcu_Lin0_RxMsg1_oLIN00_bebbf6f0_Rx
        ComIPduSignalRef = Vcu_Lin0_RxMsg2_Sig2_oVcu_Lin0_RxMsg1_oLIN00_cff765bb_Rx
        ComIPduSignalRef = Vcu_Lin0_RxMsg2_Sig3_oVcu_Lin0_RxMsg1_oLIN00_6a7cf5b5_Rx
        ComPduIdRef = Vcu_Lin0_RxMsg1_oLIN00_537f3cf2_Rx
        ComIPduMainFunctionRef = ComMainFunctionRx
      Vcu_Lin0_RxMsg2_Sig3_oVcu_Lin0_RxMsg1_oLIN00_6a7cf5b5_Rx (ComSignal):
        ComBitPosition = 24
        ComBitSize = 8
        ComSignalEndianness = LITTLE_ENDIAN
        ComSignalInitValue = 0
        ComSignalType = UINT8
        ComSignalAccess = ACCESS_UNCLEAR
        ComHandleId = 22
        ComSystemTemplateSystemSignalRef = Vcu_Lin0_RxMsg2_Sig3
      VCU_oLIN00_Tx_1dc75bd5 (ComIPduGroup): ComIPduGroupHandleId=1
      EXT4_Valid_oVcuTxIoMsg2_oTC37X_VCU_CAN00_ced21b28_Tx (ComSignal):
        ComBitPosition = 48
        ComBitSize = 16
        ComSignalEndianness = LITTLE_ENDIAN
        ComSignalInitValue = 0
        ComSignalType = UINT16
        ComTimeout = 0
        ComTransferProperty = PENDING
        ComSignalAccess = ACCESS_UNCLEAR
        ComHandleId = 3
        ComSystemTemplateSystemSignalRef = EXT4_Valid
      EXT_A_IN2_oVcuTxIoMsg1_oTC37X_VCU_CAN00_241cb78c_Tx (ComSignal):
        ComBitPosition = 32
        ComBitSize = 16
        ComSignalEndianness = LITTLE_ENDIAN
        ComSignalInitValue = 0
        ComSignalType = SINT16
        ComTimeout = 0
        ComTransferProperty = PENDING
        ComSignalAccess = ACCESS_UNCLEAR
        ComHandleId = 17
        ComSystemTemplateSystemSignalRef = EXT_A_IN2
      VcuTxIoMsg1_oTC37X_VCU_CAN00_54884add_Tx (ComIPdu):
        ComIPduDirection = SEND
        ComIPduType = NORMAL
        ComIPduHandleId = 2
        ComIPduSignalProcessing = DEFERRED
        ComIPduCancellationSupport = false
        ComIPduGroupRef = VCU_oTC37X_VCU_CAN00_Tx_f6d10bbf
        ComIPduSignalRef = EXT1_Valid_oVcuTxIoMsg1_oTC37X_VCU_CAN00_caf787ea_Tx
        ComIPduSignalRef = EXT2_Valid_oVcuTxIoMsg1_oTC37X_VCU_CAN00_9096b88a_Tx
        ComIPduSignalRef = EXT_A_IN1_oVcuTxIoMsg1_oTC37X_VCU_CAN00_37348eff_Tx
        ComIPduSignalRef = EXT_A_IN2_oVcuTxIoMsg1_oTC37X_VCU_CAN00_241cb78c_Tx
        ComPduIdRef = VcuTxIoMsg1_oTC37X_VCU_CAN00_54884add_Tx
        ComIPduMainFunctionRef = ComMainFunctionTx
        ComTxIPdu: ComMinimumDelayTime=0, ComTxIPduUnusedAreasDefault=0
          ComTxModeTrue
            ComTxMode: ComTxModeMode=PERIODIC, ComTxModeTimeOffset=0, ComTxModeTimePeriod=0.5
          ComTxModeFalse
            ComTxMode: ComTxModeMode=PERIODIC, ComTxModeTimeOffset=0, ComTxModeTimePeriod=0.5
      4 x ComSignal, all with ComBitSize=16, ComSignalEndianness=LITTLE_ENDIAN, ComSignalInitValue=0, ComTimeout=0, ComTransferProperty=PENDING, ComSignalAccess=ACCESS_UNCLEAR:
        EXT_A_IN1_oVcuTxIoMsg1_oTC37X_VCU_CAN00_37348eff_Tx: ComBitPosition=0, ComSignalType=SINT16, ComHandleId=16, ComSystemTemplateSystemSignalRef=EXT_A_IN1
        EXT1_Valid_oVcuTxIoMsg1_oTC37X_VCU_CAN00_caf787ea_Tx: ComBitPosition=16, ComSignalType=UINT16, ComHandleId=0, ComSystemTemplateSystemSignalRef=EXT1_Valid
        EXT_A_IN3_oVcuTxIoMsg2_oTC37X_VCU_CAN00_c07d823f_Tx: ComBitPosition=0, ComSignalType=SINT16, ComHandleId=18, ComSystemTemplateSystemSignalRef=EXT_A_IN3
        EXT2_Valid_oVcuTxIoMsg1_oTC37X_VCU_CAN00_9096b88a_Tx: ComBitPosition=48, ComSignalType=UINT16, ComHandleId=1, ComSystemTemplateSystemSignalRef=EXT2_Valid
      VcuTxIoMsg2_oTC37X_VCU_CAN00_be0e97bf_Tx (ComIPdu):
        ComIPduDirection = SEND
        ComIPduType = NORMAL
        ComIPduHandleId = 3
        ComIPduSignalProcessing = DEFERRED
        ComIPduCancellationSupport = false
        ComIPduGroupRef = VCU_oTC37X_VCU_CAN00_Tx_f6d10bbf
        ComIPduSignalRef = EXT3_Valid_oVcuTxIoMsg2_oTC37X_VCU_CAN00_fae072f7_Tx
        ComIPduSignalRef = EXT4_Valid_oVcuTxIoMsg2_oTC37X_VCU_CAN00_ced21b28_Tx
        ComIPduSignalRef = EXT_A_IN3_oVcuTxIoMsg2_oTC37X_VCU_CAN00_c07d823f_Tx
        ComIPduSignalRef = EXT_A_IN4_oVcuTxIoMsg2_oTC37X_VCU_CAN00_e8ca1808_Tx
        ComPduIdRef = VcuTxIoMsg2_oTC37X_VCU_CAN00_be0e97bf_Tx
        ComIPduMainFunctionRef = ComMainFunctionTx
        ComTxIPdu: ComMinimumDelayTime=0, ComTxIPduUnusedAreasDefault=0
          ComTxModeTrue
            ComTxMode: ComTxModeMode=PERIODIC, ComTxModeTimeOffset=0, ComTxModeTimePeriod=0.5
          ComTxModeFalse
            ComTxMode: ComTxModeMode=PERIODIC, ComTxModeTimeOffset=0, ComTxModeTimePeriod=0.5
      7 x ComSignal, all with ComBitSize=16, ComSignalEndianness=LITTLE_ENDIAN, ComSignalInitValue=0, ComTimeout=0, ComTransferProperty=PENDING, ComSignalAccess=ACCESS_UNCLEAR:
        EXT3_Valid_oVcuTxIoMsg2_oTC37X_VCU_CAN00_fae072f7_Tx: ComBitPosition=16, ComSignalType=UINT16, ComHandleId=2, ComSystemTemplateSystemSignalRef=EXT3_Valid
        EXT_A_IN4_oVcuTxIoMsg2_oTC37X_VCU_CAN00_e8ca1808_Tx: ComBitPosition=32, ComSignalType=SINT16, ComHandleId=19, ComSystemTemplateSystemSignalRef=EXT_A_IN4
        EXT6_Valid_oVcuTxIoMsg3_oTC37X_VCU_CAN00_fb1185b6_Tx: ComBitPosition=48, ComSignalType=UINT16, ComHandleId=5, ComSystemTemplateSystemSignalRef=EXT6_Valid
        EXT16_Valid_oVcuTxIoMsg8_oTC37X_VCU_CAN00_fd3a983d_Tx: ComBitPosition=48, ComSignalType=UINT16, ComHandleId=15, ComSystemTemplateSystemSignalRef=EXT16_Valid
        EXT11_Valid_oVcuTxIoMsg6_oTC37X_VCU_CAN00_d025e36b_Tx: ComBitPosition=16, ComSignalType=UINT16, ComHandleId=10, ComSystemTemplateSystemSignalRef=EXT11_Valid
        EXT_A_IN10_oVcuTxIoMsg5_oTC37X_VCU_CAN00_83e5b725_Tx: ComBitPosition=32, ComSignalType=SINT16, ComHandleId=25, ComSystemTemplateSystemSignalRef=EXT_A_IN10
        EXT5_Valid_oVcuTxIoMsg3_oTC37X_VCU_CAN00_a170bad6_Tx: ComBitPosition=16, ComSignalType=UINT16, ComHandleId=4, ComSystemTemplateSystemSignalRef=EXT5_Valid
      VcuTxIoMsg4_oTC37X_VCU_CAN00_b0722b3a_Tx (ComIPdu):
        ComIPduDirection = SEND
        ComIPduType = NORMAL
        ComIPduHandleId = 5
        ComIPduSignalProcessing = DEFERRED
        ComIPduCancellationSupport = false
        ComIPduGroupRef = VCU_oTC37X_VCU_CAN00_Tx_f6d10bbf
        ComIPduSignalRef = EXT7_Valid_oVcuTxIoMsg4_oTC37X_VCU_CAN00_9acf98cd_Tx
        ComIPduSignalRef = EXT8_Valid_oVcuTxIoMsg4_oTC37X_VCU_CAN00_725b5c6c_Tx
        ComIPduSignalRef = EXT_A_IN7_oVcuTxIoMsg4_oTC37X_VCU_CAN00_f59e9dfe_Tx
        ComIPduSignalRef = EXT_A_IN8_oVcuTxIoMsg4_oTC37X_VCU_CAN00_aa164141_Tx
        ComPduIdRef = VcuTxIoMsg4_oTC37X_VCU_CAN00_b0722b3a_Tx
        ComIPduMainFunctionRef = ComMainFunctionTx
        ComTxIPdu: ComMinimumDelayTime=0, ComTxIPduUnusedAreasDefault=0
          ComTxModeTrue
            ComTxMode: ComTxModeMode=PERIODIC, ComTxModeTimeOffset=0, ComTxModeTimePeriod=0.5
          ComTxModeFalse
            ComTxMode: ComTxModeMode=PERIODIC, ComTxModeTimeOffset=0, ComTxModeTimePeriod=0.5
      EXT13_Valid_oVcuTxIoMsg7_oTC37X_VCU_CAN00_e5e67df5_Tx (ComSignal):
        ComBitPosition = 16
        ComBitSize = 16
        ComSignalEndianness = LITTLE_ENDIAN
        ComSignalInitValue = 0
        ComSignalType = UINT16
        ComTimeout = 0
        ComTransferProperty = PENDING
        ComSignalAccess = ACCESS_UNCLEAR
        ComHandleId = 12
        ComSystemTemplateSystemSignalRef = EXT13_Valid
      VcuTxIoMsg8_oTC37X_VCU_CAN00_ac8b5230_Tx (ComIPdu):
        ComIPduDirection = SEND
        ComIPduType = NORMAL
        ComIPduHandleId = 9
        ComIPduSignalProcessing = DEFERRED
        ComIPduCancellationSupport = false
        ComIPduGroupRef = VCU_oTC37X_VCU_CAN00_Tx_f6d10bbf
        ComIPduSignalRef = EXT15_Valid_oVcuTxIoMsg8_oTC37X_VCU_CAN00_a75ba75d_Tx
        ComIPduSignalRef = EXT16_Valid_oVcuTxIoMsg8_oTC37X_VCU_CAN00_fd3a983d_Tx
        ComIPduSignalRef = EXT_A_IN15_oVcuTxIoMsg8_oTC37X_VCU_CAN00_4536335b_Tx
        ComIPduSignalRef = EXT_A_IN16_oVcuTxIoMsg8_oTC37X_VCU_CAN00_561e0a28_Tx
        ComPduIdRef = VcuTxIoMsg8_oTC37X_VCU_CAN00_ac8b5230_Tx
        ComIPduMainFunctionRef = ComMainFunctionTx
        ComTxIPdu: ComMinimumDelayTime=0, ComTxIPduUnusedAreasDefault=0
          ComTxModeTrue
            ComTxMode: ComTxModeMode=PERIODIC, ComTxModeTimeOffset=0, ComTxModeTimePeriod=0.5
          ComTxModeFalse
            ComTxMode: ComTxModeMode=PERIODIC, ComTxModeTimeOffset=0, ComTxModeTimePeriod=0.5
      9 x ComSignal, all with ComBitSize=16, ComSignalEndianness=LITTLE_ENDIAN, ComSignalInitValue=0, ComTimeout=0, ComTransferProperty=PENDING, ComSignalAccess=ACCESS_UNCLEAR:
        EXT10_Valid_oVcuTxIoMsg5_oTC37X_VCU_CAN00_ba532916_Tx: ComBitPosition=48, ComSignalType=UINT16, ComHandleId=9, ComSystemTemplateSystemSignalRef=EXT10_Valid
        EXT_A_IN6_oVcuTxIoMsg3_oTC37X_VCU_CAN00_1a577f4b_Tx: ComBitPosition=32, ComSignalType=SINT16, ComHandleId=21, ComSystemTemplateSystemSignalRef=EXT_A_IN6
        EXT12_Valid_oVcuTxIoMsg6_oTC37X_VCU_CAN00_8a44dc0b_Tx: ComBitPosition=48, ComSignalType=UINT16, ComHandleId=11, ComSystemTemplateSystemSignalRef=EXT12_Valid
        EXT9_Valid_oVcuTxIoMsg5_oTC37X_VCU_CAN00_1df9fd92_Tx: ComBitPosition=16, ComSignalType=UINT16, ComHandleId=8, ComSystemTemplateSystemSignalRef=EXT9_Valid
        EXT_A_IN12_oVcuTxIoMsg6_oTC37X_VCU_CAN00_74acbbe5_Tx: ComBitPosition=32, ComSignalType=SINT16, ComHandleId=27, ComSystemTemplateSystemSignalRef=EXT_A_IN12
        EXT_A_IN7_oVcuTxIoMsg4_oTC37X_VCU_CAN00_f59e9dfe_Tx: ComBitPosition=0, ComSignalType=SINT16, ComHandleId=22, ComSystemTemplateSystemSignalRef=EXT_A_IN7
        EXT_A_IN13_oVcuTxIoMsg7_oTC37X_VCU_CAN00_9519e5d5_Tx: ComBitPosition=0, ComSignalType=SINT16, ComHandleId=28, ComSystemTemplateSystemSignalRef=EXT_A_IN13
        EXT_A_IN9_oVcuTxIoMsg5_oTC37X_VCU_CAN00_4ba31f71_Tx: ComBitPosition=0, ComSignalType=SINT16, ComHandleId=24, ComSystemTemplateSystemSignalRef=EXT_A_IN9
        EXT7_Valid_oVcuTxIoMsg4_oTC37X_VCU_CAN00_9acf98cd_Tx: ComBitPosition=16, ComSignalType=UINT16, ComHandleId=6, ComSystemTemplateSystemSignalRef=EXT7_Valid
      VcuTxIoMsg5_oTC37X_VCU_CAN00_5f209ddb_Tx (ComIPdu):
        ComIPduDirection = SEND
        ComIPduType = NORMAL
        ComIPduHandleId = 6
        ComIPduSignalProcessing = DEFERRED
        ComIPduCancellationSupport = false
        ComIPduGroupRef = VCU_oTC37X_VCU_CAN00_Tx_f6d10bbf
        ComIPduSignalRef = EXT10_Valid_oVcuTxIoMsg5_oTC37X_VCU_CAN00_ba532916_Tx
        ComIPduSignalRef = EXT9_Valid_oVcuTxIoMsg5_oTC37X_VCU_CAN00_1df9fd92_Tx
        ComIPduSignalRef = EXT_A_IN10_oVcuTxIoMsg5_oTC37X_VCU_CAN00_83e5b725_Tx
        ComIPduSignalRef = EXT_A_IN9_oVcuTxIoMsg5_oTC37X_VCU_CAN00_4ba31f71_Tx
        ComPduIdRef = VcuTxIoMsg5_oTC37X_VCU_CAN00_5f209ddb_Tx
        ComIPduMainFunctionRef = ComMainFunctionTx
        ComTxIPdu: ComMinimumDelayTime=0, ComTxIPduUnusedAreasDefault=0
          ComTxModeTrue
            ComTxMode: ComTxModeMode=PERIODIC, ComTxModeTimeOffset=0, ComTxModeTimePeriod=0.5
          ComTxModeFalse
            ComTxMode: ComTxModeMode=PERIODIC, ComTxModeTimeOffset=0, ComTxModeTimePeriod=0.5
      EXT_A_IN11_oVcuTxIoMsg6_oTC37X_VCU_CAN00_67848296_Tx (ComSignal):
        ComBitPosition = 0
        ComBitSize = 16
        ComSignalEndianness = LITTLE_ENDIAN
        ComSignalInitValue = 0
        ComSignalType = SINT16
        ComTimeout = 0
        ComTransferProperty = PENDING
        ComSignalAccess = ACCESS_UNCLEAR
        ComHandleId = 26
        ComSystemTemplateSystemSignalRef = EXT_A_IN11
      EXT_A_IN14_oVcuTxIoMsg7_oTC37X_VCU_CAN00_bdae7fe2_Tx (ComSignal):
        ComBitPosition = 32
        ComBitSize = 16
        ComSignalEndianness = LITTLE_ENDIAN
        ComSignalInitValue = 0
        ComSignalType = SINT16
        ComTimeout = 0
        ComTransferProperty = PENDING
        ComSignalAccess = ACCESS_UNCLEAR
        ComHandleId = 29
        ComSystemTemplateSystemSignalRef = EXT_A_IN14
      VcuTxIoMsg3_oTC37X_VCU_CAN00_515c215e_Tx (ComIPdu):
        ComIPduDirection = SEND
        ComIPduType = NORMAL
        ComIPduHandleId = 4
        ComIPduSignalProcessing = DEFERRED
        ComIPduCancellationSupport = false
        ComIPduGroupRef = VCU_oTC37X_VCU_CAN00_Tx_f6d10bbf
        ComIPduSignalRef = EXT5_Valid_oVcuTxIoMsg3_oTC37X_VCU_CAN00_a170bad6_Tx
        ComIPduSignalRef = EXT6_Valid_oVcuTxIoMsg3_oTC37X_VCU_CAN00_fb1185b6_Tx
        ComIPduSignalRef = EXT_A_IN5_oVcuTxIoMsg3_oTC37X_VCU_CAN00_097f4638_Tx
        ComIPduSignalRef = EXT_A_IN6_oVcuTxIoMsg3_oTC37X_VCU_CAN00_1a577f4b_Tx
        ComPduIdRef = VcuTxIoMsg3_oTC37X_VCU_CAN00_515c215e_Tx
        ComIPduMainFunctionRef = ComMainFunctionTx
        ComTxIPdu: ComMinimumDelayTime=0, ComTxIPduUnusedAreasDefault=0
          ComTxModeTrue
            ComTxMode: ComTxModeMode=PERIODIC, ComTxModeTimeOffset=0, ComTxModeTimePeriod=0.5
          ComTxModeFalse
            ComTxMode: ComTxModeMode=PERIODIC, ComTxModeTimeOffset=0, ComTxModeTimePeriod=0.5
      7 x ComSignal, all with ComBitSize=16, ComSignalEndianness=LITTLE_ENDIAN, ComSignalInitValue=0, ComTimeout=0, ComTransferProperty=PENDING, ComSignalAccess=ACCESS_UNCLEAR:
        EXT14_Valid_oVcuTxIoMsg7_oTC37X_VCU_CAN00_d1d4142a_Tx: ComBitPosition=48, ComSignalType=UINT16, ComHandleId=13, ComSystemTemplateSystemSignalRef=EXT14_Valid
        EXT15_Valid_oVcuTxIoMsg8_oTC37X_VCU_CAN00_a75ba75d_Tx: ComBitPosition=16, ComSignalType=UINT16, ComHandleId=14, ComSystemTemplateSystemSignalRef=EXT15_Valid
        EXT_A_IN5_oVcuTxIoMsg3_oTC37X_VCU_CAN00_097f4638_Tx: ComBitPosition=0, ComSignalType=SINT16, ComHandleId=20, ComSystemTemplateSystemSignalRef=EXT_A_IN5
        EXT_A_IN8_oVcuTxIoMsg4_oTC37X_VCU_CAN00_aa164141_Tx: ComBitPosition=32, ComSignalType=SINT16, ComHandleId=23, ComSystemTemplateSystemSignalRef=EXT_A_IN8
        EXT_A_IN16_oVcuTxIoMsg8_oTC37X_VCU_CAN00_561e0a28_Tx: ComBitPosition=32, ComSignalType=SINT16, ComHandleId=31, ComSystemTemplateSystemSignalRef=EXT_A_IN16
        EXT8_Valid_oVcuTxIoMsg4_oTC37X_VCU_CAN00_725b5c6c_Tx: ComBitPosition=48, ComSignalType=UINT16, ComHandleId=7, ComSystemTemplateSystemSignalRef=EXT8_Valid
        EXT_A_IN15_oVcuTxIoMsg8_oTC37X_VCU_CAN00_4536335b_Tx: ComBitPosition=0, ComSignalType=SINT16, ComHandleId=30, ComSystemTemplateSystemSignalRef=EXT_A_IN15
      VcuTxIoMsg7_oTC37X_VCU_CAN00_5af4f658_Tx (ComIPdu):
        ComIPduDirection = SEND
        ComIPduType = NORMAL
        ComIPduHandleId = 8
        ComIPduSignalProcessing = DEFERRED
        ComIPduCancellationSupport = false
        ComIPduGroupRef = VCU_oTC37X_VCU_CAN00_Tx_f6d10bbf
        ComIPduSignalRef = EXT13_Valid_oVcuTxIoMsg7_oTC37X_VCU_CAN00_e5e67df5_Tx
        ComIPduSignalRef = EXT14_Valid_oVcuTxIoMsg7_oTC37X_VCU_CAN00_d1d4142a_Tx
        ComIPduSignalRef = EXT_A_IN13_oVcuTxIoMsg7_oTC37X_VCU_CAN00_9519e5d5_Tx
        ComIPduSignalRef = EXT_A_IN14_oVcuTxIoMsg7_oTC37X_VCU_CAN00_bdae7fe2_Tx
        ComPduIdRef = VcuTxIoMsg7_oTC37X_VCU_CAN00_5af4f658_Tx
        ComIPduMainFunctionRef = ComMainFunctionTx
        ComTxIPdu: ComMinimumDelayTime=0, ComTxIPduUnusedAreasDefault=0
          ComTxModeTrue
            ComTxMode: ComTxModeMode=PERIODIC, ComTxModeTimeOffset=0, ComTxModeTimePeriod=0.5
          ComTxModeFalse
            ComTxMode: ComTxModeMode=PERIODIC, ComTxModeTimeOffset=0, ComTxModeTimePeriod=0.5
      VcuTxIoMsg6_oTC37X_VCU_CAN00_b5a640b9_Tx (ComIPdu):
        ComIPduDirection = SEND
        ComIPduType = NORMAL
        ComIPduHandleId = 7
        ComIPduSignalProcessing = DEFERRED
        ComIPduCancellationSupport = false
        ComIPduGroupRef = VCU_oTC37X_VCU_CAN00_Tx_f6d10bbf
        ComIPduSignalRef = EXT11_Valid_oVcuTxIoMsg6_oTC37X_VCU_CAN00_d025e36b_Tx
        ComIPduSignalRef = EXT12_Valid_oVcuTxIoMsg6_oTC37X_VCU_CAN00_8a44dc0b_Tx
        ComIPduSignalRef = EXT_A_IN11_oVcuTxIoMsg6_oTC37X_VCU_CAN00_67848296_Tx
        ComIPduSignalRef = EXT_A_IN12_oVcuTxIoMsg6_oTC37X_VCU_CAN00_74acbbe5_Tx
        ComPduIdRef = VcuTxIoMsg6_oTC37X_VCU_CAN00_b5a640b9_Tx
        ComIPduMainFunctionRef = ComMainFunctionTx
        ComTxIPdu: ComMinimumDelayTime=0, ComTxIPduUnusedAreasDefault=0
          ComTxModeTrue
            ComTxMode: ComTxModeMode=PERIODIC, ComTxModeTimeOffset=0, ComTxModeTimePeriod=0.5
          ComTxModeFalse
            ComTxMode: ComTxModeMode=PERIODIC, ComTxModeTimeOffset=0, ComTxModeTimePeriod=0.5
    ComGeneral:
      ComConfigurationUseDet = true
      ComSafeBswChecks = false
      ComEnableSignalGroupArrayApi = false
      ComRetryFailedTransmitRequests = true
      ComSupportedIPduGroups = 6
      ComVersionInfoApi = false
      ComAdvancedIPduCallouts = true
      ComOptimizedIPduGroupHandling = false
      ComMetaDataSupport = false
      ComDeferredEventCacheSupport = false
      ComDescriptionGateway = false
      ComDescriptionRoutingCodeGeneration = false
      ComStrictRepetitionPeriod = false
      ComMixedModePeriodicSuppression = false
      ComSignalGateway = NONE
      ComUserCbkHeaderFile = Rte_Cbk.h
      ComUserCbkHeaderFile = Appl_Cbk.h
