AUTOSAR XML (schema 00048)
package /ActiveEcuC
  module config Com: implementation-config-variant=VARIANT-PRE-COMPILE, module-description=Com_Impl
    ComGeneration:
      ComOutOfBoundsWriteProtectionStrategy = NONE
      ComOutOfBoundsWriteSanitizer = false
      ComOutOfBoundsReadSanitizer = false
      ComReduceConstantData2Define = false
      ComBoolDataInArrayOfStructStrategy = BOOLEAN
      ComDeduplicateIndirectedData = true
      ComDataDeduplicationStrategy = WITH_CAST
      ComReduceBoolDataByNegationThreshold = 2
      ComReduceBoolDataByNumericalComparisonThreshold = 2
      ComReduceBoolDataByNumericalRelationThreshold = 2
      ComReduceBoolDataByNumericalOperandStrategy = WITH_ANY_VALUE
      ComReduceNumericalDataByOffsetThreshold = 2
      ComReduceNumericalDataByArraySubtractionThreshold = 2
      ComReduceDataByStreaming = false
      ComShortSymbols = false
      ComInterfacesForDeactivatedData = false
      ComReferringKeysInComments = false
    ComOptimization:
      ComTxProcessingISRLockThreshold = 1
      ComRxProcessingISRLockThreshold = 1
      ComGatewayProcessingISRLockThreshold = 1
      ComGatewayDescriptionProcessingISRLockThreshold = 1
      ComIPduGroupISRLockThreshold = 1
    ComConfig: ComConfigurationId=0, ComRxDeferredNotificationCacheSize=1, ComRxImmediateNotificationCacheSize=0
      VCU_oTC37X_VCU_CAN00_Tx_f6d10bbf (ComIPduGroup): ComIPduGroupHandleId=7
      10 x ComSignal, all with ComBitSize=16, ComSignalEndianness=LITTLE_ENDIAN, ComSignalInitValue=0, ComSignalType=SINT16:
        VcuRxMsg2_Sig3_oVcuRxMsg2_oTC37X_VCU_CAN00_31c6b130_Rx: ComBitPosition=48, ComTimeout=2, ComSignalAccess=ACCESS_NEEDED_BY_SWC_OR_COM, ComHandleId=78, ComNotification=Rte_COMCbk_VcuRxMsg2_Sig3_oVcuRxMsg2_oTC37X_VCU_CAN00_31c6b130_Rx, ComTimeoutNotification=Rte_COMCbkRxTOut_VcuRxMsg2_Sig3_oVcuRxMsg2_oTC37X_VCU_CAN00_31c6b130_Rx, ComSystemTemplateSystemSignalRef=VcuRxMsg2_Sig3
        VcuTxMsg2_Sig3_oVcuTxMsg2_oTC37X_VCU_CAN00_a04bfcfd_Tx: ComBitPosition=48, ComTimeout=0, ComTransferProperty=PENDING, ComSignalAccess=ACCESS_UNCLEAR, ComHandleId=91, ComSystemTemplateSystemSignalRef=VcuTxMsg2_Sig3
        VcuRxMsg2_Sig0_oVcuRxMsg2_oTC37X_VCU_CAN00_94ceda5c_Rx: ComBitPosition=0, ComTimeout=2, ComSignalAccess=ACCESS_NEEDED_BY_SWC_OR_COM, ComHandleId=75, ComNotification=Rte_COMCbk_VcuRxMsg2_Sig0_oVcuRxMsg2_oTC37X_VCU_CAN00_94ceda5c_Rx, ComTimeoutNotification=Com_Msg201h_Timeout_Notification, ComFirstTimeout=2, ComSystemTemplateSystemSignalRef=VcuRxMsg2_Sig0
        VcuRxMsg2_Sig2_oVcuRxMsg2_oTC37X_VCU_CAN00_52c16814_Rx: ComBitPosition=32, ComTimeout=2, ComSignalAccess=ACCESS_UNCLEAR, ComHandleId=77, ComNotification=Rte_COMCbk_VcuRxMsg2_Sig2_oVcuRxMsg2_oTC37X_VCU_CAN00_52c16814_Rx, ComTimeoutNotification=Rte_COMCbkRxTOut_VcuRxMsg2_Sig2_oVcuRxMsg2_oTC37X_VCU_CAN00_52c16814_Rx, ComSystemTemplateSystemSignalRef=VcuRxMsg2_Sig2
        VcuTxMsg1_Sig1_oVcuTxMsg1_oTC37X_VCU_CAN00_e144608d_Tx: ComBitPosition=16, ComTimeout=0, ComTransferProperty=PENDING, ComSignalAccess=ACCESS_UNCLEAR, ComHandleId=85, ComSystemTemplateSystemSignalRef=VcuTxMsg1_Sig1
        VcuTxMsg2_Sig0_oVcuTxMsg2_oTC37X_VCU_CAN00_05439791_Tx: ComBitPosition=0, ComTimeout=0, ComTransferProperty=PENDING, ComSignalAccess=ACCESS_UNCLEAR, ComHandleId=88, ComSystemTemplateSystemSignalRef=VcuTxMsg2_Sig0
        VcuRxMsg1_Sig2_oVcuRxMsg1_oTC37X_VCU_CAN00_d5c1462c_Rx: ComBitPosition=32, ComTimeout=2, ComSignalAccess=ACCESS_UNCLEAR, ComHandleId=73, ComNotification=Rte_COMCbk_VcuRxMsg1_Sig2_oVcuRxMsg1_oTC37X_VCU_CAN00_d5c1462c_Rx, ComTimeoutNotification=Rte_COMCbkRxTOut_VcuRxMsg1_Sig2_oVcuRxMsg1_oTC37X_VCU_CAN00_d5c1462c_Rx, ComSystemTemplateSystemSignalRef=VcuRxMsg1_Sig2
        VcuTxMsg1_Sig2_oVcuTxMsg1_oTC37X_VCU_CAN00_444c0be1_Tx: ComBitPosition=32, ComTimeout=0, ComTransferProperty=PENDING, ComSignalAccess=ACCESS_UNCLEAR, ComHandleId=86, ComSystemTemplateSystemSignalRef=VcuTxMsg1_Sig2
        VcuRxMsg2_Sig1_oVcuRxMsg2_oTC37X_VCU_CAN00_f7c90378_Rx: ComBitPosition=16, ComTimeout=2, ComSignalAccess=ACCESS_UNCLEAR, ComHandleId=76, ComNotification=Rte_COMCbk_VcuRxMsg2_Sig1_oVcuRxMsg2_oTC37X_VCU_CAN00_f7c90378_Rx, ComTimeoutNotification=Rte_COMCbkRxTOut_VcuRxMsg2_Sig1_oVcuRxMsg2_oTC37X_VCU_CAN00_f7c90378_Rx, ComSystemTemplateSystemSignalRef=VcuRxMsg2_Sig1
        VcuTxMsg2_Sig2_oVcuTxMsg2_oTC37X_VCU_CAN00_c34c25d9_Tx: ComBitPosition=32, ComTimeout=0, ComTransferProperty=PENDING, ComSignalAccess=ACCESS_UNCLEAR, ComHandleId=90, ComSystemTemplateSystemSignalRef=VcuTxMsg2_Sig2
      VcuTxMsg1_oTC37X_VCU_CAN00_954a27ee_Tx (ComIPdu):
        ComIPduDirection = SEND
        ComIPduType = NORMAL
        ComIPduHandleId = 22
        ComIPduSignalProcessing = DEFERRED
        ComIPduCancellationSupport = false
        ComIPduGroupRef = VCU_oTC37X_VCU_CAN00_Tx_f6d10bbf
        ComIPduSignalRef = VcuTxMsg1_Sig0_oVcuTxMsg1_oTC37X_VCU_CAN00_8243b9a9_Tx
        ComIPduSignalRef = VcuTxMsg1_Sig1_oVcuTxMsg1_oTC37X_VCU_CAN00_e144608d_Tx
        ComIPduSignalRef = VcuTxMsg1_Sig2_oVcuTxMsg1_oTC37X_VCU_CAN00_444c0be1_Tx
        ComIPduSignalRef = VcuTxMsg1_Sig3_oVcuTxMsg1_oTC37X_VCU_CAN00_274bd2c5_Tx
        ComPduIdRef = VcuTxMsg1_oTC37X_VCU_CAN00_954a27ee_Tx
        ComIPduMainFunctionRef = ComMainFunctionTx
        ComTxIPdu: ComMinimumDelayTime=0, ComTxIPduUnusedAreasDefault=0
          ComTxModeTrue
            ComTxMode: ComTxModeMode=PERIODIC, ComTxModeTimeOffset=0.1, ComTxModeTimePeriod=0.5
          ComTxModeFalse
            ComTxMode: ComTxModeMode=PERIODIC, ComTxModeTimeOffset=0, ComTxModeTimePeriod=0.5
      3 x ComSignal, all with ComBitSize=16, ComSignalEndianness=LITTLE_ENDIAN, ComSignalInitValue=0, ComSignalType=SINT16, ComSignalAccess=ACCESS_UNCLEAR:
        VcuRxMsg1_Sig1_oVcuRxMsg1_oTC37X_VCU_CAN00_70c92d40_Rx: ComBitPosition=16, ComTimeout=2, ComHandleId=72, ComNotification=Rte_COMCbk_VcuRxMsg1_Sig1_oVcuRxMsg1_oTC37X_VCU_CAN00_70c92d40_Rx, ComTimeoutNotification=Rte_COMCbkRxTOut_VcuRxMsg1_Sig1_oVcuRxMsg1_oTC37X_VCU_CAN00_70c92d40_Rx, ComSystemTemplateSystemSignalRef=VcuRxMsg1_Sig1
        VcuRxMsg1_Sig0_oVcuRxMsg1_oTC37X_VCU_CAN00_13cef464_Rx: ComBitPosition=0, ComTimeout=2, ComHandleId=71, ComNotification=Rte_COMCbk_VcuRxMsg1_Sig0_oVcuRxMsg1_oTC37X_VCU_CAN00_13cef464_Rx, ComTimeoutNotification=Com_Msg200h_Timeout_Notification, ComFirstTimeout=2, ComSystemTemplateSystemSignalRef=VcuRxMsg1_Sig0
        VcuTxMsg1_Sig3_oVcuTxMsg1_oTC37X_VCU_CAN00_274bd2c5_Tx: ComBitPosition=48, ComTimeout=0, ComTransferProperty=PENDING, ComHandleId=87, ComSystemTemplateSystemSignalRef=VcuTxMsg1_Sig3
      VCU_oTC37X_VCU_CAN00_Rx_a08bac39 (ComIPduGroup): ComIPduGroupHandleId=6
      VcuTxMsg2_Sig1_oVcuTxMsg2_oTC37X_VCU_CAN00_66444eb5_Tx (ComSignal):
        ComBitPosition = 16
        ComBitSize = 16
        ComSignalEndianness = LITTLE_ENDIAN
        ComSignalInitValue = 0
        ComSignalType = SINT16
        ComTimeout = 0
        ComTransferProperty = PENDING
        ComSignalAccess = ACCESS_UNCLEAR
        ComHandleId = 89
        ComSystemTemplateSystemSignalRef = VcuTxMsg2_Sig1
      3 x ComIPdu, all with ComIPduType=NORMAL, ComIPduSignalProcessing=DEFERRED, ComIPduCancellationSupport=false:
        VcuRxMsg1_oTC37X_VCU_CAN00_78805594_Rx: ComIPduDirection=RECEIVE, ComIPduHandleId=13, ComIPduGroupRef=VCU_oTC37X_VCU_CAN00_Rx_a08bac39, ComIPduSignalRef=VcuRxMsg1_Sig0_oVcuRxMsg1_oTC37X_VCU_CAN00_13cef464_Rx, ComIPduSignalRef=VcuRxMsg1_Sig1_oVcuRxMsg1_oTC37X_VCU_CAN00_70c92d40_Rx, ComIPduSignalRef=VcuRxMsg1_Sig2_oVcuRxMsg1_oTC37X_VCU_CAN00_d5c1462c_Rx, ComIPduSignalRef=VcuRxMsg1_Sig3_oVcuRxMsg1_oTC37X_VCU_CAN00_b6c69f08_Rx, ComPduIdRef=VcuRxMsg1_oTC37X_VCU_CAN00_78805594_Rx, ComIPduMainFunctionRef=ComMainFunctionRx
        VcuTxMsg2_oTC37X_VCU_CAN00_7fccfa8c_Tx: ComIPduDirection=SEND, ComIPduHandleId=23, ComIPduGroupRef=VCU_oTC37X_VCU_CAN00_Tx_f6d10bbf, ComIPduSignalRef=VcuTxMsg2_Sig0_oVcuTxMsg2_oTC37X_VCU_CAN00_05439791_Tx, ComIPduSignalRef=VcuTxMsg2_Sig1_oVcuTxMsg2_oTC37X_VCU_CAN00_66444eb5_Tx, ComIPduSignalRef=VcuTxMsg2_Sig2_oVcuTxMsg2_oTC37X_VCU_CAN00_c34c25d9_Tx, ComIPduSignalRef=VcuTxMsg2_Sig3_oVcuTxMsg2_oTC37X_VCU_CAN00_a04bfcfd_Tx, ComPduIdRef=VcuTxMsg2_oTC37X_VCU_CAN00_7fccfa8c_Tx, ComIPduMainFunctionRef=ComMainFunctionTx
          ComTxIPdu: ComMinimumDelayTime=0, ComTxIPduUnusedAreasDefault=0
            ComTxModeTrue
              ComTxMode: ComTxModeMode=PERIODIC, ComTxModeTimeOffset=0.1, ComTxModeTimePeriod=0.5
            ComTxModeFalse
              ComTxMode: ComTxModeMode=PERIODIC, ComTxModeTimeOffset=0, ComTxModeTimePeriod=0.5
        VcuRxMsg2_oTC37X_VCU_CAN00_920688f6_Rx: ComIPduDirection=RECEIVE, ComIPduHandleId=14, ComIPduGroupRef=VCU_oTC37X_VCU_CAN00_Rx_a08bac39, ComIPduSignalRef=VcuRxMsg2_Sig0_oVcuRxMsg2_oTC37X_VCU_CAN00_94ceda5c_Rx, ComIPduSignalRef=VcuRxMsg2_Sig1_oVcuRxMsg2_oTC37X_VCU_CAN00_f7c90378_Rx, ComIPduSignalRef=VcuRxMsg2_Sig2_oVcuRxMsg2_oTC37X_VCU_CAN00_52c16814_Rx, ComIPduSignalRef=VcuRxMsg2_Sig3_oVcuRxMsg2_oTC37X_VCU_CAN00_31c6b130_Rx, ComPduIdRef=VcuRxMsg2_oTC37X_VCU_CAN00_920688f6_Rx, ComIPduMainFunctionRef=ComMainFunctionRx
      VcuTxMsg1_Sig0_oVcuTxMsg1_oTC37X_VCU_CAN00_8243b9a9_Tx (ComSignal):
        ComBitPosition = 0
        ComBitSize = 16
        ComSignalEndianness = LITTLE_ENDIAN
        ComSignalInitValue = 0
        ComSignalType = SINT16
        ComTimeout = 0
        ComTransferProperty = PENDING
        ComSignalAccess = ACCESS_UNCLEAR
        ComHandleId = 84
        ComSystemTemplateSystemSignalRef = VcuTxMsg1_Sig0
      VcuRxMsg1_Sig3_oVcuRxMsg1_oTC37X_VCU_CAN00_b6c69f08_Rx (ComSignal):
        ComBitPosition = 48
        ComBitSize = 16
        ComSignalEndianness = LITTLE_ENDIAN
        ComSignalInitValue = 0
        ComSignalType = SINT16
        ComTimeout = 2
        ComSignalAccess = ACCESS_UNCLEAR
        ComHandleId = 74
        ComNotification = Rte_COMCbk_VcuRxMsg1_Sig3_oVcuRxMsg1_oTC37X_VCU_CAN00_b6c69f08_Rx
        ComTimeoutNotification = Rte_COMCbkRxTOut_VcuRxMsg1_Sig3_oVcuRxMsg1_oTC37X_VCU_CAN00_b6c69f08_Rx
        ComSystemTemplateSystemSignalRef = VcuRxMsg1_Sig3
      ComMainFunctionRx: ComMainRxTimeBase=0.01
      ComMainFunctionTx: ComMainTxTimeBase=0.01
      VCU_oTC37X_VCU_CAN01_Rx_1837cb5c (ComIPduGroup): ComIPduGroupHandleId=8
      VCU_oTC37X_VCU_CAN01_Tx_4e6d6cda (ComIPduGroup): ComIPduGroupHandleId=9
      9 x ComSignal, all with ComBitSize=16, ComSignalEndianness=LITTLE_ENDIAN, ComSignalInitValue=0, ComSignalType=SINT16, ComTimeout=0, ComSignalAccess=ACCESS_UNCLEAR:
        VcuRxMsg4_Sig3_oVcuRxMsg4_oTC37X_VCU_CAN01_93b0db97_Rx: ComBitPosition=48, ComHandleId=94, ComSystemTemplateSystemSignalRef=VcuRxMsg4_Sig3
        VcuAdcTxMsg1_Sig3_oVcuAdcTxMsg1_oTC37X_VCU_CAN01_be6f7633_Tx: ComBitPosition=48, ComTransferProperty=PENDING, ComHandleId=66, ComSystemTemplateSystemSignalRef=VcuAdcTxMsg1_Sig3
        VcuAdcTxMsg2_Sig0_oVcuAdcTxMsg2_oTC37X_VCU_CAN01_c7979c8e_Tx: ComBitPosition=0, ComTransferProperty=PENDING, ComHandleId=68, ComSystemTemplateSystemSignalRef=VcuAdcTxMsg2_Sig0
        VcuRxMsg3_Sig1_oVcuRxMsg3_oTC37X_VCU_CAN01_4b1ed439_Rx: ComBitPosition=16, ComHandleId=82, ComSystemTemplateSystemSignalRef=VcuRxMsg3_Sig1
        VcuRxMsg3_Sig3_oVcuRxMsg3_oTC37X_VCU_CAN01_8d116671_Rx: ComBitPosition=48, ComHandleId=86, ComSystemTemplateSystemSignalRef=VcuRxMsg3_Sig3
        VcuAdcTxMsg2_Sig1_oVcuAdcTxMsg2_oTC37X_VCU_CAN01_364d9924_Tx: ComBitPosition=16, ComTransferProperty=PENDING, ComHandleId=70, ComSystemTemplateSystemSignalRef=VcuAdcTxMsg2_Sig1
        VcuAdcTxMsg2_Sig3_oVcuAdcTxMsg2_oTC37X_VCU_CAN01_0e889431_Tx: ComBitPosition=48, ComTransferProperty=PENDING, ComHandleId=74, ComSystemTemplateSystemSignalRef=VcuAdcTxMsg2_Sig3
        VcuAdcTxMsg1_Sig1_oVcuAdcTxMsg1_oTC37X_VCU_CAN01_86aa7b26_Tx: ComBitPosition=16, ComTransferProperty=PENDING, ComHandleId=62, ComSystemTemplateSystemSignalRef=VcuAdcTxMsg1_Sig1
        VcuRxMsg4_Sig1_oVcuRxMsg4_oTC37X_VCU_CAN01_55bf69df_Rx: ComBitPosition=16, ComHandleId=90, ComSystemTemplateSystemSignalRef=VcuRxMsg4_Sig1
      VcuAdcTxMsg2_oTC37X_VCU_CAN01_1723c88c_Tx (ComIPdu):
        ComIPduDirection = SEND
        ComIPduType = NORMAL
        ComIPduHandleId = 9
        ComIPduSignalProcessing = DEFERRED
        ComIPduCancellationSupport = false
        ComIPduGroupRef = VCU_oTC37X_VCU_CAN01_Tx_4e6d6cda
        ComIPduSignalRef = VcuAdcTxMsg2_Sig0_oVcuAdcTxMsg2_oTC37X_VCU_CAN01_c7979c8e_Tx
        ComIPduSignalRef = VcuAdcTxMsg2_Sig1_oVcuAdcTxMsg2_oTC37X_VCU_CAN01_364d9924_Tx
        ComIPduSignalRef = VcuAdcTxMsg2_Sig2_oVcuAdcTxMsg2_oTC37X_VCU_CAN01_ff52919b_Tx
        ComIPduSignalRef = VcuAdcTxMsg2_Sig3_oVcuAdcTxMsg2_oTC37X_VCU_CAN01_0e889431_Tx
        ComPduIdRef = VcuAdcTxMsg2_oTC37X_VCU_CAN01_1723c88c_Tx
        ComIPduMainFunctionRef = ComMainFunctionTx
        ComTxIPdu: ComMinimumDelayTime=0, ComTxIPduUnusedAreasDefault=0
          ComTxModeTrue
            ComTxMode: ComTxModeMode=PERIODIC, ComTxModeTimeOffset=0, ComTxModeTimePeriod=0.5
          ComTxModeFalse
            ComTxMode: ComTxModeMode=PERIODIC, ComTxModeTimeOffset=0, ComTxModeTimePeriod=0.5
      VcuRxMsg3_Sig2_oVcuRxMsg3_oTC37X_VCU_CAN01_ee16bf55_Rx (ComSignal):
        ComBitPosition = 32
        ComBitSize = 16
        ComSignalEndianness = LITTLE_ENDIAN
        ComSignalInitValue = 0
        ComSignalType = SINT16
        ComTimeout = 0
        ComSignalAccess = ACCESS_UNCLEAR
        ComHandleId = 84
        ComSystemTemplateSystemSignalRef = VcuRxMsg3_Sig2
      VcuRxMsg4_Sig2_oVcuRxMsg4_oTC37X_VCU_CAN01_f0b702b3_Rx (ComSignal):
        ComBitPosition = 32
        ComBitSize = 16
        ComSignalEndianness = LITTLE_ENDIAN
        ComSignalInitValue = 0
        ComSignalType = SINT16
        ComTimeout = 0
        ComSignalAccess = ACCESS_UNCLEAR
        ComHandleId = 92
        ComSystemTemplateSystemSignalRef = VcuRxMsg4_Sig2
      VcuAdcTxMsg1_oTC37X_VCU_CAN01_fda515ee_Tx (ComIPdu):
        ComIPduDirection = SEND
        ComIPduType = NORMAL
        ComIPduHandleId = 8
        ComIPduSignalProcessing = DEFERRED
        ComIPduCancellationSupport = false
        ComIPduGroupRef = VCU_oTC37X_VCU_CAN01_Tx_4e6d6cda
        ComIPduSignalRef = VcuAdcTxMsg1_Sig0_oVcuAdcTxMsg1_oTC37X_VCU_CAN01_77707e8c_Tx
        ComIPduSignalRef = VcuAdcTxMsg1_Sig1_oVcuAdcTxMsg1_oTC37X_VCU_CAN01_86aa7b26_Tx
        ComIPduSignalRef = VcuAdcTxMsg1_Sig2_oVcuAdcTxMsg1_oTC37X_VCU_CAN01_4fb57399_Tx
        ComIPduSignalRef = VcuAdcTxMsg1_Sig3_oVcuAdcTxMsg1_oTC37X_VCU_CAN01_be6f7633_Tx
        ComPduIdRef = VcuAdcTxMsg1_oTC37X_VCU_CAN01_fda515ee_Tx
        ComIPduMainFunctionRef = ComMainFunctionTx
        ComTxIPdu: ComMinimumDelayTime=0, ComTxIPduUnusedAreasDefault=0
          ComTxModeTrue
            ComTxMode: ComTxModeMode=PERIODIC, ComTxModeTimeOffset=0, ComTxModeTimePeriod=0.5
          ComTxModeFalse
            ComTxMode: ComTxModeMode=PERIODIC, ComTxModeTimeOffset=0, ComTxModeTimePeriod=0.5
      VcuRxMsg3_oTC37X_VCU_CAN01_0a530e81_Rx (ComIPdu):
        ComIPduDirection = RECEIVE
        ComIPduType = NORMAL
        ComIPduHandleId = 15
        ComIPduSignalProcessing = DEFERRED
        ComIPduCancellationSupport = false
        ComIPduGroupRef = VCU_oTC37X_VCU_CAN01_Rx_1837cb5c
        ComIPduSignalRef = VcuRxMsg3_Sig0_oVcuRxMsg3_oTC37X_VCU_CAN01_28190d1d_Rx
        ComIPduSignalRef = VcuRxMsg3_Sig1_oVcuRxMsg3_oTC37X_VCU_CAN01_4b1ed439_Rx
        ComIPduSignalRef = VcuRxMsg3_Sig2_oVcuRxMsg3_oTC37X_VCU_CAN01_ee16bf55_Rx
        ComIPduSignalRef = VcuRxMsg3_Sig3_oVcuRxMsg3_oTC37X_VCU_CAN01_8d116671_Rx
        ComPduIdRef = VcuRxMsg3_oTC37X_VCU_CAN01_0a530e81_Rx
        ComIPduMainFunctionRef = ComMainFunctionRx
      4 x ComSignal, all with ComBitSize=16, ComSignalEndianness=LITTLE_ENDIAN, ComSignalInitValue=0, ComSignalType=SINT16, ComTimeout=0, ComSignalAccess=ACCESS_UNCLEAR:
        VcuAdcTxMsg1_Sig2_oVcuAdcTxMsg1_oTC37X_VCU_CAN01_4fb57399_Tx: ComBitPosition=32, ComTransferProperty=PENDING, ComHandleId=64, ComSystemTemplateSystemSignalRef=VcuAdcTxMsg1_Sig2
        VcuRxMsg3_Sig0_oVcuRxMsg3_oTC37X_VCU_CAN01_28190d1d_Rx: ComBitPosition=0, ComHandleId=80, ComSystemTemplateSystemSignalRef=VcuRxMsg3_Sig0
        VcuAdcTxMsg1_Sig0_oVcuAdcTxMsg1_oTC37X_VCU_CAN01_77707e8c_Tx: ComBitPosition=0, ComTransferProperty=PENDING, ComHandleId=60, ComSystemTemplateSystemSignalRef=VcuAdcTxMsg1_Sig0
        VcuRxMsg4_Sig0_oVcuRxMsg4_oTC37X_VCU_CAN01_36b8b0fb_Rx: ComBitPosition=0, ComHandleId=88, ComSystemTemplateSystemSignalRef=VcuRxMsg4_Sig0
      VcuRxMsg4_oTC37X_VCU_CAN01_eb7d04e5_Rx (ComIPdu):
        ComIPduDirection = RECEIVE
        ComIPduType = NORMAL
        ComIPduHandleId = 16
        ComIPduSignalProcessing = DEFERRED
        ComIPduCancellationSupport = false
        ComIPduGroupRef = VCU_oTC37X_VCU_CAN01_Rx_1837cb5c
        ComIPduSignalRef = VcuRxMsg4_Sig0_oVcuRxMsg4_oTC37X_VCU_CAN01_36b8b0fb_Rx
        ComIPduSignalRef = VcuRxMsg4_Sig1_oVcuRxMsg4_oTC37X_VCU_CAN01_55bf69df_Rx
        ComIPduSignalRef = VcuRxMsg4_Sig2_oVcuRxMsg4_oTC37X_VCU_CAN01_f0b702b3_Rx
        ComIPduSignalRef = VcuRxMsg4_Sig3_oVcuRxMsg4_oTC37X_VCU_CAN01_93b0db97_Rx
        ComPduIdRef = VcuRxMsg4_oTC37X_VCU_CAN01_eb7d04e5_Rx
        ComIPduMainFunctionRef = ComMainFunctionRx
      VcuAdcTxMsg2_Sig2_oVcuAdcTxMsg2_oTC37X_VCU_CAN01_ff52919b_Tx (ComSignal):
        ComBitPosition = 32
        ComBitSize = 16
        ComSignalEndianness = LITTLE_ENDIAN
        ComSignalInitValue = 0
        ComSignalType = SINT16
        ComTimeout = 0
        ComTransferProperty = PENDING
        ComSignalAccess = ACCESS_UNCLEAR
        ComHandleId = 72
        ComSystemTemplateSystemSignalRef = VcuAdcTxMsg2_Sig2
      VCU_oLIN00_Rx_4b9dfc53 (ComIPduGroup): ComIPduGroupHandleId=2
      VCU_oLIN00_Tx_1dc75bd5 (ComIPduGroup): ComIPduGroupHandleId=3
      EXT4_Valid_oVcuTxIoMsg2_oTC37X_VCU_CAN00_ced21b28_Tx (ComSignal):
        ComBitPosition = 48
        ComBitSize = 16
        ComSignalEndianness = LITTLE_ENDIAN
        ComSignalInitValue = 0
        ComSignalType = UINT16
        ComTimeout = 0
        ComTransferProperty = PENDING
        ComSignalAccess = ACCESS_UNCLEAR
        ComHandleId = 14
        ComSystemTemplateSystemSignalRef = EXT4_Valid
      EXT_A_IN2_oVcuTxIoMsg1_oTC37X_VCU_CAN00_241cb78c_Tx (ComSignal):
        ComBitPosition = 32
        ComBitSize = 16
        ComSignalEndianness = LITTLE_ENDIAN
        ComSignalInitValue = 0
        ComSignalType = SINT16
        ComTimeout = 0
        ComTransferProperty = PENDING
        ComSignalAccess = ACCESS_UNCLEAR
        ComHandleId = 28
        ComSystemTemplateSystemSignalRef = EXT_A_IN2
      VcuTxIoMsg1_oTC37X_VCU_CAN00_54884add_Tx (ComIPdu):
        ComIPduDirection = SEND
        ComIPduType = NORMAL
        ComIPduHandleId = 14
        ComIPduSignalProcessing = DEFERRED
        ComIPduCancellationSupport = false
        ComIPduGroupRef = VCU_oTC37X_VCU_CAN00_Tx_f6d10bbf
        ComIPduSignalRef = EXT1_Valid_oVcuTxIoMsg1_oTC37X_VCU_CAN00_caf787ea_Tx
        ComIPduSignalRef = EXT2_Valid_oVcuTxIoMsg1_oTC37X_VCU_CAN00_9096b88a_Tx
        ComIPduSignalRef = EXT_A_IN1_oVcuTxIoMsg1_oTC37X_VCU_CAN00_37348eff_Tx
        ComIPduSignalRef = EXT_A_IN2_oVcuTxIoMsg1_oTC37X_VCU_CAN00_241cb78c_Tx
        ComPduIdRef = VcuTxIoMsg1_oTC37X_VCU_CAN00_54884add_Tx
        ComIPduMainFunctionRef = ComMainFunctionTx
        ComTxIPdu: ComMinimumDelayTime=0, ComTxIPduUnusedAreasDefault=0
          ComTxModeTrue
            ComTxMode: ComTxModeMode=PERIODIC, ComTxModeTimeOffset=0, ComTxModeTimePeriod=0.5
          ComTxModeFalse
            ComTxMode: ComTxModeMode=PERIODIC, ComTxModeTimeOffset=0, ComTxModeTimePeriod=0.5
      4 x ComSignal, all with ComBitSize=16, ComSignalEndianness=LITTLE_ENDIAN, ComSignalInitValue=0, ComTimeout=0, ComTransferProperty=PENDING, ComSignalAccess=ACCESS_UNCLEAR:
        EXT_A_IN1_oVcuTxIoMsg1_oTC37X_VCU_CAN00_37348eff_Tx: ComBitPosition=0, ComSignalType=SINT16, ComHandleId=27, ComSystemTemplateSystemSignalRef=EXT_A_IN1
        EXT1_Valid_oVcuTxIoMsg1_oTC37X_VCU_CAN00_caf787ea_Tx: ComBitPosition=16, ComSignalType=UINT16, ComHandleId=11, ComSystemTemplateSystemSignalRef=EXT1_Valid
        EXT_A_IN3_oVcuTxIoMsg2_oTC37X_VCU_CAN00_c07d823f_Tx: ComBitPosition=0, ComSignalType=SINT16, ComHandleId=29, ComSystemTemplateSystemSignalRef=EXT_A_IN3
        EXT2_Valid_oVcuTxIoMsg1_oTC37X_VCU_CAN00_9096b88a_Tx: ComBitPosition=48, ComSignalType=UINT16, ComHandleId=12, ComSystemTemplateSystemSignalRef=EXT2_Valid
      VcuTxIoMsg2_oTC37X_VCU_CAN00_be0e97bf_Tx (ComIPdu):
        ComIPduDirection = SEND
        ComIPduType = NORMAL
        ComIPduHandleId = 15
        ComIPduSignalProcessing = DEFERRED
        ComIPduCancellationSupport = false
        ComIPduGroupRef = VCU_oTC37X_VCU_CAN00_Tx_f6d10bbf
        ComIPduSignalRef = EXT3_Valid_oVcuTxIoMsg2_oTC37X_VCU_CAN00_fae072f7_Tx
        ComIPduSignalRef = EXT4_Valid_oVcuTxIoMsg2_oTC37X_VCU_CAN00_ced21b28_Tx
        ComIPduSignalRef = EXT_A_IN3_oVcuTxIoMsg2_oTC37X_VCU_CAN00_c07d823f_Tx
        ComIPduSignalRef = EXT_A_IN4_oVcuTxIoMsg2_oTC37X_VCU_CAN00_e8ca1808_Tx
        ComPduIdRef = VcuTxIoMsg2_oTC37X_VCU_CAN00_be0e97bf_Tx
        ComIPduMainFunctionRef = ComMainFunctionTx
        ComTxIPdu: ComMinimumDelayTime=0, ComTxIPduUnusedAreasDefault=0
          ComTxModeTrue
            ComTxMode: ComTxModeMode=PERIODIC, ComTxModeTimeOffset=0, ComTxModeTimePeriod=0.5
          ComTxModeFalse
            ComTxMode: ComTxModeMode=PERIODIC, ComTxModeTimeOffset=0, ComTxModeTimePeriod=0.5
      7 x ComSignal, all with ComBitSize=16, ComSignalEndianness=LITTLE_ENDIAN, ComSignalInitValue=0, ComTimeout=0, ComTransferProperty=PENDING, ComSignalAccess=ACCESS_UNCLEAR:
        EXT3_Valid_oVcuTxIoMsg2_oTC37X_VCU_CAN00_fae072f7_Tx: ComBitPosition=16, ComSignalType=UINT16, ComHandleId=13, ComSystemTemplateSystemSignalRef=EXT3_Valid
        EXT_A_IN4_oVcuTxIoMsg2_oTC37X_VCU_CAN00_e8ca1808_Tx: ComBitPosition=32, ComSignalType=SINT16, ComHandleId=30, ComSystemTemplateSystemSignalRef=EXT_A_IN4
        EXT6_Valid_oVcuTxIoMsg3_oTC37X_VCU_CAN00_fb1185b6_Tx: ComBitPosition=48, ComSignalType=UINT16, ComHandleId=16, ComSystemTemplateSystemSignalRef=EXT6_Valid
        EXT16_Valid_oVcuTxIoMsg8_oTC37X_VCU_CAN00_fd3a983d_Tx: ComBitPosition=48, ComSignalType=UINT16, ComHandleId=26, ComSystemTemplateSystemSignalRef=EXT16_Valid
        EXT11_Valid_oVcuTxIoMsg6_oTC37X_VCU_CAN00_d025e36b_Tx: ComBitPosition=16, ComSignalType=UINT16, ComHandleId=21, ComSystemTemplateSystemSignalRef=EXT11_Valid
        EXT_A_IN10_oVcuTxIoMsg5_oTC37X_VCU_CAN00_83e5b725_Tx: ComBitPosition=32, ComSignalType=SINT16, ComHandleId=36, ComSystemTemplateSystemSignalRef=EXT_A_IN10
        EXT5_Valid_oVcuTxIoMsg3_oTC37X_VCU_CAN00_a170bad6_Tx: ComBitPosition=16, ComSignalType=UINT16, ComHandleId=15, ComSystemTemplateSystemSignalRef=EXT5_Valid
      VcuTxIoMsg4_oTC37X_VCU_CAN00_b0722b3a_Tx (ComIPdu):
        ComIPduDirection = SEND
        ComIPduType = NORMAL
        ComIPduHandleId = 17
        ComIPduSignalProcessing = DEFERRED
        ComIPduCancellationSupport = false
        ComIPduGroupRef = VCU_oTC37X_VCU_CAN00_Tx_f6d10bbf
        ComIPduSignalRef = EXT7_Valid_oVcuTxIoMsg4_oTC37X_VCU_CAN00_9acf98cd_Tx
        ComIPduSignalRef = EXT8_Valid_oVcuTxIoMsg4_oTC37X_VCU_CAN00_725b5c6c_Tx
        ComIPduSignalRef = EXT_A_IN7_oVcuTxIoMsg4_oTC37X_VCU_CAN00_f59e9dfe_Tx
        ComIPduSignalRef = EXT_A_IN8_oVcuTxIoMsg4_oTC37X_VCU_CAN00_aa164141_Tx
        ComPduIdRef = VcuTxIoMsg4_oTC37X_VCU_CAN00_b0722b3a_Tx
        ComIPduMainFunctionRef = ComMainFunctionTx
        ComTxIPdu: ComMinimumDelayTime=0, ComTxIPduUnusedAreasDefault=0
          ComTxModeTrue
            ComTxMode: ComTxModeMode=PERIODIC, ComTxModeTimeOffset=0, ComTxModeTimePeriod=0.5
          ComTxModeFalse
            ComTxMode: ComTxModeMode=PERIODIC, ComTxModeTimeOffset=0, ComTxModeTimePeriod=0.5
      EXT13_Valid_oVcuTxIoMsg7_oTC37X_VCU_CAN00_e5e67df5_Tx (ComSignal):
        ComBitPosition = 16
        ComBitSize = 16
        ComSignalEndianness = LITTLE_ENDIAN
        ComSignalInitValue = 0
        ComSignalType = UINT16
        ComTimeout = 0
        ComTransferProperty = PENDING
        ComSignalAccess = ACCESS_UNCLEAR
        ComHandleId = 23
        ComSystemTemplateSystemSignalRef = EXT13_Valid
      VcuTxIoMsg8_oTC37X_VCU_CAN00_ac8b5230_Tx (ComIPdu):
        ComIPduDirection = SEND
        ComIPduType = NORMAL
        ComIPduHandleId = 21
        ComIPduSignalProcessing = DEFERRED
        ComIPduCancellationSupport = false
        ComIPduGroupRef = VCU_oTC37X_VCU_CAN00_Tx_f6d10bbf
        ComIPduSignalRef = EXT15_Valid_oVcuTxIoMsg8_oTC37X_VCU_CAN00_a75ba75d_Tx
        ComIPduSignalRef = EXT16_Valid_oVcuTxIoMsg8_oTC37X_VCU_CAN00_fd3a983d_Tx
        ComIPduSignalRef = EXT_A_IN15_oVcuTxIoMsg8_oTC37X_VCU_CAN00_4536335b_Tx
        ComIPduSignalRef = EXT_A_IN16_oVcuTxIoMsg8_oTC37X_VCU_CAN00_561e0a28_Tx
        ComPduIdRef = VcuTxIoMsg8_oTC37X_VCU_CAN00_ac8b5230_Tx
        ComIPduMainFunctionRef = ComMainFunctionTx
        ComTxIPdu: ComMinimumDelayTime=0, ComTxIPduUnusedAreasDefault=0
          ComTxModeTrue
            ComTxMode: ComTxModeMode=PERIODIC, ComTxModeTimeOffset=0, ComTxModeTimePeriod=0.5
          ComTxModeFalse
            ComTxMode: ComTxModeMode=PERIODIC, ComTxModeTimeOffset=0, ComTxModeTimePeriod=0.5
      9 x ComSignal, all with ComBitSize=16, ComSignalEndianness=LITTLE_ENDIAN, ComSignalInitValue=0, ComTimeout=0, ComTransferProperty=PENDING, ComSignalAccess=ACCESS_UNCLEAR:
        EXT10_Valid_oVcuTxIoMsg5_oTC37X_VCU_CAN00_ba532916_Tx: ComBitPosition=48, ComSignalType=UINT16, ComHandleId=20, ComSystemTemplateSystemSignalRef=EXT10_Valid
        EXT_A_IN6_oVcuTxIoMsg3_oTC37X_VCU_CAN00_1a577f4b_Tx: ComBitPosition=32, ComSignalType=SINT16, ComHandleId=32, ComSystemTemplateSystemSignalRef=EXT_A_IN6
        EXT12_Valid_oVcuTxIoMsg6_oTC37X_VCU_CAN00_8a44dc0b_Tx: ComBitPosition=48, ComSignalType=UINT16, ComHandleId=22, ComSystemTemplateSystemSignalRef=EXT12_Valid
        EXT9_Valid_oVcuTxIoMsg5_oTC37X_VCU_CAN00_1df9fd92_Tx: ComBitPosition=16, ComSignalType=UINT16, ComHandleId=19, ComSystemTemplateSystemSignalRef=EXT9_Valid
        EXT_A_IN12_oVcuTxIoMsg6_oTC37X_VCU_CAN00_74acbbe5_Tx: ComBitPosition=32, ComSignalType=SINT16, ComHandleId=38, ComSystemTemplateSystemSignalRef=EXT_A_IN12
        EXT_A_IN7_oVcuTxIoMsg4_oTC37X_VCU_CAN00_f59e9dfe_Tx: ComBitPosition=0, ComSignalType=SINT16, ComHandleId=33, ComSystemTemplateSystemSignalRef=EXT_A_IN7
        EXT_A_IN13_oVcuTxIoMsg7_oTC37X_VCU_CAN00_9519e5d5_Tx: ComBitPosition=0, ComSignalType=SINT16, ComHandleId=39, ComSystemTemplateSystemSignalRef=EXT_A_IN13
        EXT_A_IN9_oVcuTxIoMsg5_oTC37X_VCU_CAN00_4ba31f71_Tx: ComBitPosition=0, ComSignalType=SINT16, ComHandleId=35, ComSystemTemplateSystemSignalRef=EXT_A_IN9
        EXT7_Valid_oVcuTxIoMsg4_oTC37X_VCU_CAN00_9acf98cd_Tx: ComBitPosition=16, ComSignalType=UINT16, ComHandleId=17, ComSystemTemplateSystemSignalRef=EXT7_Valid
      VcuTxIoMsg5_oTC37X_VCU_CAN00_5f209ddb_Tx (ComIPdu):
        ComIPduDirection = SEND
        ComIPduType = NORMAL
        ComIPduHandleId = 18
        ComIPduSignalProcessing = DEFERRED
        ComIPduCancellationSupport = false
        ComIPduGroupRef = VCU_oTC37X_VCU_CAN00_Tx_f6d10bbf
        ComIPduSignalRef = EXT10_Valid_oVcuTxIoMsg5_oTC37X_VCU_CAN00_ba532916_Tx
        ComIPduSignalRef = EXT9_Valid_oVcuTxIoMsg5_oTC37X_VCU_CAN00_1df9fd92_Tx
        ComIPduSignalRef = EXT_A_IN10_oVcuTxIoMsg5_oTC37X_VCU_CAN00_83e5b725_Tx
        ComIPduSignalRef = EXT_A_IN9_oVcuTxIoMsg5_oTC37X_VCU_CAN00_4ba31f71_Tx
        ComPduIdRef = VcuTxIoMsg5_oTC37X_VCU_CAN00_5f209ddb_Tx
        ComIPduMainFunctionRef = ComMainFunctionTx
        ComTxIPdu: ComMinimumDelayTime=0, ComTxIPduUnusedAreasDefault=0
          ComTxModeTrue
            ComTxMode: ComTxModeMode=PERIODIC, ComTxModeTimeOffset=0, ComTxModeTimePeriod=0.5
          ComTxModeFalse
            ComTxMode: ComTxModeMode=PERIODIC, ComTxModeTimeOffset=0, ComTxModeTimePeriod=0.5
      EXT_A_IN11_oVcuTxIoMsg6_oTC37X_VCU_CAN00_67848296_Tx (ComSignal):
        ComBitPosition = 0
        ComBitSize = 16
        ComSignalEndianness = LITTLE_ENDIAN
        ComSignalInitValue = 0
        ComSignalType = SINT16
        ComTimeout = 0
        ComTransferProperty = PENDING
        ComSignalAccess = ACCESS_UNCLEAR
        ComHandleId = 37
        ComSystemTemplateSystemSignalRef = EXT_A_IN11
      EXT_A_IN14_oVcuTxIoMsg7_oTC37X_VCU_CAN00_bdae7fe2_Tx (ComSignal):
        ComBitPosition = 32
        ComBitSize = 16
        ComSignalEndianness = LITTLE_ENDIAN
        ComSignalInitValue = 0
        ComSignalType = SINT16
        ComTimeout = 0
        ComTransferProperty = PENDING
        ComSignalAccess = ACCESS_UNCLEAR
        ComHandleId = 40
        ComSystemTemplateSystemSignalRef = EXT_A_IN14
      VcuTxIoMsg3_oTC37X_VCU_CAN00_515c215e_Tx (ComIPdu):
        ComIPduDirection = SEND
        ComIPduType = NORMAL
        ComIPduHandleId = 16
        ComIPduSignalProcessing = DEFERRED
        ComIPduCancellationSupport = false
        ComIPduGroupRef = VCU_oTC37X_VCU_CAN00_Tx_f6d10bbf
        ComIPduSignalRef = EXT5_Valid_oVcuTxIoMsg3_oTC37X_VCU_CAN00_a170bad6_Tx
        ComIPduSignalRef = EXT6_Valid_oVcuTxIoMsg3_oTC37X_VCU_CAN00_fb1185b6_Tx
        ComIPduSignalRef = EXT_A_IN5_oVcuTxIoMsg3_oTC37X_VCU_CAN00_097f4638_Tx
        ComIPduSignalRef = EXT_A_IN6_oVcuTxIoMsg3_oTC37X_VCU_CAN00_1a577f4b_Tx
        ComPduIdRef = VcuTxIoMsg3_oTC37X_VCU_CAN00_515c215e_Tx
        ComIPduMainFunctionRef = ComMainFunctionTx
        ComTxIPdu: ComMinimumDelayTime=0, ComTxIPduUnusedAreasDefault=0
          ComTxModeTrue
            ComTxMode: ComTxModeMode=PERIODIC, ComTxModeTimeOffset=0, ComTxModeTimePeriod=0.5
          ComTxModeFalse
            ComTxMode: ComTxModeMode=PERIODIC, ComTxModeTimeOffset=0, ComTxModeTimePeriod=0.5
      7 x ComSignal, all with ComBitSize=16, ComSignalEndianness=LITTLE_ENDIAN, ComSignalInitValue=0, ComTimeout=0, ComTransferProperty=PENDING, ComSignalAccess=ACCESS_UNCLEAR:
        EXT14_Valid_oVcuTxIoMsg7_oTC37X_VCU_CAN00_d1d4142a_Tx: ComBitPosition=48, ComSignalType=UINT16, ComHandleId=24, ComSystemTemplateSystemSignalRef=EXT14_Valid
        EXT15_Valid_oVcuTxIoMsg8_oTC37X_VCU_CAN00_a75ba75d_Tx: ComBitPosition=16, ComSignalType=UINT16, ComHandleId=25, ComSystemTemplateSystemSignalRef=EXT15_Valid
        EXT_A_IN5_oVcuTxIoMsg3_oTC37X_VCU_CAN00_097f4638_Tx: ComBitPosition=0, ComSignalType=SINT16, ComHandleId=31, ComSystemTemplateSystemSignalRef=EXT_A_IN5
        EXT_A_IN8_oVcuTxIoMsg4_oTC37X_VCU_CAN00_aa164141_Tx: ComBitPosition=32, ComSignalType=SINT16, ComHandleId=34, ComSystemTemplateSystemSignalRef=EXT_A_IN8
        EXT_A_IN16_oVcuTxIoMsg8_oTC37X_VCU_CAN00_561e0a28_Tx: ComBitPosition=32, ComSignalType=SINT16, ComHandleId=42, ComSystemTemplateSystemSignalRef=EXT_A_IN16
        EXT8_Valid_oVcuTxIoMsg4_oTC37X_VCU_CAN00_725b5c6c_Tx: ComBitPosition=48, ComSignalType=UINT16, ComHandleId=18, ComSystemTemplateSystemSignalRef=EXT8_Valid
        EXT_A_IN15_oVcuTxIoMsg8_oTC37X_VCU_CAN00_4536335b_Tx: ComBitPosition=0, ComSignalType=SINT16, ComHandleId=41, ComSystemTemplateSystemSignalRef=EXT_A_IN15
      VcuTxIoMsg7_oTC37X_VCU_CAN00_5af4f658_Tx (ComIPdu):
        ComIPduDirection = SEND
        ComIPduType = NORMAL
        ComIPduHandleId = 20
        ComIPduSignalProcessing = DEFERRED
        ComIPduCancellationSupport = false
        ComIPduGroupRef = VCU_oTC37X_VCU_CAN00_Tx_f6d10bbf
        ComIPduSignalRef = EXT13_Valid_oVcuTxIoMsg7_oTC37X_VCU_CAN00_e5e67df5_Tx
        ComIPduSignalRef = EXT14_Valid_oVcuTxIoMsg7_oTC37X_VCU_CAN00_d1d4142a_Tx
        ComIPduSignalRef = EXT_A_IN13_oVcuTxIoMsg7_oTC37X_VCU_CAN00_9519e5d5_Tx
        ComIPduSignalRef = EXT_A_IN14_oVcuTxIoMsg7_oTC37X_VCU_CAN00_bdae7fe2_Tx
        ComPduIdRef = VcuTxIoMsg7_oTC37X_VCU_CAN00_5af4f658_Tx
        ComIPduMainFunctionRef = ComMainFunctionTx
        ComTxIPdu: ComMinimumDelayTime=0, ComTxIPduUnusedAreasDefault=0
          ComTxModeTrue
            ComTxMode: ComTxModeMode=PERIODIC, ComTxModeTimeOffset=0, ComTxModeTimePeriod=0.5
          ComTxModeFalse
            ComTxMode: ComTxModeMode=PERIODIC, ComTxModeTimeOffset=0, ComTxModeTimePeriod=0.5
      VcuTxIoMsg6_oTC37X_VCU_CAN00_b5a640b9_Tx (ComIPdu):
        ComIPduDirection = SEND
        ComIPduType = NORMAL
        ComIPduHandleId = 19
        ComIPduSignalProcessing = DEFERRED
        ComIPduCancellationSupport = false
        ComIPduGroupRef = VCU_oTC37X_VCU_CAN00_Tx_f6d10bbf
        ComIPduSignalRef = EXT11_Valid_oVcuTxIoMsg6_oTC37X_VCU_CAN00_d025e36b_Tx
        ComIPduSignalRef = EXT12_Valid_oVcuTxIoMsg6_oTC37X_VCU_CAN00_8a44dc0b_Tx
        ComIPduSignalRef = EXT_A_IN11_oVcuTxIoMsg6_oTC37X_VCU_CAN00_67848296_Tx
        ComIPduSignalRef = EXT_A_IN12_oVcuTxIoMsg6_oTC37X_VCU_CAN00_74acbbe5_Tx
        ComPduIdRef = VcuTxIoMsg6_oTC37X_VCU_CAN00_b5a640b9_Tx
        ComIPduMainFunctionRef = ComMainFunctionTx
        ComTxIPdu: ComMinimumDelayTime=0, ComTxIPduUnusedAreasDefault=0
          ComTxModeTrue
            ComTxMode: ComTxModeMode=PERIODIC, ComTxModeTimeOffset=0, ComTxModeTimePeriod=0.5
          ComTxModeFalse
            ComTxMode: ComTxModeMode=PERIODIC, ComTxModeTimeOffset=0, ComTxModeTimePeriod=0.5
      TCU_HVCH_heating_rq_oTCU_HVCH_Cmd_oLIN00_5e3a32b2_Tx (ComSignal):
        ComBitPosition = 0
        ComBitSize = 7
        ComSignalEndianness = LITTLE_ENDIAN
        ComSignalInitValue = 0
        ComSignalType = UINT8
        ComSignalAccess = ACCESS_UNCLEAR
        ComHandleId = 47
        ComTransferProperty = PENDING
        ComSystemTemplateSystemSignalRef = TCU_HVCH_heating_rq
      VCU_EXV_1_oLIN00_50eec975_Tx (ComIPdu):
        ComIPduDirection = SEND
        ComIPduType = NORMAL
        ComIPduHandleId = 3
        ComIPduSignalProcessing = DEFERRED
        ComIPduCancellationSupport = false
        ComIPduGroupRef = VCU_oLIN00_Tx_1dc75bd5
        ComIPduSignalRef = TMM_EXV1_EnableRequest_oVCU_EXV_1_oLIN00_d988d266_Tx
        ComIPduSignalRef = TMM_EXV1_PositionRequest_oVCU_EXV_1_oLIN00_cbd2de27_Tx
        ComIPduSignalRef = TMM_EXV1_initRequest_oVCU_EXV_1_oLIN00_082350ea_Tx
        ComPduIdRef = VCU_EXV_1_oLIN00_50eec975_Tx
        ComIPduMainFunctionRef = ComMainFunctionTx
        ComTxIPdu: ComTxIPduUnusedAreasDefault=255, ComMinimumDelayTime=0
          ComTxModeTrue
            ComTxMode: ComTxModeMode=NONE
          ComTxModeFalse
            ComTxMode: ComTxModeMode=NONE
      HVCH_LIN_Flt_oHVCH_Rsp01_oLIN00_9aaa25bf_Rx (ComSignal):
        ComBitPosition = 44
        ComBitSize = 1
        ComSignalEndianness = LITTLE_ENDIAN
        ComSignalInitValue = 0
        ComSignalType = BOOLEAN
        ComSignalAccess = ACCESS_UNCLEAR
        ComHandleId = 35
        ComSystemTemplateSystemSignalRef = HVCH_LIN_Flt
      TCU_HVCH_Cmd_oLIN00_385d5651_Tx (ComIPdu):
        ComIPduDirection = SEND
        ComIPduType = NORMAL
        ComIPduHandleId = 2
        ComIPduSignalProcessing = DEFERRED
        ComIPduCancellationSupport = false
        ComIPduGroupRef = VCU_oLIN00_Tx_1dc75bd5
        ComIPduSignalRef = TCU_HVCHMaxPowerLimit_oTCU_HVCH_Cmd_oLIN00_4bc53e0b_Tx
        ComIPduSignalRef = TCU_HVCH_On_Rq_oTCU_HVCH_Cmd_oLIN00_9f442eaf_Tx
        ComIPduSignalRef = TCU_HVCH_TmaxLim_output_oTCU_HVCH_Cmd_oLIN00_5e45d521_Tx
        ComIPduSignalRef = TCU_HVCH_heating_rq_oTCU_HVCH_Cmd_oLIN00_5e3a32b2_Tx
        ComPduIdRef = TCU_HVCH_Cmd_oLIN00_385d5651_Tx
        ComIPduMainFunctionRef = ComMainFunctionTx
        ComTxIPdu: ComTxIPduUnusedAreasDefault=255, ComMinimumDelayTime=0
          ComTxModeTrue
            ComTxMode: ComTxModeMode=NONE
          ComTxModeFalse
            ComTxMode: ComTxModeMode=NONE
      EXV_2_VCU_oLIN00_1e4a3daf_Rx (ComIPdu):
        ComIPduDirection = RECEIVE
        ComIPduType = NORMAL
        ComIPduHandleId = 2
        ComIPduSignalProcessing = DEFERRED
        ComIPduCancellationSupport = false
        ComIPduGroupRef = VCU_oLIN00_Rx_4b9dfc53
        ComIPduSignalRef = EXV2_CurrentInitState_oEXV_2_VCU_oLIN00_adb498ec_Rx
        ComIPduSignalRef = EXV2_CurrentPosition_oEXV_2_VCU_oLIN00_91e32486_Rx
        ComIPduSignalRef = EXV2_FaultState_oEXV_2_VCU_oLIN00_41c0e318_Rx
        ComIPduSignalRef = EXV2_ResponseError_oEXV_2_VCU_oLIN00_e747f934_Rx
        ComIPduSignalRef = EXV2_RunState_oEXV_2_VCU_oLIN00_859c8088_Rx
        ComIPduSignalRef = EXV2_TemperatureWarn_oEXV_2_VCU_oLIN00_5f7c92a2_Rx
        ComIPduSignalRef = EXV2_VoltageState_oEXV_2_VCU_oLIN00_8f3a2738_Rx
        ComPduIdRef = EXV_2_VCU_oLIN00_1e4a3daf_Rx
        ComIPduMainFunctionRef = ComMainFunctionRx
      13 x ComSignal, all with ComSignalEndianness=LITTLE_ENDIAN, ComSignalAccess=ACCESS_UNCLEAR:
        HVCH_Status_oHVCH_Rsp01_oLIN00_60afdc75_Rx: ComBitPosition=32, ComBitSize=3, ComSignalInitValue=0, ComSignalType=UINT8, ComHandleId=39, ComSystemTemplateSystemSignalRef=HVCH_Status
        EXV2_Fault_Stat_oEXV2_Status_oLIN00_ab6350b6_Rx: ComBitPosition=8, ComBitSize=4, ComSignalInitValue=0, ComSignalType=UINT8, ComHandleId=16, ComSystemTemplateSystemSignalRef=EXV2_Fault_Stat
        HVCH_DutyCycle_oHVCH_Rsp01_oLIN00_ad1e6a22_Rx: ComBitPosition=24, ComBitSize=8, ComSignalInitValue=50, ComSignalType=UINT8, ComHandleId=28, ComSystemTemplateSystemSignalRef=HVCH_DutyCycle
        Breakage_Fault_STA_oSVA_VCU_STD_oLIN00_a3ac9cf8_Rx: ComBitPosition=3, ComBitSize=1, ComSignalInitValue=0, ComSignalType=BOOLEAN, ComHandleId=3, ComSystemTemplateSystemSignalRef=Breakage_Fault_STA
        PMP3_PumpPowerSta_oPMP3_Sts_oLIN00_884db7a7_Rx: ComBitPosition=4, ComBitSize=2, ComSignalInitValue=0, ComSignalType=UINT8, ComHandleId=55, ComSystemTemplateSystemSignalRef=PMP3_PumpPowerSta
        Act_Pos_sta_oSVA_VCU_STD_oLIN00_642c9ffa_Rx: ComBitPosition=8, ComBitSize=12, ComSignalInitValue=0, ComSignalType=UINT16, ComHandleId=1, ComSystemTemplateSystemSignalRef=Act_Pos_sta
        EXV2_RunState_oEXV_2_VCU_oLIN00_859c8088_Rx: ComBitPosition=3, ComBitSize=1, ComSignalInitValue=0, ComSignalType=BOOLEAN, ComHandleId=20, ComSystemTemplateSystemSignalRef=EXV2_RunState
        PMP2_PumpMotorSta_oPMP2_Sts_oLIN00_d6d3ab88_Rx: ComBitPosition=1, ComBitSize=2, ComSignalInitValue=0, ComSignalType=UINT8, ComHandleId=47, ComSystemTemplateSystemSignalRef=PMP2_PumpMotorSta
        Target_Pos_cmd_oVCU_SVA_CMD_oLIN00_b87f26ef_Tx: ComBitPosition=16, ComBitSize=12, ComSignalInitValue=0, ComSignalType=UINT16, ComHandleId=55, ComTransferProperty=PENDING, ComSystemTemplateSystemSignalRef=Target_Pos_cmd
        PMP2_PumpTempSta_oPMP2_Sts_oLIN00_81f2fa55_Rx: ComBitPosition=6, ComBitSize=2, ComSignalInitValue=0, ComSignalType=UINT8, ComHandleId=49, ComSystemTemplateSystemSignalRef=PMP2_PumpTempSta
        TMM_EXV1_PositionRequest_oVCU_EXV_1_oLIN00_cbd2de27_Tx: ComBitPosition=0, ComBitSize=16, ComSignalInitValue=0, ComSignalType=UINT16, ComHandleId=49, ComTransferProperty=PENDING, ComSystemTemplateSystemSignalRef=TMM_EXV1_PositionRequest
        EXV2_CurrentInitState_oEXV_2_VCU_oLIN00_adb498ec_Rx: ComBitPosition=1, ComBitSize=2, ComSignalInitValue=0, ComSignalType=UINT8, ComHandleId=13, ComSystemTemplateSystemSignalRef=EXV2_CurrentInitState
        EXV1_ResponseError_oEXV_1_VCU_oLIN00_cbce9ad1_Rx: ComBitPosition=0, ComBitSize=1, ComSignalInitValue=0, ComSignalType=BOOLEAN, ComHandleId=9, ComSystemTemplateSystemSignalRef=EXV1_ResponseError
      PMP_Cmd_oLIN00_3912b28b_Tx (ComIPdu):
        ComIPduDirection = SEND
        ComIPduType = NORMAL
        ComIPduHandleId = 1
        ComIPduSignalProcessing = DEFERRED
        ComIPduCancellationSupport = false
        ComIPduGroupRef = VCU_oLIN00_Tx_1dc75bd5
        ComIPduSignalRef = ECC_PMP2_SpdSet_oPMP_Cmd_oLIN00_8cabc4b7_Tx
        ComIPduSignalRef = ECC_PMP3_SpdSet_oPMP_Cmd_oLIN00_0d8ea190_Tx
        ComPduIdRef = PMP_Cmd_oLIN00_3912b28b_Tx
        ComIPduMainFunctionRef = ComMainFunctionTx
        ComTxIPdu: ComTxIPduUnusedAreasDefault=255, ComMinimumDelayTime=0
          ComTxModeTrue
            ComTxMode: ComTxModeMode=NONE
          ComTxModeFalse
            ComTxMode: ComTxModeMode=NONE
      4 x ComSignal, all with ComSignalEndianness=LITTLE_ENDIAN, ComSignalInitValue=0, ComSignalType=UINT8, ComSignalAccess=ACCESS_UNCLEAR:
        HVCH_CurrSens_Flt_oHVCH_Rsp01_oLIN00_09f7bc74_Rx: ComBitPosition=56, ComBitSize=5, ComHandleId=27, ComSystemTemplateSystemSignalRef=HVCH_CurrSens_Flt
        ECC_PMP2_SpdSet_oPMP_Cmd_oLIN00_8cabc4b7_Tx: ComBitPosition=8, ComBitSize=8, ComHandleId=6, ComTransferProperty=PENDING, ComSystemTemplateSystemSignalRef=ECC_PMP2_SpdSet
        Calibration_sta_oSVA_VCU_STD_oLIN00_dcb4af08_Rx: ComBitPosition=0, ComBitSize=2, ComHandleId=5, ComSystemTemplateSystemSignalRef=Calibration_sta
        EXV1_FaultState_oEXV_1_VCU_oLIN00_72ff14f0_Rx: ComBitPosition=4, ComBitSize=4, ComHandleId=8, ComSystemTemplateSystemSignalRef=EXV1_FaultState
      EDCU_EXV2_oLIN00_1f8750a5_Tx (ComIPdu):
        ComIPduDirection = SEND
        ComIPduType = NORMAL
        ComIPduHandleId = 0
        ComIPduSignalProcessing = DEFERRED
        ComIPduCancellationSupport = false
        ComIPduGroupRef = VCU_oLIN00_Tx_1dc75bd5
        ComIPduSignalRef = EDCU_EXV2_Cmd_Init_Rq_oEDCU_EXV2_oLIN00_0144aec9_Tx
        ComIPduSignalRef = EDCU_EXV2_Cmd_Move_Enbl_oEDCU_EXV2_oLIN00_d6797517_Tx
        ComIPduSignalRef = EDCU_EXV2_Cmd_Set_Rq_oEDCU_EXV2_oLIN00_66e5876a_Tx
        ComPduIdRef = EDCU_EXV2_oLIN00_1f8750a5_Tx
        ComIPduMainFunctionRef = ComMainFunctionTx
        ComTxIPdu: ComTxIPduUnusedAreasDefault=255, ComMinimumDelayTime=0
          ComTxModeTrue
            ComTxMode: ComTxModeMode=NONE
          ComTxModeFalse
            ComTxMode: ComTxModeMode=NONE
      4 x ComSignal, all with ComSignalEndianness=LITTLE_ENDIAN, ComSignalInitValue=0, ComSignalAccess=ACCESS_UNCLEAR:
        HVCH_defectHeaterCircuits_oHVCH_Rsp01_oLIN00_61948e74_Rx: ComBitPosition=35, ComBitSize=3, ComSignalType=UINT8, ComHandleId=42, ComSystemTemplateSystemSignalRef=HVCH_defectHeaterCircuits
        RsErr_EXV2_oEXV2_Status_oLIN00_5c35655a_Rx: ComBitPosition=0, ComBitSize=1, ComSignalType=BOOLEAN, ComHandleId=59, ComSystemTemplateSystemSignalRef=RsErr_EXV2
        HVCH_HV_Voltage_Valid_oHVCH_Rsp01_oLIN00_2914831e_Rx: ComBitPosition=40, ComBitSize=2, ComSignalType=UINT8, ComHandleId=31, ComSystemTemplateSystemSignalRef=HVCH_HV_Voltage_Valid
        PMP2_PumpDryRunningSta_oPMP2_Sts_oLIN00_3e217a22_Rx: ComBitPosition=3, ComBitSize=1, ComSignalType=BOOLEAN, ComHandleId=45, ComSystemTemplateSystemSignalRef=PMP2_PumpDryRunningSta
      VCU_EXV_2_oLIN00_de61ce96_Tx (ComIPdu):
        ComIPduDirection = SEND
        ComIPduType = NORMAL
        ComIPduHandleId = 4
        ComIPduSignalProcessing = DEFERRED
        ComIPduCancellationSupport = false
        ComIPduGroupRef = VCU_oLIN00_Tx_1dc75bd5
        ComIPduSignalRef = TMM_EXV2_EnableRequest_oVCU_EXV_2_oLIN00_0c106490_Tx
        ComIPduSignalRef = TMM_EXV2_PositionRequest_oVCU_EXV_2_oLIN00_ce8ee7dd_Tx
        ComIPduSignalRef = TMM_EXV2_initRequest_oVCU_EXV_2_oLIN00_95846e7a_Tx
        ComPduIdRef = VCU_EXV_2_oLIN00_de61ce96_Tx
        ComIPduMainFunctionRef = ComMainFunctionTx
        ComTxIPdu: ComTxIPduUnusedAreasDefault=255, ComMinimumDelayTime=0
          ComTxModeTrue
            ComTxMode: ComTxModeMode=NONE
          ComTxModeFalse
            ComTxMode: ComTxModeMode=NONE
      5 x ComSignal, all with ComSignalEndianness=LITTLE_ENDIAN, ComSignalInitValue=0, ComSignalAccess=ACCESS_UNCLEAR:
        EXV2_TemperatureWarn_oEXV_2_VCU_oLIN00_5f7c92a2_Rx: ComBitPosition=10, ComBitSize=2, ComSignalType=UINT8, ComHandleId=22, ComSystemTemplateSystemSignalRef=EXV2_TemperatureWarn
        HVCH_Off_ShrtCurr_oHVCH_Rsp01_oLIN00_bf58ab45_Rx: ComBitPosition=46, ComBitSize=1, ComSignalType=BOOLEAN, ComHandleId=37, ComSystemTemplateSystemSignalRef=HVCH_Off_ShrtCurr
        LIN_Resp_Error_sta_oSVA_VCU_STD_oLIN00_47f7ca93_Rx: ComBitPosition=32, ComBitSize=1, ComSignalType=BOOLEAN, ComHandleId=43, ComSystemTemplateSystemSignalRef=LIN_Resp_Error_sta
        EXV1_CurrentInitState_oEXV_1_VCU_oLIN00_beca31e2_Rx: ComBitPosition=1, ComBitSize=2, ComSignalType=UINT8, ComHandleId=6, ComSystemTemplateSystemSignalRef=EXV1_CurrentInitState
        HVCH_TempSens_Flt_oHVCH_Rsp01_oLIN00_66cb2c71_Rx: ComBitPosition=42, ComBitSize=1, ComSignalType=BOOLEAN, ComHandleId=41, ComSystemTemplateSystemSignalRef=HVCH_TempSens_Flt
      EXV2_Status_oLIN00_d5e93929_Rx (ComIPdu):
        ComIPduDirection = RECEIVE
        ComIPduType = NORMAL
        ComIPduHandleId = 0
        ComIPduSignalProcessing = DEFERRED
        ComIPduCancellationSupport = false
        ComIPduGroupRef = VCU_oLIN00_Rx_4b9dfc53
        ComIPduSignalRef = EXV2_Fault_Stat_oEXV2_Status_oLIN00_ab6350b6_Rx
        ComIPduSignalRef = EXV2_OvrTemp_Warn_oEXV2_Status_oLIN00_ba77659e_Rx
        ComIPduSignalRef = EXV2_Pos_oEXV2_Status_oLIN00_da80603b_Rx
        ComIPduSignalRef = EXV2_Run_Stat_oEXV2_Status_oLIN00_0e992e12_Rx
        ComIPduSignalRef = EXV2_Volt_Stat_oEXV2_Status_oLIN00_c8727eb0_Rx
        ComIPduSignalRef = EXV2_curInit_Stat_oEXV2_Status_oLIN00_b0ace0f5_Rx
        ComIPduSignalRef = RsErr_EXV2_oEXV2_Status_oLIN00_5c35655a_Rx
        ComPduIdRef = EXV2_Status_oLIN00_d5e93929_Rx
        ComIPduMainFunctionRef = ComMainFunctionRx
      3 x ComSignal, all with ComSignalEndianness=LITTLE_ENDIAN, ComSignalInitValue=0, ComSignalAccess=ACCESS_UNCLEAR:
        TMM_EXV2_initRequest_oVCU_EXV_2_oLIN00_95846e7a_Tx: ComBitPosition=24, ComBitSize=3, ComSignalType=UINT8, ComHandleId=53, ComTransferProperty=PENDING, ComSystemTemplateSystemSignalRef=TMM_EXV2_initRequest
        EXV2_VoltageState_oEXV_2_VCU_oLIN00_8f3a2738_Rx: ComBitPosition=8, ComBitSize=2, ComSignalType=UINT8, ComHandleId=24, ComSystemTemplateSystemSignalRef=EXV2_VoltageState
        EXV2_Run_Stat_oEXV2_Status_oLIN00_0e992e12_Rx: ComBitPosition=4, ComBitSize=1, ComSignalType=BOOLEAN, ComHandleId=21, ComSystemTemplateSystemSignalRef=EXV2_Run_Stat
      EXV_1_VCU_oLIN00_69d4ef5f_Rx (ComIPdu):
        ComIPduDirection = RECEIVE
        ComIPduType = NORMAL
        ComIPduHandleId = 1
        ComIPduSignalProcessing = DEFERRED
        ComIPduCancellationSupport = false
        ComIPduGroupRef = VCU_oLIN00_Rx_4b9dfc53
        ComIPduSignalRef = EXV1_CurrentInitState_oEXV_1_VCU_oLIN00_beca31e2_Rx
        ComIPduSignalRef = EXV1_CurrentPosition_oEXV_1_VCU_oLIN00_6daec86f_Rx
        ComIPduSignalRef = EXV1_FaultState_oEXV_1_VCU_oLIN00_72ff14f0_Rx
        ComIPduSignalRef = EXV1_ResponseError_oEXV_1_VCU_oLIN00_cbce9ad1_Rx
        ComIPduSignalRef = EXV1_RunState_oEXV_1_VCU_oLIN00_f0dc555f_Rx
        ComIPduSignalRef = EXV1_TemperatureWarn_oEXV_1_VCU_oLIN00_a3317e4b_Rx
        ComIPduSignalRef = EXV1_VoltageState_oEXV_1_VCU_oLIN00_31bbfd77_Rx
        ComPduIdRef = EXV_1_VCU_oLIN00_69d4ef5f_Rx
        ComIPduMainFunctionRef = ComMainFunctionRx
      6 x ComSignal, all with ComSignalEndianness=LITTLE_ENDIAN, ComSignalInitValue=0, ComSignalAccess=ACCESS_UNCLEAR:
        HVCH_TempLim_oHVCH_Rsp01_oLIN00_d22e6add_Rx: ComBitPosition=43, ComBitSize=1, ComSignalType=BOOLEAN, ComHandleId=40, ComSystemTemplateSystemSignalRef=HVCH_TempLim
        EDCU_EXV2_Cmd_Move_Enbl_oEDCU_EXV2_oLIN00_d6797517_Tx: ComBitPosition=16, ComBitSize=1, ComSignalType=BOOLEAN, ComHandleId=9, ComTransferProperty=PENDING, ComSystemTemplateSystemSignalRef=EDCU_EXV2_Cmd_Move_Enbl
        TCU_HVCH_TmaxLim_output_oTCU_HVCH_Cmd_oLIN00_5e45d521_Tx: ComBitPosition=24, ComBitSize=8, ComSignalType=UINT8, ComHandleId=46, ComTransferProperty=PENDING, ComSystemTemplateSystemSignalRef=TCU_HVCH_TmaxLim_output
        EXV1_CurrentPosition_oEXV_1_VCU_oLIN00_6daec86f_Rx: ComBitPosition=16, ComBitSize=16, ComSignalType=UINT16, ComHandleId=7, ComSystemTemplateSystemSignalRef=EXV1_CurrentPosition
        PMP3_PumpInputVolt_oPMP3_Sts_oLIN00_75dfecf6_Rx: ComBitPosition=8, ComBitSize=8, ComSignalType=UINT8, ComHandleId=53, ComSystemTemplateSystemSignalRef=PMP3_PumpInputVolt
        EXV1_VoltageState_oEXV_1_VCU_oLIN00_31bbfd77_Rx: ComBitPosition=8, ComBitSize=2, ComSignalType=UINT8, ComHandleId=12, ComSystemTemplateSystemSignalRef=EXV1_VoltageState
      PMP3_Sts_oLIN00_511c4704_Rx (ComIPdu):
        ComIPduDirection = RECEIVE
        ComIPduType = NORMAL
        ComIPduHandleId = 6
        ComIPduSignalProcessing = DEFERRED
        ComIPduCancellationSupport = false
        ComIPduGroupRef = VCU_oLIN00_Rx_4b9dfc53
        ComIPduSignalRef = PMP3_PumpDryRunningSta_oPMP3_Sts_oLIN00_30f4e2d8_Rx
        ComIPduSignalRef = PMP3_PumpInputVolt_oPMP3_Sts_oLIN00_75dfecf6_Rx
        ComIPduSignalRef = PMP3_PumpMotorSta_oPMP3_Sts_oLIN00_43910f36_Rx
        ComIPduSignalRef = PMP3_PumpPowerSta_oPMP3_Sts_oLIN00_884db7a7_Rx
        ComIPduSignalRef = PMP3_PumpTempSta_oPMP3_Sts_oLIN00_26375532_Rx
        ComIPduSignalRef = PMP3_RESP_ERROR_oPMP3_Sts_oLIN00_9f14f3a0_Rx
        ComIPduSignalRef = PMP3_RealRPM_oPMP3_Sts_oLIN00_fa6fbf8a_Rx
        ComPduIdRef = PMP3_Sts_oLIN00_511c4704_Rx
        ComIPduMainFunctionRef = ComMainFunctionRx
      9 x ComSignal, all with ComSignalEndianness=LITTLE_ENDIAN, ComSignalInitValue=0, ComSignalAccess=ACCESS_UNCLEAR:
        TCU_HVCHMaxPowerLimit_oTCU_HVCH_Cmd_oLIN00_4bc53e0b_Tx: ComBitPosition=16, ComBitSize=8, ComSignalType=UINT8, ComHandleId=44, ComTransferProperty=PENDING, ComSystemTemplateSystemSignalRef=TCU_HVCHMaxPowerLimit
        ECC_PMP3_SpdSet_oPMP_Cmd_oLIN00_0d8ea190_Tx: ComBitPosition=16, ComBitSize=8, ComSignalType=UINT8, ComHandleId=7, ComTransferProperty=PENDING, ComSystemTemplateSystemSignalRef=ECC_PMP3_SpdSet
        TCU_HVCH_On_Rq_oTCU_HVCH_Cmd_oLIN00_9f442eaf_Tx: ComBitPosition=8, ComBitSize=2, ComSignalDataInvalidValue=3, ComSignalType=UINT8, ComHandleId=45, ComTransferProperty=PENDING, ComSystemTemplateSystemSignalRef=TCU_HVCH_On_Rq
        TMM_EXV2_PositionRequest_oVCU_EXV_2_oLIN00_ce8ee7dd_Tx: ComBitPosition=0, ComBitSize=16, ComSignalType=UINT16, ComHandleId=52, ComTransferProperty=PENDING, ComSystemTemplateSystemSignalRef=TMM_EXV2_PositionRequest
        EXV2_curInit_Stat_oEXV2_Status_oLIN00_b0ace0f5_Rx: ComBitPosition=2, ComBitSize=2, ComSignalType=UINT8, ComHandleId=25, ComSystemTemplateSystemSignalRef=EXV2_curInit_Stat
        EDCU_EXV2_Cmd_Init_Rq_oEDCU_EXV2_oLIN00_0144aec9_Tx: ComBitPosition=24, ComBitSize=3, ComSignalType=UINT8, ComHandleId=8, ComTransferProperty=PENDING, ComSystemTemplateSystemSignalRef=EDCU_EXV2_Cmd_Init_Rq
        TMM_EXV1_initRequest_oVCU_EXV_1_oLIN00_082350ea_Tx: ComBitPosition=24, ComBitSize=3, ComSignalType=UINT8, ComHandleId=50, ComTransferProperty=PENDING, ComSystemTemplateSystemSignalRef=TMM_EXV1_initRequest
        EXV1_RunState_oEXV_1_VCU_oLIN00_f0dc555f_Rx: ComBitPosition=3, ComBitSize=1, ComSignalType=BOOLEAN, ComHandleId=10, ComSystemTemplateSystemSignalRef=EXV1_RunState
        HVCH_IntelTemp_oHVCH_Rsp02_oLIN00_2b487110_Rx: ComBitPosition=0, ComBitSize=8, ComSignalType=UINT8, ComHandleId=33, ComSystemTemplateSystemSignalRef=HVCH_IntelTemp
      SVA_VCU_STD_oLIN00_4526aa1c_Rx (ComIPdu):
        ComIPduDirection = RECEIVE
        ComIPduType = NORMAL
        ComIPduHandleId = 7
        ComIPduSignalProcessing = DEFERRED
        ComIPduCancellationSupport = false
        ComIPduGroupRef = VCU_oLIN00_Rx_4b9dfc53
        ComIPduSignalRef = Act_Pos_sta_oSVA_VCU_STD_oLIN00_642c9ffa_Rx
        ComIPduSignalRef = Blockage_Fault_STA_oSVA_VCU_STD_oLIN00_6c89246f_Rx
        ComIPduSignalRef = Breakage_Fault_STA_oSVA_VCU_STD_oLIN00_a3ac9cf8_Rx
        ComIPduSignalRef = Calibration_sta_oSVA_VCU_STD_oLIN00_dcb4af08_Rx
        ComIPduSignalRef = LIN_Resp_Error_sta_oSVA_VCU_STD_oLIN00_47f7ca93_Rx
        ComPduIdRef = SVA_VCU_STD_oLIN00_4526aa1c_Rx
        ComIPduMainFunctionRef = ComMainFunctionRx
      EXV2_Volt_Stat_oEXV2_Status_oLIN00_c8727eb0_Rx (ComSignal):
        ComBitPosition = 12
        ComBitSize = 2
        ComSignalEndianness = LITTLE_ENDIAN
        ComSignalInitValue = 0
        ComSignalType = UINT8
        ComSignalAccess = ACCESS_UNCLEAR
        ComHandleId = 23
        ComSystemTemplateSystemSignalRef = EXV2_Volt_Stat
      HVCH_Rsp02_oLIN00_286c390c_Rx (ComIPdu):
        ComIPduDirection = RECEIVE
        ComIPduType = NORMAL
        ComIPduHandleId = 4
        ComIPduSignalProcessing = DEFERRED
        ComIPduCancellationSupport = false
        ComIPduGroupRef = VCU_oLIN00_Rx_4b9dfc53
        ComIPduSignalRef = HVCH_IntelTemp_oHVCH_Rsp02_oLIN00_2b487110_Rx
        ComPduIdRef = HVCH_Rsp02_oLIN00_286c390c_Rx
        ComIPduMainFunctionRef = ComMainFunctionRx
      HVCH_Rsp01_oLIN00_a6e33eef_Rx (ComIPdu):
        ComIPduDirection = RECEIVE
        ComIPduType = NORMAL
        ComIPduHandleId = 3
        ComIPduSignalProcessing = DEFERRED
        ComIPduCancellationSupport = false
        ComIPduGroupRef = VCU_oLIN00_Rx_4b9dfc53
        ComIPduSignalRef = HVCH_CurrSens_Flt_oHVCH_Rsp01_oLIN00_09f7bc74_Rx
        ComIPduSignalRef = HVCH_DutyCycle_oHVCH_Rsp01_oLIN00_ad1e6a22_Rx
        ComIPduSignalRef = HVCH_ExtPwrSup_Flt_oHVCH_Rsp01_oLIN00_28926933_Rx
        ComIPduSignalRef = HVCH_HV_DC_curr_oHVCH_Rsp01_oLIN00_f613e39d_Rx
        ComIPduSignalRef = HVCH_HV_Voltage_Valid_oHVCH_Rsp01_oLIN00_2914831e_Rx
        ComIPduSignalRef = HVCH_HV_voltage_oHVCH_Rsp01_oLIN00_3d3da318_Rx
        ComIPduSignalRef = HVCH_InternalPCBTemp_oHVCH_Rsp01_oLIN00_398b53e8_Rx
        ComIPduSignalRef = HVCH_LIN_Flt_oHVCH_Rsp01_oLIN00_9aaa25bf_Rx
        ComIPduSignalRef = HVCH_MediumTemp_oHVCH_Rsp01_oLIN00_a3387de4_Rx
        ComIPduSignalRef = HVCH_Off_ShrtCurr_oHVCH_Rsp01_oLIN00_bf58ab45_Rx
        ComIPduSignalRef = HVCH_RsErr_oHVCH_Rsp01_oLIN00_527b0f8f_Rx
        ComIPduSignalRef = HVCH_Status_oHVCH_Rsp01_oLIN00_60afdc75_Rx
        ComIPduSignalRef = HVCH_TempLim_oHVCH_Rsp01_oLIN00_d22e6add_Rx
        ComIPduSignalRef = HVCH_TempSens_Flt_oHVCH_Rsp01_oLIN00_66cb2c71_Rx
        ComIPduSignalRef = HVCH_defectHeaterCircuits_oHVCH_Rsp01_oLIN00_61948e74_Rx
        ComPduIdRef = HVCH_Rsp01_oLIN00_a6e33eef_Rx
        ComIPduMainFunctionRef = ComMainFunctionRx
      3 x ComSignal, all with ComSignalEndianness=LITTLE_ENDIAN, ComSignalInitValue=0, ComSignalType=UINT8, ComSignalAccess=ACCESS_UNCLEAR:
        HVCH_HV_voltage_oHVCH_Rsp01_oLIN00_3d3da318_Rx: ComBitPosition=8, ComBitSize=8, ComHandleId=32, ComSystemTemplateSystemSignalRef=HVCH_HV_voltage
        PMP2_PumpInputVolt_oPMP2_Sts_oLIN00_1fa0a533_Rx: ComBitPosition=8, ComBitSize=8, ComHandleId=46, ComSystemTemplateSystemSignalRef=PMP2_PumpInputVolt
        PMP2_PumpPowerSta_oPMP2_Sts_oLIN00_1d0f1319_Rx: ComBitPosition=4, ComBitSize=2, ComHandleId=48, ComSystemTemplateSystemSignalRef=PMP2_PumpPowerSta
      PMP2_Sts_oLIN00_cab90b6b_Rx (ComIPdu):
        ComIPduDirection = RECEIVE
        ComIPduType = NORMAL
        ComIPduHandleId = 5
        ComIPduSignalProcessing = DEFERRED
        ComIPduCancellationSupport = false
        ComIPduGroupRef = VCU_oLIN00_Rx_4b9dfc53
        ComIPduSignalRef = PMP2_PumpDryRunningSta_oPMP2_Sts_oLIN00_3e217a22_Rx
        ComIPduSignalRef = PMP2_PumpInputVolt_oPMP2_Sts_oLIN00_1fa0a533_Rx
        ComIPduSignalRef = PMP2_PumpMotorSta_oPMP2_Sts_oLIN00_d6d3ab88_Rx
        ComIPduSignalRef = PMP2_PumpPowerSta_oPMP2_Sts_oLIN00_1d0f1319_Rx
        ComIPduSignalRef = PMP2_PumpTempSta_oPMP2_Sts_oLIN00_81f2fa55_Rx
        ComIPduSignalRef = PMP2_RESP_ERROR_oPMP2_Sts_oLIN00_67b666eb_Rx
        ComIPduSignalRef = PMP2_RealRPM_oPMP2_Sts_oLIN00_86d75572_Rx
        ComPduIdRef = PMP2_Sts_oLIN00_cab90b6b_Rx
        ComIPduMainFunctionRef = ComMainFunctionRx
      23 x ComSignal, all with ComSignalEndianness=LITTLE_ENDIAN, ComSignalInitValue=0, ComSignalAccess=ACCESS_UNCLEAR:
        PMP3_RESP_ERROR_oPMP3_Sts_oLIN00_9f14f3a0_Rx: ComBitPosition=0, ComBitSize=1, ComSignalType=BOOLEAN, ComHandleId=57, ComSystemTemplateSystemSignalRef=PMP3_RESP_ERROR
        TMM_EXV2_EnableRequest_oVCU_EXV_2_oLIN00_0c106490_Tx: ComBitPosition=16, ComBitSize=1, ComSignalType=BOOLEAN, ComHandleId=51, ComTransferProperty=PENDING, ComSystemTemplateSystemSignalRef=TMM_EXV2_EnableRequest
        EXV2_ResponseError_oEXV_2_VCU_oLIN00_e747f934_Rx: ComBitPosition=0, ComBitSize=1, ComSignalType=BOOLEAN, ComHandleId=19, ComSystemTemplateSystemSignalRef=EXV2_ResponseError
        HVCH_ExtPwrSup_Flt_oHVCH_Rsp01_oLIN00_28926933_Rx: ComBitPosition=45, ComBitSize=1, ComSignalType=BOOLEAN, ComHandleId=29, ComSystemTemplateSystemSignalRef=HVCH_ExtPwrSup_Flt
        HVCH_MediumTemp_oHVCH_Rsp01_oLIN00_a3387de4_Rx: ComBitPosition=16, ComBitSize=8, ComSignalType=UINT8, ComHandleId=36, ComSystemTemplateSystemSignalRef=HVCH_MediumTemp
        PMP3_PumpDryRunningSta_oPMP3_Sts_oLIN00_30f4e2d8_Rx: ComBitPosition=3, ComBitSize=1, ComSignalType=BOOLEAN, ComHandleId=52, ComSystemTemplateSystemSignalRef=PMP3_PumpDryRunningSta
        HVCH_InternalPCBTemp_oHVCH_Rsp01_oLIN00_398b53e8_Rx: ComBitPosition=48, ComBitSize=8, ComSignalType=UINT8, ComHandleId=34, ComSystemTemplateSystemSignalRef=HVCH_InternalPCBTemp
        Calibration_cmd_oVCU_SVA_CMD_oLIN00_6732180a_Tx: ComBitPosition=8, ComBitSize=1, ComSignalType=BOOLEAN, ComHandleId=5, ComTransferProperty=PENDING, ComSystemTemplateSystemSignalRef=Calibration_cmd
        PMP2_RealRPM_oPMP2_Sts_oLIN00_86d75572_Rx: ComBitPosition=24, ComBitSize=8, ComSignalType=UINT8, ComHandleId=51, ComSystemTemplateSystemSignalRef=PMP2_RealRPM
        EXV2_CurrentPosition_oEXV_2_VCU_oLIN00_91e32486_Rx: ComBitPosition=16, ComBitSize=16, ComSignalType=UINT16, ComHandleId=14, ComSystemTemplateSystemSignalRef=EXV2_CurrentPosition
        Blockage_Fault_STA_oSVA_VCU_STD_oLIN00_6c89246f_Rx: ComBitPosition=2, ComBitSize=1, ComSignalType=BOOLEAN, ComHandleId=2, ComSystemTemplateSystemSignalRef=Blockage_Fault_STA
        PMP3_RealRPM_oPMP3_Sts_oLIN00_fa6fbf8a_Rx: ComBitPosition=24, ComBitSize=8, ComSignalType=UINT8, ComHandleId=58, ComSystemTemplateSystemSignalRef=PMP3_RealRPM
        EXV2_OvrTemp_Warn_oEXV2_Status_oLIN00_ba77659e_Rx: ComBitPosition=14, ComBitSize=2, ComSignalType=UINT8, ComHandleId=17, ComSystemTemplateSystemSignalRef=EXV2_OvrTemp_Warn
        PMP3_PumpTempSta_oPMP3_Sts_oLIN00_26375532_Rx: ComBitPosition=6, ComBitSize=2, ComSignalType=UINT8, ComHandleId=56, ComSystemTemplateSystemSignalRef=PMP3_PumpTempSta
        HVCH_HV_DC_curr_oHVCH_Rsp01_oLIN00_f613e39d_Rx: ComBitPosition=0, ComBitSize=8, ComSignalType=UINT8, ComHandleId=30, ComSystemTemplateSystemSignalRef=HVCH_HV_DC_curr
        EXV1_TemperatureWarn_oEXV_1_VCU_oLIN00_a3317e4b_Rx: ComBitPosition=10, ComBitSize=2, ComSignalType=UINT8, ComHandleId=11, ComSystemTemplateSystemSignalRef=EXV1_TemperatureWarn
        EXV2_FaultState_oEXV_2_VCU_oLIN00_41c0e318_Rx: ComBitPosition=4, ComBitSize=4, ComSignalType=UINT8, ComHandleId=15, ComSystemTemplateSystemSignalRef=EXV2_FaultState
        EDCU_EXV2_Cmd_Set_Rq_oEDCU_EXV2_oLIN00_66e5876a_Tx: ComBitPosition=0, ComBitSize=16, ComSignalType=UINT16, ComHandleId=10, ComTransferProperty=PENDING, ComSystemTemplateSystemSignalRef=EDCU_EXV2_Cmd_Set_Rq
        HVCH_RsErr_oHVCH_Rsp01_oLIN00_527b0f8f_Rx: ComBitPosition=61, ComBitSize=1, ComSignalType=BOOLEAN, ComHandleId=38, ComSystemTemplateSystemSignalRef=HVCH_RsErr
        EXV2_Pos_oEXV2_Status_oLIN00_da80603b_Rx: ComBitPosition=16, ComBitSize=16, ComSignalType=UINT16, ComHandleId=18, ComSystemTemplateSystemSignalRef=EXV2_Pos
        TMM_EXV1_EnableRequest_oVCU_EXV_1_oLIN00_d988d266_Tx: ComBitPosition=16, ComBitSize=1, ComSignalType=BOOLEAN, ComHandleId=48, ComTransferProperty=PENDING, ComSystemTemplateSystemSignalRef=TMM_EXV1_EnableRequest
        PMP2_RESP_ERROR_oPMP2_Sts_oLIN00_67b666eb_Rx: ComBitPosition=0, ComBitSize=1, ComSignalType=BOOLEAN, ComHandleId=50, ComSystemTemplateSystemSignalRef=PMP2_RESP_ERROR
        PMP3_PumpMotorSta_oPMP3_Sts_oLIN00_43910f36_Rx: ComBitPosition=1, ComBitSize=2, ComSignalType=UINT8, ComHandleId=54, ComSystemTemplateSystemSignalRef=PMP3_PumpMotorSta
      VCU_SVA_CMD_oLIN00_756d14f6_Tx (ComIPdu):
        ComIPduDirection = SEND
        ComIPduType = NORMAL
        ComIPduHandleId = 7
        ComIPduSignalProcessing = DEFERRED
        ComIPduCancellationSupport = false
        ComIPduGroupRef = VCU_oLIN00_Tx_1dc75bd5
        ComIPduSignalRef = Calibration_cmd_oVCU_SVA_CMD_oLIN00_6732180a_Tx
        ComIPduSignalRef = Target_Pos_cmd_oVCU_SVA_CMD_oLIN00_b87f26ef_Tx
        ComPduIdRef = VCU_SVA_CMD_oLIN00_756d14f6_Tx
        ComIPduMainFunctionRef = ComMainFunctionTx
        ComTxIPdu: ComTxIPduUnusedAreasDefault=255, ComMinimumDelayTime=0
          ComTxModeTrue
            ComTxMode: ComTxModeMode=NONE
          ComTxModeFalse
            ComTxMode: ComTxModeMode=NONE
      4 x ComSignal, all with ComSignalEndianness=BIG_ENDIAN, ComSignalInitValue=0, ComTimeout=0, ComSignalAccess=ACCESS_UNCLEAR:
        Tevap_Tchiller_out_oVCU_Minor_01_oKAMA_FP_EPT_0303_29906cec_Tx: ComBitPosition=31, ComBitSize=6, ComSignalType=UINT8, ComTransferProperty=PENDING, ComHandleId=56, ComSystemTemplateSystemSignalRef=Tevap_Tchiller_out
        A_I_Actuator_With_F_B_request_oVCU_Minor_03_oKAMA_FP_EPT_0303_0324126f_Rx: ComBitPosition=4, ComBitSize=2, ComSignalType=UINT8, ComHandleId=0, ComSystemTemplateSystemSignalRef=A_I_Actuator_With_F_B_request
        COMP_Tsuc_oVCU_Minor_02_oKAMA_FP_EPT_0303_ae091dda_Tx: ComBitPosition=15, ComBitSize=6, ComSignalType=UINT8, ComTransferProperty=PENDING, ComHandleId=4, ComSystemTemplateSystemSignalRef=COMP_Tsuc
        SV1_request_oVCU_Minor_03_oKAMA_FP_EPT_0303_a1028998_Rx: ComBitPosition=7, ComBitSize=1, ComSignalType=BOOLEAN, ComHandleId=60, ComSystemTemplateSystemSignalRef=SV1_request
      VCU_oKAMA_FP_EPT_0303_Tx_51b27697 (ComIPduGroup): ComIPduGroupHandleId=1
      COMP_Psuc_oVCU_Minor_02_oKAMA_FP_EPT_0303_9659454d_Tx (ComSignal):
        ComBitPosition = 7
        ComBitSize = 6
        ComSignalEndianness = BIG_ENDIAN
        ComSignalInitValue = 0
        ComSignalType = UINT8
        ComTimeout = 0
        ComTransferProperty = PENDING
        ComSignalAccess = ACCESS_UNCLEAR
        ComHandleId = 2
        ComSystemTemplateSystemSignalRef = COMP_Psuc
      VCU_Minor_01_oKAMA_FP_EPT_0303_39c0a2ee_Tx (ComIPdu):
        ComIPduDirection = SEND
        ComIPduType = NORMAL
        ComIPduHandleId = 5
        ComIPduSignalProcessing = DEFERRED
        ComIPduCancellationSupport = false
        ComIPduGroupRef = VCU_oKAMA_FP_EPT_0303_Tx_51b27697
        ComIPduSignalRef = A_I_F_B_oVCU_Minor_01_oKAMA_FP_EPT_0303_576573ee_Tx
        ComIPduSignalRef = MODE_F_B_oVCU_Minor_01_oKAMA_FP_EPT_0303_8d5db84c_Tx
        ComIPduSignalRef = Tamb_oVCU_Minor_01_oKAMA_FP_EPT_0303_8a5abefe_Tx
        ComIPduSignalRef = Tevap_Tchiller_out_oVCU_Minor_01_oKAMA_FP_EPT_0303_29906cec_Tx
        ComIPduSignalRef = Tohx_in_oVCU_Minor_01_oKAMA_FP_EPT_0303_ef5c5e50_Tx
        ComIPduSignalRef = Tohx_out_oVCU_Minor_01_oKAMA_FP_EPT_0303_63435844_Tx
        ComPduIdRef = VCU_Minor_01_oKAMA_FP_EPT_0303_39c0a2ee_Tx
        ComIPduMainFunctionRef = ComMainFunctionTx
        ComTxIPdu: ComMinimumDelayTime=0, ComTxIPduUnusedAreasDefault=0
          ComTxModeTrue
            ComTxMode: ComTxModeMode=PERIODIC, ComTxModeTimeOffset=0, ComTxModeTimePeriod=0.02
          ComTxModeFalse
            ComTxMode: ComTxModeMode=PERIODIC, ComTxModeTimeOffset=0, ComTxModeTimePeriod=0.02
      5 x ComSignal, all with ComSignalEndianness=BIG_ENDIAN, ComSignalInitValue=0, ComSignalType=UINT8, ComTimeout=0, ComSignalAccess=ACCESS_UNCLEAR:
        HVAC_Blower_request_oVCU_Minor_03_oKAMA_FP_EPT_0303_ea1e3327_Rx: ComBitPosition=23, ComBitSize=7, ComHandleId=26, ComSystemTemplateSystemSignalRef=HVAC_Blower_request
        Tohx_out_oVCU_Minor_01_oKAMA_FP_EPT_0303_63435844_Tx: ComBitPosition=39, ComBitSize=6, ComTransferProperty=PENDING, ComHandleId=59, ComSystemTemplateSystemSignalRef=Tohx_out
        COMP_Tdis_oVCU_Minor_02_oKAMA_FP_EPT_0303_73ade512_Tx: ComBitPosition=31, ComBitSize=6, ComTransferProperty=PENDING, ComHandleId=3, ComSystemTemplateSystemSignalRef=COMP_Tdis
        COOLING_FAN_request_oVCU_Minor_03_oKAMA_FP_EPT_0303_282b4f5d_Rx: ComBitPosition=15, ComBitSize=7, ComHandleId=4, ComSystemTemplateSystemSignalRef=COOLING_FAN_request
        COMP_Pdis_oVCU_Minor_02_oKAMA_FP_EPT_0303_4bfdbd85_Tx: ComBitPosition=23, ComBitSize=6, ComTransferProperty=PENDING, ComHandleId=1, ComSystemTemplateSystemSignalRef=COMP_Pdis
      VCU_Minor_03_oKAMA_FP_EPT_0303_4d74a41f_Rx (ComIPdu):
        ComIPduDirection = RECEIVE
        ComIPduType = NORMAL
        ComIPduHandleId = 8
        ComIPduSignalProcessing = DEFERRED
        ComIPduCancellationSupport = false
        ComIPduGroupRef = VCU_oKAMA_FP_EPT_0303_Rx_07e8d111
        ComIPduSignalRef = A_I_Actuator_With_F_B_request_oVCU_Minor_03_oKAMA_FP_EPT_0303_0324126f_Rx
        ComIPduSignalRef = COOLING_FAN_request_oVCU_Minor_03_oKAMA_FP_EPT_0303_282b4f5d_Rx
        ComIPduSignalRef = HVAC_Blower_request_oVCU_Minor_03_oKAMA_FP_EPT_0303_ea1e3327_Rx
        ComIPduSignalRef = Mode_Actuator_request_oVCU_Minor_03_oKAMA_FP_EPT_0303_b0a0ba91_Rx
        ComIPduSignalRef = SV1_request_oVCU_Minor_03_oKAMA_FP_EPT_0303_a1028998_Rx
        ComIPduSignalRef = SV2_request_oVCU_Minor_03_oKAMA_FP_EPT_0303_424b3e3a_Rx
        ComIPduSignalRef = SV3_request_oVCU_Minor_03_oKAMA_FP_EPT_0303_aa5cae9b_Rx
        ComPduIdRef = VCU_Minor_03_oKAMA_FP_EPT_0303_4d74a41f_Rx
        ComIPduMainFunctionRef = ComMainFunctionRx
      4 x ComSignal, all with ComSignalEndianness=BIG_ENDIAN, ComSignalInitValue=0, ComTimeout=0, ComSignalAccess=ACCESS_UNCLEAR:
        SV2_request_oVCU_Minor_03_oKAMA_FP_EPT_0303_424b3e3a_Rx: ComBitPosition=6, ComBitSize=1, ComSignalType=BOOLEAN, ComHandleId=61, ComSystemTemplateSystemSignalRef=SV2_request
        A_I_F_B_oVCU_Minor_01_oKAMA_FP_EPT_0303_576573ee_Tx: ComBitPosition=7, ComBitSize=6, ComSignalType=UINT8, ComTransferProperty=PENDING, ComHandleId=0, ComSystemTemplateSystemSignalRef=A_I_F_B
        Tincar_oVCU_Minor_02_oKAMA_FP_EPT_0303_a42f9f70_Tx: ComBitPosition=39, ComBitSize=6, ComSignalType=UINT8, ComTransferProperty=PENDING, ComHandleId=57, ComSystemTemplateSystemSignalRef=Tincar
        Mode_Actuator_request_oVCU_Minor_03_oKAMA_FP_EPT_0303_b0a0ba91_Rx: ComBitPosition=2, ComBitSize=2, ComSignalType=UINT8, ComHandleId=44, ComSystemTemplateSystemSignalRef=Mode_Actuator_request
      VCU_Minor_02_oKAMA_FP_EPT_0303_9a962447_Tx (ComIPdu):
        ComIPduDirection = SEND
        ComIPduType = NORMAL
        ComIPduHandleId = 6
        ComIPduSignalProcessing = DEFERRED
        ComIPduCancellationSupport = false
        ComIPduGroupRef = VCU_oKAMA_FP_EPT_0303_Tx_51b27697
        ComIPduSignalRef = COMP_Pdis_oVCU_Minor_02_oKAMA_FP_EPT_0303_4bfdbd85_Tx
        ComIPduSignalRef = COMP_Psuc_oVCU_Minor_02_oKAMA_FP_EPT_0303_9659454d_Tx
        ComIPduSignalRef = COMP_Tdis_oVCU_Minor_02_oKAMA_FP_EPT_0303_73ade512_Tx
        ComIPduSignalRef = COMP_Tsuc_oVCU_Minor_02_oKAMA_FP_EPT_0303_ae091dda_Tx
        ComIPduSignalRef = Tincar_oVCU_Minor_02_oKAMA_FP_EPT_0303_a42f9f70_Tx
        ComPduIdRef = VCU_Minor_02_oKAMA_FP_EPT_0303_9a962447_Tx
        ComIPduMainFunctionRef = ComMainFunctionTx
        ComTxIPdu: ComMinimumDelayTime=0, ComTxIPduUnusedAreasDefault=0
          ComTxModeTrue
            ComTxMode: ComTxModeMode=PERIODIC, ComTxModeTimeOffset=0, ComTxModeTimePeriod=0.02
          ComTxModeFalse
            ComTxMode: ComTxModeMode=PERIODIC, ComTxModeTimeOffset=0, ComTxModeTimePeriod=0.02
      Tamb_oVCU_Minor_01_oKAMA_FP_EPT_0303_8a5abefe_Tx (ComSignal):
        ComBitPosition = 23
        ComBitSize = 6
        ComSignalEndianness = BIG_ENDIAN
        ComSignalInitValue = 0
        ComSignalType = UINT8
        ComTimeout = 0
        ComTransferProperty = PENDING
        ComSignalAccess = ACCESS_UNCLEAR
        ComHandleId = 54
        ComSystemTemplateSystemSignalRef = Tamb
      VCU_oKAMA_FP_EPT_0303_Rx_07e8d111 (ComIPduGroup): ComIPduGroupHandleId=0
      3 x ComSignal, all with ComSignalEndianness=BIG_ENDIAN, ComSignalInitValue=0, ComTimeout=0, ComSignalAccess=ACCESS_UNCLEAR:
        Tohx_in_oVCU_Minor_01_oKAMA_FP_EPT_0303_ef5c5e50_Tx: ComBitPosition=47, ComBitSize=6, ComSignalType=UINT8, ComTransferProperty=PENDING, ComHandleId=58, ComSystemTemplateSystemSignalRef=Tohx_in
        MODE_F_B_oVCU_Minor_01_oKAMA_FP_EPT_0303_8d5db84c_Tx: ComBitPosition=15, ComBitSize=6, ComSignalType=UINT8, ComTransferProperty=PENDING, ComHandleId=43, ComSystemTemplateSystemSignalRef=MODE_F_B
        SV3_request_oVCU_Minor_03_oKAMA_FP_EPT_0303_aa5cae9b_Rx: ComBitPosition=5, ComBitSize=1, ComSignalType=BOOLEAN, ComHandleId=62, ComSystemTemplateSystemSignalRef=SV3_request
      VCU_oTC37X_VCU_CAN12_Rx_37e24d02 (ComIPduGroup): ComIPduGroupHandleId=12
      3 x ComSignal, all with ComBitSize=16, ComSignalEndianness=LITTLE_ENDIAN, ComSignalInitValue=0, ComSignalType=SINT16, ComTimeout=0, ComSignalAccess=ACCESS_UNCLEAR:
        VcuCan12TxMsg2_Sig2_oVcuCan12TxMsg2_oTC37X_VCU_CAN12_a3805b6d_Tx: ComBitPosition=32, ComTransferProperty=PENDING, ComHandleId=82, ComSystemTemplateSystemSignalRef=VcuCan12TxMsg2_Sig2
        VcuCan12TxMsg1_Sig3_oVcuCan12TxMsg1_oTC37X_VCU_CAN12_be1fcbc2_Tx: ComBitPosition=48, ComTransferProperty=PENDING, ComHandleId=79, ComSystemTemplateSystemSignalRef=VcuCan12TxMsg1_Sig3
        VcuCan12RxMsg3_Sig0_oVcuCan12RxMsg3_oTC37X_VCU_CAN12_5a65a77f_Rx: ComBitPosition=0, ComHandleId=63, ComSystemTemplateSystemSignalRef=VcuCan12RxMsg3_Sig0
      VcuCan12RxMsg4_oTC37X_VCU_CAN12_d9ab3246_Rx (ComIPdu):
        ComIPduDirection = RECEIVE
        ComIPduType = NORMAL
        ComIPduHandleId = 12
        ComIPduSignalProcessing = DEFERRED
        ComIPduCancellationSupport = false
        ComIPduGroupRef = VCU_oTC37X_VCU_CAN12_Rx_37e24d02
        ComIPduSignalRef = VcuCan12RxMsg4_Sig0_oVcuCan12RxMsg4_oTC37X_VCU_CAN12_89859905_Rx
        ComIPduSignalRef = VcuCan12RxMsg4_Sig1_oVcuCan12RxMsg4_oTC37X_VCU_CAN12_ad07c833_Rx
        ComIPduSignalRef = VcuCan12RxMsg4_Sig2_oVcuCan12RxMsg4_oTC37X_VCU_CAN12_c0813b69_Rx
        ComIPduSignalRef = VcuCan12RxMsg4_Sig3_oVcuCan12RxMsg4_oTC37X_VCU_CAN12_e4036a5f_Rx
        ComPduIdRef = VcuCan12RxMsg4_oTC37X_VCU_CAN12_d9ab3246_Rx
        ComIPduMainFunctionRef = ComMainFunctionRx
      7 x ComSignal, all with ComBitSize=16, ComSignalEndianness=LITTLE_ENDIAN, ComSignalInitValue=0, ComSignalType=SINT16, ComTimeout=0, ComSignalAccess=ACCESS_UNCLEAR:
        VcuCan12RxMsg4_Sig0_oVcuCan12RxMsg4_oTC37X_VCU_CAN12_89859905_Rx: ComBitPosition=0, ComHandleId=67, ComSystemTemplateSystemSignalRef=VcuCan12RxMsg4_Sig0
        VcuCan12RxMsg3_Sig2_oVcuCan12RxMsg3_oTC37X_VCU_CAN12_13610513_Rx: ComBitPosition=32, ComHandleId=65, ComSystemTemplateSystemSignalRef=VcuCan12RxMsg3_Sig2
        VcuCan12RxMsg3_Sig1_oVcuCan12RxMsg3_oTC37X_VCU_CAN12_7ee7f649_Rx: ComBitPosition=16, ComHandleId=64, ComSystemTemplateSystemSignalRef=VcuCan12RxMsg3_Sig1
        VcuCan12TxMsg2_Sig1_oVcuCan12TxMsg2_oTC37X_VCU_CAN12_ce06a837_Tx: ComBitPosition=16, ComTransferProperty=PENDING, ComHandleId=81, ComSystemTemplateSystemSignalRef=VcuCan12TxMsg2_Sig1
        VcuCan12TxMsg2_Sig3_oVcuCan12TxMsg2_oTC37X_VCU_CAN12_87020a5b_Tx: ComBitPosition=48, ComTransferProperty=PENDING, ComHandleId=83, ComSystemTemplateSystemSignalRef=VcuCan12TxMsg2_Sig3
        VcuCan12TxMsg1_Sig2_oVcuCan12TxMsg1_oTC37X_VCU_CAN12_9a9d9af4_Tx: ComBitPosition=32, ComTransferProperty=PENDING, ComHandleId=78, ComSystemTemplateSystemSignalRef=VcuCan12TxMsg1_Sig2
        VcuCan12RxMsg4_Sig2_oVcuCan12RxMsg4_oTC37X_VCU_CAN12_c0813b69_Rx: ComBitPosition=32, ComHandleId=69, ComSystemTemplateSystemSignalRef=VcuCan12RxMsg4_Sig2
      VcuCan12RxMsg3_oTC37X_VCU_CAN12_38853822_Rx (ComIPdu):
        ComIPduDirection = RECEIVE
        ComIPduType = NORMAL
        ComIPduHandleId = 11
        ComIPduSignalProcessing = DEFERRED
        ComIPduCancellationSupport = false
        ComIPduGroupRef = VCU_oTC37X_VCU_CAN12_Rx_37e24d02
        ComIPduSignalRef = VcuCan12RxMsg3_Sig0_oVcuCan12RxMsg3_oTC37X_VCU_CAN12_5a65a77f_Rx
        ComIPduSignalRef = VcuCan12RxMsg3_Sig1_oVcuCan12RxMsg3_oTC37X_VCU_CAN12_7ee7f649_Rx
        ComIPduSignalRef = VcuCan12RxMsg3_Sig2_oVcuCan12RxMsg3_oTC37X_VCU_CAN12_13610513_Rx
        ComIPduSignalRef = VcuCan12RxMsg3_Sig3_oVcuCan12RxMsg3_oTC37X_VCU_CAN12_37e35425_Rx
        ComPduIdRef = VcuCan12RxMsg3_oTC37X_VCU_CAN12_38853822_Rx
        ComIPduMainFunctionRef = ComMainFunctionRx
      3 x ComSignal, all with ComBitSize=16, ComSignalEndianness=LITTLE_ENDIAN, ComSignalInitValue=0, ComSignalType=SINT16, ComTimeout=0, ComSignalAccess=ACCESS_UNCLEAR:
        VcuCan12RxMsg4_Sig1_oVcuCan12RxMsg4_oTC37X_VCU_CAN12_ad07c833_Rx: ComBitPosition=16, ComHandleId=68, ComSystemTemplateSystemSignalRef=VcuCan12RxMsg4_Sig1
        VcuCan12TxMsg1_Sig0_oVcuCan12TxMsg1_oTC37X_VCU_CAN12_d3993898_Tx: ComBitPosition=0, ComTransferProperty=PENDING, ComHandleId=76, ComSystemTemplateSystemSignalRef=VcuCan12TxMsg1_Sig0
        VcuCan12RxMsg3_Sig3_oVcuCan12RxMsg3_oTC37X_VCU_CAN12_37e35425_Rx: ComBitPosition=48, ComHandleId=66, ComSystemTemplateSystemSignalRef=VcuCan12RxMsg3_Sig3
      VCU_oTC37X_VCU_CAN12_Tx_61b8ea84 (ComIPduGroup): ComIPduGroupHandleId=13
      VcuCan12RxMsg4_Sig3_oVcuCan12RxMsg4_oTC37X_VCU_CAN12_e4036a5f_Rx (ComSignal):
        ComBitPosition = 48
        ComBitSize = 16
        ComSignalEndianness = LITTLE_ENDIAN
        ComSignalInitValue = 0
        ComSignalType = SINT16
        ComTimeout = 0
        ComSignalAccess = ACCESS_UNCLEAR
        ComHandleId = 70
        ComSystemTemplateSystemSignalRef = VcuCan12RxMsg4_Sig3
      VcuCan12TxMsg2_oTC37X_VCU_CAN12_3a1dfcb9_Tx (ComIPdu):
        ComIPduDirection = SEND
        ComIPduType = NORMAL
        ComIPduHandleId = 13
        ComIPduSignalProcessing = DEFERRED
        ComIPduCancellationSupport = false
        ComIPduGroupRef = VCU_oTC37X_VCU_CAN12_Tx_61b8ea84
        ComIPduSignalRef = VcuCan12TxMsg2_Sig0_oVcuCan12TxMsg2_oTC37X_VCU_CAN12_ea84f901_Tx
        ComIPduSignalRef = VcuCan12TxMsg2_Sig1_oVcuCan12TxMsg2_oTC37X_VCU_CAN12_ce06a837_Tx
        ComIPduSignalRef = VcuCan12TxMsg2_Sig2_oVcuCan12TxMsg2_oTC37X_VCU_CAN12_a3805b6d_Tx
        ComIPduSignalRef = VcuCan12TxMsg2_Sig3_oVcuCan12TxMsg2_oTC37X_VCU_CAN12_87020a5b_Tx
        ComPduIdRef = VcuCan12TxMsg2_oTC37X_VCU_CAN12_3a1dfcb9_Tx
        ComIPduMainFunctionRef = ComMainFunctionTx
        ComTxIPdu: ComMinimumDelayTime=0, ComTxIPduUnusedAreasDefault=0
          ComTxModeTrue
            ComTxMode: ComTxModeMode=PERIODIC, ComTxModeTimeOffset=0, ComTxModeTimePeriod=0.5
          ComTxModeFalse
            ComTxMode: ComTxModeMode=PERIODIC, ComTxModeTimeOffset=0, ComTxModeTimePeriod=0.5
      VcuCan12TxMsg1_oTC37X_VCU_CAN12_d09b21db_Tx (ComIPdu):
        ComIPduDirection = SEND
        ComIPduType = NORMAL
        ComIPduHandleId = 12
        ComIPduSignalProcessing = DEFERRED
        ComIPduCancellationSupport = false
        ComIPduGroupRef = VCU_oTC37X_VCU_CAN12_Tx_61b8ea84
        ComIPduSignalRef = VcuCan12TxMsg1_Sig0_oVcuCan12TxMsg1_oTC37X_VCU_CAN12_d3993898_Tx
        ComIPduSignalRef = VcuCan12TxMsg1_Sig1_oVcuCan12TxMsg1_oTC37X_VCU_CAN12_f71b69ae_Tx
        ComIPduSignalRef = VcuCan12TxMsg1_Sig2_oVcuCan12TxMsg1_oTC37X_VCU_CAN12_9a9d9af4_Tx
        ComIPduSignalRef = VcuCan12TxMsg1_Sig3_oVcuCan12TxMsg1_oTC37X_VCU_CAN12_be1fcbc2_Tx
        ComPduIdRef = VcuCan12TxMsg1_oTC37X_VCU_CAN12_d09b21db_Tx
        ComIPduMainFunctionRef = ComMainFunctionTx
        ComTxIPdu: ComMinimumDelayTime=0, ComTxIPduUnusedAreasDefault=0
          ComTxModeTrue
            ComTxMode: ComTxModeMode=PERIODIC, ComTxModeTimeOffset=0, ComTxModeTimePeriod=0.5
          ComTxModeFalse
            ComTxMode: ComTxModeMode=PERIODIC, ComTxModeTimeOffset=0, ComTxModeTimePeriod=0.5
      4 x ComSignal, all with ComBitSize=16, ComSignalEndianness=LITTLE_ENDIAN, ComSignalInitValue=0, ComSignalType=SINT16, ComTimeout=0, ComTransferProperty=PENDING, ComSignalAccess=ACCESS_UNCLEAR:
        VcuCan12TxMsg2_Sig0_oVcuCan12TxMsg2_oTC37X_VCU_CAN12_ea84f901_Tx: ComBitPosition=0, ComHandleId=80, ComSystemTemplateSystemSignalRef=VcuCan12TxMsg2_Sig0
        VcuCan12TxMsg1_Sig1_oVcuCan12TxMsg1_oTC37X_VCU_CAN12_f71b69ae_Tx: ComBitPosition=16, ComHandleId=77, ComSystemTemplateSystemSignalRef=VcuCan12TxMsg1_Sig1
        VcuAdcTxMsg2_Sig1_oVcuCan03TxMsg2_oTC37X_VCU_CAN03_0a1d7eaa_Tx: ComBitPosition=16, ComHandleId=71, ComSystemTemplateSystemSignalRef=VcuAdcTxMsg2_Sig1
        VcuAdcTxMsg1_Sig0_oVcuCan03TxMsg1_oTC37X_VCU_CAN03_1782ee05_Tx: ComBitPosition=0, ComHandleId=61, ComSystemTemplateSystemSignalRef=VcuAdcTxMsg1_Sig0
      VCU_oTC37X_VCU_CAN03_Rx_b23e03d7 (ComIPduGroup): ComIPduGroupHandleId=10
      3 x ComSignal, all with ComBitSize=16, ComSignalEndianness=LITTLE_ENDIAN, ComSignalInitValue=0, ComSignalType=SINT16, ComTimeout=0, ComSignalAccess=ACCESS_UNCLEAR:
        VcuAdcTxMsg1_Sig1_oVcuCan03TxMsg1_oTC37X_VCU_CAN03_3300bf33_Tx: ComBitPosition=16, ComTransferProperty=PENDING, ComHandleId=63, ComSystemTemplateSystemSignalRef=VcuAdcTxMsg1_Sig1
        VcuRxMsg3_Sig1_oVcuCan03RxMsg1_oTC37X_VCU_CAN03_8f9ddda0_Rx: ComBitPosition=16, ComHandleId=81, ComSystemTemplateSystemSignalRef=VcuRxMsg3_Sig1
        VcuRxMsg4_Sig2_oVcuCan03RxMsg2_oTC37X_VCU_CAN03_3a53c786_Rx: ComBitPosition=32, ComHandleId=91, ComSystemTemplateSystemSignalRef=VcuRxMsg4_Sig2
      VcuCan03RxMsg2_oTC37X_VCU_CAN03_9d657a3d_Rx (ComIPdu):
        ComIPduDirection = RECEIVE
        ComIPduType = NORMAL
        ComIPduHandleId = 10
        ComIPduSignalProcessing = DEFERRED
        ComIPduCancellationSupport = false
        ComIPduGroupRef = VCU_oTC37X_VCU_CAN03_Rx_b23e03d7
        ComIPduSignalRef = VcuRxMsg4_Sig0_oVcuCan03RxMsg2_oTC37X_VCU_CAN03_735765ea_Rx
        ComIPduSignalRef = VcuRxMsg4_Sig1_oVcuCan03RxMsg2_oTC37X_VCU_CAN03_57d534dc_Rx
        ComIPduSignalRef = VcuRxMsg4_Sig2_oVcuCan03RxMsg2_oTC37X_VCU_CAN03_3a53c786_Rx
        ComIPduSignalRef = VcuRxMsg4_Sig3_oVcuCan03RxMsg2_oTC37X_VCU_CAN03_1ed196b0_Rx
        ComPduIdRef = VcuCan03RxMsg2_oTC37X_VCU_CAN03_9d657a3d_Rx
        ComIPduMainFunctionRef = ComMainFunctionRx
      6 x ComSignal, all with ComBitSize=16, ComSignalEndianness=LITTLE_ENDIAN, ComSignalInitValue=0, ComSignalType=SINT16, ComTimeout=0, ComSignalAccess=ACCESS_UNCLEAR:
        VcuAdcTxMsg2_Sig2_oVcuCan03TxMsg2_oTC37X_VCU_CAN03_679b8df0_Tx: ComBitPosition=32, ComTransferProperty=PENDING, ComHandleId=73, ComSystemTemplateSystemSignalRef=VcuAdcTxMsg2_Sig2
        VcuRxMsg4_Sig0_oVcuCan03RxMsg2_oTC37X_VCU_CAN03_735765ea_Rx: ComBitPosition=0, ComHandleId=87, ComSystemTemplateSystemSignalRef=VcuRxMsg4_Sig0
        VcuRxMsg4_Sig1_oVcuCan03RxMsg2_oTC37X_VCU_CAN03_57d534dc_Rx: ComBitPosition=16, ComHandleId=89, ComSystemTemplateSystemSignalRef=VcuRxMsg4_Sig1
        VcuRxMsg3_Sig0_oVcuCan03RxMsg1_oTC37X_VCU_CAN03_ab1f8c96_Rx: ComBitPosition=0, ComHandleId=79, ComSystemTemplateSystemSignalRef=VcuRxMsg3_Sig0
        VcuRxMsg4_Sig3_oVcuCan03RxMsg2_oTC37X_VCU_CAN03_1ed196b0_Rx: ComBitPosition=48, ComHandleId=93, ComSystemTemplateSystemSignalRef=VcuRxMsg4_Sig3
        VcuAdcTxMsg1_Sig3_oVcuCan03TxMsg1_oTC37X_VCU_CAN03_7a041d5f_Tx: ComBitPosition=48, ComTransferProperty=PENDING, ComHandleId=67, ComSystemTemplateSystemSignalRef=VcuAdcTxMsg1_Sig3
      VcuCan03RxMsg1_oTC37X_VCU_CAN03_77e3a75f_Rx (ComIPdu):
        ComIPduDirection = RECEIVE
        ComIPduType = NORMAL
        ComIPduHandleId = 9
        ComIPduSignalProcessing = DEFERRED
        ComIPduCancellationSupport = false
        ComIPduGroupRef = VCU_oTC37X_VCU_CAN03_Rx_b23e03d7
        ComIPduSignalRef = VcuRxMsg3_Sig0_oVcuCan03RxMsg1_oTC37X_VCU_CAN03_ab1f8c96_Rx
        ComIPduSignalRef = VcuRxMsg3_Sig1_oVcuCan03RxMsg1_oTC37X_VCU_CAN03_8f9ddda0_Rx
        ComIPduSignalRef = VcuRxMsg3_Sig2_oVcuCan03RxMsg1_oTC37X_VCU_CAN03_e21b2efa_Rx
        ComIPduSignalRef = VcuRxMsg3_Sig3_oVcuCan03RxMsg1_oTC37X_VCU_CAN03_c6997fcc_Rx
        ComPduIdRef = VcuCan03RxMsg1_oTC37X_VCU_CAN03_77e3a75f_Rx
        ComIPduMainFunctionRef = ComMainFunctionRx
      3 x ComSignal, all with ComBitSize=16, ComSignalEndianness=LITTLE_ENDIAN, ComSignalInitValue=0, ComSignalType=SINT16, ComTimeout=0, ComSignalAccess=ACCESS_UNCLEAR:
        VcuAdcTxMsg2_Sig0_oVcuCan03TxMsg2_oTC37X_VCU_CAN03_2e9f2f9c_Tx: ComBitPosition=0, ComTransferProperty=PENDING, ComHandleId=69, ComSystemTemplateSystemSignalRef=VcuAdcTxMsg2_Sig0
        VcuAdcTxMsg1_Sig2_oVcuCan03TxMsg1_oTC37X_VCU_CAN03_5e864c69_Tx: ComBitPosition=32, ComTransferProperty=PENDING, ComHandleId=65, ComSystemTemplateSystemSignalRef=VcuAdcTxMsg1_Sig2
        VcuRxMsg3_Sig3_oVcuCan03RxMsg1_oTC37X_VCU_CAN03_c6997fcc_Rx: ComBitPosition=48, ComHandleId=85, ComSystemTemplateSystemSignalRef=VcuRxMsg3_Sig3
      VcuCan03TxMsg1_oTC37X_VCU_CAN03_9a29d525_Tx (ComIPdu):
        ComIPduDirection = SEND
        ComIPduType = NORMAL
        ComIPduHandleId = 10
        ComIPduSignalProcessing = DEFERRED
        ComIPduCancellationSupport = false
        ComIPduGroupRef = VCU_oTC37X_VCU_CAN03_Tx_e464a451
        ComIPduSignalRef = VcuAdcTxMsg1_Sig0_oVcuCan03TxMsg1_oTC37X_VCU_CAN03_1782ee05_Tx
        ComIPduSignalRef = VcuAdcTxMsg1_Sig1_oVcuCan03TxMsg1_oTC37X_VCU_CAN03_3300bf33_Tx
        ComIPduSignalRef = VcuAdcTxMsg1_Sig2_oVcuCan03TxMsg1_oTC37X_VCU_CAN03_5e864c69_Tx
        ComIPduSignalRef = VcuAdcTxMsg1_Sig3_oVcuCan03TxMsg1_oTC37X_VCU_CAN03_7a041d5f_Tx
        ComPduIdRef = VcuCan03TxMsg1_oTC37X_VCU_CAN03_9a29d525_Tx
        ComIPduMainFunctionRef = ComMainFunctionTx
        ComTxIPdu: ComMinimumDelayTime=0, ComTxIPduUnusedAreasDefault=0
          ComTxModeTrue
            ComTxMode: ComTxModeMode=PERIODIC, ComTxModeTimeOffset=0, ComTxModeTimePeriod=0.5
          ComTxModeFalse
            ComTxMode: ComTxModeMode=PERIODIC, ComTxModeTimeOffset=0, ComTxModeTimePeriod=0.5
      VcuRxMsg3_Sig2_oVcuCan03RxMsg1_oTC37X_VCU_CAN03_e21b2efa_Rx (ComSignal):
        ComBitPosition = 32
        ComBitSize = 16
        ComSignalEndianness = LITTLE_ENDIAN
        ComSignalInitValue = 0
        ComSignalType = SINT16
        ComTimeout = 0
        ComSignalAccess = ACCESS_UNCLEAR
        ComHandleId = 83
        ComSystemTemplateSystemSignalRef = VcuRxMsg3_Sig2
      VcuCan03TxMsg2_oTC37X_VCU_CAN03_70af0847_Tx (ComIPdu):
        ComIPduDirection = SEND
        ComIPduType = NORMAL
        ComIPduHandleId = 11
        ComIPduSignalProcessing = DEFERRED
        ComIPduCancellationSupport = false
        ComIPduGroupRef = VCU_oTC37X_VCU_CAN03_Tx_e464a451
        ComIPduSignalRef = VcuAdcTxMsg2_Sig0_oVcuCan03TxMsg2_oTC37X_VCU_CAN03_2e9f2f9c_Tx
        ComIPduSignalRef = VcuAdcTxMsg2_Sig1_oVcuCan03TxMsg2_oTC37X_VCU_CAN03_0a1d7eaa_Tx
        ComIPduSignalRef = VcuAdcTxMsg2_Sig2_oVcuCan03TxMsg2_oTC37X_VCU_CAN03_679b8df0_Tx
        ComIPduSignalRef = VcuAdcTxMsg2_Sig3_oVcuCan03TxMsg2_oTC37X_VCU_CAN03_4319dcc6_Tx
        ComPduIdRef = VcuCan03TxMsg2_oTC37X_VCU_CAN03_70af0847_Tx
        ComIPduMainFunctionRef = ComMainFunctionTx
        ComTxIPdu: ComMinimumDelayTime=0, ComTxIPduUnusedAreasDefault=0
          ComTxModeTrue
            ComTxMode: ComTxModeMode=PERIODIC, ComTxModeTimeOffset=0, ComTxModeTimePeriod=0.5
          ComTxModeFalse
            ComTxMode: ComTxModeMode=PERIODIC, ComTxModeTimeOffset=0, ComTxModeTimePeriod=0.5
      VCU_oTC37X_VCU_CAN03_Tx_e464a451 (ComIPduGroup): ComIPduGroupHandleId=11
      VcuAdcTxMsg2_Sig3_oVcuCan03TxMsg2_oTC37X_VCU_CAN03_4319dcc6_Tx (ComSignal):
        ComBitPosition = 48
        ComBitSize = 16
        ComSignalEndianness = LITTLE_ENDIAN
        ComSignalInitValue = 0
        ComSignalType = SINT16
        ComTimeout = 0
        ComTransferProperty = PENDING
        ComSignalAccess = ACCESS_UNCLEAR
        ComHandleId = 75
        ComSystemTemplateSystemSignalRef = VcuAdcTxMsg2_Sig3
      VCU_oLIN01_Rx_f3219b36 (ComIPduGroup): ComIPduGroupHandleId=4
      Vcu_Lin0_TxMsg2_oLIN01_0a12d45a_Tx (ComIPdu):
        ComIPduDirection = SEND
        ComIPduType = NORMAL
        ComIPduHandleId = 25
        ComIPduSignalProcessing = DEFERRED
        ComIPduCancellationSupport = false
        ComIPduGroupRef = VCU_oLIN01_Tx_a57b3cb0
        ComIPduSignalRef = Vcu_Lin0_TxMsg2_Sig0_oVcu_Lin0_TxMsg2_oLIN01_ca2bd13d_Tx
        ComIPduSignalRef = Vcu_Lin0_TxMsg2_Sig1_oVcu_Lin0_TxMsg2_oLIN01_6fa04133_Tx
        ComIPduSignalRef = Vcu_Lin0_TxMsg2_Sig2_oVcu_Lin0_TxMsg2_oLIN01_5a4df760_Tx
        ComIPduSignalRef = Vcu_Lin0_TxMsg2_Sig3_oVcu_Lin0_TxMsg2_oLIN01_ffc6676e_Tx
        ComPduIdRef = Vcu_Lin0_TxMsg2_oLIN01_0a12d45a_Tx
        ComIPduMainFunctionRef = ComMainFunctionTx
        ComTxIPdu: ComTxIPduUnusedAreasDefault=255, ComMinimumDelayTime=0
          ComTxModeTrue
            ComTxMode: ComTxModeMode=NONE
          ComTxModeFalse
            ComTxMode: ComTxModeMode=NONE
      VCU_oLIN01_Tx_a57b3cb0 (ComIPduGroup): ComIPduGroupHandleId=5
      Vcu_Lin0_TxMsg1_Sig1_oVcu_Lin0_TxMsg1_oLIN01_a58e63c8_Tx (ComSignal):
        ComBitPosition = 8
        ComBitSize = 8
        ComSignalEndianness = LITTLE_ENDIAN
        ComSignalInitValue = 0
        ComSignalType = UINT8
        ComSignalAccess = ACCESS_UNCLEAR
        ComHandleId = 93
        ComTransferProperty = PENDING
        ComSystemTemplateSystemSignalRef = Vcu_Lin0_TxMsg1_Sig1
      Vcu_Lin0_RxMsg2_oLIN01_aaf70b87_Rx (ComIPdu):
        ComIPduDirection = RECEIVE
        ComIPduType = NORMAL
        ComIPduHandleId = 18
        ComIPduSignalProcessing = DEFERRED
        ComIPduCancellationSupport = false
        ComIPduGroupRef = VCU_oLIN01_Rx_f3219b36
        ComIPduSignalRef = Vcu_Lin0_RxMsg2_Sig0_oVcu_Lin0_RxMsg2_oLIN01_a6197493_Rx
        ComIPduSignalRef = Vcu_Lin0_RxMsg2_Sig1_oVcu_Lin0_RxMsg2_oLIN01_0392e49d_Rx
        ComIPduSignalRef = Vcu_Lin0_RxMsg2_Sig2_oVcu_Lin0_RxMsg2_oLIN01_367f52ce_Rx
        ComIPduSignalRef = Vcu_Lin0_RxMsg2_Sig3_oVcu_Lin0_RxMsg2_oLIN01_93f4c2c0_Rx
        ComPduIdRef = Vcu_Lin0_RxMsg2_oLIN01_aaf70b87_Rx
        ComIPduMainFunctionRef = ComMainFunctionRx
      4 x ComSignal, all with ComBitSize=8, ComSignalEndianness=LITTLE_ENDIAN, ComSignalInitValue=0, ComSignalType=UINT8, ComSignalAccess=ACCESS_UNCLEAR:
        Vcu_Lin0_RxMsg2_Sig0_oVcu_Lin0_RxMsg2_oLIN01_a6197493_Rx: ComBitPosition=0, ComHandleId=97, ComSystemTemplateSystemSignalRef=Vcu_Lin0_RxMsg2_Sig0
        Vcu_Lin0_RxMsg2_Sig2_oVcu_Lin0_RxMsg2_oLIN01_367f52ce_Rx: ComBitPosition=16, ComHandleId=100, ComSystemTemplateSystemSignalRef=Vcu_Lin0_RxMsg2_Sig2
        Vcu_Lin0_TxMsg1_Sig0_oVcu_Lin0_TxMsg1_oLIN01_0005f3c6_Tx: ComBitPosition=0, ComHandleId=92, ComTransferProperty=PENDING, ComSystemTemplateSystemSignalRef=Vcu_Lin0_TxMsg1_Sig0
        Vcu_Lin0_TxMsg1_Sig3_oVcu_Lin0_TxMsg1_oLIN01_35e84595_Tx: ComBitPosition=24, ComHandleId=95, ComTransferProperty=PENDING, ComSystemTemplateSystemSignalRef=Vcu_Lin0_TxMsg1_Sig3
      Vcu_Lin0_RxMsg1_oLIN01_24780c64_Rx (ComIPdu):
        ComIPduDirection = RECEIVE
        ComIPduType = NORMAL
        ComIPduHandleId = 17
        ComIPduSignalProcessing = DEFERRED
        ComIPduCancellationSupport = false
        ComIPduGroupRef = VCU_oLIN01_Rx_f3219b36
        ComIPduSignalRef = Vcu_Lin0_RxMsg1_Sig0_oVcu_Lin0_RxMsg1_oLIN01_6c375668_Rx
        ComIPduSignalRef = Vcu_Lin0_RxMsg1_Sig1_oVcu_Lin0_RxMsg1_oLIN01_c9bcc666_Rx
        ComIPduSignalRef = Vcu_Lin0_RxMsg2_Sig2_oVcu_Lin0_RxMsg1_oLIN01_b8f0552d_Rx
        ComIPduSignalRef = Vcu_Lin0_RxMsg2_Sig3_oVcu_Lin0_RxMsg1_oLIN01_1d7bc523_Rx
        ComPduIdRef = Vcu_Lin0_RxMsg1_oLIN01_24780c64_Rx
        ComIPduMainFunctionRef = ComMainFunctionRx
      9 x ComSignal, all with ComBitSize=8, ComSignalEndianness=LITTLE_ENDIAN, ComSignalInitValue=0, ComSignalType=UINT8, ComSignalAccess=ACCESS_UNCLEAR:
        Vcu_Lin0_RxMsg2_Sig3_oVcu_Lin0_RxMsg2_oLIN01_93f4c2c0_Rx: ComBitPosition=32, ComHandleId=102, ComSystemTemplateSystemSignalRef=Vcu_Lin0_RxMsg2_Sig3
        Vcu_Lin0_TxMsg2_Sig1_oVcu_Lin0_TxMsg2_oLIN01_6fa04133_Tx: ComBitPosition=8, ComHandleId=97, ComTransferProperty=PENDING, ComSystemTemplateSystemSignalRef=Vcu_Lin0_TxMsg2_Sig1
        Vcu_Lin0_TxMsg2_Sig3_oVcu_Lin0_TxMsg2_oLIN01_ffc6676e_Tx: ComBitPosition=24, ComHandleId=99, ComTransferProperty=PENDING, ComSystemTemplateSystemSignalRef=Vcu_Lin0_TxMsg2_Sig3
        Vcu_Lin0_RxMsg1_Sig1_oVcu_Lin0_RxMsg1_oLIN01_c9bcc666_Rx: ComBitPosition=0, ComHandleId=96, ComSystemTemplateSystemSignalRef=Vcu_Lin0_RxMsg1_Sig1
        Vcu_Lin0_RxMsg2_Sig3_oVcu_Lin0_RxMsg1_oLIN01_1d7bc523_Rx: ComBitPosition=24, ComHandleId=101, ComSystemTemplateSystemSignalRef=Vcu_Lin0_RxMsg2_Sig3
        Vcu_Lin0_TxMsg1_Sig2_oVcu_Lin0_TxMsg1_oLIN01_9063d59b_Tx: ComBitPosition=16, ComHandleId=94, ComTransferProperty=PENDING, ComSystemTemplateSystemSignalRef=Vcu_Lin0_TxMsg1_Sig2
        Vcu_Lin0_TxMsg2_Sig2_oVcu_Lin0_TxMsg2_oLIN01_5a4df760_Tx: ComBitPosition=16, ComHandleId=98, ComTransferProperty=PENDING, ComSystemTemplateSystemSignalRef=Vcu_Lin0_TxMsg2_Sig2
        Vcu_Lin0_RxMsg2_Sig2_oVcu_Lin0_RxMsg1_oLIN01_b8f0552d_Rx: ComBitPosition=16, ComHandleId=99, ComSystemTemplateSystemSignalRef=Vcu_Lin0_RxMsg2_Sig2
        Vcu_Lin0_TxMsg2_Sig0_oVcu_Lin0_TxMsg2_oLIN01_ca2bd13d_Tx: ComBitPosition=0, ComHandleId=96, ComTransferProperty=PENDING, ComSystemTemplateSystemSignalRef=Vcu_Lin0_TxMsg2_Sig0
      Vcu_Lin0_TxMsg1_oLIN01_849dd3b9_Tx (ComIPdu):
        ComIPduDirection = SEND
        ComIPduType = NORMAL
        ComIPduHandleId = 24
        ComIPduSignalProcessing = DEFERRED
        ComIPduCancellationSupport = false
        ComIPduGroupRef = VCU_oLIN01_Tx_a57b3cb0
        ComIPduSignalRef = Vcu_Lin0_TxMsg1_Sig0_oVcu_Lin0_TxMsg1_oLIN01_0005f3c6_Tx
        ComIPduSignalRef = Vcu_Lin0_TxMsg1_Sig1_oVcu_Lin0_TxMsg1_oLIN01_a58e63c8_Tx
        ComIPduSignalRef = Vcu_Lin0_TxMsg1_Sig2_oVcu_Lin0_TxMsg1_oLIN01_9063d59b_Tx
        ComIPduSignalRef = Vcu_Lin0_TxMsg1_Sig3_oVcu_Lin0_TxMsg1_oLIN01_35e84595_Tx
        ComPduIdRef = Vcu_Lin0_TxMsg1_oLIN01_849dd3b9_Tx
        ComIPduMainFunctionRef = ComMainFunctionTx
        ComTxIPdu: ComTxIPduUnusedAreasDefault=255, ComMinimumDelayTime=0
          ComTxModeTrue
            ComTxMode: ComTxModeMode=NONE
          ComTxModeFalse
            ComTxMode: ComTxModeMode=NONE
      Vcu_Lin0_RxMsg1_Sig0_oVcu_Lin0_RxMsg1_oLIN01_6c375668_Rx (ComSignal):
        ComBitPosition = 8
        ComBitSize = 8
        ComSignalEndianness = LITTLE_ENDIAN
        ComSignalInitValue = 0
        ComSignalType = UINT8
        ComSignalAccess = ACCESS_UNCLEAR
        ComHandleId = 95
        ComSystemTemplateSystemSignalRef = Vcu_Lin0_RxMsg1_Sig0
      Vcu_Lin0_RxMsg2_Sig1_oVcu_Lin0_RxMsg2_oLIN01_0392e49d_Rx (ComSignal):
        ComBitPosition = 8
        ComBitSize = 8
        ComSignalEndianness = LITTLE_ENDIAN
        ComSignalInitValue = 0
        ComSignalType = UINT8
        ComSignalAccess = ACCESS_UNCLEAR
        ComHandleId = 98
        ComSystemTemplateSystemSignalRef = Vcu_Lin0_RxMsg2_Sig1
    ComGeneral:
      ComConfigurationUseDet = true
      ComSafeBswChecks = false
      ComEnableSignalGroupArrayApi = false
      ComRetryFailedTransmitRequests = true
      ComSupportedIPduGroups = 14
      ComVersionInfoApi = false
      ComAdvancedIPduCallouts = true
      ComOptimizedIPduGroupHandling = false
      ComMetaDataSupport = false
      ComDeferredEventCacheSupport = false
      ComDescriptionGateway = false
      ComDescriptionRoutingCodeGeneration = false
      ComStrictRepetitionPeriod = false
      ComMixedModePeriodicSuppression = false
      ComSignalGateway = NONE
      ComUserCbkHeaderFile = Rte_Cbk.h
      ComUserCbkHeaderFile = Appl_Cbk.h
