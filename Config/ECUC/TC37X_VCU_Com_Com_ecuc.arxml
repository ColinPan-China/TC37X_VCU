[part 2 of 2: package /ActiveEcuC]
AUTOSAR XML (schema 00048)
package /ActiveEcuC  (continued)
  module config Com: implementation-config-variant=VARIANT-PRE-COMPILE, module-description=Com_Impl  (continued)
    ComConfig: ComConfigurationId=0, ComRxDeferredNotificationCacheSize=1, ComRxImmediateNotificationCacheSize=0  (continued)
      VcuMeasurementMsg0_oTC37X_VCU_CAN01_0deb23c3_Tx (ComIPdu):
        ComIPduDirection = SEND
        ComIPduType = NORMAL
        ComIPduHandleId = 48
        ComIPduSignalProcessing = DEFERRED
        ComIPduCancellationSupport = false
        ComIPduGroupRef = VCU_oTC37X_VCU_CAN01_Tx_4e6d6cda
        ComIPduSignalRef = EXT_PWM_IN1_Duty_oVcuMeasurementMsg0_oTC37X_VCU_CAN01_92760a96_Tx
        ComIPduSignalRef = EXT_PWM_IN1_Period_oVcuMeasurementMsg0_oTC37X_VCU_CAN01_c46a50e4_Tx
        ComIPduSignalRef = EXT_PWM_IN2_Duty_oVcuMeasurementMsg0_oTC37X_VCU_CAN01_5b42119b_Tx
        ComIPduSignalRef = EXT_PWM_IN2_Period_oVcuMeasurementMsg0_oTC37X_VCU_CAN01_fba12e71_Tx
        ComIPduSignalRef = Ext_IN2_oVcuMeasurementMsg0_oTC37X_VCU_CAN01_a925e19e_Tx
        ComPduIdRef = VcuMeasurementMsg0_oTC37X_VCU_CAN01_0deb23c3_Tx
        ComIPduMainFunctionRef = ComMainFunctionTx
        ComTxIPdu: ComMinimumDelayTime=0, ComTxIPduUnusedAreasDefault=0
          ComTxModeTrue
            ComTxMode: ComTxModeMode=PERIODIC, ComTxModeTimeOffset=0, ComTxModeTimePeriod=0.5
          ComTxModeFalse
            ComTxMode: ComTxModeMode=PERIODIC, ComTxModeTimeOffset=0, ComTxModeTimePeriod=0.5
      EXT_PWM_IN1_Duty_oVcuMeasurementMsg0_oTC37X_VCU_CAN01_92760a96_Tx (ComSignal):
        ComBitPosition = 16
        ComBitSize = 8
        ComSignalEndianness = LITTLE_ENDIAN
        ComSignalInitValue = 0
        ComSignalType = SINT8
        ComTimeout = 0
        ComTransferProperty = PENDING
        ComSignalAccess = ACCESS_UNCLEAR
        ComHandleId = 54
        ComSystemTemplateSystemSignalRef = EXT_PWM_IN1_Duty
      EXT_PWM_IN1_Period_oVcuMeasurementMsg0_oTC37X_VCU_CAN01_c46a50e4_Tx (ComSignal):
        ComBitPosition = 0
        ComBitSize = 16
        ComSignalEndianness = LITTLE_ENDIAN
        ComSignalInitValue = 0
        ComSignalType = SINT16
        ComTimeout = 0
        ComTransferProperty = PENDING
        ComSignalAccess = ACCESS_UNCLEAR
        ComHandleId = 55
        ComSystemTemplateSystemSignalRef = EXT_PWM_IN1_Period
      VcuRxCtrlMsg2_oTC37X_VCU_CAN01_b79e4137_Rx (ComIPdu):
        ComIPduDirection = RECEIVE
        ComIPduType = NORMAL
        ComIPduHandleId = 95
        ComIPduSignalProcessing = DEFERRED
        ComIPduCancellationSupport = false
        ComIPduGroupRef = VCU_oTC37X_VCU_CAN01_Rx_1837cb5c
        ComIPduSignalRef = Tle888qk_Lout14_En_oVcuRxCtrlMsg2_oTC37X_VCU_CAN01_a11e1e88_Rx
        ComIPduSignalRef = Tle888qk_Lout16_En_oVcuRxCtrlMsg2_oTC37X_VCU_CAN01_508eb1e3_Rx
        ComIPduSignalRef = Tle888qk_Lout1_En_oVcuRxCtrlMsg2_oTC37X_VCU_CAN01_0e3571fa_Rx
        ComIPduSignalRef = Tle888qk_Lout8_En_oVcuRxCtrlMsg2_oTC37X_VCU_CAN01_ebe51441_Rx
        ComPduIdRef = VcuRxCtrlMsg2_oTC37X_VCU_CAN01_b79e4137_Rx
        ComIPduMainFunctionRef = ComMainFunctionRx
      5 x ComSignal, all with ComBitSize=8, ComSignalEndianness=LITTLE_ENDIAN, ComSignalInitValue=0, ComSignalType=SINT8, ComTimeout=0, ComSignalAccess=ACCESS_UNCLEAR:
        Tle888qk_Lout8_En_oVcuRxCtrlMsg2_oTC37X_VCU_CAN01_ebe51441_Rx: ComBitPosition=8, ComHandleId=522, ComSystemTemplateSystemSignalRef=Tle888qk_Lout8_En
        EXT_PWM_IN2_Duty_oVcuMeasurementMsg0_oTC37X_VCU_CAN01_5b42119b_Tx: ComBitPosition=40, ComTransferProperty=PENDING, ComHandleId=56, ComSystemTemplateSystemSignalRef=EXT_PWM_IN2_Duty
        Tle888qk_Lout16_En_oVcuRxCtrlMsg2_oTC37X_VCU_CAN01_508eb1e3_Rx: ComBitPosition=24, ComHandleId=524, ComSystemTemplateSystemSignalRef=Tle888qk_Lout16_En
        Ext_IN2_oVcuMeasurementMsg0_oTC37X_VCU_CAN01_a925e19e_Tx: ComBitPosition=48, ComTransferProperty=PENDING, ComHandleId=58, ComSystemTemplateSystemSignalRef=Ext_IN2
        Tle888qk_Lout1_En_oVcuRxCtrlMsg2_oTC37X_VCU_CAN01_0e3571fa_Rx: ComBitPosition=0, ComHandleId=521, ComNotification=Rte_COMCbk_Tle888qk_Lout1_En_oVcuRxCtrlMsg2_oTC37X_VCU_CAN01_0e3571fa_Rx, ComSystemTemplateSystemSignalRef=Tle888qk_Lout1_En
      VCU_oLIN02_Rx_e19434d8 (ComIPduGroup): ComIPduGroupHandleId=9
      Vcu_Lin3_RxMsg1_oLIN02_ac0c37a7_Rx (ComIPdu):
        ComIPduDirection = RECEIVE
        ComIPduType = NORMAL
        ComIPduHandleId = 100
        ComIPduSignalProcessing = DEFERRED
        ComIPduCancellationSupport = false
        ComIPduGroupRef = VCU_oLIN02_Rx_e19434d8
        ComIPduSignalRef = Vcu_Lin3_RxMsg1_Sig0_oVcu_Lin3_RxMsg1_oLIN02_be2252cb_Rx
        ComIPduSignalRef = Vcu_Lin3_RxMsg1_Sig1_oVcu_Lin3_RxMsg1_oLIN02_1ba9c2c5_Rx
        ComIPduSignalRef = Vcu_Lin3_RxMsg2_Sig2_oVcu_Lin3_RxMsg1_oLIN02_6ae5518e_Rx
        ComIPduSignalRef = Vcu_Lin3_RxMsg2_Sig3_oVcu_Lin3_RxMsg1_oLIN02_cf6ec180_Rx
        ComPduIdRef = Vcu_Lin3_RxMsg1_oLIN02_ac0c37a7_Rx
        ComIPduMainFunctionRef = ComMainFunctionRx
      Vcu_Lin3_TxMsg1_Sig3_oVcu_Lin3_TxMsg1_oLIN02_e7fd4136_Tx (ComSignal):
        ComBitPosition = 24
        ComBitSize = 8
        ComSignalEndianness = LITTLE_ENDIAN
        ComSignalInitValue = 0
        ComSignalType = UINT8
        ComSignalAccess = ACCESS_UNCLEAR
        ComHandleId = 283
        ComTransferProperty = PENDING
        ComSystemTemplateSystemSignalRef = Vcu_Lin3_TxMsg1_Sig3
      Vcu_Lin3_RxMsg2_oLIN02_22833044_Rx (ComIPdu):
        ComIPduDirection = RECEIVE
        ComIPduType = NORMAL
        ComIPduHandleId = 101
        ComIPduSignalProcessing = DEFERRED
        ComIPduCancellationSupport = false
        ComIPduGroupRef = VCU_oLIN02_Rx_e19434d8
        ComIPduSignalRef = Vcu_Lin3_RxMsg2_Sig0_oVcu_Lin3_RxMsg2_oLIN02_740c7030_Rx
        ComIPduSignalRef = Vcu_Lin3_RxMsg2_Sig1_oVcu_Lin3_RxMsg2_oLIN02_d187e03e_Rx
        ComIPduSignalRef = Vcu_Lin3_RxMsg2_Sig2_oVcu_Lin3_RxMsg2_oLIN02_e46a566d_Rx
        ComIPduSignalRef = Vcu_Lin3_RxMsg2_Sig3_oVcu_Lin3_RxMsg2_oLIN02_41e1c663_Rx
        ComPduIdRef = Vcu_Lin3_RxMsg2_oLIN02_22833044_Rx
        ComIPduMainFunctionRef = ComMainFunctionRx
      Vcu_Lin3_TxMsg2_oLIN02_8266ef99_Tx (ComIPdu):
        ComIPduDirection = SEND
        ComIPduType = NORMAL
        ComIPduHandleId = 52
        ComIPduSignalProcessing = DEFERRED
        ComIPduCancellationSupport = false
        ComIPduGroupRef = VCU_oLIN02_Tx_b7ce935e
        ComIPduSignalRef = Vcu_Lin3_TxMsg2_Sig0_oVcu_Lin3_TxMsg2_oLIN02_183ed59e_Tx
        ComIPduSignalRef = Vcu_Lin3_TxMsg2_Sig1_oVcu_Lin3_TxMsg2_oLIN02_bdb54590_Tx
        ComIPduSignalRef = Vcu_Lin3_TxMsg2_Sig2_oVcu_Lin3_TxMsg2_oLIN02_8858f3c3_Tx
        ComIPduSignalRef = Vcu_Lin3_TxMsg2_Sig3_oVcu_Lin3_TxMsg2_oLIN02_2dd363cd_Tx
        ComPduIdRef = Vcu_Lin3_TxMsg2_oLIN02_8266ef99_Tx
        ComIPduMainFunctionRef = ComMainFunctionTx
        ComTxIPdu: ComTxIPduUnusedAreasDefault=255, ComMinimumDelayTime=0
          ComTxModeTrue
            ComTxMode: ComTxModeMode=NONE
          ComTxModeFalse
            ComTxMode: ComTxModeMode=NONE
      4 x ComSignal, all with ComBitSize=8, ComSignalEndianness=LITTLE_ENDIAN, ComSignalInitValue=0, ComSignalType=UINT8, ComSignalAccess=ACCESS_UNCLEAR:
        Vcu_Lin3_TxMsg1_Sig2_oVcu_Lin3_TxMsg1_oLIN02_4276d138_Tx: ComBitPosition=16, ComHandleId=282, ComTransferProperty=PENDING, ComSystemTemplateSystemSignalRef=Vcu_Lin3_TxMsg1_Sig2
        Vcu_Lin3_RxMsg2_Sig2_oVcu_Lin3_RxMsg2_oLIN02_e46a566d_Rx: ComBitPosition=16, ComHandleId=566, ComSystemTemplateSystemSignalRef=Vcu_Lin3_RxMsg2_Sig2
        Vcu_Lin3_RxMsg2_Sig0_oVcu_Lin3_RxMsg2_oLIN02_740c7030_Rx: ComBitPosition=0, ComHandleId=563, ComSystemTemplateSystemSignalRef=Vcu_Lin3_RxMsg2_Sig0
        Vcu_Lin3_RxMsg1_Sig1_oVcu_Lin3_RxMsg1_oLIN02_1ba9c2c5_Rx: ComBitPosition=0, ComHandleId=562, ComSystemTemplateSystemSignalRef=Vcu_Lin3_RxMsg1_Sig1
      Vcu_Lin3_TxMsg1_oLIN02_0ce9e87a_Tx (ComIPdu):
        ComIPduDirection = SEND
        ComIPduType = NORMAL
        ComIPduHandleId = 51
        ComIPduSignalProcessing = DEFERRED
        ComIPduCancellationSupport = false
        ComIPduGroupRef = VCU_oLIN02_Tx_b7ce935e
        ComIPduSignalRef = Vcu_Lin3_TxMsg1_Sig0_oVcu_Lin3_TxMsg1_oLIN02_d210f765_Tx
        ComIPduSignalRef = Vcu_Lin3_TxMsg1_Sig1_oVcu_Lin3_TxMsg1_oLIN02_779b676b_Tx
        ComIPduSignalRef = Vcu_Lin3_TxMsg1_Sig2_oVcu_Lin3_TxMsg1_oLIN02_4276d138_Tx
        ComIPduSignalRef = Vcu_Lin3_TxMsg1_Sig3_oVcu_Lin3_TxMsg1_oLIN02_e7fd4136_Tx
        ComPduIdRef = Vcu_Lin3_TxMsg1_oLIN02_0ce9e87a_Tx
        ComIPduMainFunctionRef = ComMainFunctionTx
        ComTxIPdu: ComTxIPduUnusedAreasDefault=255, ComMinimumDelayTime=0
          ComTxModeTrue
            ComTxMode: ComTxModeMode=NONE
          ComTxModeFalse
            ComTxMode: ComTxModeMode=NONE
      VCU_oLIN02_Tx_b7ce935e (ComIPduGroup): ComIPduGroupHandleId=10
      11 x ComSignal, all with ComBitSize=8, ComSignalEndianness=LITTLE_ENDIAN, ComSignalInitValue=0, ComSignalType=UINT8, ComSignalAccess=ACCESS_UNCLEAR:
        Vcu_Lin3_TxMsg2_Sig3_oVcu_Lin3_TxMsg2_oLIN02_2dd363cd_Tx: ComBitPosition=24, ComHandleId=287, ComTransferProperty=PENDING, ComSystemTemplateSystemSignalRef=Vcu_Lin3_TxMsg2_Sig3
        Vcu_Lin3_TxMsg2_Sig2_oVcu_Lin3_TxMsg2_oLIN02_8858f3c3_Tx: ComBitPosition=16, ComHandleId=286, ComTransferProperty=PENDING, ComSystemTemplateSystemSignalRef=Vcu_Lin3_TxMsg2_Sig2
        Vcu_Lin3_RxMsg2_Sig2_oVcu_Lin3_RxMsg1_oLIN02_6ae5518e_Rx: ComBitPosition=16, ComHandleId=565, ComSystemTemplateSystemSignalRef=Vcu_Lin3_RxMsg2_Sig2
        Vcu_Lin3_RxMsg2_Sig3_oVcu_Lin3_RxMsg2_oLIN02_41e1c663_Rx: ComBitPosition=32, ComHandleId=568, ComSystemTemplateSystemSignalRef=Vcu_Lin3_RxMsg2_Sig3
        Vcu_Lin3_TxMsg2_Sig0_oVcu_Lin3_TxMsg2_oLIN02_183ed59e_Tx: ComBitPosition=0, ComHandleId=284, ComTransferProperty=PENDING, ComSystemTemplateSystemSignalRef=Vcu_Lin3_TxMsg2_Sig0
        Vcu_Lin3_RxMsg1_Sig0_oVcu_Lin3_RxMsg1_oLIN02_be2252cb_Rx: ComBitPosition=8, ComHandleId=561, ComSystemTemplateSystemSignalRef=Vcu_Lin3_RxMsg1_Sig0
        Vcu_Lin3_TxMsg1_Sig1_oVcu_Lin3_TxMsg1_oLIN02_779b676b_Tx: ComBitPosition=8, ComHandleId=281, ComTransferProperty=PENDING, ComSystemTemplateSystemSignalRef=Vcu_Lin3_TxMsg1_Sig1
        Vcu_Lin3_RxMsg2_Sig1_oVcu_Lin3_RxMsg2_oLIN02_d187e03e_Rx: ComBitPosition=8, ComHandleId=564, ComSystemTemplateSystemSignalRef=Vcu_Lin3_RxMsg2_Sig1
        Vcu_Lin3_TxMsg2_Sig1_oVcu_Lin3_TxMsg2_oLIN02_bdb54590_Tx: ComBitPosition=8, ComHandleId=285, ComTransferProperty=PENDING, ComSystemTemplateSystemSignalRef=Vcu_Lin3_TxMsg2_Sig1
        Vcu_Lin3_RxMsg2_Sig3_oVcu_Lin3_RxMsg1_oLIN02_cf6ec180_Rx: ComBitPosition=24, ComHandleId=567, ComSystemTemplateSystemSignalRef=Vcu_Lin3_RxMsg2_Sig3
        Vcu_Lin3_TxMsg1_Sig0_oVcu_Lin3_TxMsg1_oLIN02_d210f765_Tx: ComBitPosition=0, ComHandleId=280, ComTransferProperty=PENDING, ComSystemTemplateSystemSignalRef=Vcu_Lin3_TxMsg1_Sig0
      BMS_status_04_oATOM_CAN_Matrix_PT_V600_20250211_ed71e625_Rx (ComIPdu):
        ComIPduDirection = RECEIVE
        ComIPduType = NORMAL
        ComIPduHandleId = 29
        ComIPduSignalProcessing = DEFERRED
        ComIPduCancellationSupport = false
        ComIPduGroupRef = VCU_oATOM_CAN_Matrix_PT_V600_20250211_Rx_49b064ca
        ComIPduSignalGroupRef = SG_BMS_status_04_SigGroup_oBMS_status_04_oATOM_CAN_Matrix_PT_V600_20250211_7f748bd3_Rx
        ComPduIdRef = BMS_status_04_oATOM_CAN_Matrix_PT_V600_20250211_ed71e625_Rx
        ComIPduMainFunctionRef = ComMainFunctionRx
      POD_DCDC_02_oATOM_CAN_Matrix_PT_V600_20250211_e5ca5d0b_Rx (ComIPdu):
        ComIPduDirection = RECEIVE
        ComIPduType = NORMAL
        ComIPduHandleId = 70
        ComIPduSignalProcessing = DEFERRED
        ComIPduCancellationSupport = false
        ComIPduGroupRef = VCU_oATOM_CAN_Matrix_PT_V600_20250211_Rx_49b064ca
        ComIPduSignalGroupRef = SG_POD_DCDC_02_SigGroup_oPOD_DCDC_02_oATOM_CAN_Matrix_PT_V600_20250211_62e3e6f8_Rx
        ComPduIdRef = POD_DCDC_02_oATOM_CAN_Matrix_PT_V600_20250211_e5ca5d0b_Rx
        ComIPduMainFunctionRef = ComMainFunctionRx
      5 x ComSignalGroup, all with ComTransferProperty=PENDING, ComSignalGroupAccess=ACCESS_UNCLEAR:
        SG_POD_DCDC_02_SigGroup_oPOD_DCDC_02_oATOM_CAN_Matrix_PT_V600_20250211_62e3e6f8_Rx: ComHandleId=63, ComSystemTemplateSignalGroupRef=SG_POD_DCDC_02_SigGroup
          POD_DCDC_FaultLevel_oPOD_DCDC_02_oATOM_CAN_Matrix_PT_V600_20250211_eefe3afb_Rx (ComGroupSignal):
            ComBitPosition = 7
            ComBitSize = 2
            ComSignalEndianness = BIG_ENDIAN
            ComSignalInitValue = 0
            ComSignalType = UINT8
            ComSignalAccess = ACCESS_UNCLEAR
            ComHandleId = 445
            ComSystemTemplateSystemSignalRef = POD_DCDC_FaultLevel
          POD_DCDC_Side2Overtempfault_oPOD_DCDC_02_oATOM_CAN_Matrix_PT_V600_20250211_52f42506_Rx (ComGroupSignal):
            ComBitPosition = 14
            ComBitSize = 1
            ComSignalEndianness = BIG_ENDIAN
            ComSignalInitValue = 0
            ComSignalType = BOOLEAN
            ComSignalAccess = ACCESS_UNCLEAR
            ComHandleId = 446
            ComSystemTemplateSystemSignalRef = POD_DCDC_Side2Overtempfault
        SG_BMS_VersionInfor_SigGroup_oBMS_VersionInfor_oATOM_CAN_Matrix_PT_V600_20250211_3c7841d8_Rx: ComHandleId=25, ComSystemTemplateSignalGroupRef=SG_BMS_VersionInfor_SigGroup
          BMS_ComVersion_oBMS_VersionInfor_oATOM_CAN_Matrix_PT_V600_20250211_a6b9c4fe_Rx (ComGroupSignal):
            ComBitPosition = 39
            ComBitSize = 16
            ComSignalEndianness = BIG_ENDIAN
            ComSignalInitValue = 0
            ComSignalType = UINT16
            ComSignalAccess = ACCESS_UNCLEAR
            ComHandleId = 205
            ComSystemTemplateSystemSignalRef = BMS_ComVersion
          BMS_BatProRights_oBMS_VersionInfor_oATOM_CAN_Matrix_PT_V600_20250211_65b7c251_Rx (ComGroupSignal):
            ComBitPosition = 51
            ComBitSize = 1
            ComSignalEndianness = BIG_ENDIAN
            ComSignalInitValue = 0
            ComSignalType = BOOLEAN
            ComSignalAccess = ACCESS_UNCLEAR
            ComHandleId = 204
            ComSystemTemplateSystemSignalRef = BMS_BatProRights
        SG_BMS_status_02_SigGroup_oBMS_status_02_oATOM_CAN_Matrix_PT_V600_20250211_1f7aebc7_Rx: ComHandleId=27, ComSystemTemplateSignalGroupRef=SG_BMS_status_02_SigGroup
          3 x ComGroupSignal, all with ComSignalEndianness=BIG_ENDIAN, ComSignalInitValue=0, ComSignalType=UINT16, ComSignalAccess=ACCESS_UNCLEAR:
            BMS_Heatcurrent_oBMS_status_02_oATOM_CAN_Matrix_PT_V600_20250211_d7161a8d_Rx: ComBitPosition=55, ComBitSize=16, ComHandleId=222, ComSystemTemplateSystemSignalRef=BMS_Heatcurrent
            BMS_BattVolt_oBMS_status_02_oATOM_CAN_Matrix_PT_V600_20250211_434721f0_Rx: ComBitPosition=23, ComBitSize=14, ComHandleId=221, ComSystemTemplateSystemSignalRef=BMS_BattVolt
            BMS_BattCurr_oBMS_status_02_oATOM_CAN_Matrix_PT_V600_20250211_114279ae_Rx: ComBitPosition=39, ComBitSize=15, ComHandleId=220, ComSystemTemplateSystemSignalRef=BMS_BattCurr
        SG_VCU_DiagInfor_SigGroup_oVCU_DiagInfor_oATOM_CAN_Matrix_PT_V600_20250211_f76d1342_Tx: ComHandleId=13, ComSystemTemplateSignalGroupRef=SG_VCU_DiagInfor_SigGroup
          VCU_DTC_Number_oVCU_DiagInfor_oATOM_CAN_Matrix_PT_V600_20250211_bf444eeb_Tx (ComGroupSignal):
            ComBitPosition = 7
            ComBitSize = 8
            ComSignalEndianness = BIG_ENDIAN
            ComSignalInitValue = 0
            ComSignalType = UINT8
            ComTransferProperty = PENDING
            ComSignalAccess = ACCESS_UNCLEAR
            ComHandleId = 164
            ComSystemTemplateSystemSignalRef = VCU_DTC_Number
        SG_BCM_05_SigGroup_oBCM_05_oATOM_CAN_Matrix_PT_V600_20250211_46c76b05_Rx: ComHandleId=9, ComSystemTemplateSignalGroupRef=SG_BCM_05_SigGroup
          17 x ComGroupSignal, all with ComSignalEndianness=BIG_ENDIAN, ComSignalAccess=ACCESS_UNCLEAR:
            BCM_GearTimesSts_oBCM_05_oATOM_CAN_Matrix_PT_V600_20250211_f9cf4f13_Rx: ComBitPosition=15, ComBitSize=3, ComSignalInitValue=5, ComSignalType=UINT8, ComHandleId=129, ComSystemTemplateSystemSignalRef=BCM_GearTimesSts
            BCM_WiperServiceSts_oBCM_05_oATOM_CAN_Matrix_PT_V600_20250211_00dc1681_Rx: ComBitPosition=33, ComBitSize=2, ComSignalInitValue=0, ComSignalType=UINT8, ComHandleId=135, ComSystemTemplateSystemSignalRef=BCM_WiperServiceSts
            Checksum_33A_oBCM_05_oATOM_CAN_Matrix_PT_V600_20250211_240d647b_Rx: ComBitPosition=7, ComBitSize=8, ComSignalInitValue=0, ComSignalType=UINT8, ComHandleId=137, ComSystemTemplateSystemSignalRef=Checksum_33A
            BCM_PuddleLiReq_oBCM_05_oATOM_CAN_Matrix_PT_V600_20250211_e2d97524_Rx: ComBitPosition=39, ComBitSize=2, ComSignalInitValue=1, ComSignalType=UINT8, ComHandleId=131, ComSystemTemplateSystemSignalRef=BCM_PuddleLiReq
            BCM_DomeLampBrightSts_oBCM_05_oATOM_CAN_Matrix_PT_V600_20250211_a496c206_Rx: ComBitPosition=37, ComBitSize=1, ComSignalInitValue=1, ComSignalType=BOOLEAN, ComHandleId=125, ComSystemTemplateSystemSignalRef=BCM_DomeLampBrightSts
            BCM_WiperWorkingSts_oBCM_05_oATOM_CAN_Matrix_PT_V600_20250211_2776ea8d_Rx: ComBitPosition=47, ComBitSize=3, ComSignalInitValue=0, ComSignalType=UINT8, ComHandleId=136, ComSystemTemplateSystemSignalRef=BCM_WiperWorkingSts
            BCM_ChrgFlapLockSts_oBCM_05_oATOM_CAN_Matrix_PT_V600_20250211_178f84af_Rx: ComBitPosition=12, ComBitSize=1, ComSignalInitValue=0, ComSignalType=BOOLEAN, ComHandleId=123, ComSystemTemplateSystemSignalRef=BCM_ChrgFlapLockSts
            BCM_FLSeatBeltRemindReq_oBCM_05_oATOM_CAN_Matrix_PT_V600_20250211_65ab8c1e_Rx: ComBitPosition=19, ComBitSize=2, ComSignalInitValue=0, ComSignalType=UINT8, ComHandleId=126, ComSystemTemplateSystemSignalRef=BCM_FLSeatBeltRemindReq
            BCM_AutoCloseWinFunSts_oBCM_05_oATOM_CAN_Matrix_PT_V600_20250211_721cde79_Rx: ComBitPosition=36, ComBitSize=1, ComSignalInitValue=0, ComSignalType=BOOLEAN, ComHandleId=122, ComSystemTemplateSystemSignalRef=BCM_AutoCloseWinFunSts
            MessageCounter_33A_oBCM_05_oATOM_CAN_Matrix_PT_V600_20250211_e46a568a_Rx: ComBitPosition=11, ComBitSize=4, ComSignalInitValue=0, ComSignalType=UINT8, ComHandleId=138, ComSystemTemplateSystemSignalRef=MessageCounter_33A
            BCM_DomeLampAutoSts_oBCM_05_oATOM_CAN_Matrix_PT_V600_20250211_d0321d9a_Rx: ComBitPosition=41, ComBitSize=2, ComSignalInitValue=1, ComSignalType=UINT8, ComHandleId=124, ComSystemTemplateSystemSignalRef=BCM_DomeLampAutoSts
            BCM_FRSeatBeltRemindReq_oBCM_05_oATOM_CAN_Matrix_PT_V600_20250211_4ddb1af9_Rx: ComBitPosition=17, ComBitSize=2, ComSignalInitValue=0, ComSignalType=UINT8, ComHandleId=127, ComSystemTemplateSystemSignalRef=BCM_FRSeatBeltRemindReq
            BCM_FrontWiperModeSts_oBCM_05_oATOM_CAN_Matrix_PT_V600_20250211_bc45dbca_Rx: ComBitPosition=44, ComBitSize=3, ComSignalInitValue=0, ComSignalType=UINT8, ComHandleId=128, ComSystemTemplateSystemSignalRef=BCM_FrontWiperModeSts
            BCM_RLSeatBeltRemindReq_oBCM_05_oATOM_CAN_Matrix_PT_V600_20250211_f8ff7457_Rx: ComBitPosition=31, ComBitSize=2, ComSignalInitValue=0, ComSignalType=UINT8, ComHandleId=132, ComSystemTemplateSystemSignalRef=BCM_RLSeatBeltRemindReq
            BCM_KeyNotInCarRemind_oBCM_05_oATOM_CAN_Matrix_PT_V600_20250211_26929e5b_Rx: ComBitPosition=20, ComBitSize=1, ComSignalInitValue=0, ComSignalType=BOOLEAN, ComHandleId=130, ComSystemTemplateSystemSignalRef=BCM_KeyNotInCarRemind
            BCM_RRSeatBeltRemindReq_oBCM_05_oATOM_CAN_Matrix_PT_V600_20250211_d08fe2b0_Rx: ComBitPosition=29, ComBitSize=2, ComSignalInitValue=0, ComSignalType=UINT8, ComHandleId=133, ComSystemTemplateSystemSignalRef=BCM_RRSeatBeltRemindReq
            BCM_WelLightshowOnOffSts_oBCM_05_oATOM_CAN_Matrix_PT_V600_20250211_5761d474_Rx: ComBitPosition=51, ComBitSize=2, ComSignalInitValue=2, ComSignalType=UINT8, ComHandleId=134, ComSystemTemplateSystemSignalRef=BCM_WelLightshowOnOffSts
      BCM_Authentication_oATOM_CAN_Matrix_PT_V600_20250211_f1177f98_Rx (ComIPdu):
        ComIPduDirection = RECEIVE
        ComIPduType = NORMAL
        ComIPduHandleId = 12
        ComIPduSignalProcessing = DEFERRED
        ComIPduCancellationSupport = false
        ComIPduGroupRef = VCU_oATOM_CAN_Matrix_PT_V600_20250211_Rx_49b064ca
        ComIPduSignalGroupRef = SG_BCM_Authentication_SigGroup_oBCM_Authentication_oATOM_CAN_Matrix_PT_V600_20250211_e24c50d2_Rx
        ComPduIdRef = BCM_Authentication_oATOM_CAN_Matrix_PT_V600_20250211_f1177f98_Rx
        ComIPduMainFunctionRef = ComMainFunctionRx
      VCU_DCDC_oATOM_CAN_Matrix_PT_V600_20250211_2c28a723_Tx (ComIPdu):
        ComIPduDirection = SEND
        ComIPduType = NORMAL
        ComIPduHandleId = 15
        ComIPduSignalProcessing = DEFERRED
        ComIPduCancellationSupport = false
        ComIPduGroupRef = VCU_oATOM_CAN_Matrix_PT_V600_20250211_Tx_1feac34c
        ComIPduSignalGroupRef = SG_VCU_DCDC_SigGroup_oVCU_DCDC_oATOM_CAN_Matrix_PT_V600_20250211_d0a22af6_Tx
        ComPduIdRef = VCU_DCDC_oATOM_CAN_Matrix_PT_V600_20250211_2c28a723_Tx
        ComIPduMainFunctionRef = ComMainFunctionTx
        ComTxIPdu: ComMinimumDelayTime=0, ComTxIPduUnusedAreasDefault=0
          ComTxModeTrue
            ComTxMode: ComTxModeMode=PERIODIC, ComTxModeTimeOffset=0, ComTxModeTimePeriod=0.1
          ComTxModeFalse
            ComTxMode: ComTxModeMode=PERIODIC, ComTxModeTimeOffset=0, ComTxModeTimePeriod=0.1
      SG_VCU_06_SigGroup_oVCU_06_oATOM_CAN_Matrix_PT_V600_20250211_e447d442_Tx (ComSignalGroup): ComTransferProperty=PENDING, ComSignalGroupAccess=ACCESS_UNCLEAR, ComHandleId=6, ComSystemTemplateSignalGroupRef=SG_VCU_06_SigGroup
        6 x ComGroupSignal, all with ComSignalEndianness=BIG_ENDIAN, ComSignalInitValue=0, ComTransferProperty=PENDING, ComSignalAccess=ACCESS_UNCLEAR:
          VCU_MCUPower_oVCU_06_oATOM_CAN_Matrix_PT_V600_20250211_5ed6e72f_Tx: ComBitPosition=45, ComBitSize=10, ComSignalType=UINT16, ComHandleId=92, ComSystemTemplateSystemSignalRef=VCU_MCUPower
          VCU_PermitPackPTC_oVCU_06_oATOM_CAN_Matrix_PT_V600_20250211_8f94a915_Tx: ComBitPosition=15, ComBitSize=1, ComSignalType=BOOLEAN, ComHandleId=93, ComSystemTemplateSystemSignalRef=VCU_PermitPackPTC
          VCU_ChargeTime_oVCU_06_oATOM_CAN_Matrix_PT_V600_20250211_b03563a4_Tx: ComBitPosition=13, ComBitSize=12, ComSignalType=UINT16, ComHandleId=89, ComSystemTemplateSystemSignalRef=VCU_ChargeTime
          VCU_DisChgPowerLimit_oVCU_06_oATOM_CAN_Matrix_PT_V600_20250211_aae83d58_Tx: ComBitPosition=7, ComBitSize=8, ComSignalType=UINT8, ComHandleId=90, ComSystemTemplateSystemSignalRef=VCU_DisChgPowerLimit
          VCU_ChargeEnergy_oVCU_06_oATOM_CAN_Matrix_PT_V600_20250211_aa509ad7_Tx: ComBitPosition=49, ComBitSize=10, ComSignalType=UINT16, ComHandleId=88, ComSystemTemplateSystemSignalRef=VCU_ChargeEnergy
          VCU_DisplayMileage_oVCU_06_oATOM_CAN_Matrix_PT_V600_20250211_1f4b707e_Tx: ComBitPosition=39, ComBitSize=10, ComSignalType=UINT16, ComHandleId=91, ComSystemTemplateSystemSignalRef=VCU_DisplayMileage
      SG_BMS_PRO_SigGroup_oBMS_PRO_oATOM_CAN_Matrix_PT_V600_20250211_21a267c0_Rx (ComSignalGroup): ComTransferProperty=PENDING, ComSignalGroupAccess=ACCESS_UNCLEAR, ComHandleId=23, ComSystemTemplateSignalGroupRef=SG_BMS_PRO_SigGroup
        3 x ComGroupSignal, all with ComBitSize=8, ComSignalEndianness=BIG_ENDIAN, ComSignalInitValue=0, ComSignalType=UINT8, ComSignalAccess=ACCESS_UNCLEAR:
          BMS_BatProDatYear_oBMS_PRO_oATOM_CAN_Matrix_PT_V600_20250211_329b6492_Rx: ComBitPosition=7, ComHandleId=199, ComSystemTemplateSystemSignalRef=BMS_BatProDatYear
          BMS_BatProDatDay_oBMS_PRO_oATOM_CAN_Matrix_PT_V600_20250211_7f9a6bc2_Rx: ComBitPosition=23, ComHandleId=197, ComSystemTemplateSystemSignalRef=BMS_BatProDatDay
          BMS_BatProDatMonth_oBMS_PRO_oATOM_CAN_Matrix_PT_V600_20250211_a585932e_Rx: ComBitPosition=15, ComHandleId=198, ComSystemTemplateSystemSignalRef=BMS_BatProDatMonth
      4 x ComIPdu, all with ComIPduDirection=RECEIVE, ComIPduType=NORMAL, ComIPduSignalProcessing=DEFERRED, ComIPduCancellationSupport=false, ComIPduGroupRef=VCU_oATOM_CAN_Matrix_PT_V600_20250211_Rx_49b064ca, ComIPduMainFunctionRef=ComMainFunctionRx:
        CGW_VIN2_oATOM_CAN_Matrix_PT_V600_20250211_edcb66c5_Rx: ComIPduHandleId=33, ComIPduSignalGroupRef=SG_CGW_VIN2_SigGroup_oCGW_VIN2_oATOM_CAN_Matrix_PT_V600_20250211_c0accf92_Rx, ComPduIdRef=CGW_VIN2_oATOM_CAN_Matrix_PT_V600_20250211_edcb66c5_Rx
        POD_OBC_STATUS_02_oATOM_CAN_Matrix_PT_V600_20250211_5da6c285_Rx: ComIPduHandleId=72, ComIPduSignalGroupRef=SG_POD_OBC_STATUS_02_SigGroup_oPOD_OBC_STATUS_02_oATOM_CAN_Matrix_PT_V600_20250211_49c67a09_Rx, ComPduIdRef=POD_OBC_STATUS_02_oATOM_CAN_Matrix_PT_V600_20250211_5da6c285_Rx
        BMS_status_03_oATOM_CAN_Matrix_PT_V600_20250211_ee388b9e_Rx: ComIPduHandleId=28, ComIPduSignalGroupRef=SG_BMS_status_03_SigGroup_oBMS_status_03_oATOM_CAN_Matrix_PT_V600_20250211_b9a8f9fe_Rx, ComPduIdRef=BMS_status_03_oATOM_CAN_Matrix_PT_V600_20250211_ee388b9e_Rx
        BMS_BatInfor_03_oATOM_CAN_Matrix_PT_V600_20250211_83595004_Rx: ComIPduHandleId=15, ComIPduSignalGroupRef=SG_BMS_BatInfor_03_SigGroup_oBMS_BatInfor_03_oATOM_CAN_Matrix_PT_V600_20250211_f03896ae_Rx, ComPduIdRef=BMS_BatInfor_03_oATOM_CAN_Matrix_PT_V600_20250211_83595004_Rx
      7 x ComSignalGroup, all with ComTransferProperty=PENDING, ComSignalGroupAccess=ACCESS_UNCLEAR:
        SG_POD_Status_01_SigGroup_oPOD_Status_01_oATOM_CAN_Matrix_PT_V600_20250211_880c9d5a_Rx: ComHandleId=68, ComSystemTemplateSignalGroupRef=SG_POD_Status_01_SigGroup
          3 x ComGroupSignal, all with ComSignalEndianness=BIG_ENDIAN, ComSignalInitValue=0, ComSignalAccess=ACCESS_UNCLEAR:
            POD_DCInletTempA_oPOD_Status_01_oATOM_CAN_Matrix_PT_V600_20250211_3fbc48fa_Rx: ComBitPosition=39, ComBitSize=8, ComSignalType=UINT8, ComHandleId=472, ComSystemTemplateSystemSignalRef=POD_DCInletTempA
            POD_DCInletTempB_oPOD_Status_01_oATOM_CAN_Matrix_PT_V600_20250211_689e64a8_Rx: ComBitPosition=47, ComBitSize=8, ComSignalType=UINT8, ComHandleId=473, ComSystemTemplateSystemSignalRef=POD_DCInletTempB
            POD_DCFCVoltage_oPOD_Status_01_oATOM_CAN_Matrix_PT_V600_20250211_b89acdd0_Rx: ComBitPosition=12, ComBitSize=13, ComSignalType=UINT16, ComHandleId=471, ComSystemTemplateSystemSignalRef=POD_DCFCVoltage
        SG_BMS_BatInfor_02_SigGroup_oBMS_BatInfor_02_oATOM_CAN_Matrix_PT_V600_20250211_426bcc59_Rx: ComHandleId=14, ComSystemTemplateSignalGroupRef=SG_BMS_BatInfor_02_SigGroup
          BMS_BatSupName_oBMS_BatInfor_02_oATOM_CAN_Matrix_PT_V600_20250211_eaf2f758_Rx (ComGroupSignal):
            ComBitPosition = 0
            ComSignalEndianness = opaque
            ComSignalInitValue = 0 0 0 0 0 0 0 0
            ComSignalLength = 8
            ComSignalType = UINT8_N
            ComSignalAccess = ACCESS_UNCLEAR
            ComHandleId = 154
            ComSystemTemplateSystemSignalRef = BMS_BatSupName
        SG_BMS_Charge_03_SigGroup_oBMS_Charge_03_oATOM_CAN_Matrix_PT_V600_20250211_b7b455f8_Rx: ComHandleId=20, ComSystemTemplateSignalGroupRef=SG_BMS_Charge_03_SigGroup
          3 x ComGroupSignal, all with ComSignalEndianness=BIG_ENDIAN, ComSignalInitValue=0, ComSignalAccess=ACCESS_UNCLEAR:
            BMS_BatChagSum_oBMS_Charge_03_oATOM_CAN_Matrix_PT_V600_20250211_acd539d3_Rx: ComBitPosition=47, ComBitSize=16, ComSignalType=UINT16, ComHandleId=179, ComSystemTemplateSystemSignalRef=BMS_BatChagSum
            BMS_SumChgkwh_oBMS_Charge_03_oATOM_CAN_Matrix_PT_V600_20250211_483ef743_Rx: ComBitPosition=15, ComBitSize=25, ComSignalType=UINT32, ComHandleId=181, ComSystemTemplateSystemSignalRef=BMS_SumChgkwh
            BMS_SingChgkwh_oBMS_Charge_03_oATOM_CAN_Matrix_PT_V600_20250211_015ce54e_Rx: ComBitPosition=7, ComBitSize=8, ComSignalType=UINT8, ComHandleId=180, ComSystemTemplateSystemSignalRef=BMS_SingChgkwh
        SG_Uds_EPT_Boot_Response_SigGroup_oUds_EPT_Boot_Response_oATOM_CAN_Matrix_PT_V600_20250211_37dd7ff6_Tx: ComHandleId=0, ComSystemTemplateSignalGroupRef=SG_Uds_EPT_Boot_Response_SigGroup
          8 x ComGroupSignal, all with ComBitSize=8, ComSignalEndianness=LITTLE_ENDIAN, ComSignalInitValue=0, ComSignalType=UINT8, ComTransferProperty=TRIGGERED, ComSignalAccess=ACCESS_UNCLEAR:
            Uds_EPT_bootResponse_Byte1_oUds_EPT_Boot_Response_oATOM_CAN_Matrix_PT_V600_20250211_399cd346_Tx: ComBitPosition=8, ComHandleId=60, ComSystemTemplateSystemSignalRef=Uds_EPT_bootResponse_Byte1
            Uds_EPT_bootResponse_Byte6_oUds_EPT_Boot_Response_oATOM_CAN_Matrix_PT_V600_20250211_16b8fbfe_Tx: ComBitPosition=48, ComHandleId=65, ComSystemTemplateSystemSignalRef=Uds_EPT_bootResponse_Byte6
            Uds_EPT_bootResponse_Byte2_oUds_EPT_Boot_Response_oATOM_CAN_Matrix_PT_V600_20250211_e6d5c3f3_Tx: ComBitPosition=16, ComHandleId=61, ComSystemTemplateSystemSignalRef=Uds_EPT_bootResponse_Byte2
            Uds_EPT_bootResponse_Byte5_oUds_EPT_Boot_Response_oATOM_CAN_Matrix_PT_V600_20250211_c9f1eb4b_Tx: ComBitPosition=40, ComHandleId=64, ComSystemTemplateSystemSignalRef=Uds_EPT_bootResponse_Byte5
            Uds_EPT_bootResponse_Byte0_oUds_EPT_Boot_Response_oATOM_CAN_Matrix_PT_V600_20250211_735bdcd5_Tx: ComBitPosition=0, ComHandleId=59, ComSystemTemplateSystemSignalRef=Uds_EPT_bootResponse_Byte0
            Uds_EPT_bootResponse_Byte4_oUds_EPT_Boot_Response_oATOM_CAN_Matrix_PT_V600_20250211_8336e4d8_Tx: ComBitPosition=32, ComHandleId=63, ComSystemTemplateSystemSignalRef=Uds_EPT_bootResponse_Byte4
            Uds_EPT_bootResponse_Byte7_oUds_EPT_Boot_Response_oATOM_CAN_Matrix_PT_V600_20250211_5c7ff46d_Tx: ComBitPosition=56, ComHandleId=66, ComSystemTemplateSystemSignalRef=Uds_EPT_bootResponse_Byte7
            Uds_EPT_bootResponse_Byte3_oUds_EPT_Boot_Response_oATOM_CAN_Matrix_PT_V600_20250211_ac12cc60_Tx: ComBitPosition=24, ComHandleId=62, ComSystemTemplateSystemSignalRef=Uds_EPT_bootResponse_Byte3
        SG_BMS_ErrorInfo_SigGroup_oBMS_ErrorInfo_oATOM_CAN_Matrix_PT_V600_20250211_0728f72e_Rx: ComHandleId=22, ComSystemTemplateSignalGroupRef=SG_BMS_ErrorInfo_SigGroup
          10 x ComGroupSignal, all with ComSignalEndianness=BIG_ENDIAN, ComSignalInitValue=0, ComSignalAccess=ACCESS_UNCLEAR:
            BMS_ErrorChaCurrentOver_oBMS_ErrorInfo_oATOM_CAN_Matrix_PT_V600_20250211_a2ef7503_Rx: ComBitPosition=11, ComBitSize=2, ComSignalType=UINT8, ComHandleId=191, ComSystemTemplateSystemSignalRef=BMS_ErrorChaCurrentOver
            BMS_ErrorHighSoc_oBMS_ErrorInfo_oATOM_CAN_Matrix_PT_V600_20250211_73bd0212_Rx: ComBitPosition=35, ComBitSize=1, ComSignalType=BOOLEAN, ComHandleId=192, ComSystemTemplateSystemSignalRef=BMS_ErrorHighSoc
            BMS_ErrorPreChaFailed_oBMS_ErrorInfo_oATOM_CAN_Matrix_PT_V600_20250211_59a6a965_Rx: ComBitPosition=26, ComBitSize=1, ComSignalType=BOOLEAN, ComHandleId=194, ComSystemTemplateSystemSignalRef=BMS_ErrorPreChaFailed
            BMS_ErrorCellHighTemp_oBMS_ErrorInfo_oATOM_CAN_Matrix_PT_V600_20250211_99700c48_Rx: ComBitPosition=3, ComBitSize=2, ComSignalType=UINT8, ComHandleId=187, ComSystemTemplateSystemSignalRef=BMS_ErrorCellHighTemp
            BMS_ErrorCellOverVolt_oBMS_ErrorInfo_oATOM_CAN_Matrix_PT_V600_20250211_5db8e4a2_Rx: ComBitPosition=7, ComBitSize=2, ComSignalType=UINT8, ComHandleId=189, ComSystemTemplateSystemSignalRef=BMS_ErrorCellOverVolt
            BMS_ThermalRunawayFault_oBMS_ErrorInfo_oATOM_CAN_Matrix_PT_V600_20250211_bc9ae26c_Rx: ComBitPosition=43, ComBitSize=1, ComSignalType=BOOLEAN, ComHandleId=196, ComSystemTemplateSystemSignalRef=BMS_ThermalRunawayFault
            BMS_ErrorLowSoc_oBMS_ErrorInfo_oATOM_CAN_Matrix_PT_V600_20250211_b96841e2_Rx: ComBitPosition=37, ComBitSize=2, ComSignalType=UINT8, ComHandleId=193, ComSystemTemplateSystemSignalRef=BMS_ErrorLowSoc
            BMS_ErrorCellUnderVolt_oBMS_ErrorInfo_oATOM_CAN_Matrix_PT_V600_20250211_56775465_Rx: ComBitPosition=5, ComBitSize=2, ComSignalType=UINT8, ComHandleId=190, ComSystemTemplateSystemSignalRef=BMS_ErrorCellUnderVolt
            BMS_ErrorRelay_oBMS_ErrorInfo_oATOM_CAN_Matrix_PT_V600_20250211_117a9031_Rx: ComBitPosition=25, ComBitSize=1, ComSignalType=BOOLEAN, ComHandleId=195, ComSystemTemplateSystemSignalRef=BMS_ErrorRelay
            BMS_ErrorCellLowTemp_oBMS_ErrorInfo_oATOM_CAN_Matrix_PT_V600_20250211_c40cc4fe_Rx: ComBitPosition=1, ComBitSize=2, ComSignalType=UINT8, ComHandleId=188, ComSystemTemplateSystemSignalRef=BMS_ErrorCellLowTemp
        SG_POD_OBC_STATUS_04_SigGroup_oPOD_OBC_STATUS_04_oATOM_CAN_Matrix_PT_V600_20250211_bdcb78f3_Rx: ComHandleId=67, ComSystemTemplateSignalGroupRef=SG_POD_OBC_STATUS_04_SigGroup
          6 x ComGroupSignal, all with ComSignalEndianness=BIG_ENDIAN, ComSignalInitValue=0, ComSignalType=UINT16, ComSignalAccess=ACCESS_UNCLEAR:
            POD_OBC_InputACVoltage_R_oPOD_OBC_STATUS_04_oATOM_CAN_Matrix_PT_V600_20250211_779a5b73_Rx: ComBitPosition=27, ComBitSize=12, ComHandleId=468, ComSystemTemplateSystemSignalRef=POD_OBC_InputACVoltage_R
            POD_OBC_InputACCurrent_S_oPOD_OBC_STATUS_04_oATOM_CAN_Matrix_PT_V600_20250211_6b3657a6_Rx: ComBitPosition=13, ComBitSize=9, ComHandleId=466, ComSystemTemplateSystemSignalRef=POD_OBC_InputACCurrent_S
            POD_OBC_InputACVoltage_T_oPOD_OBC_STATUS_04_oATOM_CAN_Matrix_PT_V600_20250211_7247aec7_Rx: ComBitPosition=51, ComBitSize=12, ComHandleId=470, ComSystemTemplateSystemSignalRef=POD_OBC_InputACVoltage_T
            POD_OBC_InputACCurrent_T_oPOD_OBC_STATUS_04_oATOM_CAN_Matrix_PT_V600_20250211_6f4e0ba4_Rx: ComBitPosition=20, ComBitSize=9, ComHandleId=467, ComSystemTemplateSystemSignalRef=POD_OBC_InputACCurrent_T
            POD_OBC_InputACVoltage_S_oPOD_OBC_STATUS_04_oATOM_CAN_Matrix_PT_V600_20250211_763ff2c5_Rx: ComBitPosition=47, ComBitSize=12, ComHandleId=469, ComSystemTemplateSystemSignalRef=POD_OBC_InputACVoltage_S
            POD_OBC_InputACCurrent_R_oPOD_OBC_STATUS_04_oATOM_CAN_Matrix_PT_V600_20250211_6a93fe10_Rx: ComBitPosition=7, ComBitSize=10, ComHandleId=465, ComSystemTemplateSystemSignalRef=POD_OBC_InputACCurrent_R
        SG_VCU_MCU_03_SigGroup_oVCU_MCU_03_oATOM_CAN_Matrix_PT_V600_20250211_ff58040a_Tx: ComHandleId=21, ComSystemTemplateSignalGroupRef=SG_VCU_MCU_03_SigGroup
          11 x ComGroupSignal, all with ComSignalEndianness=BIG_ENDIAN, ComSignalInitValue=0, ComTransferProperty=PENDING, ComSignalAccess=ACCESS_UNCLEAR:
            VCU_MCUDesiredTorque_oVCU_MCU_03_oATOM_CAN_Matrix_PT_V600_20250211_9f2e292a_Tx: ComBitPosition=23, ComBitSize=11, ComSignalType=UINT16, ComHandleId=226, ComSystemTemplateSystemSignalRef=VCU_MCUDesiredTorque
            MessageCounter_095_oVCU_MCU_03_oATOM_CAN_Matrix_PT_V600_20250211_97fb6b98_Tx: ComBitPosition=11, ComBitSize=4, ComSignalType=UINT8, ComHandleId=222, ComSystemTemplateSystemSignalRef=MessageCounter_095
            VCU_RequestedModeMCU_oVCU_MCU_03_oATOM_CAN_Matrix_PT_V600_20250211_a8922b7c_Tx: ComBitPosition=43, ComBitSize=4, ComSignalType=UINT8, ComHandleId=229, ComSystemTemplateSystemSignalRef=VCU_RequestedModeMCU
            VCU_KL15eOn_oVCU_MCU_03_oATOM_CAN_Matrix_PT_V600_20250211_1c5ba0a1_Tx: ComBitPosition=39, ComBitSize=1, ComSignalType=BOOLEAN, ComHandleId=225, ComSystemTemplateSystemSignalRef=VCU_KL15eOn
            VCU_TCSActive_oVCU_MCU_03_oATOM_CAN_Matrix_PT_V600_20250211_c8bc2da2_Tx: ComBitPosition=38, ComBitSize=1, ComSignalType=BOOLEAN, ComHandleId=230, ComSystemTemplateSystemSignalRef=VCU_TCSActive
            VCU_MCUSurgeDamperState_oVCU_MCU_03_oATOM_CAN_Matrix_PT_V600_20250211_74632c3f_Tx: ComBitPosition=37, ComBitSize=2, ComSignalType=UINT8, ComHandleId=227, ComSystemTemplateSystemSignalRef=VCU_MCUSurgeDamperState
            VCU_TrqThresholdDampgCtl_oVCU_MCU_03_oATOM_CAN_Matrix_PT_V600_20250211_b9ab6cb7_Tx: ComBitPosition=55, ComBitSize=8, ComSignalType=UINT8, ComHandleId=231, ComSystemTemplateSystemSignalRef=VCU_TrqThresholdDampgCtl
            Checksum_095_oVCU_MCU_03_oATOM_CAN_Matrix_PT_V600_20250211_3f161474_Tx: ComBitPosition=7, ComBitSize=8, ComSignalType=UINT8, ComHandleId=221, ComSystemTemplateSystemSignalRef=Checksum_095
            VCU_ActualGear_oVCU_MCU_03_oATOM_CAN_Matrix_PT_V600_20250211_92924ed4_Tx: ComBitPosition=34, ComBitSize=3, ComSignalType=UINT8, ComHandleId=223, ComSystemTemplateSystemSignalRef=VCU_ActualGear
            VCU_BrakepedalStatus_oVCU_MCU_03_oATOM_CAN_Matrix_PT_V600_20250211_cdd89588_Tx: ComBitPosition=47, ComBitSize=2, ComSignalType=UINT8, ComHandleId=224, ComSystemTemplateSystemSignalRef=VCU_BrakepedalStatus
            VCU_PWTErrorLevel_oVCU_MCU_03_oATOM_CAN_Matrix_PT_V600_20250211_7878dbff_Tx: ComBitPosition=15, ComBitSize=4, ComSignalType=UINT8, ComHandleId=228, ComSystemTemplateSystemSignalRef=VCU_PWTErrorLevel
      SGW_16_oATOM_CAN_Matrix_PT_V600_20250211_6bfd3d6f_Rx (ComIPdu):
        ComIPduDirection = RECEIVE
        ComIPduType = NORMAL
        ComIPduHandleId = 80
        ComIPduSignalProcessing = DEFERRED
        ComIPduCancellationSupport = false
        ComIPduGroupRef = VCU_oATOM_CAN_Matrix_PT_V600_20250211_Rx_49b064ca
        ComIPduSignalGroupRef = SG_SGW_16_SigGroup_oSGW_16_oATOM_CAN_Matrix_PT_V600_20250211_194d06e6_Rx
        ComPduIdRef = SGW_16_oATOM_CAN_Matrix_PT_V600_20250211_6bfd3d6f_Rx
        ComIPduMainFunctionRef = ComMainFunctionRx
      4 x ComSignalGroup, all with ComTransferProperty=PENDING, ComSignalGroupAccess=ACCESS_UNCLEAR:
        SG_VCU_POD_SigGroup_oVCU_POD_oATOM_CAN_Matrix_PT_V600_20250211_c17d64e5_Tx: ComHandleId=23, ComSystemTemplateSignalGroupRef=SG_VCU_POD_SigGroup
          5 x ComGroupSignal, all with ComSignalEndianness=BIG_ENDIAN, ComTransferProperty=PENDING, ComSignalAccess=ACCESS_UNCLEAR:
            VCU_Enable_DC_Relay_oVCU_POD_oATOM_CAN_Matrix_PT_V600_20250211_187d15ec_Tx: ComBitPosition=23, ComBitSize=1, ComSignalInitValue=1, ComSignalType=BOOLEAN, ComHandleId=238, ComSystemTemplateSystemSignalRef=VCU_Enable_DC_Relay
            VCU_OBC_ChargeCurrentCommand_oVCU_POD_oATOM_CAN_Matrix_PT_V600_20250211_afae32a2_Tx: ComBitPosition=31, ComBitSize=13, ComSignalInitValue=0, ComSignalType=UINT16, ComHandleId=239, ComSystemTemplateSystemSignalRef=VCU_OBC_ChargeCurrentCommand
            VCU_EnableOBC_oVCU_POD_oATOM_CAN_Matrix_PT_V600_20250211_316adab0_Tx: ComBitPosition=19, ComBitSize=2, ComSignalInitValue=0, ComSignalType=UINT8, ComHandleId=237, ComSystemTemplateSystemSignalRef=VCU_EnableOBC
            VCU_OBC_Control_of_S2_SW_oVCU_POD_oATOM_CAN_Matrix_PT_V600_20250211_2bbcc657_Tx: ComBitPosition=22, ComBitSize=1, ComSignalInitValue=1, ComSignalType=BOOLEAN, ComHandleId=240, ComSystemTemplateSystemSignalRef=VCU_OBC_Control_of_S2_SW
            VCU_OBC_Control_of_em_lock_oVCU_POD_oATOM_CAN_Matrix_PT_V600_20250211_476ced65_Tx: ComBitPosition=21, ComBitSize=1, ComSignalInitValue=1, ComSignalType=BOOLEAN, ComHandleId=241, ComSystemTemplateSystemSignalRef=VCU_OBC_Control_of_em_lock
        SG_IVI_OdometerInfor_SigGroup_oIVI_OdometerInfor_oATOM_CAN_Matrix_PT_V600_20250211_3516238b_Rx: ComHandleId=55, ComSystemTemplateSignalGroupRef=SG_IVI_OdometerInfor_SigGroup
          IVI_OdometerInfor_oIVI_OdometerInfor_oATOM_CAN_Matrix_PT_V600_20250211_e6e371ee_Rx (ComGroupSignal):
            ComBitPosition = 7
            ComBitSize = 24
            ComSignalEndianness = BIG_ENDIAN
            ComSignalInitValue = 0
            ComSignalType = UINT32
            ComSignalAccess = ACCESS_UNCLEAR
            ComHandleId = 424
            ComSystemTemplateSystemSignalRef = IVI_OdometerInfor
        SG_BMS_DIRelayState_SigGroup_oBMS_DIRelayState_oATOM_CAN_Matrix_PT_V600_20250211_ca554d8c_Rx: ComHandleId=21, ComSystemTemplateSignalGroupRef=SG_BMS_DIRelayState_SigGroup
          5 x ComGroupSignal, all with ComSignalEndianness=BIG_ENDIAN, ComSignalInitValue=0, ComSignalAccess=ACCESS_UNCLEAR:
            BMS_NegRelayStatus_oBMS_DIRelayState_oATOM_CAN_Matrix_PT_V600_20250211_cb3f998e_Rx: ComBitPosition=3, ComBitSize=2, ComSignalType=UINT8, ComHandleId=182, ComSystemTemplateSystemSignalRef=BMS_NegRelayStatus
            BMS_PreRelayStatus_oBMS_DIRelayState_oATOM_CAN_Matrix_PT_V600_20250211_51af39b6_Rx: ComBitPosition=1, ComBitSize=2, ComSignalType=UINT8, ComHandleId=186, ComSystemTemplateSystemSignalRef=BMS_PreRelayStatus
            BMS_PTCRelayStatus_oBMS_DIRelayState_oATOM_CAN_Matrix_PT_V600_20250211_51f2d2bd_Rx: ComBitPosition=5, ComBitSize=2, ComSignalType=UINT8, ComHandleId=183, ComSystemTemplateSystemSignalRef=BMS_PTCRelayStatus
            BMS_PTC_VoltageValue_oBMS_DIRelayState_oATOM_CAN_Matrix_PT_V600_20250211_01e2b502_Rx: ComBitPosition=39, ComBitSize=10, ComSignalType=UINT16, ComHandleId=184, ComSystemTemplateSystemSignalRef=BMS_PTC_VoltageValue
            BMS_PosRelayStatus_oBMS_DIRelayState_oATOM_CAN_Matrix_PT_V600_20250211_0aa0be71_Rx: ComBitPosition=7, ComBitSize=2, ComSignalType=UINT8, ComHandleId=185, ComSystemTemplateSystemSignalRef=BMS_PosRelayStatus
        SG_DCM_RL_SigGroup_oDCM_RL_oATOM_CAN_Matrix_PT_V600_20250211_a6554e24_Rx: ComHandleId=38, ComSystemTemplateSignalGroupRef=SG_DCM_RL_SigGroup
          DCM_RL_DoorRLSts_oDCM_RL_oATOM_CAN_Matrix_PT_V600_20250211_9ea56f59_Rx (ComGroupSignal):
            ComBitPosition = 54
            ComBitSize = 1
            ComSignalEndianness = BIG_ENDIAN
            ComSignalInitValue = 0
            ComSignalType = BOOLEAN
            ComSignalAccess = ACCESS_UNCLEAR
            ComHandleId = 287
            ComSystemTemplateSystemSignalRef = DCM_RL_DoorRLSts
      3 x ComIPdu, all with ComIPduType=NORMAL, ComIPduSignalProcessing=DEFERRED, ComIPduCancellationSupport=false:
        VCU_06_oATOM_CAN_Matrix_PT_V600_20250211_a07ded02_Tx: ComIPduDirection=SEND, ComIPduHandleId=9, ComIPduGroupRef=VCU_oATOM_CAN_Matrix_PT_V600_20250211_Tx_1feac34c, ComIPduSignalGroupRef=SG_VCU_06_SigGroup_oVCU_06_oATOM_CAN_Matrix_PT_V600_20250211_e447d442_Tx, ComPduIdRef=VCU_06_oATOM_CAN_Matrix_PT_V600_20250211_a07ded02_Tx, ComIPduMainFunctionRef=ComMainFunctionTx
          ComTxIPdu: ComMinimumDelayTime=0, ComTxIPduUnusedAreasDefault=0
            ComTxModeTrue
              ComTxMode: ComTxModeMode=PERIODIC, ComTxModeTimeOffset=0, ComTxModeTimePeriod=0.1
            ComTxModeFalse
              ComTxMode: ComTxModeMode=PERIODIC, ComTxModeTimeOffset=0, ComTxModeTimePeriod=0.1
        POD_DCDC_01_oATOM_CAN_Matrix_PT_V600_20250211_6e196312_Rx: ComIPduDirection=RECEIVE, ComIPduHandleId=69, ComIPduGroupRef=VCU_oATOM_CAN_Matrix_PT_V600_20250211_Rx_49b064ca, ComIPduSignalGroupRef=SG_POD_DCDC_01_SigGroup_oPOD_DCDC_01_oATOM_CAN_Matrix_PT_V600_20250211_c0cfae4d_Rx, ComPduIdRef=POD_DCDC_01_oATOM_CAN_Matrix_PT_V600_20250211_6e196312_Rx, ComIPduMainFunctionRef=ComMainFunctionRx
        CGW_02_oATOM_CAN_Matrix_PT_V600_20250211_82f0b9a6_Rx: ComIPduDirection=RECEIVE, ComIPduHandleId=31, ComIPduGroupRef=VCU_oATOM_CAN_Matrix_PT_V600_20250211_Rx_49b064ca, ComIPduSignalGroupRef=SG_CGW_02_SigGroup_oCGW_02_oATOM_CAN_Matrix_PT_V600_20250211_a306e41a_Rx, ComPduIdRef=CGW_02_oATOM_CAN_Matrix_PT_V600_20250211_82f0b9a6_Rx, ComIPduMainFunctionRef=ComMainFunctionRx
      SG_VCU_BMS_SigGroup_oVCU_BMS_oATOM_CAN_Matrix_PT_V600_20250211_ed2292a1_Tx (ComSignalGroup): ComTransferProperty=PENDING, ComSignalGroupAccess=ACCESS_UNCLEAR, ComHandleId=10, ComSystemTemplateSignalGroupRef=SG_VCU_BMS_SigGroup
        13 x ComGroupSignal, all with ComSignalEndianness=BIG_ENDIAN, ComTransferProperty=PENDING, ComSignalAccess=ACCESS_UNCLEAR:
          VCU_BMS_Control_of_PosRelay_oVCU_BMS_oATOM_CAN_Matrix_PT_V600_20250211_f5e4abc7_Tx: ComBitPosition=53, ComBitSize=2, ComSignalInitValue=0, ComSignalType=UINT8, ComHandleId=137, ComSystemTemplateSystemSignalRef=VCU_BMS_Control_of_PosRelay
          VCU_HVStatus_oVCU_BMS_oATOM_CAN_Matrix_PT_V600_20250211_91e61e2b_Tx: ComBitPosition=31, ComBitSize=4, ComSignalInitValue=0, ComSignalType=UINT8, ComHandleId=140, ComSystemTemplateSystemSignalRef=VCU_HVStatus
          Checksum_0D1_oVCU_BMS_oATOM_CAN_Matrix_PT_V600_20250211_f7156dad_Tx: ComBitPosition=7, ComBitSize=8, ComSignalInitValue=0, ComSignalType=UINT8, ComHandleId=133, ComSystemTemplateSystemSignalRef=Checksum_0D1
          VCU_RequestedModeBMS_oVCU_BMS_oATOM_CAN_Matrix_PT_V600_20250211_9c440503_Tx: ComBitPosition=23, ComBitSize=3, ComSignalInitValue=0, ComSignalType=UINT8, ComHandleId=145, ComSystemTemplateSystemSignalRef=VCU_RequestedModeBMS
          VCU_BMSTargetThermLevel_oVCU_BMS_oATOM_CAN_Matrix_PT_V600_20250211_a19e3360_Tx: ComBitPosition=55, ComBitSize=2, ComSignalInitValue=0, ComSignalType=UINT8, ComHandleId=136, ComSystemTemplateSystemSignalRef=VCU_BMSTargetThermLevel
          MessageCounter_0D1_oVCU_BMS_oATOM_CAN_Matrix_PT_V600_20250211_3d6fc815_Tx: ComBitPosition=11, ComBitSize=4, ComSignalInitValue=0, ComSignalType=UINT8, ComHandleId=134, ComSystemTemplateSystemSignalRef=MessageCounter_0D1
          VCU_ActDriveMode_oVCU_BMS_oATOM_CAN_Matrix_PT_V600_20250211_fe9bd573_Tx: ComBitPosition=37, ComBitSize=3, ComSignalInitValue=0, ComSignalType=UINT8, ComHandleId=135, ComSystemTemplateSystemSignalRef=VCU_ActDriveMode
          VCU_RegenBrakeLightReqVld_oVCU_BMS_oATOM_CAN_Matrix_PT_V600_20250211_8dddfa78_Tx: ComBitPosition=41, ComBitSize=1, ComSignalInitValue=0, ComSignalType=BOOLEAN, ComHandleId=143, ComSystemTemplateSystemSignalRef=VCU_RegenBrakeLightReqVld
          VCU_ChargeStatus_oVCU_BMS_oATOM_CAN_Matrix_PT_V600_20250211_28aae98c_Tx: ComBitPosition=27, ComBitSize=4, ComSignalInitValue=0, ComSignalType=UINT8, ComHandleId=138, ComSystemTemplateSystemSignalRef=VCU_ChargeStatus
          VCU_RegenBrakeLightRequest_oVCU_BMS_oATOM_CAN_Matrix_PT_V600_20250211_aa6abc7c_Tx: ComBitPosition=40, ComBitSize=1, ComSignalInitValue=0, ComSignalType=BOOLEAN, ComHandleId=144, ComSystemTemplateSystemSignalRef=VCU_RegenBrakeLightRequest
          VCU_DrvModSwitchWarn_oVCU_BMS_oATOM_CAN_Matrix_PT_V600_20250211_b5dc0276_Tx: ComBitPosition=34, ComBitSize=3, ComSignalInitValue=0, ComSignalType=UINT8, ComHandleId=139, ComSystemTemplateSystemSignalRef=VCU_DrvModSwitchWarn
          VCU_LimitLevel_oVCU_BMS_oATOM_CAN_Matrix_PT_V600_20250211_ab1dff7a_Tx: ComBitPosition=39, ComBitSize=2, ComSignalInitValue=0, ComSignalType=UINT8, ComHandleId=142, ComSystemTemplateSystemSignalRef=VCU_LimitLevel
          VCU_IsoMeasurementSwitch_oVCU_BMS_oATOM_CAN_Matrix_PT_V600_20250211_e8fa1d83_Tx: ComBitPosition=14, ComBitSize=1, ComSignalInitValue=1, ComSignalType=BOOLEAN, ComHandleId=141, ComSystemTemplateSystemSignalRef=VCU_IsoMeasurementSwitch
      SG_VCU_MCU_05_SigGroup_oVCU_MCU_05_oATOM_CAN_Matrix_PT_V600_20250211_7ef1168b_Tx (ComSignalGroup): ComTransferProperty=PENDING, ComSignalGroupAccess=ACCESS_UNCLEAR, ComHandleId=22, ComSystemTemplateSignalGroupRef=SG_VCU_MCU_05_SigGroup
        5 x ComGroupSignal, all with ComSignalEndianness=BIG_ENDIAN, ComSignalInitValue=0, ComSignalType=UINT16, ComTransferProperty=PENDING, ComSignalAccess=ACCESS_UNCLEAR:
          VCU_CreepTorque_oVCU_MCU_05_oATOM_CAN_Matrix_PT_V600_20250211_7425dee6_Tx: ComBitPosition=47, ComBitSize=11, ComHandleId=232, ComSystemTemplateSystemSignalRef=VCU_CreepTorque
          VCU_MaxTorqueGradient_oVCU_MCU_05_oATOM_CAN_Matrix_PT_V600_20250211_2927c5de_Tx: ComBitPosition=7, ComBitSize=14, ComHandleId=233, ComSystemTemplateSystemSignalRef=VCU_MaxTorqueGradient
          VCU_MaxTorqueLimit_oVCU_MCU_05_oATOM_CAN_Matrix_PT_V600_20250211_3a034e45_Tx: ComBitPosition=26, ComBitSize=11, ComHandleId=234, ComSystemTemplateSystemSignalRef=VCU_MaxTorqueLimit
          VCU_SpdLimitActTorque_oVCU_MCU_05_oATOM_CAN_Matrix_PT_V600_20250211_6de9d8ce_Tx: ComBitPosition=50, ComBitSize=11, ComHandleId=236, ComSystemTemplateSystemSignalRef=VCU_SpdLimitActTorque
          VCU_MinTorqueLimit_oVCU_MCU_05_oATOM_CAN_Matrix_PT_V600_20250211_d434a6d2_Tx: ComBitPosition=23, ComBitSize=11, ComHandleId=235, ComSystemTemplateSystemSignalRef=VCU_MinTorqueLimit
      BCM_11_oATOM_CAN_Matrix_PT_V600_20250211_10f11df6_Rx (ComIPdu):
        ComIPduDirection = RECEIVE
        ComIPduType = NORMAL
        ComIPduHandleId = 11
        ComIPduSignalProcessing = DEFERRED
        ComIPduCancellationSupport = false
        ComIPduGroupRef = VCU_oATOM_CAN_Matrix_PT_V600_20250211_Rx_49b064ca
        ComIPduSignalGroupRef = SG_BCM_11_SigGroup_oBCM_11_oATOM_CAN_Matrix_PT_V600_20250211_59b7aa06_Rx
        ComPduIdRef = BCM_11_oATOM_CAN_Matrix_PT_V600_20250211_10f11df6_Rx
        ComIPduMainFunctionRef = ComMainFunctionRx
      SGW_VCU_01_oATOM_CAN_Matrix_PT_V600_20250211_0e1163ba_Rx (ComIPdu):
        ComIPduDirection = RECEIVE
        ComIPduType = NORMAL
        ComIPduHandleId = 86
        ComIPduSignalProcessing = DEFERRED
        ComIPduCancellationSupport = false
        ComIPduGroupRef = VCU_oATOM_CAN_Matrix_PT_V600_20250211_Rx_49b064ca
        ComIPduSignalGroupRef = SG_SGW_VCU_01_SigGroup_oSGW_VCU_01_oATOM_CAN_Matrix_PT_V600_20250211_899d317b_Rx
        ComPduIdRef = SGW_VCU_01_oATOM_CAN_Matrix_PT_V600_20250211_0e1163ba_Rx
        ComIPduMainFunctionRef = ComMainFunctionRx
      3 x ComSignalGroup, all with ComTransferProperty=PENDING, ComSignalGroupAccess=ACCESS_UNCLEAR:
        SG_APTC_TCU_SigGroup_oAPTC_TCU_oATOM_CAN_Matrix_PT_V600_20250211_467c0275_Rx: ComHandleId=8, ComSystemTemplateSignalGroupRef=SG_APTC_TCU_SigGroup
          APTC_PowerConsumption_oAPTC_TCU_oATOM_CAN_Matrix_PT_V600_20250211_1649be11_Rx (ComGroupSignal):
            ComBitPosition = 31
            ComBitSize = 8
            ComSignalEndianness = BIG_ENDIAN
            ComSignalInitValue = 0
            ComSignalType = UINT8
            ComSignalAccess = ACCESS_UNCLEAR
            ComHandleId = 121
            ComSystemTemplateSystemSignalRef = APTC_PowerConsumption
        SG_POD_DCDC_01_SigGroup_oPOD_DCDC_01_oATOM_CAN_Matrix_PT_V600_20250211_c0cfae4d_Rx: ComHandleId=62, ComSystemTemplateSignalGroupRef=SG_POD_DCDC_01_SigGroup
          3 x ComGroupSignal, all with ComSignalEndianness=BIG_ENDIAN, ComSignalInitValue=0, ComSignalAccess=ACCESS_UNCLEAR:
            POD_DCDC_HVInputCurrent_oPOD_DCDC_01_oATOM_CAN_Matrix_PT_V600_20250211_135e2f35_Rx: ComBitPosition=55, ComBitSize=8, ComSignalType=UINT8, ComHandleId=442, ComSystemTemplateSystemSignalRef=POD_DCDC_HVInputCurrent
            POD_DCDC_WorkMode_oPOD_DCDC_01_oATOM_CAN_Matrix_PT_V600_20250211_444a4f6b_Rx: ComBitPosition=28, ComBitSize=3, ComSignalType=UINT8, ComHandleId=444, ComSystemTemplateSystemSignalRef=POD_DCDC_WorkMode
            POD_DCDC_HVInputVoltage_oPOD_DCDC_01_oATOM_CAN_Matrix_PT_V600_20250211_9c7a540a_Rx: ComBitPosition=9, ComBitSize=13, ComSignalType=UINT16, ComHandleId=443, ComSystemTemplateSystemSignalRef=POD_DCDC_HVInputVoltage
        SG_SGW_Time_SigGroup_oSGW_Time_oATOM_CAN_Matrix_PT_V600_20250211_0ca37593_Rx: ComHandleId=78, ComSystemTemplateSignalGroupRef=SG_SGW_Time_SigGroup
          7 x ComGroupSignal, all with ComSignalEndianness=BIG_ENDIAN, ComSignalAccess=ACCESS_UNCLEAR:
            SGW_TimeInfoDay_oSGW_Time_oATOM_CAN_Matrix_PT_V600_20250211_880a47df_Rx: ComBitPosition=31, ComBitSize=5, ComSignalInitValue=1, ComSignalType=UINT8, ComHandleId=500, ComSystemTemplateSystemSignalRef=SGW_TimeInfoDay
            SGW_TimeInfoSecond_oSGW_Time_oATOM_CAN_Matrix_PT_V600_20250211_ed2116e5_Rx: ComBitPosition=7, ComBitSize=6, ComSignalInitValue=0, ComSignalType=UINT8, ComHandleId=504, ComSystemTemplateSystemSignalRef=SGW_TimeInfoSecond
            SGW_TimeValid_oSGW_Time_oATOM_CAN_Matrix_PT_V600_20250211_4cd83a01_Rx: ComBitPosition=41, ComBitSize=1, ComSignalInitValue=1, ComSignalType=BOOLEAN, ComHandleId=506, ComSystemTemplateSystemSignalRef=SGW_TimeValid
            SGW_TimeInfoYear_oSGW_Time_oATOM_CAN_Matrix_PT_V600_20250211_76136356_Rx: ComBitPosition=47, ComBitSize=6, ComSignalInitValue=0, ComSignalType=UINT8, ComHandleId=505, ComSystemTemplateSystemSignalRef=SGW_TimeInfoYear
            SGW_TimeInfoHour_oSGW_Time_oATOM_CAN_Matrix_PT_V600_20250211_bc8cc791_Rx: ComBitPosition=23, ComBitSize=5, ComSignalInitValue=0, ComSignalType=UINT8, ComHandleId=501, ComSystemTemplateSystemSignalRef=SGW_TimeInfoHour
            SGW_TimeInfoMonth_oSGW_Time_oATOM_CAN_Matrix_PT_V600_20250211_0acdad62_Rx: ComBitPosition=39, ComBitSize=4, ComSignalInitValue=1, ComSignalType=UINT8, ComHandleId=503, ComSystemTemplateSystemSignalRef=SGW_TimeInfoMonth
            SGW_TimeInfoMinute_oSGW_Time_oATOM_CAN_Matrix_PT_V600_20250211_107045bf_Rx: ComBitPosition=15, ComBitSize=6, ComSignalInitValue=0, ComSignalType=UINT8, ComHandleId=502, ComSystemTemplateSystemSignalRef=SGW_TimeInfoMinute
      Uds_EPT_Boot_Response_oATOM_CAN_Matrix_PT_V600_20250211_8bdda24d_Tx (ComIPdu):
        ComIPduDirection = SEND
        ComIPduType = NORMAL
        ComIPduHandleId = 3
        ComIPduSignalProcessing = DEFERRED
        ComIPduCancellationSupport = false
        ComIPduGroupRef = VCU_oATOM_CAN_Matrix_PT_V600_20250211_Tx_1feac34c
        ComIPduSignalGroupRef = SG_Uds_EPT_Boot_Response_SigGroup_oUds_EPT_Boot_Response_oATOM_CAN_Matrix_PT_V600_20250211_37dd7ff6_Tx
        ComPduIdRef = Uds_EPT_Boot_Response_oATOM_CAN_Matrix_PT_V600_20250211_8bdda24d_Tx
        ComIPduMainFunctionRef = ComMainFunctionTx
        ComTxIPdu: ComMinimumDelayTime=0, ComTxIPduUnusedAreasDefault=0
          ComTxModeTrue
            ComTxMode: ComTxModeMode=DIRECT, ComTxModeNumberOfRepetitions=0, ComTxModeRepetitionPeriod=0
          ComTxModeFalse
            ComTxMode: ComTxModeMode=DIRECT, ComTxModeNumberOfRepetitions=0, ComTxModeRepetitionPeriod=0
      3 x ComSignalGroup, all with ComTransferProperty=PENDING, ComSignalGroupAccess=ACCESS_UNCLEAR:
        SG_DCM_FR_SigGroup_oDCM_FR_oATOM_CAN_Matrix_PT_V600_20250211_eb540c93_Rx: ComHandleId=37, ComSystemTemplateSignalGroupRef=SG_DCM_FR_SigGroup
          DCM_FR_DoorFRSts_oDCM_FR_oATOM_CAN_Matrix_PT_V600_20250211_525d6e8b_Rx (ComGroupSignal):
            ComBitPosition = 54
            ComBitSize = 1
            ComSignalEndianness = BIG_ENDIAN
            ComSignalInitValue = 0
            ComSignalType = BOOLEAN
            ComSignalAccess = ACCESS_UNCLEAR
            ComHandleId = 286
            ComSystemTemplateSystemSignalRef = DCM_FR_DoorFRSts
        SG_DCM_RR_SigGroup_oDCM_RR_oATOM_CAN_Matrix_PT_V600_20250211_9219ec09_Rx: ComHandleId=39, ComSystemTemplateSignalGroupRef=SG_DCM_RR_SigGroup
          DCM_RR_DoorRRSts_oDCM_RR_oATOM_CAN_Matrix_PT_V600_20250211_c830eb38_Rx (ComGroupSignal):
            ComBitPosition = 54
            ComBitSize = 1
            ComSignalEndianness = BIG_ENDIAN
            ComSignalInitValue = 0
            ComSignalType = BOOLEAN
            ComSignalAccess = ACCESS_UNCLEAR
            ComHandleId = 288
            ComSystemTemplateSystemSignalRef = DCM_RR_DoorRRSts
        SG_SGW_01_SigGroup_oSGW_01_oATOM_CAN_Matrix_PT_V600_20250211_37bbfdeb_Rx: ComHandleId=71, ComSystemTemplateSignalGroupRef=SG_SGW_01_SigGroup
          5 x ComGroupSignal, all with ComBitSize=2, ComSignalEndianness=BIG_ENDIAN, ComSignalType=UINT8, ComSignalAccess=ACCESS_UNCLEAR:
            SGW_TimingChargeSwitchStatus_oSGW_01_oATOM_CAN_Matrix_PT_V600_20250211_83e61a6c_Rx: ComBitPosition=7, ComSignalInitValue=0, ComHandleId=487, ComSystemTemplateSystemSignalRef=SGW_TimingChargeSwitchStatus
            SGW_AppointChargeCmd_oSGW_01_oATOM_CAN_Matrix_PT_V600_20250211_cf3a83f6_Rx: ComBitPosition=23, ComSignalInitValue=0, ComHandleId=483, ComSystemTemplateSystemSignalRef=SGW_AppointChargeCmd
            SGW_ChargeFormSet_oSGW_01_oATOM_CAN_Matrix_PT_V600_20250211_3f92bd57_Rx: ComBitPosition=15, ComSignalInitValue=1, ComHandleId=484, ComSystemTemplateSystemSignalRef=SGW_ChargeFormSet
            SGW_DschrgOnOffSet_oSGW_01_oATOM_CAN_Matrix_PT_V600_20250211_a0a977dd_Rx: ComBitPosition=21, ComSignalInitValue=0, ComHandleId=485, ComSystemTemplateSystemSignalRef=SGW_DschrgOnOffSet
            SGW_LockACPlug_oSGW_01_oATOM_CAN_Matrix_PT_V600_20250211_5ade64ae_Rx: ComBitPosition=17, ComSignalInitValue=0, ComHandleId=486, ComSystemTemplateSystemSignalRef=SGW_LockACPlug
      3 x ComIPdu, all with ComIPduDirection=RECEIVE, ComIPduType=NORMAL, ComIPduSignalProcessing=DEFERRED, ComIPduCancellationSupport=false, ComIPduGroupRef=VCU_oATOM_CAN_Matrix_PT_V600_20250211_Rx_49b064ca, ComIPduMainFunctionRef=ComMainFunctionRx:
        CGW_01_oATOM_CAN_Matrix_PT_V600_20250211_092387bf_Rx: ComIPduHandleId=30, ComIPduSignalGroupRef=SG_CGW_01_SigGroup_oCGW_01_oATOM_CAN_Matrix_PT_V600_20250211_9280de14_Rx, ComPduIdRef=CGW_01_oATOM_CAN_Matrix_PT_V600_20250211_092387bf_Rx
        MCU_DeratingStatus_oATOM_CAN_Matrix_PT_V600_20250211_06ac1cd5_Rx: ComIPduHandleId=63, ComIPduSignalGroupRef=SG_MCU_DeratingStatus_SigGroup_oMCU_DeratingStatus_oATOM_CAN_Matrix_PT_V600_20250211_c60bf9ce_Rx, ComPduIdRef=MCU_DeratingStatus_oATOM_CAN_Matrix_PT_V600_20250211_06ac1cd5_Rx
        BMS_TCU_oATOM_CAN_Matrix_PT_V600_20250211_911c2b08_Rx: ComIPduHandleId=24, ComIPduSignalGroupRef=SG_BMS_TCU_SigGroup_oBMS_TCU_oATOM_CAN_Matrix_PT_V600_20250211_541a46a3_Rx, ComPduIdRef=BMS_TCU_oATOM_CAN_Matrix_PT_V600_20250211_911c2b08_Rx
      3 x ComSignalGroup, all with ComTransferProperty=PENDING, ComSignalGroupAccess=ACCESS_UNCLEAR:
        SG_IVI_03_SigGroup_oIVI_03_oATOM_CAN_Matrix_PT_V600_20250211_bf981109_Rx: ComHandleId=54, ComSystemTemplateSignalGroupRef=SG_IVI_03_SigGroup
          5 x ComGroupSignal, all with ComSignalEndianness=BIG_ENDIAN, ComSignalInitValue=0, ComSignalAccess=ACCESS_UNCLEAR:
            IVI_SFIDippedBeamSet_oIVI_03_oATOM_CAN_Matrix_PT_V600_20250211_23dcee29_Rx: ComBitPosition=23, ComBitSize=2, ComSignalType=UINT8, ComHandleId=421, ComSystemTemplateSystemSignalRef=IVI_SFIDippedBeamSet
            IVI_BulbCheckSts_oIVI_03_oATOM_CAN_Matrix_PT_V600_20250211_ac8ee3d9_Rx: ComBitPosition=17, ComBitSize=1, ComSignalType=BOOLEAN, ComHandleId=420, ComSystemTemplateSystemSignalRef=IVI_BulbCheckSts
            Checksum_0F9_oIVI_03_oATOM_CAN_Matrix_PT_V600_20250211_77cc8260_Rx: ComBitPosition=7, ComBitSize=8, ComSignalType=UINT8, ComHandleId=419, ComSystemTemplateSystemSignalRef=Checksum_0F9
            IVI_SFIabnormalSts_oIVI_03_oATOM_CAN_Matrix_PT_V600_20250211_fd225a73_Rx: ComBitPosition=20, ComBitSize=1, ComSignalType=BOOLEAN, ComHandleId=422, ComSystemTemplateSystemSignalRef=IVI_SFIabnormalSts
            MessageCounter_0F9_oIVI_03_oATOM_CAN_Matrix_PT_V600_20250211_b7abb091_Rx: ComBitPosition=11, ComBitSize=4, ComSignalType=UINT8, ComHandleId=423, ComSystemTemplateSystemSignalRef=MessageCounter_0F9
        SG_TCU_02_SigGroup_oTCU_02_oATOM_CAN_Matrix_PT_V600_20250211_a432f792_Rx: ComHandleId=81, ComSystemTemplateSignalGroupRef=SG_TCU_02_SigGroup
          TCU_HVCHHighVoltage_oTCU_02_oATOM_CAN_Matrix_PT_V600_20250211_3d196c75_Rx (ComGroupSignal):
            ComBitPosition = 7
            ComBitSize = 9
            ComSignalEndianness = BIG_ENDIAN
            ComSignalInitValue = 0
            ComSignalType = UINT16
            ComSignalAccess = ACCESS_UNCLEAR
            ComHandleId = 517
            ComSystemTemplateSystemSignalRef = TCU_HVCHHighVoltage
          TCU_HVCHHVDCCurrent_oTCU_02_oATOM_CAN_Matrix_PT_V600_20250211_400bea9a_Rx (ComGroupSignal):
            ComBitPosition = 63
            ComBitSize = 8
            ComSignalEndianness = BIG_ENDIAN
            ComSignalInitValue = 0
            ComSignalType = UINT8
            ComSignalAccess = ACCESS_UNCLEAR
            ComHandleId = 516
            ComSystemTemplateSystemSignalRef = TCU_HVCHHVDCCurrent
        SG_VCU_02_SigGroup_oVCU_02_oATOM_CAN_Matrix_PT_V600_20250211_109f7195_Tx: ComHandleId=2, ComSystemTemplateSignalGroupRef=SG_VCU_02_SigGroup
          5 x ComGroupSignal, all with ComSignalEndianness=BIG_ENDIAN, ComTransferProperty=PENDING, ComSignalAccess=ACCESS_UNCLEAR:
            VCU_WakeUpStatus_oVCU_02_oATOM_CAN_Matrix_PT_V600_20250211_3647d380_Tx: ComBitPosition=63, ComBitSize=8, ComSignalInitValue=0, ComSignalType=UINT8, ComHandleId=76, ComSystemTemplateSystemSignalRef=VCU_WakeUpStatus
            VCU_BS_Current_oVCU_02_oATOM_CAN_Matrix_PT_V600_20250211_6a8ce61f_Tx: ComBitPosition=15, ComBitSize=14, ComSignalInitValue=0, ComSignalType=UINT16, ComHandleId=72, ComSystemTemplateSystemSignalRef=VCU_BS_Current
            VCU_BS_IndicatorSts_oVCU_02_oATOM_CAN_Matrix_PT_V600_20250211_326f1c5a_Tx: ComBitPosition=31, ComBitSize=1, ComSignalInitValue=0, ComSignalType=BOOLEAN, ComHandleId=74, ComSystemTemplateSystemSignalRef=VCU_BS_IndicatorSts
            VCU_BS_LV_Batt_oVCU_02_oATOM_CAN_Matrix_PT_V600_20250211_7e8bacb2_Tx: ComBitPosition=47, ComBitSize=15, ComSignalInitValue=0, ComSignalType=UINT16, ComHandleId=75, ComSystemTemplateSystemSignalRef=VCU_BS_LV_Batt
            VCU_BS_IBSBatSOC_oVCU_02_oATOM_CAN_Matrix_PT_V600_20250211_0b2b2218_Tx: ComBitPosition=7, ComBitSize=8, ComSignalInitValue=80, ComSignalType=UINT8, ComHandleId=73, ComSystemTemplateSystemSignalRef=VCU_BS_IBSBatSOC
      POD_OBC_STATUS_04_oATOM_CAN_Matrix_PT_V600_20250211_9171b8f6_Rx (ComIPdu):
        ComIPduDirection = RECEIVE
        ComIPduType = NORMAL
        ComIPduHandleId = 74
        ComIPduSignalProcessing = DEFERRED
        ComIPduCancellationSupport = false
        ComIPduGroupRef = VCU_oATOM_CAN_Matrix_PT_V600_20250211_Rx_49b064ca
        ComIPduSignalGroupRef = SG_POD_OBC_STATUS_04_SigGroup_oPOD_OBC_STATUS_04_oATOM_CAN_Matrix_PT_V600_20250211_bdcb78f3_Rx
        ComPduIdRef = POD_OBC_STATUS_04_oATOM_CAN_Matrix_PT_V600_20250211_9171b8f6_Rx
        ComIPduMainFunctionRef = ComMainFunctionRx
      VCU_TCU_oATOM_CAN_Matrix_PT_V600_20250211_8e1c824e_Tx (ComIPdu):
        ComIPduDirection = SEND
        ComIPduType = NORMAL
        ComIPduHandleId = 32
        ComIPduSignalProcessing = DEFERRED
        ComIPduCancellationSupport = false
        ComIPduGroupRef = VCU_oATOM_CAN_Matrix_PT_V600_20250211_Tx_1feac34c
        ComIPduSignalGroupRef = SG_VCU_TCU_SigGroup_oVCU_TCU_oATOM_CAN_Matrix_PT_V600_20250211_1a98021d_Tx
        ComPduIdRef = VCU_TCU_oATOM_CAN_Matrix_PT_V600_20250211_8e1c824e_Tx
        ComIPduMainFunctionRef = ComMainFunctionTx
        ComTxIPdu: ComMinimumDelayTime=0, ComTxIPduUnusedAreasDefault=0
          ComTxModeTrue
            ComTxMode: ComTxModeMode=PERIODIC, ComTxModeTimeOffset=0, ComTxModeTimePeriod=0.1
          ComTxModeFalse
            ComTxMode: ComTxModeMode=PERIODIC, ComTxModeTimeOffset=0, ComTxModeTimePeriod=0.1
      SG_SGW_VCU_01_SigGroup_oSGW_VCU_01_oATOM_CAN_Matrix_PT_V600_20250211_899d317b_Rx (ComSignalGroup): ComTransferProperty=PENDING, ComSignalGroupAccess=ACCESS_UNCLEAR, ComHandleId=79, ComSystemTemplateSignalGroupRef=SG_SGW_VCU_01_SigGroup
        5 x ComGroupSignal, all with ComSignalEndianness=BIG_ENDIAN, ComSignalType=UINT8, ComSignalAccess=ACCESS_UNCLEAR:
          IVI_MaxChrgSocSet_oSGW_VCU_01_oATOM_CAN_Matrix_PT_V600_20250211_99c3e2a8_Rx: ComBitPosition=39, ComBitSize=8, ComSignalInitValue=254, ComHandleId=510, ComSystemTemplateSystemSignalRef=IVI_MaxChrgSocSet
          IVI_V2LidisSet_oSGW_VCU_01_oATOM_CAN_Matrix_PT_V600_20250211_25a8a73a_Rx: ComBitPosition=47, ComBitSize=8, ComSignalInitValue=254, ComHandleId=511, ComSystemTemplateSystemSignalRef=IVI_V2LidisSet
          IVI_DschrgOnOffSet_oSGW_VCU_01_oATOM_CAN_Matrix_PT_V600_20250211_21f6b725_Rx: ComBitPosition=9, ComBitSize=2, ComSignalInitValue=0, ComHandleId=508, ComSystemTemplateSystemSignalRef=IVI_DschrgOnOffSet
          IVI_DriveModeSet_oSGW_VCU_01_oATOM_CAN_Matrix_PT_V600_20250211_e3273eed_Rx: ComBitPosition=23, ComBitSize=3, ComSignalInitValue=0, ComHandleId=507, ComSystemTemplateSystemSignalRef=IVI_DriveModeSet
          IVI_ForwardVmaxAllowed_oSGW_VCU_01_oATOM_CAN_Matrix_PT_V600_20250211_13b9eae3_Rx: ComBitPosition=31, ComBitSize=8, ComSignalInitValue=0, ComHandleId=509, ComSystemTemplateSystemSignalRef=IVI_ForwardVmaxAllowed
      VCU_02_oATOM_CAN_Matrix_PT_V600_20250211_28e7bea0_Tx (ComIPdu):
        ComIPduDirection = SEND
        ComIPduType = NORMAL
        ComIPduHandleId = 5
        ComIPduSignalProcessing = DEFERRED
        ComIPduCancellationSupport = false
        ComIPduGroupRef = VCU_oATOM_CAN_Matrix_PT_V600_20250211_Tx_1feac34c
        ComIPduSignalGroupRef = SG_VCU_02_SigGroup_oVCU_02_oATOM_CAN_Matrix_PT_V600_20250211_109f7195_Tx
        ComPduIdRef = VCU_02_oATOM_CAN_Matrix_PT_V600_20250211_28e7bea0_Tx
        ComIPduMainFunctionRef = ComMainFunctionTx
        ComTxIPdu: ComMinimumDelayTime=0, ComTxIPduUnusedAreasDefault=0
          ComTxModeTrue
            ComTxMode: ComTxModeMode=PERIODIC, ComTxModeTimeOffset=0, ComTxModeTimePeriod=0.2
          ComTxModeFalse
            ComTxMode: ComTxModeMode=PERIODIC, ComTxModeTimeOffset=0, ComTxModeTimePeriod=0.2
      SG_MCU_02_SigGroup_oMCU_02_oATOM_CAN_Matrix_PT_V600_20250211_09c28691_Rx (ComSignalGroup): ComTransferProperty=PENDING, ComSignalGroupAccess=ACCESS_UNCLEAR, ComHandleId=57, ComSystemTemplateSignalGroupRef=SG_MCU_02_SigGroup
        MCU_BDmpCActv_oMCU_02_oATOM_CAN_Matrix_PT_V600_20250211_c0586eb8_Rx (ComGroupSignal):
          ComBitPosition = 59
          ComBitSize = 1
          ComSignalEndianness = BIG_ENDIAN
          ComSignalInitValue = 0
          ComSignalType = BOOLEAN
          ComSignalAccess = ACCESS_UNCLEAR
          ComHandleId = 433
          ComSystemTemplateSystemSignalRef = MCU_BDmpCActv
        MCU_VCUWorkMode_oMCU_02_oATOM_CAN_Matrix_PT_V600_20250211_2a117a8b_Rx (ComGroupSignal):
          ComBitPosition = 63
          ComBitSize = 4
          ComSignalEndianness = BIG_ENDIAN
          ComSignalInitValue = 0
          ComSignalType = UINT8
          ComSignalAccess = ACCESS_UNCLEAR
          ComHandleId = 434
          ComSystemTemplateSystemSignalRef = MCU_VCUWorkMode
      DCM_RL_oATOM_CAN_Matrix_PT_V600_20250211_b2ab7ecc_Rx (ComIPdu):
        ComIPduDirection = RECEIVE
        ComIPduType = NORMAL
        ComIPduHandleId = 38
        ComIPduSignalProcessing = DEFERRED
        ComIPduCancellationSupport = false
        ComIPduGroupRef = VCU_oATOM_CAN_Matrix_PT_V600_20250211_Rx_49b064ca
        ComIPduSignalGroupRef = SG_DCM_RL_SigGroup_oDCM_RL_oATOM_CAN_Matrix_PT_V600_20250211_a6554e24_Rx
        ComPduIdRef = DCM_RL_oATOM_CAN_Matrix_PT_V600_20250211_b2ab7ecc_Rx
        ComIPduMainFunctionRef = ComMainFunctionRx
      SG_VCU_SynReq_01_SigGroup_oVCU_SynReq_01_oATOM_CAN_Matrix_PT_V600_20250211_2ec232a9_Tx (ComSignalGroup): ComTransferProperty=PENDING, ComSignalGroupAccess=ACCESS_UNCLEAR, ComHandleId=25, ComSystemTemplateSignalGroupRef=SG_VCU_SynReq_01_SigGroup
        VCU_SynRequest_oVCU_SynReq_01_oATOM_CAN_Matrix_PT_V600_20250211_c64837e4_Tx (ComGroupSignal):
          ComBitPosition = 7
          ComBitSize = 24
          ComSignalEndianness = BIG_ENDIAN
          ComSignalInitValue = 16777215
          ComSignalType = UINT32
          ComTransferProperty = TRIGGERED
          ComSignalAccess = ACCESS_UNCLEAR
          ComHandleId = 246
          ComSystemTemplateSystemSignalRef = VCU_SynRequest
      VCU_05_oATOM_CAN_Matrix_PT_V600_20250211_2baed31b_Tx (ComIPdu):
        ComIPduDirection = SEND
        ComIPduType = NORMAL
        ComIPduHandleId = 8
        ComIPduSignalProcessing = DEFERRED
        ComIPduCancellationSupport = false
        ComIPduGroupRef = VCU_oATOM_CAN_Matrix_PT_V600_20250211_Tx_1feac34c
        ComIPduSignalGroupRef = SG_VCU_05_SigGroup_oVCU_05_oATOM_CAN_Matrix_PT_V600_20250211_d5c1ee4c_Tx
        ComPduIdRef = VCU_05_oATOM_CAN_Matrix_PT_V600_20250211_2baed31b_Tx
        ComIPduMainFunctionRef = ComMainFunctionTx
        ComTxIPdu: ComMinimumDelayTime=0, ComTxIPduUnusedAreasDefault=0
          ComTxModeTrue
            ComTxMode: ComTxModeMode=PERIODIC, ComTxModeTimeOffset=0, ComTxModeTimePeriod=0.1
          ComTxModeFalse
            ComTxMode: ComTxModeMode=PERIODIC, ComTxModeTimeOffset=0, ComTxModeTimePeriod=0.1
      SG_POD_OBC_STATUS_02_SigGroup_oPOD_OBC_STATUS_02_oATOM_CAN_Matrix_PT_V600_20250211_49c67a09_Rx (ComSignalGroup): ComTransferProperty=PENDING, ComSignalGroupAccess=ACCESS_UNCLEAR, ComHandleId=65, ComSystemTemplateSignalGroupRef=SG_POD_OBC_STATUS_02_SigGroup
        3 x ComGroupSignal, all with ComSignalEndianness=BIG_ENDIAN, ComSignalInitValue=0, ComSignalAccess=ACCESS_UNCLEAR:
          POD_OBC_OutputDCChargeVoltage_oPOD_OBC_STATUS_02_oATOM_CAN_Matrix_PT_V600_20250211_249f5302_Rx: ComBitPosition=55, ComBitSize=14, ComSignalType=UINT16, ComHandleId=459, ComSystemTemplateSystemSignalRef=POD_OBC_OutputDCChargeVoltage
          POD_OBC_ChrgOutpPwrAvl_oPOD_OBC_STATUS_02_oATOM_CAN_Matrix_PT_V600_20250211_a1981126_Rx: ComBitPosition=7, ComBitSize=8, ComSignalType=UINT8, ComHandleId=457, ComSystemTemplateSystemSignalRef=POD_OBC_ChrgOutpPwrAvl
          POD_OBC_OutputDCChargeCurrent_oPOD_OBC_STATUS_02_oATOM_CAN_Matrix_PT_V600_20250211_9a885370_Rx: ComBitPosition=15, ComBitSize=13, ComSignalType=UINT16, ComHandleId=458, ComSystemTemplateSystemSignalRef=POD_OBC_OutputDCChargeCurrent
      SG_VCU_05_SigGroup_oVCU_05_oATOM_CAN_Matrix_PT_V600_20250211_d5c1ee4c_Tx (ComSignalGroup): ComTransferProperty=PENDING, ComSignalGroupAccess=ACCESS_UNCLEAR, ComHandleId=5, ComSystemTemplateSignalGroupRef=SG_VCU_05_SigGroup
        4 x ComGroupSignal, all with ComBitSize=16, ComSignalEndianness=BIG_ENDIAN, ComSignalInitValue=0, ComSignalType=UINT16, ComTransferProperty=PENDING, ComSignalAccess=ACCESS_UNCLEAR:
          VCU_MinimumOutputVoltage_oVCU_05_oATOM_CAN_Matrix_PT_V600_20250211_0cda6ee1_Tx: ComBitPosition=55, ComHandleId=87, ComSystemTemplateSystemSignalRef=VCU_MinimumOutputVoltage
          VCU_MaximumOutputCurrent_oVCU_05_oATOM_CAN_Matrix_PT_V600_20250211_fe0b8d7d_Tx: ComBitPosition=7, ComHandleId=84, ComSystemTemplateSystemSignalRef=VCU_MaximumOutputCurrent
          VCU_MaximumOutputVoltage_oVCU_05_oATOM_CAN_Matrix_PT_V600_20250211_9c0bf641_Tx: ComBitPosition=23, ComHandleId=85, ComSystemTemplateSystemSignalRef=VCU_MaximumOutputVoltage
          VCU_MinimumOutputCurrent_oVCU_05_oATOM_CAN_Matrix_PT_V600_20250211_6eda15dd_Tx: ComBitPosition=39, ComHandleId=86, ComSystemTemplateSystemSignalRef=VCU_MinimumOutputCurrent
      4 x ComIPdu, all with ComIPduType=NORMAL, ComIPduSignalProcessing=DEFERRED, ComIPduCancellationSupport=false:
        VCU_MCU_05_oATOM_CAN_Matrix_PT_V600_20250211_fe17094b_Tx: ComIPduDirection=SEND, ComIPduHandleId=27, ComIPduGroupRef=VCU_oATOM_CAN_Matrix_PT_V600_20250211_Tx_1feac34c, ComIPduSignalGroupRef=SG_VCU_MCU_05_SigGroup_oVCU_MCU_05_oATOM_CAN_Matrix_PT_V600_20250211_7ef1168b_Tx, ComPduIdRef=VCU_MCU_05_oATOM_CAN_Matrix_PT_V600_20250211_fe17094b_Tx, ComIPduMainFunctionRef=ComMainFunctionTx
          ComTxIPdu: ComMinimumDelayTime=0, ComTxIPduUnusedAreasDefault=0
            ComTxModeTrue
              ComTxMode: ComTxModeMode=PERIODIC, ComTxModeTimeOffset=0, ComTxModeTimePeriod=0.02
            ComTxModeFalse
              ComTxMode: ComTxModeMode=PERIODIC, ComTxModeTimeOffset=0, ComTxModeTimePeriod=0.02
        DCM_FL_02_oATOM_CAN_Matrix_PT_V600_20250211_01d0b409_Rx: ComIPduDirection=RECEIVE, ComIPduHandleId=35, ComIPduGroupRef=VCU_oATOM_CAN_Matrix_PT_V600_20250211_Rx_49b064ca, ComIPduSignalGroupRef=SG_DCM_FL_02_SigGroup_oDCM_FL_02_oATOM_CAN_Matrix_PT_V600_20250211_46147686_Rx, ComPduIdRef=DCM_FL_02_oATOM_CAN_Matrix_PT_V600_20250211_01d0b409_Rx, ComIPduMainFunctionRef=ComMainFunctionRx
        IVI_OdometerInfor_oATOM_CAN_Matrix_PT_V600_20250211_fa3740ee_Rx: ComIPduDirection=RECEIVE, ComIPduHandleId=60, ComIPduGroupRef=VCU_oATOM_CAN_Matrix_PT_V600_20250211_Rx_49b064ca, ComIPduSignalGroupRef=SG_IVI_OdometerInfor_SigGroup_oIVI_OdometerInfor_oATOM_CAN_Matrix_PT_V600_20250211_3516238b_Rx, ComPduIdRef=IVI_OdometerInfor_oATOM_CAN_Matrix_PT_V600_20250211_fa3740ee_Rx, ComIPduMainFunctionRef=ComMainFunctionRx
        BCM_06_oATOM_CAN_Matrix_PT_V600_20250211_86c8a4d8_Rx: ComIPduDirection=RECEIVE, ComIPduHandleId=10, ComIPduGroupRef=VCU_oATOM_CAN_Matrix_PT_V600_20250211_Rx_49b064ca, ComIPduSignalGroupRef=SG_BCM_06_SigGroup_oBCM_06_oATOM_CAN_Matrix_PT_V600_20250211_7741510b_Rx, ComPduIdRef=BCM_06_oATOM_CAN_Matrix_PT_V600_20250211_86c8a4d8_Rx, ComIPduMainFunctionRef=ComMainFunctionRx
      SG_POD_OBC_CHRGSTATION_SigGroup_oPOD_OBC_CHRGSTATION_oATOM_CAN_Matrix_PT_V600_20250211_4d87b474_Rx (ComSignalGroup): ComTransferProperty=PENDING, ComSignalGroupAccess=ACCESS_UNCLEAR, ComHandleId=64, ComSystemTemplateSignalGroupRef=SG_POD_OBC_CHRGSTATION_SigGroup
        10 x ComGroupSignal, all with ComSignalEndianness=BIG_ENDIAN, ComSignalAccess=ACCESS_UNCLEAR:
          POD_OBC_CCCurrentLimit_oPOD_OBC_CHRGSTATION_oATOM_CAN_Matrix_PT_V600_20250211_19f9b4da_Rx: ComBitPosition=23, ComBitSize=8, ComSignalInitValue=0, ComSignalType=UINT8, ComHandleId=447, ComSystemTemplateSystemSignalRef=POD_OBC_CCCurrentLimit
          POD_OBC_CPCurrentLimit_oPOD_OBC_CHRGSTATION_oATOM_CAN_Matrix_PT_V600_20250211_53d381d9_Rx: ComBitPosition=7, ComBitSize=8, ComSignalInitValue=0, ComSignalType=UINT8, ComHandleId=449, ComSystemTemplateSystemSignalRef=POD_OBC_CPCurrentLimit
          POD_OBC_CPStatus_oPOD_OBC_CHRGSTATION_oATOM_CAN_Matrix_PT_V600_20250211_d6c8ee40_Rx: ComBitPosition=11, ComBitSize=3, ComSignalInitValue=0, ComSignalType=UINT8, ComHandleId=451, ComSystemTemplateSystemSignalRef=POD_OBC_CPStatus
          POD_OBC_ChargCapacibility_oPOD_OBC_CHRGSTATION_oATOM_CAN_Matrix_PT_V600_20250211_1bd7c0f0_Rx: ComBitPosition=53, ComBitSize=2, ComSignalInitValue=0, ComSignalType=UINT8, ComHandleId=452, ComSystemTemplateSystemSignalRef=POD_OBC_ChargCapacibility
          POD_OBC_S2State_oPOD_OBC_CHRGSTATION_oATOM_CAN_Matrix_PT_V600_20250211_d46756d3_Rx: ComBitPosition=51, ComBitSize=2, ComSignalInitValue=1, ComSignalType=UINT8, ComHandleId=455, ComSystemTemplateSystemSignalRef=POD_OBC_S2State
          POD_OBC_CCStatus_oPOD_OBC_CHRGSTATION_oATOM_CAN_Matrix_PT_V600_20250211_6df4ee5e_Rx: ComBitPosition=15, ComBitSize=4, ComSignalInitValue=0, ComSignalType=UINT8, ComHandleId=448, ComSystemTemplateSystemSignalRef=POD_OBC_CCStatus
          POD_OBC_OBCMaxPermOutpCrrt_oPOD_OBC_CHRGSTATION_oATOM_CAN_Matrix_PT_V600_20250211_27da1158_Rx: ComBitPosition=48, ComBitSize=9, ComSignalInitValue=0, ComSignalType=UINT16, ComHandleId=454, ComSystemTemplateSystemSignalRef=POD_OBC_OBCMaxPermOutpCrrt
          POD_OBC_WorkMode_oPOD_OBC_CHRGSTATION_oATOM_CAN_Matrix_PT_V600_20250211_206572d6_Rx: ComBitPosition=36, ComBitSize=3, ComSignalInitValue=0, ComSignalType=UINT8, ComHandleId=456, ComSystemTemplateSystemSignalRef=POD_OBC_WorkMode
          POD_OBC_EMLockState_oPOD_OBC_CHRGSTATION_oATOM_CAN_Matrix_PT_V600_20250211_4eb1f977_Rx: ComBitPosition=55, ComBitSize=2, ComSignalInitValue=0, ComSignalType=UINT8, ComHandleId=453, ComSystemTemplateSystemSignalRef=POD_OBC_EMLockState
          POD_OBC_CPDuty_oPOD_OBC_CHRGSTATION_oATOM_CAN_Matrix_PT_V600_20250211_602b732e_Rx: ComBitPosition=47, ComBitSize=8, ComSignalInitValue=0, ComSignalType=UINT8, ComHandleId=450, ComSystemTemplateSystemSignalRef=POD_OBC_CPDuty
      VCU_SynReq_01_oATOM_CAN_Matrix_PT_V600_20250211_9b305e0d_Tx (ComIPdu):
        ComIPduDirection = SEND
        ComIPduType = NORMAL
        ComIPduHandleId = 31
        ComIPduSignalProcessing = DEFERRED
        ComIPduCancellationSupport = false
        ComIPduGroupRef = VCU_oATOM_CAN_Matrix_PT_V600_20250211_Tx_1feac34c
        ComIPduSignalGroupRef = SG_VCU_SynReq_01_SigGroup_oVCU_SynReq_01_oATOM_CAN_Matrix_PT_V600_20250211_2ec232a9_Tx
        ComPduIdRef = VCU_SynReq_01_oATOM_CAN_Matrix_PT_V600_20250211_9b305e0d_Tx
        ComIPduMainFunctionRef = ComMainFunctionTx
        ComTxIPdu: ComMinimumDelayTime=0, ComTxIPduUnusedAreasDefault=0
          ComTxModeTrue
            ComTxMode: ComTxModeMode=DIRECT, ComTxModeNumberOfRepetitions=0, ComTxModeRepetitionPeriod=0
          ComTxModeFalse
            ComTxMode: ComTxModeMode=DIRECT, ComTxModeNumberOfRepetitions=0, ComTxModeRepetitionPeriod=0
      SG_EVCOM_State_01_SigGroup_oEVCOM_State_01_oATOM_CAN_Matrix_PT_V600_20250211_16f3767b_Rx (ComSignalGroup): ComTransferProperty=PENDING, ComSignalGroupAccess=ACCESS_UNCLEAR, ComHandleId=40, ComSystemTemplateSignalGroupRef=SG_EVCOM_State_01_SigGroup
        EVCOM_CompActlCnsmpCur_oEVCOM_State_01_oATOM_CAN_Matrix_PT_V600_20250211_a627e94c_Rx (ComGroupSignal):
          ComBitPosition = 47
          ComBitSize = 8
          ComSignalEndianness = BIG_ENDIAN
          ComSignalInitValue = 0
          ComSignalType = UINT8
          ComSignalAccess = ACCESS_UNCLEAR
          ComHandleId = 289
          ComSystemTemplateSystemSignalRef = EVCOM_CompActlCnsmpCur
        EVCOM_CompActlPwrCnsmp_oEVCOM_State_01_oATOM_CAN_Matrix_PT_V600_20250211_d741f4fb_Rx (ComGroupSignal):
          ComBitPosition = 39
          ComBitSize = 8
          ComSignalEndianness = BIG_ENDIAN
          ComSignalInitValue = 0
          ComSignalType = UINT8
          ComSignalAccess = ACCESS_UNCLEAR
          ComHandleId = 290
          ComSystemTemplateSystemSignalRef = EVCOM_CompActlPwrCnsmp
      IVI_01_oATOM_CAN_Matrix_PT_V600_20250211_12948905_Rx (ComIPdu):
        ComIPduDirection = RECEIVE
        ComIPduType = NORMAL
        ComIPduHandleId = 58
        ComIPduSignalProcessing = DEFERRED
        ComIPduCancellationSupport = false
        ComIPduGroupRef = VCU_oATOM_CAN_Matrix_PT_V600_20250211_Rx_49b064ca
        ComIPduSignalGroupRef = SG_IVI_01_SigGroup_oIVI_01_oATOM_CAN_Matrix_PT_V600_20250211_284cc0c2_Rx
        ComPduIdRef = IVI_01_oATOM_CAN_Matrix_PT_V600_20250211_12948905_Rx
        ComIPduMainFunctionRef = ComMainFunctionRx
      SG_VCU_MCU_02_SigGroup_oVCU_MCU_02_oATOM_CAN_Matrix_PT_V600_20250211_2d530015_Tx (ComSignalGroup): ComTransferProperty=PENDING, ComSignalGroupAccess=ACCESS_UNCLEAR, ComHandleId=19, ComSystemTemplateSignalGroupRef=SG_VCU_MCU_02_SigGroup
        3 x ComGroupSignal, all with ComSignalEndianness=BIG_ENDIAN, ComTransferProperty=PENDING, ComSignalAccess=ACCESS_UNCLEAR:
          VCU_MCUActHeatPwr_oVCU_MCU_02_oATOM_CAN_Matrix_PT_V600_20250211_420c1833_Tx: ComBitPosition=55, ComBitSize=8, ComSignalInitValue=0, ComSignalType=UINT8, ComHandleId=207, ComSystemTemplateSystemSignalRef=VCU_MCUActHeatPwr
          VCU_MotorSpdReq_oVCU_MCU_02_oATOM_CAN_Matrix_PT_V600_20250211_c5c80260_Tx: ComBitPosition=23, ComBitSize=16, ComSignalInitValue=32767, ComSignalType=UINT16, ComHandleId=209, ComSystemTemplateSystemSignalRef=VCU_MotorSpdReq
          VCU_MaxSpdLimit_oVCU_MCU_02_oATOM_CAN_Matrix_PT_V600_20250211_1d67c298_Tx: ComBitPosition=39, ComBitSize=16, ComSignalInitValue=32767, ComSignalType=UINT16, ComHandleId=208, ComSystemTemplateSystemSignalRef=VCU_MaxSpdLimit
      PRND_oATOM_CAN_Matrix_PT_V600_20250211_a04a662c_Rx (ComIPdu):
        ComIPduDirection = RECEIVE
        ComIPduType = NORMAL
        ComIPduHandleId = 77
        ComIPduSignalProcessing = DEFERRED
        ComIPduCancellationSupport = false
        ComIPduGroupRef = VCU_oATOM_CAN_Matrix_PT_V600_20250211_Rx_49b064ca
        ComIPduSignalGroupRef = SG_PRND_SigGroup_oPRND_oATOM_CAN_Matrix_PT_V600_20250211_ddf34a23_Rx
        ComPduIdRef = PRND_oATOM_CAN_Matrix_PT_V600_20250211_a04a662c_Rx
        ComIPduMainFunctionRef = ComMainFunctionRx
      SG_BCM_11_SigGroup_oBCM_11_oATOM_CAN_Matrix_PT_V600_20250211_59b7aa06_Rx (ComSignalGroup): ComTransferProperty=PENDING, ComSignalGroupAccess=ACCESS_UNCLEAR, ComHandleId=11, ComSystemTemplateSignalGroupRef=SG_BCM_11_SigGroup
        3 x ComGroupSignal, all with ComSignalEndianness=BIG_ENDIAN, ComSignalInitValue=0, ComSignalAccess=ACCESS_UNCLEAR:
          BCM_Immo_State_oBCM_11_oATOM_CAN_Matrix_PT_V600_20250211_b85d08af_Rx: ComBitPosition=7, ComBitSize=1, ComSignalType=BOOLEAN, ComHandleId=143, ComSystemTemplateSystemSignalRef=BCM_Immo_State
          BCM_SecOCFV_272_oBCM_11_oATOM_CAN_Matrix_PT_V600_20250211_4451baff_Rx: ComBitPosition=23, ComBitSize=16, ComSignalType=UINT16, ComHandleId=144, ComSystemTemplateSystemSignalRef=BCM_SecOCFV_272
          BCM_SecOCMAC_272_oBCM_11_oATOM_CAN_Matrix_PT_V600_20250211_397206c9_Rx: ComBitPosition=39, ComBitSize=32, ComSignalType=UINT32, ComHandleId=145, ComSystemTemplateSystemSignalRef=BCM_SecOCMAC_272
      VCU_POD_oATOM_CAN_Matrix_PT_V600_20250211_28db6ecb_Tx (ComIPdu):
        ComIPduDirection = SEND
        ComIPduType = NORMAL
        ComIPduHandleId = 28
        ComIPduSignalProcessing = DEFERRED
        ComIPduCancellationSupport = false
        ComIPduGroupRef = VCU_oATOM_CAN_Matrix_PT_V600_20250211_Tx_1feac34c
        ComIPduSignalGroupRef = SG_VCU_POD_SigGroup_oVCU_POD_oATOM_CAN_Matrix_PT_V600_20250211_c17d64e5_Tx
        ComPduIdRef = VCU_POD_oATOM_CAN_Matrix_PT_V600_20250211_28db6ecb_Tx
        ComIPduMainFunctionRef = ComMainFunctionTx
        ComTxIPdu: ComMinimumDelayTime=0, ComTxIPduUnusedAreasDefault=0
          ComTxModeTrue
            ComTxMode: ComTxModeMode=PERIODIC, ComTxModeTimeOffset=0, ComTxModeTimePeriod=0.05
          ComTxModeFalse
            ComTxMode: ComTxModeMode=PERIODIC, ComTxModeTimeOffset=0, ComTxModeTimePeriod=0.05
      6 x ComSignalGroup, all with ComTransferProperty=PENDING, ComSignalGroupAccess=ACCESS_UNCLEAR:
        SG_PRND_SigGroup_oPRND_oATOM_CAN_Matrix_PT_V600_20250211_ddf34a23_Rx: ComHandleId=70, ComSystemTemplateSignalGroupRef=SG_PRND_SigGroup
          6 x ComGroupSignal, all with ComSignalEndianness=BIG_ENDIAN, ComSignalInitValue=0, ComSignalAccess=ACCESS_UNCLEAR:
            PRND_RNDbutton_oPRND_oATOM_CAN_Matrix_PT_V600_20250211_400cef5e_Rx: ComBitPosition=15, ComBitSize=3, ComSignalType=UINT8, ComHandleId=482, ComSystemTemplateSystemSignalRef=PRND_RNDbutton
            Checksum_248_oPRND_oATOM_CAN_Matrix_PT_V600_20250211_2169404d_Rx: ComBitPosition=7, ComBitSize=8, ComSignalType=UINT8, ComHandleId=477, ComSystemTemplateSystemSignalRef=Checksum_248
            PRND_Pbutton_FaultSts_oPRND_oATOM_CAN_Matrix_PT_V600_20250211_748786ed_Rx: ComBitPosition=19, ComBitSize=1, ComSignalType=BOOLEAN, ComHandleId=479, ComSystemTemplateSystemSignalRef=PRND_Pbutton_FaultSts
            MessageCounter_248_oPRND_oATOM_CAN_Matrix_PT_V600_20250211_7249f622_Rx: ComBitPosition=11, ComBitSize=4, ComSignalType=UINT8, ComHandleId=478, ComSystemTemplateSystemSignalRef=MessageCounter_248
            PRND_Pbutton_oPRND_oATOM_CAN_Matrix_PT_V600_20250211_2bc3bb96_Rx: ComBitPosition=21, ComBitSize=2, ComSignalType=UINT8, ComHandleId=480, ComSystemTemplateSystemSignalRef=PRND_Pbutton
            PRND_RNDbutton_FaultSts_oPRND_oATOM_CAN_Matrix_PT_V600_20250211_fe92ca7a_Rx: ComBitPosition=18, ComBitSize=1, ComSignalType=BOOLEAN, ComHandleId=481, ComSystemTemplateSystemSignalRef=PRND_RNDbutton_FaultSts
        SG_BCM_06_SigGroup_oBCM_06_oATOM_CAN_Matrix_PT_V600_20250211_7741510b_Rx: ComHandleId=10, ComSystemTemplateSignalGroupRef=SG_BCM_06_SigGroup
          4 x ComGroupSignal, all with ComSignalEndianness=BIG_ENDIAN, ComSignalInitValue=0, ComSignalAccess=ACCESS_UNCLEAR:
            MessageCounter_271_oBCM_06_oATOM_CAN_Matrix_PT_V600_20250211_8423cb57_Rx: ComBitPosition=11, ComBitSize=4, ComSignalType=UINT8, ComHandleId=141, ComSystemTemplateSystemSignalRef=MessageCounter_271
            BCM_PowerOffDisplayReq_oBCM_06_oATOM_CAN_Matrix_PT_V600_20250211_9133ccdf_Rx: ComBitPosition=33, ComBitSize=1, ComSignalType=BOOLEAN, ComHandleId=140, ComSystemTemplateSystemSignalRef=BCM_PowerOffDisplayReq
            checksum_271_oBCM_06_oATOM_CAN_Matrix_PT_V600_20250211_70f1cf66_Rx: ComBitPosition=7, ComBitSize=8, ComSignalType=UINT8, ComHandleId=142, ComSystemTemplateSystemSignalRef=checksum_271
            BCM_PepsPowerMode_oBCM_06_oATOM_CAN_Matrix_PT_V600_20250211_db922ead_Rx: ComBitPosition=39, ComBitSize=3, ComSignalType=UINT8, ComHandleId=139, ComSystemTemplateSystemSignalRef=BCM_PepsPowerMode
        SG_BMS_BatInfor_03_SigGroup_oBMS_BatInfor_03_oATOM_CAN_Matrix_PT_V600_20250211_f03896ae_Rx: ComHandleId=15, ComSystemTemplateSignalGroupRef=SG_BMS_BatInfor_03_SigGroup
          BMS_RemainCapacity_oBMS_BatInfor_03_oATOM_CAN_Matrix_PT_V600_20250211_0c2dc68f_Rx (ComGroupSignal):
            ComBitPosition = 23
            ComBitSize = 16
            ComSignalEndianness = BIG_ENDIAN
            ComSignalInitValue = 0
            ComSignalType = UINT16
            ComSignalAccess = ACCESS_UNCLEAR
            ComHandleId = 155
            ComSystemTemplateSystemSignalRef = BMS_RemainCapacity
        SG_VCU_AccPedal_SigGroup_oVCU_AccPedal_oATOM_CAN_Matrix_PT_V600_20250211_950dd51c_Tx: ComHandleId=8, ComSystemTemplateSignalGroupRef=SG_VCU_AccPedal_SigGroup
          13 x ComGroupSignal, all with ComSignalEndianness=BIG_ENDIAN, ComSignalInitValue=0, ComTransferProperty=PENDING, ComSignalAccess=ACCESS_UNCLEAR:
            MessageCounter_0D2_oVCU_AccPedal_oATOM_CAN_Matrix_PT_V600_20250211_5c5e7f25_Tx: ComBitPosition=11, ComBitSize=4, ComSignalType=UINT8, ComHandleId=108, ComSystemTemplateSystemSignalRef=MessageCounter_0D2
            VCU_TargetGear_oVCU_AccPedal_oATOM_CAN_Matrix_PT_V600_20250211_e675a125_Tx: ComBitPosition=43, ComBitSize=3, ComSignalType=UINT8, ComHandleId=113, ComSystemTemplateSystemSignalRef=VCU_TargetGear
            VCU_AccelerationPedal_oVCU_AccPedal_oATOM_CAN_Matrix_PT_V600_20250211_c713057e_Tx: ComBitPosition=23, ComBitSize=10, ComSignalType=UINT16, ComHandleId=110, ComSystemTemplateSystemSignalRef=VCU_AccelerationPedal
            VCU_VehicleSpeed_oVCU_AccPedal_oATOM_CAN_Matrix_PT_V600_20250211_e55dbbb8_Tx: ComBitPosition=55, ComBitSize=13, ComSignalType=UINT16, ComHandleId=117, ComSystemTemplateSystemSignalRef=VCU_VehicleSpeed
            VCU_VirtualACPedal_oVCU_AccPedal_oATOM_CAN_Matrix_PT_V600_20250211_3cf30a01_Tx: ComBitPosition=25, ComBitSize=10, ComSignalType=UINT16, ComHandleId=119, ComSystemTemplateSystemSignalRef=VCU_VirtualACPedal
            Checksum_0D2_oVCU_AccPedal_oATOM_CAN_Matrix_PT_V600_20250211_6e2f0785_Tx: ComBitPosition=7, ComBitSize=8, ComSignalType=UINT8, ComHandleId=107, ComSystemTemplateSystemSignalRef=Checksum_0D2
            VCU_Kickdown_oVCU_AccPedal_oATOM_CAN_Matrix_PT_V600_20250211_28896ada_Tx: ComBitPosition=56, ComBitSize=1, ComSignalType=BOOLEAN, ComHandleId=112, ComSystemTemplateSystemSignalRef=VCU_Kickdown
            VCU_VehicleSpeedValid_oVCU_AccPedal_oATOM_CAN_Matrix_PT_V600_20250211_4f4e24a1_Tx: ComBitPosition=15, ComBitSize=1, ComSignalType=BOOLEAN, ComHandleId=116, ComSystemTemplateSystemSignalRef=VCU_VehicleSpeedValid
            VCU_EPBReq_oVCU_AccPedal_oATOM_CAN_Matrix_PT_V600_20250211_75768735_Tx: ComBitPosition=14, ComBitSize=2, ComSignalType=UINT8, ComHandleId=111, ComSystemTemplateSystemSignalRef=VCU_EPBReq
            VCU_VLCTorqueRequestActive_oVCU_AccPedal_oATOM_CAN_Matrix_PT_V600_20250211_9e6fe6cc_Tx: ComBitPosition=57, ComBitSize=1, ComSignalType=BOOLEAN, ComHandleId=114, ComSystemTemplateSystemSignalRef=VCU_VLCTorqueRequestActive
            VCU_VLCTorqueRequestAvailable_oVCU_AccPedal_oATOM_CAN_Matrix_PT_V600_20250211_ef5183de_Tx: ComBitPosition=58, ComBitSize=1, ComSignalType=BOOLEAN, ComHandleId=115, ComSystemTemplateSystemSignalRef=VCU_VLCTorqueRequestAvailable
            VCU_VirtualACPedalValid_oVCU_AccPedal_oATOM_CAN_Matrix_PT_V600_20250211_744b6907_Tx: ComBitPosition=26, ComBitSize=1, ComSignalType=BOOLEAN, ComHandleId=118, ComSystemTemplateSystemSignalRef=VCU_VirtualACPedalValid
            VCU_AccelerationPedalValid_oVCU_AccPedal_oATOM_CAN_Matrix_PT_V600_20250211_0900e699_Tx: ComBitPosition=29, ComBitSize=1, ComSignalType=BOOLEAN, ComHandleId=109, ComSystemTemplateSystemSignalRef=VCU_AccelerationPedalValid
        SG_BMS_status_04_SigGroup_oBMS_status_04_oATOM_CAN_Matrix_PT_V600_20250211_7f748bd3_Rx: ComHandleId=29, ComSystemTemplateSignalGroupRef=SG_BMS_status_04_SigGroup
          BMS_FeedbackCurr_oBMS_status_04_oATOM_CAN_Matrix_PT_V600_20250211_adfb81c2_Rx (ComGroupSignal):
            ComBitPosition = 7
            ComBitSize = 16
            ComSignalEndianness = BIG_ENDIAN
            ComSignalInitValue = 0
            ComSignalType = SINT16
            ComSignalAccess = ACCESS_UNCLEAR
            ComHandleId = 227
            ComSystemTemplateSystemSignalRef = BMS_FeedbackCurr
          BMS_DisChgCurr_oBMS_status_04_oATOM_CAN_Matrix_PT_V600_20250211_9054a7c7_Rx (ComGroupSignal):
            ComBitPosition = 23
            ComBitSize = 16
            ComSignalEndianness = BIG_ENDIAN
            ComSignalInitValue = 0
            ComSignalType = SINT16
            ComSignalAccess = ACCESS_UNCLEAR
            ComHandleId = 226
            ComSystemTemplateSystemSignalRef = BMS_DisChgCurr
        SG_CGW_01_SigGroup_oCGW_01_oATOM_CAN_Matrix_PT_V600_20250211_9280de14_Rx: ComHandleId=30, ComSystemTemplateSignalGroupRef=SG_CGW_01_SigGroup
          3 x ComGroupSignal, all with ComSignalEndianness=BIG_ENDIAN, ComSignalInitValue=0, ComSignalType=UINT8, ComSignalAccess=ACCESS_UNCLEAR:
            MessageCounter_278_oCGW_01_oATOM_CAN_Matrix_PT_V600_20250211_19d7a3d0_Rx: ComBitPosition=11, ComBitSize=4, ComHandleId=230, ComSystemTemplateSystemSignalRef=MessageCounter_278
            Checksum_278_oCGW_01_oATOM_CAN_Matrix_PT_V600_20250211_d9b09121_Rx: ComBitPosition=7, ComBitSize=8, ComHandleId=229, ComSystemTemplateSystemSignalRef=Checksum_278
            CGW_VehicleState_oCGW_01_oATOM_CAN_Matrix_PT_V600_20250211_1252b1db_Rx: ComBitPosition=23, ComBitSize=4, ComHandleId=228, ComSystemTemplateSystemSignalRef=CGW_VehicleState
      SGW_IBS_01_oATOM_CAN_Matrix_PT_V600_20250211_afe1198b_Rx (ComIPdu):
        ComIPduDirection = RECEIVE
        ComIPduType = NORMAL
        ComIPduHandleId = 83
        ComIPduSignalProcessing = DEFERRED
        ComIPduCancellationSupport = false
        ComIPduGroupRef = VCU_oATOM_CAN_Matrix_PT_V600_20250211_Rx_49b064ca
        ComIPduSignalGroupRef = SG_SGW_IBS_01_SigGroup_oSGW_IBS_01_oATOM_CAN_Matrix_PT_V600_20250211_0dec95d0_Rx
        ComPduIdRef = SGW_IBS_01_oATOM_CAN_Matrix_PT_V600_20250211_afe1198b_Rx
        ComIPduMainFunctionRef = ComMainFunctionRx
      MCU_FailureCode_oATOM_CAN_Matrix_PT_V600_20250211_4a7c4da7_Rx (ComIPdu):
        ComIPduDirection = RECEIVE
        ComIPduType = NORMAL
        ComIPduHandleId = 64
        ComIPduSignalProcessing = DEFERRED
        ComIPduCancellationSupport = false
        ComIPduGroupRef = VCU_oATOM_CAN_Matrix_PT_V600_20250211_Rx_49b064ca
        ComIPduSignalGroupRef = SG_MCU_FailureCode_SigGroup_oMCU_FailureCode_oATOM_CAN_Matrix_PT_V600_20250211_bf11f7cf_Rx
        ComPduIdRef = MCU_FailureCode_oATOM_CAN_Matrix_PT_V600_20250211_4a7c4da7_Rx
        ComIPduMainFunctionRef = ComMainFunctionRx
      SG_TCU_01_SigGroup_oTCU_01_oATOM_CAN_Matrix_PT_V600_20250211_95b4cd9c_Rx (ComSignalGroup): ComTransferProperty=PENDING, ComSignalGroupAccess=ACCESS_UNCLEAR, ComHandleId=80, ComSystemTemplateSignalGroupRef=SG_TCU_01_SigGroup
        4 x ComGroupSignal, all with ComSignalEndianness=BIG_ENDIAN, ComSignalInitValue=0, ComSignalType=UINT8, ComSignalAccess=ACCESS_UNCLEAR:
          TCU_TMSFaultLevel_oTCU_01_oATOM_CAN_Matrix_PT_V600_20250211_0e521934_Rx: ComBitPosition=19, ComBitSize=3, ComHandleId=513, ComSystemTemplateSystemSignalRef=TCU_TMSFaultLevel
          TCU_TMSTotalPwrCnsmp_oTCU_01_oATOM_CAN_Matrix_PT_V600_20250211_9dde2d90_Rx: ComBitPosition=7, ComBitSize=8, ComHandleId=514, ComSystemTemplateSystemSignalRef=TCU_TMSTotalPwrCnsmp
          TCU_TMSTotoalPwrReq_oTCU_01_oATOM_CAN_Matrix_PT_V600_20250211_247c22c3_Rx: ComBitPosition=39, ComBitSize=8, ComHandleId=515, ComSystemTemplateSystemSignalRef=TCU_TMSTotoalPwrReq
          TCU_HVPwrState_oTCU_01_oATOM_CAN_Matrix_PT_V600_20250211_8d7d29e0_Rx: ComBitPosition=43, ComBitSize=2, ComHandleId=512, ComSystemTemplateSystemSignalRef=TCU_HVPwrState
      SG_MCU_DeratingStatus_SigGroup_oMCU_DeratingStatus_oATOM_CAN_Matrix_PT_V600_20250211_c60bf9ce_Rx (ComSignalGroup): ComTransferProperty=PENDING, ComSignalGroupAccess=ACCESS_UNCLEAR, ComHandleId=58, ComSystemTemplateSignalGroupRef=SG_MCU_DeratingStatus_SigGroup
        MCU_TrqAbsMax_oMCU_DeratingStatus_oATOM_CAN_Matrix_PT_V600_20250211_e9a1ec48_Rx (ComGroupSignal):
          ComBitPosition = 7
          ComBitSize = 11
          ComSignalEndianness = BIG_ENDIAN
          ComSignalInitValue = 1023
          ComSignalType = UINT16
          ComSignalAccess = ACCESS_UNCLEAR
          ComHandleId = 435
          ComSystemTemplateSystemSignalRef = MCU_TrqAbsMax
        MCU_TrqAbsMin_oMCU_DeratingStatus_oATOM_CAN_Matrix_PT_V600_20250211_84a8e353_Rx (ComGroupSignal):
          ComBitPosition = 12
          ComBitSize = 11
          ComSignalEndianness = BIG_ENDIAN
          ComSignalInitValue = 1023
          ComSignalType = UINT16
          ComSignalAccess = ACCESS_UNCLEAR
          ComHandleId = 436
          ComSystemTemplateSystemSignalRef = MCU_TrqAbsMin
      MCU_Temperature_02_oATOM_CAN_Matrix_PT_V600_20250211_89cf23c7_Rx (ComIPdu):
        ComIPduDirection = RECEIVE
        ComIPduType = NORMAL
        ComIPduHandleId = 66
        ComIPduSignalProcessing = DEFERRED
        ComIPduCancellationSupport = false
        ComIPduGroupRef = VCU_oATOM_CAN_Matrix_PT_V600_20250211_Rx_49b064ca
        ComIPduSignalGroupRef = SG_MCU_Temperature_02_SigGroup_oMCU_Temperature_02_oATOM_CAN_Matrix_PT_V600_20250211_5f18debb_Rx
        ComPduIdRef = MCU_Temperature_02_oATOM_CAN_Matrix_PT_V600_20250211_89cf23c7_Rx
        ComIPduMainFunctionRef = ComMainFunctionRx
      VCU_oATOM_CAN_Matrix_PT_V600_20250211_Rx_49b064ca (ComIPduGroup): ComIPduGroupHandleId=2
      BMS_VersionInfor_oATOM_CAN_Matrix_PT_V600_20250211_8287fedd_Rx (ComIPdu):
        ComIPduDirection = RECEIVE
        ComIPduType = NORMAL
        ComIPduHandleId = 25
        ComIPduSignalProcessing = DEFERRED
        ComIPduCancellationSupport = false
        ComIPduGroupRef = VCU_oATOM_CAN_Matrix_PT_V600_20250211_Rx_49b064ca
        ComIPduSignalGroupRef = SG_BMS_VersionInfor_SigGroup_oBMS_VersionInfor_oATOM_CAN_Matrix_PT_V600_20250211_3c7841d8_Rx
        ComPduIdRef = BMS_VersionInfor_oATOM_CAN_Matrix_PT_V600_20250211_8287fedd_Rx
        ComIPduMainFunctionRef = ComMainFunctionRx
      SGW_04_oATOM_CAN_Matrix_PT_V600_20250211_bac0c02b_Rx (ComIPdu):
        ComIPduDirection = RECEIVE
        ComIPduType = NORMAL
        ComIPduHandleId = 79
        ComIPduSignalProcessing = DEFERRED
        ComIPduCancellationSupport = false
        ComIPduGroupRef = VCU_oATOM_CAN_Matrix_PT_V600_20250211_Rx_49b064ca
        ComIPduSignalGroupRef = SG_SGW_04_SigGroup_oSGW_04_oATOM_CAN_Matrix_PT_V600_20250211_6531b3f9_Rx
        ComPduIdRef = SGW_04_oATOM_CAN_Matrix_PT_V600_20250211_bac0c02b_Rx
        ComIPduMainFunctionRef = ComMainFunctionRx
      4 x ComSignalGroup, all with ComTransferProperty=PENDING, ComSignalGroupAccess=ACCESS_UNCLEAR:
        SG_VCU_HMIsignals_02_SigGroup_oVCU_HMIsignals_02_oATOM_CAN_Matrix_PT_V600_20250211_86577563_Tx: ComHandleId=16, ComSystemTemplateSignalGroupRef=SG_VCU_HMIsignals_02_SigGroup
          9 x ComGroupSignal, all with ComSignalEndianness=BIG_ENDIAN, ComTransferProperty=PENDING, ComSignalAccess=ACCESS_UNCLEAR:
            VCU_DischargeEndSoc_oVCU_HMIsignals_02_oATOM_CAN_Matrix_PT_V600_20250211_9b22038e_Tx: ComBitPosition=55, ComBitSize=8, ComSignalInitValue=50, ComSignalType=UINT8, ComHandleId=190, ComSystemTemplateSystemSignalRef=VCU_DischargeEndSoc
            VCU_ForwardVmaxAllowed_oVCU_HMIsignals_02_oATOM_CAN_Matrix_PT_V600_20250211_5c43602a_Tx: ComBitPosition=63, ComBitSize=8, ComSignalInitValue=0, ComSignalType=UINT8, ComHandleId=193, ComSystemTemplateSystemSignalRef=VCU_ForwardVmaxAllowed
            VCU_Display_Power_oVCU_HMIsignals_02_oATOM_CAN_Matrix_PT_V600_20250211_2c39acce_Tx: ComBitPosition=23, ComBitSize=12, ComSignalInitValue=0, ComSignalType=UINT16, ComHandleId=192, ComSystemTemplateSystemSignalRef=VCU_Display_Power
            Checksum_318_oVCU_HMIsignals_02_oATOM_CAN_Matrix_PT_V600_20250211_c35c42e9_Tx: ComBitPosition=7, ComBitSize=8, ComSignalInitValue=0, ComSignalType=UINT8, ComHandleId=188, ComSystemTemplateSystemSignalRef=Checksum_318
            VCU_Display_Cur_oVCU_HMIsignals_02_oATOM_CAN_Matrix_PT_V600_20250211_5dc7c311_Tx: ComBitPosition=25, ComBitSize=10, ComSignalInitValue=0, ComSignalType=UINT16, ComHandleId=191, ComSystemTemplateSystemSignalRef=VCU_Display_Cur
            VCU_maxChargeSOC_oVCU_HMIsignals_02_oATOM_CAN_Matrix_PT_V600_20250211_88b4636e_Tx: ComBitPosition=47, ComBitSize=8, ComSignalInitValue=255, ComSignalType=UINT8, ComHandleId=196, ComSystemTemplateSystemSignalRef=VCU_maxChargeSOC
            MessageCounter_318_oVCU_HMIsignals_02_oATOM_CAN_Matrix_PT_V600_20250211_a5b3031a_Tx: ComBitPosition=11, ComBitSize=4, ComSignalInitValue=0, ComSignalType=UINT8, ComHandleId=189, ComSystemTemplateSystemSignalRef=MessageCounter_318
            VCU_MCU_FaultLampReq_oVCU_HMIsignals_02_oATOM_CAN_Matrix_PT_V600_20250211_86119ac5_Tx: ComBitPosition=15, ComBitSize=2, ComSignalInitValue=0, ComSignalType=UINT8, ComHandleId=194, ComSystemTemplateSystemSignalRef=VCU_MCU_FaultLampReq
            VCU_SystemReady_oVCU_HMIsignals_02_oATOM_CAN_Matrix_PT_V600_20250211_04f726fe_Tx: ComBitPosition=27, ComBitSize=1, ComSignalInitValue=0, ComSignalType=BOOLEAN, ComHandleId=195, ComSystemTemplateSystemSignalRef=VCU_SystemReady
        SG_SGW_PT_01_SigGroup_oSGW_PT_01_oATOM_CAN_Matrix_PT_V600_20250211_d1f7f071_Rx: ComHandleId=77, ComSystemTemplateSignalGroupRef=SG_SGW_PT_01_SigGroup
          4 x ComGroupSignal, all with ComBitSize=2, ComSignalEndianness=BIG_ENDIAN, ComSignalInitValue=0, ComSignalType=UINT8, ComSignalAccess=ACCESS_UNCLEAR:
            IVI_LV_LimitPop_oSGW_PT_01_oATOM_CAN_Matrix_PT_V600_20250211_1112ab7d_Rx: ComBitPosition=55, ComHandleId=498, ComSystemTemplateSystemSignalRef=IVI_LV_LimitPop
            IVI_LockACPlug_oSGW_PT_01_oATOM_CAN_Matrix_PT_V600_20250211_01b87dfd_Rx: ComBitPosition=37, ComHandleId=499, ComSystemTemplateSystemSignalRef=IVI_LockACPlug
            IVI_AppointChargeCmd_oSGW_PT_01_oATOM_CAN_Matrix_PT_V600_20250211_8c65f5f8_Rx: ComBitPosition=31, ComHandleId=496, ComSystemTemplateSystemSignalRef=IVI_AppointChargeCmd
            IVI_ForwardVmaxlimitSw_oSGW_PT_01_oATOM_CAN_Matrix_PT_V600_20250211_8d0f6899_Rx: ComBitPosition=25, ComHandleId=497, ComSystemTemplateSystemSignalRef=IVI_ForwardVmaxlimitSw
        SG_SGW_IBS_01_SigGroup_oSGW_IBS_01_oATOM_CAN_Matrix_PT_V600_20250211_0dec95d0_Rx: ComHandleId=76, ComSystemTemplateSignalGroupRef=SG_SGW_IBS_01_SigGroup
          IVI_CRLevelSet_oSGW_IBS_01_oATOM_CAN_Matrix_PT_V600_20250211_8543222f_Rx (ComGroupSignal):
            ComBitPosition = 31
            ComBitSize = 3
            ComSignalEndianness = BIG_ENDIAN
            ComSignalInitValue = 0
            ComSignalType = UINT8
            ComSignalAccess = ACCESS_UNCLEAR
            ComHandleId = 495
            ComSystemTemplateSystemSignalRef = IVI_CRLevelSet
          IVI_BrakeCompensateCmd_oSGW_IBS_01_oATOM_CAN_Matrix_PT_V600_20250211_49b5a1e8_Rx (ComGroupSignal):
            ComBitPosition = 17
            ComBitSize = 2
            ComSignalEndianness = BIG_ENDIAN
            ComSignalInitValue = 0
            ComSignalType = UINT8
            ComSignalAccess = ACCESS_UNCLEAR
            ComHandleId = 494
            ComSystemTemplateSystemSignalRef = IVI_BrakeCompensateCmd
        SG_IBS_Status_05_SigGroup_oIBS_Status_05_oATOM_CAN_Matrix_PT_V600_20250211_7471090c_Rx: ComHandleId=47, ComSystemTemplateSignalGroupRef=SG_IBS_Status_05_SigGroup
          5 x ComGroupSignal, all with ComSignalEndianness=BIG_ENDIAN, ComSignalInitValue=0, ComSignalType=UINT8, ComSignalAccess=ACCESS_UNCLEAR:
            Checksum_0BB_oIBS_Status_05_oATOM_CAN_Matrix_PT_V600_20250211_d02c6941_Rx: ComBitPosition=7, ComBitSize=8, ComHandleId=358, ComSystemTemplateSystemSignalRef=Checksum_0BB
            IBS_SUBEPBworkingSts_oIBS_Status_05_oATOM_CAN_Matrix_PT_V600_20250211_6b861b0d_Rx: ComBitPosition=21, ComBitSize=3, ComHandleId=361, ComSystemTemplateSystemSignalRef=IBS_SUBEPBworkingSts
            MessageCounter_0BB_oIBS_Status_05_oATOM_CAN_Matrix_PT_V600_20250211_06c8bbd1_Rx: ComBitPosition=11, ComBitSize=4, ComHandleId=362, ComSystemTemplateSystemSignalRef=MessageCounter_0BB
            IBS_SUBEPBFailureStatus_oIBS_Status_05_oATOM_CAN_Matrix_PT_V600_20250211_85549b8d_Rx: ComBitPosition=23, ComBitSize=2, ComHandleId=360, ComSystemTemplateSystemSignalRef=IBS_SUBEPBFailureStatus
            IBS_SUBEPBControllerSts_oIBS_Status_05_oATOM_CAN_Matrix_PT_V600_20250211_4db2fa5a_Rx: ComBitPosition=17, ComBitSize=2, ComHandleId=359, ComSystemTemplateSystemSignalRef=IBS_SUBEPBControllerSts
      VCU_MCU_03_oATOM_CAN_Matrix_PT_V600_20250211_32c07338_Tx (ComIPdu):
        ComIPduDirection = SEND
        ComIPduType = NORMAL
        ComIPduHandleId = 26
        ComIPduSignalProcessing = DEFERRED
        ComIPduCancellationSupport = false
        ComIPduGroupRef = VCU_oATOM_CAN_Matrix_PT_V600_20250211_Tx_1feac34c
        ComIPduSignalGroupRef = SG_VCU_MCU_03_SigGroup_oVCU_MCU_03_oATOM_CAN_Matrix_PT_V600_20250211_ff58040a_Tx
        ComPduIdRef = VCU_MCU_03_oATOM_CAN_Matrix_PT_V600_20250211_32c07338_Tx
        ComIPduMainFunctionRef = ComMainFunctionTx
        ComTxIPdu: ComMinimumDelayTime=0, ComTxIPduUnusedAreasDefault=0
          ComTxModeTrue
            ComTxMode: ComTxModeMode=PERIODIC, ComTxModeTimeOffset=0, ComTxModeTimePeriod=0.01
          ComTxModeFalse
            ComTxMode: ComTxModeMode=PERIODIC, ComTxModeTimeOffset=0, ComTxModeTimePeriod=0.01
      4 x ComSignalGroup, all with ComTransferProperty=PENDING, ComSignalGroupAccess=ACCESS_UNCLEAR:
        SG_CGW_VIN2_SigGroup_oCGW_VIN2_oATOM_CAN_Matrix_PT_V600_20250211_c0accf92_Rx: ComHandleId=33, ComSystemTemplateSignalGroupRef=SG_CGW_VIN2_SigGroup
          8 x ComGroupSignal, all with ComBitSize=8, ComSignalEndianness=BIG_ENDIAN, ComSignalInitValue=0, ComSignalType=UINT8, ComSignalAccess=ACCESS_UNCLEAR:
            CGW_VIN11_oCGW_VIN2_oATOM_CAN_Matrix_PT_V600_20250211_e3776c32_Rx: ComBitPosition=31, ComHandleId=264, ComSystemTemplateSystemSignalRef=CGW_VIN11
            CGW_VIN8_oCGW_VIN2_oATOM_CAN_Matrix_PT_V600_20250211_d13aed08_Rx: ComBitPosition=7, ComHandleId=261, ComSystemTemplateSystemSignalRef=CGW_VIN8
            CGW_VIN12_oCGW_VIN2_oATOM_CAN_Matrix_PT_V600_20250211_dcbc12a7_Rx: ComBitPosition=39, ComHandleId=265, ComSystemTemplateSystemSignalRef=CGW_VIN12
            CGW_VIN14_oCGW_VIN2_oATOM_CAN_Matrix_PT_V600_20250211_a32aef8d_Rx: ComBitPosition=55, ComHandleId=267, ComSystemTemplateSystemSignalRef=CGW_VIN14
            CGW_VIN15_oCGW_VIN2_oATOM_CAN_Matrix_PT_V600_20250211_00bcc7c1_Rx: ComBitPosition=63, ComHandleId=268, ComSystemTemplateSystemSignalRef=CGW_VIN15
            CGW_VIN10_oCGW_VIN2_oATOM_CAN_Matrix_PT_V600_20250211_40e1447e_Rx: ComBitPosition=23, ComHandleId=263, ComSystemTemplateSystemSignalRef=CGW_VIN10
            CGW_VIN13_oCGW_VIN2_oATOM_CAN_Matrix_PT_V600_20250211_7f2a3aeb_Rx: ComBitPosition=47, ComHandleId=266, ComSystemTemplateSystemSignalRef=CGW_VIN13
            CGW_VIN9_oCGW_VIN2_oATOM_CAN_Matrix_PT_V600_20250211_72acc544_Rx: ComBitPosition=15, ComHandleId=262, ComSystemTemplateSystemSignalRef=CGW_VIN9
        SG_BCM_Authentication_SigGroup_oBCM_Authentication_oATOM_CAN_Matrix_PT_V600_20250211_e24c50d2_Rx: ComHandleId=12, ComSystemTemplateSignalGroupRef=SG_BCM_Authentication_SigGroup
          3 x ComGroupSignal, all with ComSignalEndianness=BIG_ENDIAN, ComSignalInitValue=0, ComSignalAccess=ACCESS_UNCLEAR:
            BCM_AntiTheftSts_oBCM_Authentication_oATOM_CAN_Matrix_PT_V600_20250211_10f28e9f_Rx: ComBitPosition=7, ComBitSize=3, ComSignalType=UINT8, ComHandleId=146, ComSystemTemplateSystemSignalRef=BCM_AntiTheftSts
            BCM_SecOCFV_334_oBCM_Authentication_oATOM_CAN_Matrix_PT_V600_20250211_90e9c731_Rx: ComBitPosition=23, ComBitSize=16, ComSignalType=UINT16, ComHandleId=147, ComSystemTemplateSystemSignalRef=BCM_SecOCFV_334
            BCM_SecOCMAC_334_oBCM_Authentication_oATOM_CAN_Matrix_PT_V600_20250211_9bea24c0_Rx: ComBitPosition=39, ComBitSize=32, ComSignalType=UINT32, ComHandleId=148, ComSystemTemplateSystemSignalRef=BCM_SecOCMAC_334
        SG_CGW_VIN1_SigGroup_oCGW_VIN1_oATOM_CAN_Matrix_PT_V600_20250211_49910b51_Rx: ComHandleId=32, ComSystemTemplateSignalGroupRef=SG_CGW_VIN1_SigGroup
          8 x ComGroupSignal, all with ComBitSize=8, ComSignalEndianness=BIG_ENDIAN, ComSignalInitValue=0, ComSignalType=UINT8, ComSignalAccess=ACCESS_UNCLEAR:
            CGW_VIN0_oCGW_VIN1_oATOM_CAN_Matrix_PT_V600_20250211_460f82b6_Rx: ComBitPosition=7, ComHandleId=253, ComSystemTemplateSystemSignalRef=CGW_VIN0
            CGW_VIN2_oCGW_VIN1_oATOM_CAN_Matrix_PT_V600_20250211_da52d46f_Rx: ComBitPosition=23, ComHandleId=255, ComSystemTemplateSystemSignalRef=CGW_VIN2
            CGW_VIN6_oCGW_VIN1_oATOM_CAN_Matrix_PT_V600_20250211_39997f9c_Rx: ComBitPosition=55, ComHandleId=259, ComSystemTemplateSystemSignalRef=CGW_VIN6
            CGW_VIN7_oCGW_VIN1_oATOM_CAN_Matrix_PT_V600_20250211_9a0f57d0_Rx: ComBitPosition=63, ComHandleId=260, ComSystemTemplateSystemSignalRef=CGW_VIN7
            CGW_VIN4_oCGW_VIN1_oATOM_CAN_Matrix_PT_V600_20250211_a5c42945_Rx: ComBitPosition=39, ComHandleId=257, ComSystemTemplateSystemSignalRef=CGW_VIN4
            CGW_VIN5_oCGW_VIN1_oATOM_CAN_Matrix_PT_V600_20250211_06520109_Rx: ComBitPosition=47, ComHandleId=258, ComSystemTemplateSystemSignalRef=CGW_VIN5
            CGW_VIN3_oCGW_VIN1_oATOM_CAN_Matrix_PT_V600_20250211_79c4fc23_Rx: ComBitPosition=31, ComHandleId=256, ComSystemTemplateSystemSignalRef=CGW_VIN3
            CGW_VIN1_oCGW_VIN1_oATOM_CAN_Matrix_PT_V600_20250211_e599aafa_Rx: ComBitPosition=15, ComHandleId=254, ComSystemTemplateSystemSignalRef=CGW_VIN1
        SG_CGW_02_SigGroup_oCGW_02_oATOM_CAN_Matrix_PT_V600_20250211_a306e41a_Rx: ComHandleId=31, ComSystemTemplateSignalGroupRef=SG_CGW_02_SigGroup
          22 x ComGroupSignal, all with ComBitSize=1, ComSignalEndianness=BIG_ENDIAN, ComSignalInitValue=0, ComSignalType=BOOLEAN, ComSignalAccess=ACCESS_UNCLEAR:
            CGW_DCM_FRSts_oCGW_02_oATOM_CAN_Matrix_PT_V600_20250211_b2caf30f_Rx: ComBitPosition=4, ComHandleId=237, ComSystemTemplateSystemSignalRef=CGW_DCM_FRSts
            CGW_SCU_RSts_oCGW_02_oATOM_CAN_Matrix_PT_V600_20250211_99942371_Rx: ComBitPosition=8, ComHandleId=248, ComSystemTemplateSystemSignalRef=CGW_SCU_RSts
            CGW_SwichesSts_oCGW_02_oATOM_CAN_Matrix_PT_V600_20250211_c378d64a_Rx: ComBitPosition=20, ComHandleId=251, ComSystemTemplateSystemSignalRef=CGW_SwichesSts
            CGW_CGWSts_oCGW_02_oATOM_CAN_Matrix_PT_V600_20250211_f27832b0_Rx: ComBitPosition=1, ComHandleId=235, ComSystemTemplateSystemSignalRef=CGW_CGWSts
            CGW_IVISts_oCGW_02_oATOM_CAN_Matrix_PT_V600_20250211_f58e06dc_Rx: ComBitPosition=13, ComHandleId=243, ComSystemTemplateSystemSignalRef=CGW_IVISts
            CGW_MFP_FCSts_oCGW_02_oATOM_CAN_Matrix_PT_V600_20250211_6eb7e4ef_Rx: ComBitPosition=12, ComHandleId=244, ComSystemTemplateSystemSignalRef=CGW_MFP_FCSts
            CGW_BMSSts_oCGW_02_oATOM_CAN_Matrix_PT_V600_20250211_c446f701_Rx: ComBitPosition=16, ComHandleId=233, ComSystemTemplateSystemSignalRef=CGW_BMSSts
            CGW_MFP_RCSts_oCGW_02_oATOM_CAN_Matrix_PT_V600_20250211_3107662f_Rx: ComBitPosition=11, ComHandleId=245, ComSystemTemplateSystemSignalRef=CGW_MFP_RCSts
            CGW_SGWSts_oCGW_02_oATOM_CAN_Matrix_PT_V600_20250211_9f84f3f2_Rx: ComBitPosition=0, ComHandleId=249, ComSystemTemplateSystemSignalRef=CGW_SGWSts
            CGW_VCUSts_oCGW_02_oATOM_CAN_Matrix_PT_V600_20250211_d5f4b0ad_Rx: ComBitPosition=15, ComHandleId=252, ComSystemTemplateSystemSignalRef=CGW_VCUSts
            CGW_DCM_RLSts_oCGW_02_oATOM_CAN_Matrix_PT_V600_20250211_ef4d5eca_Rx: ComBitPosition=5, ComHandleId=238, ComSystemTemplateSystemSignalRef=CGW_DCM_RLSts
            CGW_SWPSts_oCGW_02_oATOM_CAN_Matrix_PT_V600_20250211_1aac9e5f_Rx: ComBitPosition=18, ComHandleId=250, ComSystemTemplateSystemSignalRef=CGW_SWPSts
            CGW_HOD_HeatingSts_oCGW_02_oATOM_CAN_Matrix_PT_V600_20250211_d2f6c570_Rx: ComBitPosition=19, ComHandleId=242, ComSystemTemplateSystemSignalRef=CGW_HOD_HeatingSts
            CGW_HLLSts_oCGW_02_oATOM_CAN_Matrix_PT_V600_20250211_9d5cf1eb_Rx: ComBitPosition=10, ComHandleId=240, ComSystemTemplateSystemSignalRef=CGW_HLLSts
            CGW_PRNDSts_oCGW_02_oATOM_CAN_Matrix_PT_V600_20250211_bdb63078_Rx: ComBitPosition=21, ComHandleId=246, ComSystemTemplateSystemSignalRef=CGW_PRNDSts
            CGW_DCM_RRSts_oCGW_02_oATOM_CAN_Matrix_PT_V600_20250211_ed7a71cf_Rx: ComBitPosition=6, ComHandleId=239, ComSystemTemplateSystemSignalRef=CGW_DCM_RRSts
            CGW_BCMSts_oCGW_02_oATOM_CAN_Matrix_PT_V600_20250211_973cb2b1_Rx: ComBitPosition=17, ComHandleId=232, ComSystemTemplateSystemSignalRef=CGW_BCMSts
            CGW_SCU_LSts_oCGW_02_oATOM_CAN_Matrix_PT_V600_20250211_9ba30c74_Rx: ComBitPosition=7, ComHandleId=247, ComSystemTemplateSystemSignalRef=CGW_SCU_LSts
            CGW_HLRSts_oCGW_02_oATOM_CAN_Matrix_PT_V600_20250211_9f6bdeee_Rx: ComBitPosition=9, ComHandleId=241, ComSystemTemplateSystemSignalRef=CGW_HLRSts
            CGW_ADCUSts_oCGW_02_oATOM_CAN_Matrix_PT_V600_20250211_4e5b2421_Rx: ComBitPosition=14, ComHandleId=231, ComSystemTemplateSystemSignalRef=CGW_ADCUSts
            CGW_CBMSts_oCGW_02_oATOM_CAN_Matrix_PT_V600_20250211_c3f45508_Rx: ComBitPosition=2, ComHandleId=234, ComSystemTemplateSystemSignalRef=CGW_CBMSts
            CGW_DCM_FLSts_oCGW_02_oATOM_CAN_Matrix_PT_V600_20250211_b0fddc0a_Rx: ComBitPosition=3, ComHandleId=236, ComSystemTemplateSystemSignalRef=CGW_DCM_FLSts
      Uds_EPT_Boot_Request_oATOM_CAN_Matrix_PT_V600_20250211_1c93f757_Rx (ComIPdu):
        ComIPduDirection = RECEIVE
        ComIPduType = NORMAL
        ComIPduHandleId = 90
        ComIPduSignalProcessing = DEFERRED
        ComIPduCancellationSupport = false
        ComIPduGroupRef = VCU_oATOM_CAN_Matrix_PT_V600_20250211_Rx_49b064ca
        ComIPduSignalGroupRef = SG_Uds_EPT_Boot_Request_SigGroup_oUds_EPT_Boot_Request_oATOM_CAN_Matrix_PT_V600_20250211_1855e222_Rx
        ComPduIdRef = Uds_EPT_Boot_Request_oATOM_CAN_Matrix_PT_V600_20250211_1c93f757_Rx
        ComIPduMainFunctionRef = ComMainFunctionRx
      BMS_CellVoltage_oATOM_CAN_Matrix_PT_V600_20250211_61ce11e6_Rx (ComIPdu):
        ComIPduDirection = RECEIVE
        ComIPduType = NORMAL
        ComIPduHandleId = 17
        ComIPduSignalProcessing = DEFERRED
        ComIPduCancellationSupport = false
        ComIPduGroupRef = VCU_oATOM_CAN_Matrix_PT_V600_20250211_Rx_49b064ca
        ComIPduSignalGroupRef = SG_BMS_CellVoltage_SigGroup_oBMS_CellVoltage_oATOM_CAN_Matrix_PT_V600_20250211_e26ec140_Rx
        ComPduIdRef = BMS_CellVoltage_oATOM_CAN_Matrix_PT_V600_20250211_61ce11e6_Rx
        ComIPduMainFunctionRef = ComMainFunctionRx
      3 x ComSignalGroup, all with ComTransferProperty=PENDING, ComSignalGroupAccess=ACCESS_UNCLEAR:
        SG_DCM_FR_02_SigGroup_oDCM_FR_02_oATOM_CAN_Matrix_PT_V600_20250211_f609c275_Rx: ComHandleId=36, ComSystemTemplateSignalGroupRef=SG_DCM_FR_02_SigGroup
          DCM_FR_AmbientTemperatureValid_oDCM_FR_02_oATOM_CAN_Matrix_PT_V600_20250211_e90c62bb_Rx (ComGroupSignal):
            ComBitPosition = 28
            ComBitSize = 1
            ComSignalEndianness = BIG_ENDIAN
            ComSignalInitValue = 0
            ComSignalType = BOOLEAN
            ComSignalAccess = ACCESS_UNCLEAR
            ComHandleId = 284
            ComSystemTemplateSystemSignalRef = DCM_FR_AmbientTemperatureValid
          DCM_FR_AmbientTemperature_oDCM_FR_02_oATOM_CAN_Matrix_PT_V600_20250211_cadd082e_Rx (ComGroupSignal):
            ComBitPosition = 39
            ComBitSize = 8
            ComSignalEndianness = BIG_ENDIAN
            ComSignalInitValue = 70
            ComSignalType = UINT8
            ComSignalAccess = ACCESS_UNCLEAR
            ComHandleId = 285
            ComSystemTemplateSystemSignalRef = DCM_FR_AmbientTemperature
        SG_VCU_DCDC_SigGroup_oVCU_DCDC_oATOM_CAN_Matrix_PT_V600_20250211_d0a22af6_Tx: ComHandleId=12, ComSystemTemplateSignalGroupRef=SG_VCU_DCDC_SigGroup
          3 x ComGroupSignal, all with ComSignalEndianness=BIG_ENDIAN, ComSignalInitValue=0, ComTransferProperty=PENDING, ComSignalAccess=ACCESS_UNCLEAR:
            VCU_DCDCPowerLimit_oVCU_DCDC_oATOM_CAN_Matrix_PT_V600_20250211_90ed45f3_Tx: ComBitPosition=47, ComBitSize=6, ComSignalType=UINT8, ComHandleId=161, ComSystemTemplateSystemSignalRef=VCU_DCDCPowerLimit
            VCU_RequestedModeDCDC_oVCU_DCDC_oATOM_CAN_Matrix_PT_V600_20250211_c910d2b3_Tx: ComBitPosition=39, ComBitSize=3, ComSignalType=UINT8, ComHandleId=162, ComSystemTemplateSystemSignalRef=VCU_RequestedModeDCDC
            VCU_VoltageDemandLV_oVCU_DCDC_oATOM_CAN_Matrix_PT_V600_20250211_9951a04f_Tx: ComBitPosition=23, ComBitSize=9, ComSignalType=UINT16, ComHandleId=163, ComSystemTemplateSystemSignalRef=VCU_VoltageDemandLV
        SG_CGW_VIN3VER_SigGroup_oCGW_VIN3VER_oATOM_CAN_Matrix_PT_V600_20250211_7600cd71_Rx: ComHandleId=34, ComSystemTemplateSignalGroupRef=SG_CGW_VIN3VER_SigGroup
          3 x ComGroupSignal, all with ComBitSize=8, ComSignalEndianness=BIG_ENDIAN, ComSignalInitValue=0, ComSignalType=UINT8, ComSignalAccess=ACCESS_UNCLEAR:
            CGW_VERSION2_oCGW_VIN3VER_oATOM_CAN_Matrix_PT_V600_20250211_c1d420b8_Rx: ComBitPosition=23, ComHandleId=270, ComSystemTemplateSystemSignalRef=CGW_VERSION2
            CGW_VERSION1_oCGW_VIN3VER_oATOM_CAN_Matrix_PT_V600_20250211_870615dc_Rx: ComBitPosition=15, ComHandleId=269, ComSystemTemplateSystemSignalRef=CGW_VERSION1
            CGW_VIN16_oCGW_VIN3VER_oATOM_CAN_Matrix_PT_V600_20250211_e72a7464_Rx: ComBitPosition=7, ComHandleId=271, ComSystemTemplateSystemSignalRef=CGW_VIN16
      3 x ComIPdu, all with ComIPduDirection=RECEIVE, ComIPduType=NORMAL, ComIPduSignalProcessing=DEFERRED, ComIPduCancellationSupport=false, ComIPduGroupRef=VCU_oATOM_CAN_Matrix_PT_V600_20250211_Rx_49b064ca, ComIPduMainFunctionRef=ComMainFunctionRx:
        SGW_Time_oATOM_CAN_Matrix_PT_V600_20250211_2fddccce_Rx: ComIPduHandleId=85, ComIPduSignalGroupRef=SG_SGW_Time_SigGroup_oSGW_Time_oATOM_CAN_Matrix_PT_V600_20250211_0ca37593_Rx, ComPduIdRef=SGW_Time_oATOM_CAN_Matrix_PT_V600_20250211_2fddccce_Rx
        IVI_03_oATOM_CAN_Matrix_PT_V600_20250211_56d9a0d4_Rx: ComIPduHandleId=59, ComIPduSignalGroupRef=SG_IVI_03_SigGroup_oIVI_03_oATOM_CAN_Matrix_PT_V600_20250211_bf981109_Rx, ComPduIdRef=IVI_03_oATOM_CAN_Matrix_PT_V600_20250211_56d9a0d4_Rx
        BMS_Charge_01_oATOM_CAN_Matrix_PT_V600_20250211_a9484401_Rx: ComIPduHandleId=18, ComIPduSignalGroupRef=SG_BMS_Charge_01_SigGroup_oBMS_Charge_01_oATOM_CAN_Matrix_PT_V600_20250211_216177cb_Rx, ComPduIdRef=BMS_Charge_01_oATOM_CAN_Matrix_PT_V600_20250211_a9484401_Rx
      SG_BMS_CellTemp_SigGroup_oBMS_CellTemp_oATOM_CAN_Matrix_PT_V600_20250211_591a267a_Rx (ComSignalGroup): ComTransferProperty=PENDING, ComSignalGroupAccess=ACCESS_UNCLEAR, ComHandleId=16, ComSystemTemplateSignalGroupRef=SG_BMS_CellTemp_SigGroup
        6 x ComGroupSignal, all with ComBitSize=8, ComSignalEndianness=BIG_ENDIAN, ComSignalType=UINT8, ComSignalAccess=ACCESS_UNCLEAR:
          BMS_MaxCellTemp_oBMS_CellTemp_oATOM_CAN_Matrix_PT_V600_20250211_f2af76ab_Rx: ComBitPosition=23, ComSignalInitValue=255, ComHandleId=158, ComSystemTemplateSystemSignalRef=BMS_MaxCellTemp
          BMS_MinCellTempModuleNO_oBMS_CellTemp_oATOM_CAN_Matrix_PT_V600_20250211_5ad1b821_Rx: ComBitPosition=47, ComSignalInitValue=0, ComHandleId=159, ComSystemTemplateSystemSignalRef=BMS_MinCellTempModuleNO
          BMS_MaxCellTempNO_oBMS_CellTemp_oATOM_CAN_Matrix_PT_V600_20250211_34228f51_Rx: ComBitPosition=55, ComSignalInitValue=0, ComHandleId=157, ComSystemTemplateSystemSignalRef=BMS_MaxCellTempNO
          BMS_MinCellTemp_oBMS_CellTemp_oATOM_CAN_Matrix_PT_V600_20250211_cb26cda9_Rx: ComBitPosition=31, ComSignalInitValue=255, ComHandleId=161, ComSystemTemplateSystemSignalRef=BMS_MinCellTemp
          BMS_AverageCellTemp_oBMS_CellTemp_oATOM_CAN_Matrix_PT_V600_20250211_8a0ff926_Rx: ComBitPosition=15, ComSignalInitValue=255, ComHandleId=156, ComSystemTemplateSystemSignalRef=BMS_AverageCellTemp
          BMS_MinCellTempNO_oBMS_CellTemp_oATOM_CAN_Matrix_PT_V600_20250211_5aa7be5e_Rx: ComBitPosition=63, ComSignalInitValue=0, ComHandleId=160, ComSystemTemplateSystemSignalRef=BMS_MinCellTempNO
      VCU_oATOM_CAN_Matrix_PT_V600_20250211_Tx_1feac34c (ComIPduGroup): ComIPduGroupHandleId=3
      6 x ComIPdu, all with ComIPduType=NORMAL, ComIPduSignalProcessing=DEFERRED, ComIPduCancellationSupport=false:
        CGW_VIN1_oATOM_CAN_Matrix_PT_V600_20250211_661858dc_Rx: ComIPduDirection=RECEIVE, ComIPduHandleId=32, ComIPduGroupRef=VCU_oATOM_CAN_Matrix_PT_V600_20250211_Rx_49b064ca, ComIPduSignalGroupRef=SG_CGW_VIN1_SigGroup_oCGW_VIN1_oATOM_CAN_Matrix_PT_V600_20250211_49910b51_Rx, ComPduIdRef=CGW_VIN1_oATOM_CAN_Matrix_PT_V600_20250211_661858dc_Rx, ComIPduMainFunctionRef=ComMainFunctionRx
        BCM_05_oATOM_CAN_Matrix_PT_V600_20250211_0d1b9ac1_Rx: ComIPduDirection=RECEIVE, ComIPduHandleId=9, ComIPduGroupRef=VCU_oATOM_CAN_Matrix_PT_V600_20250211_Rx_49b064ca, ComIPduSignalGroupRef=SG_BCM_05_SigGroup_oBCM_05_oATOM_CAN_Matrix_PT_V600_20250211_46c76b05_Rx, ComPduIdRef=BCM_05_oATOM_CAN_Matrix_PT_V600_20250211_0d1b9ac1_Rx, ComIPduMainFunctionRef=ComMainFunctionRx
        VCU_DiagInfor_oATOM_CAN_Matrix_PT_V600_20250211_ad82eb28_Tx: ComIPduDirection=SEND, ComIPduHandleId=16, ComIPduGroupRef=VCU_oATOM_CAN_Matrix_PT_V600_20250211_Tx_1feac34c, ComIPduSignalGroupRef=SG_VCU_DiagInfor_SigGroup_oVCU_DiagInfor_oATOM_CAN_Matrix_PT_V600_20250211_f76d1342_Tx, ComPduIdRef=VCU_DiagInfor_oATOM_CAN_Matrix_PT_V600_20250211_ad82eb28_Tx, ComIPduMainFunctionRef=ComMainFunctionTx
          ComTxIPdu: ComMinimumDelayTime=0, ComTxIPduUnusedAreasDefault=0
            ComTxModeTrue
              ComTxMode: ComTxModeMode=PERIODIC, ComTxModeTimeOffset=0, ComTxModeTimePeriod=1
            ComTxModeFalse
              ComTxMode: ComTxModeMode=PERIODIC, ComTxModeTimeOffset=0, ComTxModeTimePeriod=1
        SGW_FVSynchronization_01_oATOM_CAN_Matrix_PT_V600_20250211_640f878f_Rx: ComIPduDirection=RECEIVE, ComIPduHandleId=82, ComIPduGroupRef=VCU_oATOM_CAN_Matrix_PT_V600_20250211_Rx_49b064ca, ComIPduSignalGroupRef=SG_SGW_FVSynchronization_01_SigGrou_oSGW_FVSynchronization_01_oATOM_CAN_Matrix_PT_V600_20250211_0d3cf875_Rx, ComPduIdRef=SGW_FVSynchronization_01_oATOM_CAN_Matrix_PT_V600_20250211_640f878f_Rx, ComIPduMainFunctionRef=ComMainFunctionRx
        BMS_DIRelayState_oATOM_CAN_Matrix_PT_V600_20250211_48edebca_Rx: ComIPduDirection=RECEIVE, ComIPduHandleId=21, ComIPduGroupRef=VCU_oATOM_CAN_Matrix_PT_V600_20250211_Rx_49b064ca, ComIPduSignalGroupRef=SG_BMS_DIRelayState_SigGroup_oBMS_DIRelayState_oATOM_CAN_Matrix_PT_V600_20250211_ca554d8c_Rx, ComPduIdRef=BMS_DIRelayState_oATOM_CAN_Matrix_PT_V600_20250211_48edebca_Rx, ComIPduMainFunctionRef=ComMainFunctionRx
        VCU_MCU_02_oATOM_CAN_Matrix_PT_V600_20250211_fd5e64f0_Tx: ComIPduDirection=SEND, ComIPduHandleId=24, ComIPduGroupRef=VCU_oATOM_CAN_Matrix_PT_V600_20250211_Tx_1feac34c, ComIPduSignalGroupRef=SG_VCU_MCU_02_SigGroup_oVCU_MCU_02_oATOM_CAN_Matrix_PT_V600_20250211_2d530015_Tx, ComPduIdRef=VCU_MCU_02_oATOM_CAN_Matrix_PT_V600_20250211_fd5e64f0_Tx, ComIPduMainFunctionRef=ComMainFunctionTx
          ComTxIPdu: ComMinimumDelayTime=0, ComTxIPduUnusedAreasDefault=0
            ComTxModeTrue
              ComTxMode: ComTxModeMode=PERIODIC, ComTxModeTimeOffset=0, ComTxModeTimePeriod=0.01
            ComTxModeFalse
              ComTxMode: ComTxModeMode=PERIODIC, ComTxModeTimeOffset=0, ComTxModeTimePeriod=0.01
      SG_BMS_BatInfor_01_SigGroup_oBMS_BatInfor_01_oATOM_CAN_Matrix_PT_V600_20250211_4fef2501_Rx (ComSignalGroup): ComTransferProperty=PENDING, ComSignalGroupAccess=ACCESS_UNCLEAR, ComHandleId=13, ComSystemTemplateSignalGroupRef=SG_BMS_BatInfor_01_SigGroup
        5 x ComGroupSignal, all with ComSignalEndianness=BIG_ENDIAN, ComSignalInitValue=0, ComSignalAccess=ACCESS_UNCLEAR:
          BMS_RatEnergy_oBMS_BatInfor_01_oATOM_CAN_Matrix_PT_V600_20250211_92d3972c_Rx: ComBitPosition=39, ComBitSize=16, ComSignalType=UINT16, ComHandleId=153, ComSystemTemplateSystemSignalRef=BMS_RatEnergy
          BMS_BatType_oBMS_BatInfor_01_oATOM_CAN_Matrix_PT_V600_20250211_379fb564_Rx: ComBitPosition=7, ComBitSize=8, ComSignalType=UINT8, ComHandleId=149, ComSystemTemplateSystemSignalRef=BMS_BatType
          BMS_RatCapacity_oBMS_BatInfor_01_oATOM_CAN_Matrix_PT_V600_20250211_a06c3dfc_Rx: ComBitPosition=23, ComBitSize=16, ComSignalType=UINT16, ComHandleId=152, ComSystemTemplateSystemSignalRef=BMS_RatCapacity
          BMS_CellNumbers_oBMS_BatInfor_01_oATOM_CAN_Matrix_PT_V600_20250211_c37ce81e_Rx: ComBitPosition=15, ComBitSize=8, ComSignalType=UINT8, ComHandleId=150, ComSystemTemplateSystemSignalRef=BMS_CellNumbers
          BMS_RatBatVoltage_oBMS_BatInfor_01_oATOM_CAN_Matrix_PT_V600_20250211_f1943e5d_Rx: ComBitPosition=55, ComBitSize=16, ComSignalType=UINT16, ComHandleId=151, ComSystemTemplateSystemSignalRef=BMS_RatBatVoltage
      BMS_PRO_oATOM_CAN_Matrix_PT_V600_20250211_4a8c07e1_Rx (ComIPdu):
        ComIPduDirection = RECEIVE
        ComIPduType = NORMAL
        ComIPduHandleId = 23
        ComIPduSignalProcessing = DEFERRED
        ComIPduCancellationSupport = false
        ComIPduGroupRef = VCU_oATOM_CAN_Matrix_PT_V600_20250211_Rx_49b064ca
        ComIPduSignalGroupRef = SG_BMS_PRO_SigGroup_oBMS_PRO_oATOM_CAN_Matrix_PT_V600_20250211_21a267c0_Rx
        ComPduIdRef = BMS_PRO_oATOM_CAN_Matrix_PT_V600_20250211_4a8c07e1_Rx
        ComIPduMainFunctionRef = ComMainFunctionRx
      POD_Status_01_oATOM_CAN_Matrix_PT_V600_20250211_ccbeaeb3_Rx (ComIPdu):
        ComIPduDirection = RECEIVE
        ComIPduType = NORMAL
        ComIPduHandleId = 75
        ComIPduSignalProcessing = DEFERRED
        ComIPduCancellationSupport = false
        ComIPduGroupRef = VCU_oATOM_CAN_Matrix_PT_V600_20250211_Rx_49b064ca
        ComIPduSignalGroupRef = SG_POD_Status_01_SigGroup_oPOD_Status_01_oATOM_CAN_Matrix_PT_V600_20250211_880c9d5a_Rx
        ComPduIdRef = POD_Status_01_oATOM_CAN_Matrix_PT_V600_20250211_ccbeaeb3_Rx
        ComIPduMainFunctionRef = ComMainFunctionRx
      SG_SGW_FVSynchronization_01_SigGrou_oSGW_FVSynchronization_01_oATOM_CAN_Matrix_PT_V600_20250211_0d3cf875_Rx (ComSignalGroup):
        ComTransferProperty = PENDING
        ComSignalGroupAccess = ACCESS_UNCLEAR
        ComHandleId = 75
        ComSystemTemplateSignalGroupRef = SG_SGW_FVSynchronization_01_SigGrou
        3 x ComGroupSignal, all with ComSignalEndianness=BIG_ENDIAN, ComSignalInitValue=0, ComSignalAccess=ACCESS_UNCLEAR:
          SGW_SynMsgAuthenticator_oSGW_FVSynchronization_01_oATOM_CAN_Matrix_PT_V600_20250211_b2115b74_Rx: ComBitPosition=47, ComBitSize=24, ComSignalType=UINT32, ComHandleId=492, ComSystemTemplateSystemSignalRef=SGW_SynMsgAuthenticator
          SGW_TripCounter_oSGW_FVSynchronization_01_oATOM_CAN_Matrix_PT_V600_20250211_1cad6227_Rx: ComBitPosition=7, ComBitSize=24, ComSignalType=UINT32, ComHandleId=493, ComSystemTemplateSystemSignalRef=SGW_TripCounter
          SGW_ResetCounter_oSGW_FVSynchronization_01_oATOM_CAN_Matrix_PT_V600_20250211_61156e06_Rx: ComBitPosition=31, ComBitSize=16, ComSignalType=UINT16, ComHandleId=491, ComSystemTemplateSystemSignalRef=SGW_ResetCounter
      SG_BMS_status_01_SigGroup_oBMS_status_01_oATOM_CAN_Matrix_PT_V600_20250211_2f7ddbcd_Rx (ComSignalGroup): ComTransferProperty=PENDING, ComSignalGroupAccess=ACCESS_UNCLEAR, ComHandleId=26, ComSystemTemplateSignalGroupRef=SG_BMS_status_01_SigGroup
        14 x ComGroupSignal, all with ComSignalEndianness=BIG_ENDIAN, ComSignalInitValue=0, ComSignalAccess=ACCESS_UNCLEAR:
          Checksum_0C1_oBMS_status_01_oATOM_CAN_Matrix_PT_V600_20250211_2a2c563b_Rx: ComBitPosition=7, ComBitSize=8, ComSignalType=UINT8, ComHandleId=218, ComSystemTemplateSystemSignalRef=Checksum_0C1
          BMS_ErrorIsolationSingleLow_oBMS_status_01_oATOM_CAN_Matrix_PT_V600_20250211_b188e9c7_Rx: ComBitPosition=15, ComBitSize=2, ComSignalType=UINT8, ComHandleId=208, ComSystemTemplateSystemSignalRef=BMS_ErrorIsolationSingleLow
          BMS_SOH_oBMS_status_01_oATOM_CAN_Matrix_PT_V600_20250211_1aab6bd4_Rx: ComBitPosition=47, ComBitSize=8, ComSignalType=UINT8, ComHandleId=214, ComSystemTemplateSystemSignalRef=BMS_SOH
          MessageCounter_0C1_oBMS_status_01_oATOM_CAN_Matrix_PT_V600_20250211_fcc884ab_Rx: ComBitPosition=11, ComBitSize=4, ComSignalType=UINT8, ComHandleId=219, ComSystemTemplateSystemSignalRef=MessageCounter_0C1
          BMS_PreCharge_oBMS_status_01_oATOM_CAN_Matrix_PT_V600_20250211_07564e5b_Rx: ComBitPosition=31, ComBitSize=2, ComSignalType=UINT8, ComHandleId=212, ComSystemTemplateSystemSignalRef=BMS_PreCharge
          BMS_ErrorLevel_oBMS_status_01_oATOM_CAN_Matrix_PT_V600_20250211_9a0a25e1_Rx: ComBitPosition=35, ComBitSize=4, ComSignalType=UINT8, ComHandleId=209, ComSystemTemplateSystemSignalRef=BMS_ErrorLevel
          BMS_ChargeStatus_oBMS_status_01_oATOM_CAN_Matrix_PT_V600_20250211_79fec82c_Rx: ComBitPosition=27, ComBitSize=3, ComSignalType=UINT8, ComHandleId=207, ComSystemTemplateSystemSignalRef=BMS_ChargeStatus
          BMS_RunHeatStatus_oBMS_status_01_oATOM_CAN_Matrix_PT_V600_20250211_2fcb1018_Rx: ComBitPosition=39, ComBitSize=3, ComSignalType=UINT8, ComHandleId=213, ComSystemTemplateSystemSignalRef=BMS_RunHeatStatus
          BMS_HVinterlockState_oBMS_status_01_oATOM_CAN_Matrix_PT_V600_20250211_83b45d03_Rx: ComBitPosition=18, ComBitSize=1, ComSignalType=BOOLEAN, ComHandleId=210, ComSystemTemplateSystemSignalRef=BMS_HVinterlockState
          BMS_SysRegInsulationValue_oBMS_status_01_oATOM_CAN_Matrix_PT_V600_20250211_8d0ccb80_Rx: ComBitPosition=55, ComBitSize=16, ComSignalType=UINT16, ComHandleId=215, ComSystemTemplateSystemSignalRef=BMS_SysRegInsulationValue
          BMS_BalancingStatus_oBMS_status_01_oATOM_CAN_Matrix_PT_V600_20250211_282baecd_Rx: ComBitPosition=20, ComBitSize=1, ComSignalType=BOOLEAN, ComHandleId=206, ComSystemTemplateSystemSignalRef=BMS_BalancingStatus
          BMS_InsulationDetectionStatus_oBMS_status_01_oATOM_CAN_Matrix_PT_V600_20250211_27ab5dff_Rx: ComBitPosition=19, ComBitSize=1, ComSignalType=BOOLEAN, ComHandleId=211, ComSystemTemplateSystemSignalRef=BMS_InsulationDetectionStatus
          BMS_ThrmlRunawayFault_oBMS_status_01_oATOM_CAN_Matrix_PT_V600_20250211_72ef69bf_Rx: ComBitPosition=16, ComBitSize=1, ComSignalType=BOOLEAN, ComHandleId=216, ComSystemTemplateSystemSignalRef=BMS_ThrmlRunawayFault
          BMS_WorkMode_oBMS_status_01_oATOM_CAN_Matrix_PT_V600_20250211_93c719c8_Rx: ComBitPosition=23, ComBitSize=3, ComSignalType=UINT8, ComHandleId=217, ComSystemTemplateSystemSignalRef=BMS_WorkMode
      6 x ComIPdu, all with ComIPduType=NORMAL, ComIPduSignalProcessing=DEFERRED, ComIPduCancellationSupport=false:
        TCU_01_oATOM_CAN_Matrix_PT_V600_20250211_26cca276_Rx: ComIPduDirection=RECEIVE, ComIPduHandleId=88, ComIPduGroupRef=VCU_oATOM_CAN_Matrix_PT_V600_20250211_Rx_49b064ca, ComIPduSignalGroupRef=SG_TCU_01_SigGroup_oTCU_01_oATOM_CAN_Matrix_PT_V600_20250211_95b4cd9c_Rx, ComPduIdRef=TCU_01_oATOM_CAN_Matrix_PT_V600_20250211_26cca276_Rx, ComIPduMainFunctionRef=ComMainFunctionRx
        VCU_HMIsignals_03_oATOM_CAN_Matrix_PT_V600_20250211_898acf8c_Tx: ComIPduDirection=SEND, ComIPduHandleId=22, ComIPduGroupRef=VCU_oATOM_CAN_Matrix_PT_V600_20250211_Tx_1feac34c, ComIPduSignalGroupRef=SG_VCU_HMIsignals_03_SigGroup_oVCU_HMIsignals_03_oATOM_CAN_Matrix_PT_V600_20250211_197a0877_Tx, ComPduIdRef=VCU_HMIsignals_03_oATOM_CAN_Matrix_PT_V600_20250211_898acf8c_Tx, ComIPduMainFunctionRef=ComMainFunctionTx
          ComTxIPdu: ComMinimumDelayTime=0, ComTxIPduUnusedAreasDefault=0
            ComTxModeTrue
              ComTxMode: ComTxModeMode=PERIODIC, ComTxModeTimeOffset=0, ComTxModeTimePeriod=0.2
            ComTxModeFalse
              ComTxMode: ComTxModeMode=PERIODIC, ComTxModeTimeOffset=0, ComTxModeTimePeriod=0.2
        BMS_Charge_02_oATOM_CAN_Matrix_PT_V600_20250211_229b7a18_Rx: ComIPduDirection=RECEIVE, ComIPduHandleId=19, ComIPduGroupRef=VCU_oATOM_CAN_Matrix_PT_V600_20250211_Rx_49b064ca, ComIPduSignalGroupRef=SG_BMS_Charge_02_SigGroup_oBMS_Charge_02_oATOM_CAN_Matrix_PT_V600_20250211_116647c1_Rx, ComPduIdRef=BMS_Charge_02_oATOM_CAN_Matrix_PT_V600_20250211_229b7a18_Rx, ComIPduMainFunctionRef=ComMainFunctionRx
        POD_Status_02_oATOM_CAN_Matrix_PT_V600_20250211_476d90aa_Rx: ComIPduDirection=RECEIVE, ComIPduHandleId=76, ComIPduGroupRef=VCU_oATOM_CAN_Matrix_PT_V600_20250211_Rx_49b064ca, ComIPduSignalGroupRef=SG_POD_Status_02_SigGroup_oPOD_Status_02_oATOM_CAN_Matrix_PT_V600_20250211_b80bad50_Rx, ComPduIdRef=POD_Status_02_oATOM_CAN_Matrix_PT_V600_20250211_476d90aa_Rx, ComIPduMainFunctionRef=ComMainFunctionRx
        VCU_HMIsignals_02_oATOM_CAN_Matrix_PT_V600_20250211_4614d844_Tx: ComIPduDirection=SEND, ComIPduHandleId=21, ComIPduGroupRef=VCU_oATOM_CAN_Matrix_PT_V600_20250211_Tx_1feac34c, ComIPduSignalGroupRef=SG_VCU_HMIsignals_02_SigGroup_oVCU_HMIsignals_02_oATOM_CAN_Matrix_PT_V600_20250211_86577563_Tx, ComPduIdRef=VCU_HMIsignals_02_oATOM_CAN_Matrix_PT_V600_20250211_4614d844_Tx, ComIPduMainFunctionRef=ComMainFunctionTx
          ComTxIPdu: ComMinimumDelayTime=0, ComTxIPduUnusedAreasDefault=0
            ComTxModeTrue
              ComTxMode: ComTxModeMode=PERIODIC, ComTxModeTimeOffset=0, ComTxModeTimePeriod=0.2
            ComTxModeFalse
              ComTxMode: ComTxModeMode=PERIODIC, ComTxModeTimeOffset=0, ComTxModeTimePeriod=0.2
        BMS_ErrorInfo_oATOM_CAN_Matrix_PT_V600_20250211_7b9afbfb_Rx: ComIPduDirection=RECEIVE, ComIPduHandleId=22, ComIPduGroupRef=VCU_oATOM_CAN_Matrix_PT_V600_20250211_Rx_49b064ca, ComIPduSignalGroupRef=SG_BMS_ErrorInfo_SigGroup_oBMS_ErrorInfo_oATOM_CAN_Matrix_PT_V600_20250211_0728f72e_Rx, ComPduIdRef=BMS_ErrorInfo_oATOM_CAN_Matrix_PT_V600_20250211_7b9afbfb_Rx, ComIPduMainFunctionRef=ComMainFunctionRx
      SG_SGW_16_SigGroup_oSGW_16_oATOM_CAN_Matrix_PT_V600_20250211_194d06e6_Rx (ComSignalGroup): ComTransferProperty=PENDING, ComSignalGroupAccess=ACCESS_UNCLEAR, ComHandleId=73, ComSystemTemplateSignalGroupRef=SG_SGW_16_SigGroup
        IVI_VrState_oSGW_16_oATOM_CAN_Matrix_PT_V600_20250211_518f75b6_Rx (ComGroupSignal):
          ComBitPosition = 33
          ComBitSize = 1
          ComSignalEndianness = BIG_ENDIAN
          ComSignalInitValue = 0
          ComSignalType = BOOLEAN
          ComSignalAccess = ACCESS_UNCLEAR
          ComHandleId = 489
          ComSystemTemplateSystemSignalRef = IVI_VrState
      DCM_FR_oATOM_CAN_Matrix_PT_V600_20250211_22d2db3a_Rx (ComIPdu):
        ComIPduDirection = RECEIVE
        ComIPduType = NORMAL
        ComIPduHandleId = 37
        ComIPduSignalProcessing = DEFERRED
        ComIPduCancellationSupport = false
        ComIPduGroupRef = VCU_oATOM_CAN_Matrix_PT_V600_20250211_Rx_49b064ca
        ComIPduSignalGroupRef = SG_DCM_FR_SigGroup_oDCM_FR_oATOM_CAN_Matrix_PT_V600_20250211_eb540c93_Rx
        ComPduIdRef = DCM_FR_oATOM_CAN_Matrix_PT_V600_20250211_22d2db3a_Rx
        ComIPduMainFunctionRef = ComMainFunctionRx
      VCU_AccPedal_oATOM_CAN_Matrix_PT_V600_20250211_32508e31_Tx (ComIPdu):
        ComIPduDirection = SEND
        ComIPduType = NORMAL
        ComIPduHandleId = 11
        ComIPduSignalProcessing = DEFERRED
        ComIPduCancellationSupport = false
        ComIPduGroupRef = VCU_oATOM_CAN_Matrix_PT_V600_20250211_Tx_1feac34c
        ComIPduSignalGroupRef = SG_VCU_AccPedal_SigGroup_oVCU_AccPedal_oATOM_CAN_Matrix_PT_V600_20250211_950dd51c_Tx
        ComPduIdRef = VCU_AccPedal_oATOM_CAN_Matrix_PT_V600_20250211_32508e31_Tx
        ComIPduMainFunctionRef = ComMainFunctionTx
        ComTxIPdu: ComMinimumDelayTime=0, ComTxIPduUnusedAreasDefault=0
          ComTxModeTrue
            ComTxMode: ComTxModeMode=PERIODIC, ComTxModeTimeOffset=0, ComTxModeTimePeriod=0.02
          ComTxModeFalse
            ComTxMode: ComTxModeMode=PERIODIC, ComTxModeTimeOffset=0, ComTxModeTimePeriod=0.02
      SG_IVI_01_SigGroup_oIVI_01_oATOM_CAN_Matrix_PT_V600_20250211_284cc0c2_Rx (ComSignalGroup): ComTransferProperty=PENDING, ComSignalGroupAccess=ACCESS_UNCLEAR, ComHandleId=53, ComSystemTemplateSignalGroupRef=SG_IVI_01_SigGroup
        IVI_GearRequest_oIVI_01_oATOM_CAN_Matrix_PT_V600_20250211_3ae0554e_Rx (ComGroupSignal):
          ComBitPosition = 15
          ComBitSize = 3
          ComSignalEndianness = BIG_ENDIAN
          ComSignalInitValue = 0
          ComSignalType = UINT8
          ComSignalAccess = ACCESS_UNCLEAR
          ComHandleId = 418
          ComSystemTemplateSystemSignalRef = IVI_GearRequest
      5 x ComIPdu, all with ComIPduDirection=RECEIVE, ComIPduType=NORMAL, ComIPduSignalProcessing=DEFERRED, ComIPduCancellationSupport=false, ComIPduGroupRef=VCU_oATOM_CAN_Matrix_PT_V600_20250211_Rx_49b064ca, ComIPduMainFunctionRef=ComMainFunctionRx:
        BMS_Charge_03_oATOM_CAN_Matrix_PT_V600_20250211_ed056dd0_Rx: ComIPduHandleId=20, ComIPduSignalGroupRef=SG_BMS_Charge_03_SigGroup_oBMS_Charge_03_oATOM_CAN_Matrix_PT_V600_20250211_b7b455f8_Rx, ComPduIdRef=BMS_Charge_03_oATOM_CAN_Matrix_PT_V600_20250211_ed056dd0_Rx
        EVCOM_State_01_oATOM_CAN_Matrix_PT_V600_20250211_58e3b562_Rx: ComIPduHandleId=40, ComIPduSignalGroupRef=SG_EVCOM_State_01_SigGroup_oEVCOM_State_01_oATOM_CAN_Matrix_PT_V600_20250211_16f3767b_Rx, ComPduIdRef=EVCOM_State_01_oATOM_CAN_Matrix_PT_V600_20250211_58e3b562_Rx
        BMS_CellTemp_oATOM_CAN_Matrix_PT_V600_20250211_fd2a47f3_Rx: ComIPduHandleId=16, ComIPduSignalGroupRef=SG_BMS_CellTemp_SigGroup_oBMS_CellTemp_oATOM_CAN_Matrix_PT_V600_20250211_591a267a_Rx, ComPduIdRef=BMS_CellTemp_oATOM_CAN_Matrix_PT_V600_20250211_fd2a47f3_Rx
        BMS_status_02_oATOM_CAN_Matrix_PT_V600_20250211_21a69c56_Rx: ComIPduHandleId=27, ComIPduSignalGroupRef=SG_BMS_status_02_SigGroup_oBMS_status_02_oATOM_CAN_Matrix_PT_V600_20250211_1f7aebc7_Rx, ComPduIdRef=BMS_status_02_oATOM_CAN_Matrix_PT_V600_20250211_21a69c56_Rx
        BMS_BatInfor_02_oATOM_CAN_Matrix_PT_V600_20250211_4cc747cc_Rx: ComIPduHandleId=14, ComIPduSignalGroupRef=SG_BMS_BatInfor_02_SigGroup_oBMS_BatInfor_02_oATOM_CAN_Matrix_PT_V600_20250211_426bcc59_Rx, ComPduIdRef=BMS_BatInfor_02_oATOM_CAN_Matrix_PT_V600_20250211_4cc747cc_Rx
      3 x ComSignalGroup, all with ComTransferProperty=PENDING, ComSignalGroupAccess=ACCESS_UNCLEAR:
        SG_BMS_status_03_SigGroup_oBMS_status_03_oATOM_CAN_Matrix_PT_V600_20250211_b9a8f9fe_Rx: ComHandleId=28, ComSystemTemplateSignalGroupRef=SG_BMS_status_03_SigGroup
          3 x ComGroupSignal, all with ComBitSize=16, ComSignalEndianness=BIG_ENDIAN, ComSignalInitValue=0, ComSignalType=UINT16, ComSignalAccess=ACCESS_UNCLEAR:
            BMS_PackVoltage_oBMS_status_03_oATOM_CAN_Matrix_PT_V600_20250211_4cda4f33_Rx: ComBitPosition=7, ComHandleId=225, ComSystemTemplateSystemSignalRef=BMS_PackVoltage
            BMS_LinkVoltage_oBMS_status_03_oATOM_CAN_Matrix_PT_V600_20250211_57ffa044_Rx: ComBitPosition=23, ComHandleId=224, ComSystemTemplateSystemSignalRef=BMS_LinkVoltage
            BMS_DisplaySOC_oBMS_status_03_oATOM_CAN_Matrix_PT_V600_20250211_58348b09_Rx: ComBitPosition=55, ComHandleId=223, ComSystemTemplateSystemSignalRef=BMS_DisplaySOC
        SG_DCM_FL_02_SigGroup_oDCM_FL_02_oATOM_CAN_Matrix_PT_V600_20250211_46147686_Rx: ComHandleId=35, ComSystemTemplateSignalGroupRef=SG_DCM_FL_02_SigGroup
          12 x ComGroupSignal, all with ComSignalEndianness=BIG_ENDIAN, ComSignalAccess=ACCESS_UNCLEAR:
            DCM_FL_MirrorAutoFoldUnfoldSts_oDCM_FL_02_oATOM_CAN_Matrix_PT_V600_20250211_6b867db1_Rx: ComBitPosition=62, ComBitSize=1, ComSignalInitValue=0, ComSignalType=BOOLEAN, ComHandleId=277, ComSystemTemplateSystemSignalRef=DCM_FL_MirrorAutoFoldUnfoldSts
            MessageCounter_28A_oDCM_FL_02_oATOM_CAN_Matrix_PT_V600_20250211_4642a9f0_Rx: ComBitPosition=11, ComBitSize=4, ComSignalInitValue=0, ComSignalType=UINT8, ComHandleId=283, ComSystemTemplateSystemSignalRef=MessageCounter_28A
            DCM_FL_FRWndSwA_oDCM_FL_02_oATOM_CAN_Matrix_PT_V600_20250211_a982c250_Rx: ComBitPosition=22, ComBitSize=3, ComSignalInitValue=0, ComSignalType=UINT8, ComHandleId=274, ComSystemTemplateSystemSignalRef=DCM_FL_FRWndSwA
            DCM_FL_RRWndSwA_oDCM_FL_02_oATOM_CAN_Matrix_PT_V600_20250211_09de1801_Rx: ComBitPosition=31, ComBitSize=3, ComSignalInitValue=0, ComSignalType=UINT8, ComHandleId=281, ComSystemTemplateSystemSignalRef=DCM_FL_RRWndSwA
            Checksum_28A_oDCM_FL_02_oATOM_CAN_Matrix_PT_V600_20250211_cce2105d_Rx: ComBitPosition=7, ComBitSize=8, ComSignalInitValue=0, ComSignalType=UINT8, ComHandleId=272, ComSystemTemplateSystemSignalRef=Checksum_28A
            DCM_FL_RLWndSwA_oDCM_FL_02_oATOM_CAN_Matrix_PT_V600_20250211_74fa2511_Rx: ComBitPosition=19, ComBitSize=3, ComSignalInitValue=0, ComSignalType=UINT8, ComHandleId=280, ComSystemTemplateSystemSignalRef=DCM_FL_RLWndSwA
            DCM_FL_LeftMirrorHorizontalPos_oDCM_FL_02_oATOM_CAN_Matrix_PT_V600_20250211_010d4778_Rx: ComBitPosition=47, ComBitSize=8, ComSignalInitValue=254, ComSignalType=UINT8, ComHandleId=275, ComSystemTemplateSystemSignalRef=DCM_FL_LeftMirrorHorizontalPos
            DCM_FL_MirrorFold_UnfoldSts_oDCM_FL_02_oATOM_CAN_Matrix_PT_V600_20250211_fb31c620_Rx: ComBitPosition=60, ComBitSize=1, ComSignalInitValue=0, ComSignalType=BOOLEAN, ComHandleId=279, ComSystemTemplateSystemSignalRef=DCM_FL_MirrorFold_UnfoldSts
            DCM_FL_DoorFLSts_oDCM_FL_02_oATOM_CAN_Matrix_PT_V600_20250211_2e6576e2_Rx: ComBitPosition=23, ComBitSize=1, ComSignalInitValue=0, ComSignalType=BOOLEAN, ComHandleId=273, ComSystemTemplateSystemSignalRef=DCM_FL_DoorFLSts
            DCM_FL_MirrorAutoTurnDownSts_oDCM_FL_02_oATOM_CAN_Matrix_PT_V600_20250211_da51d0f7_Rx: ComBitPosition=63, ComBitSize=1, ComSignalInitValue=0, ComSignalType=BOOLEAN, ComHandleId=278, ComSystemTemplateSystemSignalRef=DCM_FL_MirrorAutoTurnDownSts
            DCM_FL_LeftMirrorVerticalPos_oDCM_FL_02_oATOM_CAN_Matrix_PT_V600_20250211_5ff4b001_Rx: ComBitPosition=55, ComBitSize=8, ComSignalInitValue=254, ComSignalType=UINT8, ComHandleId=276, ComSystemTemplateSystemSignalRef=DCM_FL_LeftMirrorVerticalPos
            DCM_FL_RearmirrorHeatingSts_oDCM_FL_02_oATOM_CAN_Matrix_PT_V600_20250211_aa058e71_Rx: ComBitPosition=61, ComBitSize=1, ComSignalInitValue=0, ComSignalType=BOOLEAN, ComHandleId=282, ComSystemTemplateSystemSignalRef=DCM_FL_RearmirrorHeatingSts
        SG_BMS_CellVoltage_SigGroup_oBMS_CellVoltage_oATOM_CAN_Matrix_PT_V600_20250211_e26ec140_Rx: ComHandleId=17, ComSystemTemplateSignalGroupRef=SG_BMS_CellVoltage_SigGroup
          4 x ComGroupSignal, all with ComSignalEndianness=BIG_ENDIAN, ComSignalInitValue=0, ComSignalAccess=ACCESS_UNCLEAR:
            BMS_MaxCellVoltage_oBMS_CellVoltage_oATOM_CAN_Matrix_PT_V600_20250211_44643af9_Rx: ComBitPosition=7, ComBitSize=16, ComSignalType=UINT16, ComHandleId=164, ComSystemTemplateSystemSignalRef=BMS_MaxCellVoltage
            BMS_MinCellVoltage_oBMS_CellVoltage_oATOM_CAN_Matrix_PT_V600_20250211_d5508559_Rx: ComBitPosition=23, ComBitSize=16, ComSignalType=UINT16, ComHandleId=165, ComSystemTemplateSystemSignalRef=BMS_MinCellVoltage
            BMS_MaxCellVoltageNO_oBMS_CellVoltage_oATOM_CAN_Matrix_PT_V600_20250211_f7be414b_Rx: ComBitPosition=47, ComBitSize=8, ComSignalType=UINT8, ComHandleId=163, ComSystemTemplateSystemSignalRef=BMS_MaxCellVoltageNO
            BMS_MaxCellVoltageModuleNO_oBMS_CellVoltage_oATOM_CAN_Matrix_PT_V600_20250211_41af4f62_Rx: ComBitPosition=39, ComBitSize=4, ComSignalType=UINT8, ComHandleId=162, ComSystemTemplateSystemSignalRef=BMS_MaxCellVoltageModuleNO
      MCU_02_oATOM_CAN_Matrix_PT_V600_20250211_8ccf8c29_Rx (ComIPdu):
        ComIPduDirection = RECEIVE
        ComIPduType = NORMAL
        ComIPduHandleId = 62
        ComIPduSignalProcessing = DEFERRED
        ComIPduCancellationSupport = false
        ComIPduGroupRef = VCU_oATOM_CAN_Matrix_PT_V600_20250211_Rx_49b064ca
        ComIPduSignalGroupRef = SG_MCU_02_SigGroup_oMCU_02_oATOM_CAN_Matrix_PT_V600_20250211_09c28691_Rx
        ComPduIdRef = MCU_02_oATOM_CAN_Matrix_PT_V600_20250211_8ccf8c29_Rx
        ComIPduMainFunctionRef = ComMainFunctionRx
      SG_POD_OBC_STATUS_03_SigGroup_oPOD_OBC_STATUS_03_oATOM_CAN_Matrix_PT_V600_20250211_d6eb071d_Rx (ComSignalGroup): ComTransferProperty=PENDING, ComSignalGroupAccess=ACCESS_UNCLEAR, ComHandleId=66, ComSystemTemplateSignalGroupRef=SG_POD_OBC_STATUS_03_SigGroup
        5 x ComGroupSignal, all with ComSignalEndianness=BIG_ENDIAN, ComSignalInitValue=0, ComSignalAccess=ACCESS_UNCLEAR:
          POD_OBC_FaultLevel_oPOD_OBC_STATUS_03_oATOM_CAN_Matrix_PT_V600_20250211_dfddb20c_Rx: ComBitPosition=1, ComBitSize=2, ComSignalType=UINT8, ComHandleId=460, ComSystemTemplateSystemSignalRef=POD_OBC_FaultLevel
          POD_OBC_Side2Overtempfault_oPOD_OBC_STATUS_03_oATOM_CAN_Matrix_PT_V600_20250211_54bfa6d5_Rx: ComBitPosition=30, ComBitSize=1, ComSignalType=BOOLEAN, ComHandleId=464, ComSystemTemplateSystemSignalRef=POD_OBC_Side2Overtempfault
          POD_OBC_SecondarySideTemp_oPOD_OBC_STATUS_03_oATOM_CAN_Matrix_PT_V600_20250211_6ad0dc35_Rx: ComBitPosition=47, ComBitSize=8, ComSignalType=UINT8, ComHandleId=462, ComSystemTemplateSystemSignalRef=POD_OBC_SecondarySideTemp
          POD_OBC_Side1Overtempfault_oPOD_OBC_STATUS_03_oATOM_CAN_Matrix_PT_V600_20250211_180c8c7c_Rx: ComBitPosition=31, ComBitSize=1, ComSignalType=BOOLEAN, ComHandleId=463, ComSystemTemplateSystemSignalRef=POD_OBC_Side1Overtempfault
          POD_OBC_PrimarySideTemp_oPOD_OBC_STATUS_03_oATOM_CAN_Matrix_PT_V600_20250211_315b5171_Rx: ComBitPosition=39, ComBitSize=8, ComSignalType=UINT8, ComHandleId=461, ComSystemTemplateSystemSignalRef=POD_OBC_PrimarySideTemp
      3 x ComIPdu, all with ComIPduDirection=RECEIVE, ComIPduType=NORMAL, ComIPduSignalProcessing=DEFERRED, ComIPduCancellationSupport=false, ComIPduGroupRef=VCU_oATOM_CAN_Matrix_PT_V600_20250211_Rx_49b064ca, ComIPduMainFunctionRef=ComMainFunctionRx:
        SGW_01_oATOM_CAN_Matrix_PT_V600_20250211_fdc48441_Rx: ComIPduHandleId=78, ComIPduSignalGroupRef=SG_SGW_01_SigGroup_oSGW_01_oATOM_CAN_Matrix_PT_V600_20250211_37bbfdeb_Rx, ComPduIdRef=SGW_01_oATOM_CAN_Matrix_PT_V600_20250211_fdc48441_Rx
        MCU_01_oATOM_CAN_Matrix_PT_V600_20250211_071cb230_Rx: ComIPduHandleId=61, ComIPduSignalGroupRef=SG_MCU_01_SigGroup_oMCU_01_oATOM_CAN_Matrix_PT_V600_20250211_3844bc9f_Rx, ComPduIdRef=MCU_01_oATOM_CAN_Matrix_PT_V600_20250211_071cb230_Rx
        IBS_Status_05_oATOM_CAN_Matrix_PT_V600_20250211_07ae5d67_Rx: ComIPduHandleId=52, ComIPduSignalGroupRef=SG_IBS_Status_05_SigGroup_oIBS_Status_05_oATOM_CAN_Matrix_PT_V600_20250211_7471090c_Rx, ComPduIdRef=IBS_Status_05_oATOM_CAN_Matrix_PT_V600_20250211_07ae5d67_Rx
      SG_VCU_HMIsignals_03_SigGroup_oVCU_HMIsignals_03_oATOM_CAN_Matrix_PT_V600_20250211_197a0877_Tx (ComSignalGroup): ComTransferProperty=PENDING, ComSignalGroupAccess=ACCESS_UNCLEAR, ComHandleId=17, ComSystemTemplateSignalGroupRef=SG_VCU_HMIsignals_03_SigGroup
        3 x ComGroupSignal, all with ComSignalEndianness=BIG_ENDIAN, ComTransferProperty=PENDING, ComSignalAccess=ACCESS_UNCLEAR:
          VCU_Display_voltage_oVCU_HMIsignals_03_oATOM_CAN_Matrix_PT_V600_20250211_1f4e8320_Tx: ComBitPosition=23, ComBitSize=10, ComSignalInitValue=0, ComSignalType=UINT16, ComHandleId=199, ComSystemTemplateSystemSignalRef=VCU_Display_voltage
          VCU_BS_HCurrent_oVCU_HMIsignals_03_oATOM_CAN_Matrix_PT_V600_20250211_6f1b1ed0_Tx: ComBitPosition=47, ComBitSize=16, ComSignalType=SINT16, ComSignalInitValue=0, ComHandleId=197, ComSystemTemplateSystemSignalRef=VCU_BS_HCurrent
          VCU_BS_QuiescentCurrent_oVCU_HMIsignals_03_oATOM_CAN_Matrix_PT_V600_20250211_2f6b45d6_Tx: ComBitPosition=39, ComBitSize=8, ComSignalInitValue=255, ComSignalType=UINT8, ComHandleId=198, ComSystemTemplateSystemSignalRef=VCU_BS_QuiescentCurrent
      POD_OBC_CHRGSTATION_oATOM_CAN_Matrix_PT_V600_20250211_9a75b36b_Rx (ComIPdu):
        ComIPduDirection = RECEIVE
        ComIPduType = NORMAL
        ComIPduHandleId = 71
        ComIPduSignalProcessing = DEFERRED
        ComIPduCancellationSupport = false
        ComIPduGroupRef = VCU_oATOM_CAN_Matrix_PT_V600_20250211_Rx_49b064ca
        ComIPduSignalGroupRef = SG_POD_OBC_CHRGSTATION_SigGroup_oPOD_OBC_CHRGSTATION_oATOM_CAN_Matrix_PT_V600_20250211_4d87b474_Rx
        ComPduIdRef = POD_OBC_CHRGSTATION_oATOM_CAN_Matrix_PT_V600_20250211_9a75b36b_Rx
        ComIPduMainFunctionRef = ComMainFunctionRx
      SG_BMS_Charge_01_SigGroup_oBMS_Charge_01_oATOM_CAN_Matrix_PT_V600_20250211_216177cb_Rx (ComSignalGroup): ComTransferProperty=PENDING, ComSignalGroupAccess=ACCESS_UNCLEAR, ComHandleId=18, ComSystemTemplateSignalGroupRef=SG_BMS_Charge_01_SigGroup
        3 x ComGroupSignal, all with ComBitSize=16, ComSignalEndianness=BIG_ENDIAN, ComSignalInitValue=0, ComSignalType=UINT16, ComSignalAccess=ACCESS_UNCLEAR:
          BMS_RemChagTime_oBMS_Charge_01_oATOM_CAN_Matrix_PT_V600_20250211_27af82cf_Rx: ComBitPosition=7, ComHandleId=168, ComSystemTemplateSystemSignalRef=BMS_RemChagTime
          BMS_AllowChagCurrent_oBMS_Charge_01_oATOM_CAN_Matrix_PT_V600_20250211_5bdeed04_Rx: ComBitPosition=39, ComHandleId=166, ComSystemTemplateSystemSignalRef=BMS_AllowChagCurrent
          BMS_MaxChagVoltage_oBMS_Charge_01_oATOM_CAN_Matrix_PT_V600_20250211_6cebdb8e_Rx: ComBitPosition=23, ComHandleId=167, ComSystemTemplateSystemSignalRef=BMS_MaxChagVoltage
      SG_BMS_TCU_SigGroup_oBMS_TCU_oATOM_CAN_Matrix_PT_V600_20250211_541a46a3_Rx (ComSignalGroup): ComTransferProperty=PENDING, ComSignalGroupAccess=ACCESS_UNCLEAR, ComHandleId=24, ComSystemTemplateSignalGroupRef=SG_BMS_TCU_SigGroup
        4 x ComGroupSignal, all with ComSignalEndianness=BIG_ENDIAN, ComSignalAccess=ACCESS_UNCLEAR:
          BMS_RTC_Request_oBMS_TCU_oATOM_CAN_Matrix_PT_V600_20250211_dbff15fc_Rx: ComBitPosition=41, ComBitSize=1, ComSignalInitValue=0, ComSignalType=BOOLEAN, ComHandleId=203, ComSystemTemplateSystemSignalRef=BMS_RTC_Request
          BMS_KeepWarmRequest_oBMS_TCU_oATOM_CAN_Matrix_PT_V600_20250211_1b8e0c34_Rx: ComBitPosition=44, ComBitSize=1, ComSignalInitValue=0, ComSignalType=BOOLEAN, ComHandleId=201, ComSystemTemplateSystemSignalRef=BMS_KeepWarmRequest
          BMS_AllowCellTemperature_oBMS_TCU_oATOM_CAN_Matrix_PT_V600_20250211_696be742_Rx: ComBitPosition=23, ComBitSize=8, ComSignalInitValue=255, ComSignalType=UINT8, ComHandleId=200, ComSystemTemplateSystemSignalRef=BMS_AllowCellTemperature
          BMS_KeepWarmStatus_oBMS_TCU_oATOM_CAN_Matrix_PT_V600_20250211_96e48497_Rx: ComBitPosition=43, ComBitSize=2, ComSignalInitValue=0, ComSignalType=UINT8, ComHandleId=202, ComSystemTemplateSystemSignalRef=BMS_KeepWarmStatus
      TCU_02_oATOM_CAN_Matrix_PT_V600_20250211_ad1f9c6f_Rx (ComIPdu):
        ComIPduDirection = RECEIVE
        ComIPduType = NORMAL
        ComIPduHandleId = 89
        ComIPduSignalProcessing = DEFERRED
        ComIPduCancellationSupport = false
        ComIPduGroupRef = VCU_oATOM_CAN_Matrix_PT_V600_20250211_Rx_49b064ca
        ComIPduSignalGroupRef = SG_TCU_02_SigGroup_oTCU_02_oATOM_CAN_Matrix_PT_V600_20250211_a432f792_Rx
        ComPduIdRef = TCU_02_oATOM_CAN_Matrix_PT_V600_20250211_ad1f9c6f_Rx
        ComIPduMainFunctionRef = ComMainFunctionRx
      SG_MCU_Temperature_01_SigGroup_oMCU_Temperature_01_oATOM_CAN_Matrix_PT_V600_20250211_9ee5905c_Rx (ComSignalGroup): ComTransferProperty=PENDING, ComSignalGroupAccess=ACCESS_UNCLEAR, ComHandleId=60, ComSystemTemplateSignalGroupRef=SG_MCU_Temperature_01_SigGroup
        MCU_IGBTTempMax_oMCU_Temperature_01_oATOM_CAN_Matrix_PT_V600_20250211_2c994d0d_Rx (ComGroupSignal):
          ComBitPosition = 31
          ComBitSize = 8
          ComSignalEndianness = BIG_ENDIAN
          ComSignalInitValue = 0
          ComSignalType = UINT8
          ComSignalAccess = ACCESS_UNCLEAR
          ComHandleId = 440
          ComSystemTemplateSystemSignalRef = MCU_IGBTTempMax
      CGW_VIN3VER_oATOM_CAN_Matrix_PT_V600_20250211_df8c8006_Rx (ComIPdu):
        ComIPduDirection = RECEIVE
        ComIPduType = NORMAL
        ComIPduHandleId = 34
        ComIPduSignalProcessing = DEFERRED
        ComIPduCancellationSupport = false
        ComIPduGroupRef = VCU_oATOM_CAN_Matrix_PT_V600_20250211_Rx_49b064ca
        ComIPduSignalGroupRef = SG_CGW_VIN3VER_SigGroup_oCGW_VIN3VER_oATOM_CAN_Matrix_PT_V600_20250211_7600cd71_Rx
        ComPduIdRef = CGW_VIN3VER_oATOM_CAN_Matrix_PT_V600_20250211_df8c8006_Rx
        ComIPduMainFunctionRef = ComMainFunctionRx
      SG_POD_Status_02_SigGroup_oPOD_Status_02_oATOM_CAN_Matrix_PT_V600_20250211_b80bad50_Rx (ComSignalGroup): ComTransferProperty=PENDING, ComSignalGroupAccess=ACCESS_UNCLEAR, ComHandleId=69, ComSystemTemplateSignalGroupRef=SG_POD_Status_02_SigGroup
        3 x ComGroupSignal, all with ComBitSize=2, ComSignalEndianness=BIG_ENDIAN, ComSignalType=UINT8, ComSignalAccess=ACCESS_UNCLEAR:
          POD_DCPortInletTempBValid_oPOD_Status_02_oATOM_CAN_Matrix_PT_V600_20250211_ddcd197c_Rx: ComBitPosition=1, ComSignalInitValue=0, ComHandleId=475, ComSystemTemplateSystemSignalRef=POD_DCPortInletTempBValid
          POD_DCPosRelayState_oPOD_Status_02_oATOM_CAN_Matrix_PT_V600_20250211_6f150a52_Rx: ComBitPosition=5, ComSignalInitValue=1, ComHandleId=476, ComSystemTemplateSystemSignalRef=POD_DCPosRelayState
          POD_DCPortInletTempAValid_oPOD_Status_02_oATOM_CAN_Matrix_PT_V600_20250211_bbc9cc4c_Rx: ComBitPosition=3, ComSignalInitValue=0, ComHandleId=474, ComSystemTemplateSystemSignalRef=POD_DCPortInletTempAValid
      6 x ComIPdu, all with ComIPduType=NORMAL, ComIPduSignalProcessing=DEFERRED, ComIPduCancellationSupport=false:
        POD_OBC_STATUS_03_oATOM_CAN_Matrix_PT_V600_20250211_9238d54d_Rx: ComIPduDirection=RECEIVE, ComIPduHandleId=73, ComIPduGroupRef=VCU_oATOM_CAN_Matrix_PT_V600_20250211_Rx_49b064ca, ComIPduSignalGroupRef=SG_POD_OBC_STATUS_03_SigGroup_oPOD_OBC_STATUS_03_oATOM_CAN_Matrix_PT_V600_20250211_d6eb071d_Rx, ComPduIdRef=POD_OBC_STATUS_03_oATOM_CAN_Matrix_PT_V600_20250211_9238d54d_Rx, ComIPduMainFunctionRef=ComMainFunctionRx
        APTC_TCU_oATOM_CAN_Matrix_PT_V600_20250211_f53cb06f_Rx: ComIPduDirection=RECEIVE, ComIPduHandleId=8, ComIPduGroupRef=VCU_oATOM_CAN_Matrix_PT_V600_20250211_Rx_49b064ca, ComIPduSignalGroupRef=SG_APTC_TCU_SigGroup_oAPTC_TCU_oATOM_CAN_Matrix_PT_V600_20250211_467c0275_Rx, ComPduIdRef=APTC_TCU_oATOM_CAN_Matrix_PT_V600_20250211_f53cb06f_Rx, ComIPduMainFunctionRef=ComMainFunctionRx
        BMS_status_01_oATOM_CAN_Matrix_PT_V600_20250211_aa75a24f_Rx: ComIPduDirection=RECEIVE, ComIPduHandleId=26, ComIPduGroupRef=VCU_oATOM_CAN_Matrix_PT_V600_20250211_Rx_49b064ca, ComIPduSignalGroupRef=SG_BMS_status_01_SigGroup_oBMS_status_01_oATOM_CAN_Matrix_PT_V600_20250211_2f7ddbcd_Rx, ComPduIdRef=BMS_status_01_oATOM_CAN_Matrix_PT_V600_20250211_aa75a24f_Rx, ComIPduMainFunctionRef=ComMainFunctionRx
        VCU_BMS_oATOM_CAN_Matrix_PT_V600_20250211_2d559c92_Tx: ComIPduDirection=SEND, ComIPduHandleId=13, ComIPduGroupRef=VCU_oATOM_CAN_Matrix_PT_V600_20250211_Tx_1feac34c, ComIPduSignalGroupRef=SG_VCU_BMS_SigGroup_oVCU_BMS_oATOM_CAN_Matrix_PT_V600_20250211_ed2292a1_Tx, ComPduIdRef=VCU_BMS_oATOM_CAN_Matrix_PT_V600_20250211_2d559c92_Tx, ComIPduMainFunctionRef=ComMainFunctionTx
          ComTxIPdu: ComMinimumDelayTime=0, ComTxIPduUnusedAreasDefault=0
            ComTxModeTrue
              ComTxMode: ComTxModeMode=PERIODIC, ComTxModeTimeOffset=0, ComTxModeTimePeriod=0.02
            ComTxModeFalse
              ComTxMode: ComTxModeMode=PERIODIC, ComTxModeTimeOffset=0, ComTxModeTimePeriod=0.02
        BMS_BatInfor_01_oATOM_CAN_Matrix_PT_V600_20250211_c71479d5_Rx: ComIPduDirection=RECEIVE, ComIPduHandleId=13, ComIPduGroupRef=VCU_oATOM_CAN_Matrix_PT_V600_20250211_Rx_49b064ca, ComIPduSignalGroupRef=SG_BMS_BatInfor_01_SigGroup_oBMS_BatInfor_01_oATOM_CAN_Matrix_PT_V600_20250211_4fef2501_Rx, ComPduIdRef=BMS_BatInfor_01_oATOM_CAN_Matrix_PT_V600_20250211_c71479d5_Rx, ComIPduMainFunctionRef=ComMainFunctionRx
        MCU_Temperature_01_oATOM_CAN_Matrix_PT_V600_20250211_021c1dde_Rx: ComIPduDirection=RECEIVE, ComIPduHandleId=65, ComIPduGroupRef=VCU_oATOM_CAN_Matrix_PT_V600_20250211_Rx_49b064ca, ComIPduSignalGroupRef=SG_MCU_Temperature_01_SigGroup_oMCU_Temperature_01_oATOM_CAN_Matrix_PT_V600_20250211_9ee5905c_Rx, ComPduIdRef=MCU_Temperature_01_oATOM_CAN_Matrix_PT_V600_20250211_021c1dde_Rx, ComIPduMainFunctionRef=ComMainFunctionRx
      SG_MCU_01_SigGroup_oMCU_01_oATOM_CAN_Matrix_PT_V600_20250211_3844bc9f_Rx (ComSignalGroup): ComTransferProperty=PENDING, ComSignalGroupAccess=ACCESS_UNCLEAR, ComHandleId=56, ComSystemTemplateSignalGroupRef=SG_MCU_01_SigGroup
        8 x ComGroupSignal, all with ComSignalEndianness=BIG_ENDIAN, ComSignalAccess=ACCESS_UNCLEAR:
          MCU_ActualSpeedValid_oMCU_01_oATOM_CAN_Matrix_PT_V600_20250211_cc3b4560_Rx: ComBitPosition=13, ComBitSize=1, ComSignalInitValue=0, ComSignalType=BOOLEAN, ComHandleId=427, ComSystemTemplateSystemSignalRef=MCU_ActualSpeedValid
          Checksum_098_oMCU_01_oATOM_CAN_Matrix_PT_V600_20250211_3d12a66a_Rx: ComBitPosition=7, ComBitSize=8, ComSignalInitValue=0, ComSignalType=UINT8, ComHandleId=425, ComSystemTemplateSystemSignalRef=Checksum_098
          MCU_IsCurr_oMCU_01_oATOM_CAN_Matrix_PT_V600_20250211_3f405105_Rx: ComBitPosition=34, ComBitSize=11, ComSignalInitValue=1023, ComSignalType=UINT16, ComHandleId=430, ComSystemTemplateSystemSignalRef=MCU_IsCurr
          MessageCounter_098_oMCU_01_oATOM_CAN_Matrix_PT_V600_20250211_fd75949b_Rx: ComBitPosition=11, ComBitSize=4, ComSignalInitValue=0, ComSignalType=UINT8, ComHandleId=432, ComSystemTemplateSystemSignalRef=MessageCounter_098
          MCU_ActualTorque_oMCU_01_oATOM_CAN_Matrix_PT_V600_20250211_6a6087a3_Rx: ComBitPosition=23, ComBitSize=11, ComSignalInitValue=1023, ComSignalType=UINT16, ComHandleId=429, ComSystemTemplateSystemSignalRef=MCU_ActualTorque
          MCU_UdcCurr_oMCU_01_oATOM_CAN_Matrix_PT_V600_20250211_c9f788aa_Rx: ComBitPosition=28, ComBitSize=10, ComSignalInitValue=0, ComSignalType=UINT16, ComHandleId=431, ComSystemTemplateSystemSignalRef=MCU_UdcCurr
          MCU_ActTrqValid_oMCU_01_oATOM_CAN_Matrix_PT_V600_20250211_ac2cd648_Rx: ComBitPosition=12, ComBitSize=1, ComSignalInitValue=0, ComSignalType=BOOLEAN, ComHandleId=426, ComSystemTemplateSystemSignalRef=MCU_ActTrqValid
          MCU_ActualSpeed_oMCU_01_oATOM_CAN_Matrix_PT_V600_20250211_528eb860_Rx: ComBitPosition=55, ComBitSize=16, ComSignalInitValue=32767, ComSignalType=UINT16, ComHandleId=428, ComSystemTemplateSystemSignalRef=MCU_ActualSpeed
      DCM_FR_02_oATOM_CAN_Matrix_PT_V600_20250211_98d3bd3c_Rx (ComIPdu):
        ComIPduDirection = RECEIVE
        ComIPduType = NORMAL
        ComIPduHandleId = 36
        ComIPduSignalProcessing = DEFERRED
        ComIPduCancellationSupport = false
        ComIPduGroupRef = VCU_oATOM_CAN_Matrix_PT_V600_20250211_Rx_49b064ca
        ComIPduSignalGroupRef = SG_DCM_FR_02_SigGroup_oDCM_FR_02_oATOM_CAN_Matrix_PT_V600_20250211_f609c275_Rx
        ComPduIdRef = DCM_FR_02_oATOM_CAN_Matrix_PT_V600_20250211_98d3bd3c_Rx
        ComIPduMainFunctionRef = ComMainFunctionRx
      DCM_RR_oATOM_CAN_Matrix_PT_V600_20250211_fbc3e1f1_Rx (ComIPdu):
        ComIPduDirection = RECEIVE
        ComIPduType = NORMAL
        ComIPduHandleId = 39
        ComIPduSignalProcessing = DEFERRED
        ComIPduCancellationSupport = false
        ComIPduGroupRef = VCU_oATOM_CAN_Matrix_PT_V600_20250211_Rx_49b064ca
        ComIPduSignalGroupRef = SG_DCM_RR_SigGroup_oDCM_RR_oATOM_CAN_Matrix_PT_V600_20250211_9219ec09_Rx
        ComPduIdRef = DCM_RR_oATOM_CAN_Matrix_PT_V600_20250211_fbc3e1f1_Rx
        ComIPduMainFunctionRef = ComMainFunctionRx
      SG_VCU_TCU_SigGroup_oVCU_TCU_oATOM_CAN_Matrix_PT_V600_20250211_1a98021d_Tx (ComSignalGroup): ComTransferProperty=PENDING, ComSignalGroupAccess=ACCESS_UNCLEAR, ComHandleId=26, ComSystemTemplateSignalGroupRef=SG_VCU_TCU_SigGroup
        VCU_TCUPowerAllowed_oVCU_TCU_oATOM_CAN_Matrix_PT_V600_20250211_0cf367b9_Tx (ComGroupSignal):
          ComBitPosition = 13
          ComBitSize = 13
          ComSignalEndianness = BIG_ENDIAN
          ComSignalInitValue = 0
          ComSignalType = UINT16
          ComTransferProperty = PENDING
          ComSignalAccess = ACCESS_UNCLEAR
          ComHandleId = 248
          ComSystemTemplateSystemSignalRef = VCU_TCUPowerAllowed
        VCU_RequestedModeTCU_oVCU_TCU_oATOM_CAN_Matrix_PT_V600_20250211_ea14d901_Tx (ComGroupSignal):
          ComBitPosition = 15
          ComBitSize = 2
          ComSignalEndianness = BIG_ENDIAN
          ComSignalInitValue = 0
          ComSignalType = UINT8
          ComTransferProperty = PENDING
          ComSignalAccess = ACCESS_UNCLEAR
          ComHandleId = 247
          ComSystemTemplateSystemSignalRef = VCU_RequestedModeTCU
      SG_MCU_Temperature_02_SigGroup_oMCU_Temperature_02_oATOM_CAN_Matrix_PT_V600_20250211_5f18debb_Rx (ComSignalGroup): ComTransferProperty=PENDING, ComSignalGroupAccess=ACCESS_UNCLEAR, ComHandleId=61, ComSystemTemplateSignalGroupRef=SG_MCU_Temperature_02_SigGroup
        MCU_TempStatus_oMCU_Temperature_02_oATOM_CAN_Matrix_PT_V600_20250211_ccf76e7e_Rx (ComGroupSignal):
          ComBitPosition = 47
          ComBitSize = 2
          ComSignalEndianness = BIG_ENDIAN
          ComSignalInitValue = 0
          ComSignalType = UINT8
          ComSignalAccess = ACCESS_UNCLEAR
          ComHandleId = 441
          ComSystemTemplateSystemSignalRef = MCU_TempStatus
      SGW_PT_01_oATOM_CAN_Matrix_PT_V600_20250211_f69035b0_Rx (ComIPdu):
        ComIPduDirection = RECEIVE
        ComIPduType = NORMAL
        ComIPduHandleId = 84
        ComIPduSignalProcessing = DEFERRED
        ComIPduCancellationSupport = false
        ComIPduGroupRef = VCU_oATOM_CAN_Matrix_PT_V600_20250211_Rx_49b064ca
        ComIPduSignalGroupRef = SG_SGW_PT_01_SigGroup_oSGW_PT_01_oATOM_CAN_Matrix_PT_V600_20250211_d1f7f071_Rx
        ComPduIdRef = SGW_PT_01_oATOM_CAN_Matrix_PT_V600_20250211_f69035b0_Rx
        ComIPduMainFunctionRef = ComMainFunctionRx
      4 x ComSignalGroup, all with ComTransferProperty=PENDING, ComSignalGroupAccess=ACCESS_UNCLEAR:
        SG_MCU_FailureCode_SigGroup_oMCU_FailureCode_oATOM_CAN_Matrix_PT_V600_20250211_bf11f7cf_Rx: ComHandleId=59, ComSystemTemplateSignalGroupRef=SG_MCU_FailureCode_SigGroup
          3 x ComGroupSignal, all with ComSignalEndianness=BIG_ENDIAN, ComSignalInitValue=0, ComSignalType=UINT8, ComSignalAccess=ACCESS_UNCLEAR:
            MCU_FaultLevel_oMCU_FailureCode_oATOM_CAN_Matrix_PT_V600_20250211_bf7f5830_Rx: ComBitPosition=26, ComBitSize=3, ComHandleId=438, ComSystemTemplateSystemSignalRef=MCU_FaultLevel
            MessageCounter_253_oMCU_FailureCode_oATOM_CAN_Matrix_PT_V600_20250211_981cfb50_Rx: ComBitPosition=11, ComBitSize=4, ComHandleId=439, ComSystemTemplateSystemSignalRef=MessageCounter_253
            Checksum_253_oMCU_FailureCode_oATOM_CAN_Matrix_PT_V600_20250211_81801456_Rx: ComBitPosition=7, ComBitSize=8, ComHandleId=437, ComSystemTemplateSystemSignalRef=Checksum_253
        SG_SGW_04_SigGroup_oSGW_04_oATOM_CAN_Matrix_PT_V600_20250211_6531b3f9_Rx: ComHandleId=72, ComSystemTemplateSignalGroupRef=SG_SGW_04_SigGroup
          SGW_RemoteHVCtrlReq_oSGW_04_oATOM_CAN_Matrix_PT_V600_20250211_17e2f736_Rx (ComGroupSignal):
            ComBitPosition = 3
            ComBitSize = 2
            ComSignalEndianness = BIG_ENDIAN
            ComSignalInitValue = 0
            ComSignalType = UINT8
            ComSignalAccess = ACCESS_UNCLEAR
            ComHandleId = 488
            ComSystemTemplateSystemSignalRef = SGW_RemoteHVCtrlReq
        SG_Uds_EPT_Boot_Request_SigGroup_oUds_EPT_Boot_Request_oATOM_CAN_Matrix_PT_V600_20250211_1855e222_Rx: ComHandleId=82, ComSystemTemplateSignalGroupRef=SG_Uds_EPT_Boot_Request_SigGroup
          3 x ComGroupSignal, all with ComBitSize=8, ComSignalEndianness=LITTLE_ENDIAN, ComSignalInitValue=0, ComSignalType=UINT8, ComSignalAccess=ACCESS_UNCLEAR:
            UDS_EPT_BootCmd2_oUds_EPT_Boot_Request_oATOM_CAN_Matrix_PT_V600_20250211_e054f4ab_Rx: ComBitPosition=8, ComHandleId=519, ComSystemTemplateSystemSignalRef=UDS_EPT_BootCmd2
            UDS_EPT_BootCmd1_oUds_EPT_Boot_Request_oATOM_CAN_Matrix_PT_V600_20250211_c9ab8207_Rx: ComBitPosition=0, ComHandleId=518, ComSystemTemplateSystemSignalRef=UDS_EPT_BootCmd1
            UDS_EPT_BootCmd3_oUds_EPT_Boot_Request_oATOM_CAN_Matrix_PT_V600_20250211_f8fe26cf_Rx: ComBitPosition=16, ComHandleId=520, ComSystemTemplateSystemSignalRef=UDS_EPT_BootCmd3
        SG_BMS_Charge_02_SigGroup_oBMS_Charge_02_oATOM_CAN_Matrix_PT_V600_20250211_116647c1_Rx: ComHandleId=19, ComSystemTemplateSignalGroupRef=SG_BMS_Charge_02_SigGroup
          10 x ComGroupSignal, all with ComSignalEndianness=BIG_ENDIAN, ComSignalInitValue=0, ComSignalType=UINT8, ComSignalAccess=ACCESS_UNCLEAR:
            BMS_ChagComplete_oBMS_Charge_02_oATOM_CAN_Matrix_PT_V600_20250211_ea7a6697_Rx: ComBitPosition=19, ComBitSize=4, ComHandleId=176, ComSystemTemplateSystemSignalRef=BMS_ChagComplete
            BMS_DCChgMode_oBMS_Charge_02_oATOM_CAN_Matrix_PT_V600_20250211_6d869dd0_Rx: ComBitPosition=5, ComBitSize=2, ComHandleId=178, ComSystemTemplateSystemSignalRef=BMS_DCChgMode
            BMS_AbortAchiveSingleVolt_oBMS_Charge_02_oATOM_CAN_Matrix_PT_V600_20250211_b1bd7374_Rx: ComBitPosition=3, ComBitSize=2, ComHandleId=169, ComSystemTemplateSystemSignalRef=BMS_AbortAchiveSingleVolt
            BMS_AbortErrorCurrent_oBMS_Charge_02_oATOM_CAN_Matrix_PT_V600_20250211_db5d5e67_Rx: ComBitPosition=11, ComBitSize=2, ComHandleId=172, ComSystemTemplateSystemSignalRef=BMS_AbortErrorCurrent
            BMS_AbortErrorVoltage_oBMS_Charge_02_oATOM_CAN_Matrix_PT_V600_20250211_445453cb_Rx: ComBitPosition=23, ComBitSize=2, ComHandleId=173, ComSystemTemplateSystemSignalRef=BMS_AbortErrorVoltage
            BMS_AbortFaultBMSTemp_oBMS_Charge_02_oATOM_CAN_Matrix_PT_V600_20250211_403794ce_Rx: ComBitPosition=15, ComBitSize=2, ComHandleId=174, ComSystemTemplateSystemSignalRef=BMS_AbortFaultBMSTemp
            BMS_ChargeRequest_oBMS_Charge_02_oATOM_CAN_Matrix_PT_V600_20250211_1918c4e0_Rx: ComBitPosition=31, ComBitSize=3, ComHandleId=177, ComSystemTemplateSystemSignalRef=BMS_ChargeRequest
            BMS_AbortAchiveTotalVolt_oBMS_Charge_02_oATOM_CAN_Matrix_PT_V600_20250211_f53da614_Rx: ComBitPosition=1, ComBitSize=2, ComHandleId=170, ComSystemTemplateSystemSignalRef=BMS_AbortAchiveTotalVolt
            BMS_AbortAchivesetValue_oBMS_Charge_02_oATOM_CAN_Matrix_PT_V600_20250211_efa8b96b_Rx: ComBitPosition=9, ComBitSize=2, ComHandleId=171, ComSystemTemplateSystemSignalRef=BMS_AbortAchivesetValue
            BMS_AbortFaultBatteryTemp_oBMS_Charge_02_oATOM_CAN_Matrix_PT_V600_20250211_5b6b8a56_Rx: ComBitPosition=13, ComBitSize=2, ComHandleId=175, ComSystemTemplateSystemSignalRef=BMS_AbortFaultBatteryTemp
      VcuCan12TxMsg1_Sig1_oVcuCan12TxMsg1_oATOM_CAN_XCP_799d4d22_Tx (ComSignal):
        ComBitPosition = 16
        ComBitSize = 16
        ComSignalEndianness = LITTLE_ENDIAN
        ComSignalInitValue = 0
        ComSignalType = SINT16
        ComTimeout = 0
        ComTransferProperty = PENDING
        ComSignalAccess = ACCESS_UNCLEAR
        ComHandleId = 269
        ComSystemTemplateSystemSignalRef = VcuCan12TxMsg1_Sig1
      VcuCan12TxMsg1_Sig2_oVcuCan12TxMsg1_oATOM_CAN_XCP_6ab57451_Tx (ComSignal):
        ComBitPosition = 32
        ComBitSize = 16
        ComSignalEndianness = LITTLE_ENDIAN
        ComSignalInitValue = 0
        ComSignalType = SINT16
        ComTimeout = 0
        ComTransferProperty = PENDING
        ComSignalAccess = ACCESS_UNCLEAR
        ComHandleId = 270
        ComSystemTemplateSystemSignalRef = VcuCan12TxMsg1_Sig2
      VcuCan12TxMsg1_oATOM_CAN_XCP_895c1d63_Tx (ComIPdu):
        ComIPduDirection = SEND
        ComIPduType = NORMAL
        ComIPduHandleId = 47
        ComIPduSignalProcessing = DEFERRED
        ComIPduCancellationSupport = false
        ComIPduGroupRef = VCU_oATOM_CAN_XCP_Tx_ec11bff5
        ComIPduSignalRef = VcuCan12TxMsg1_Sig0_oVcuCan12TxMsg1_oATOM_CAN_XCP_777aa5f3_Tx
        ComIPduSignalRef = VcuCan12TxMsg1_Sig1_oVcuCan12TxMsg1_oATOM_CAN_XCP_799d4d22_Tx
        ComIPduSignalRef = VcuCan12TxMsg1_Sig2_oVcuCan12TxMsg1_oATOM_CAN_XCP_6ab57451_Tx
        ComIPduSignalRef = VcuCan12TxMsg1_Sig3_oVcuCan12TxMsg1_oATOM_CAN_XCP_64529c80_Tx
        ComPduIdRef = VcuCan12TxMsg1_oATOM_CAN_XCP_895c1d63_Tx
        ComIPduMainFunctionRef = ComMainFunctionTx
        ComTxIPdu: ComMinimumDelayTime=0, ComTxIPduUnusedAreasDefault=0
          ComTxModeTrue
            ComTxMode: ComTxModeMode=PERIODIC, ComTxModeTimeOffset=0, ComTxModeTimePeriod=0.5
          ComTxModeFalse
            ComTxMode: ComTxModeMode=PERIODIC, ComTxModeTimeOffset=0, ComTxModeTimePeriod=0.5
      VcuCan12TxMsg1_Sig0_oVcuCan12TxMsg1_oATOM_CAN_XCP_777aa5f3_Tx (ComSignal):
        ComBitPosition = 0
        ComBitSize = 16
        ComSignalEndianness = LITTLE_ENDIAN
        ComSignalInitValue = 0
        ComSignalType = SINT16
        ComTimeout = 0
        ComTransferProperty = PENDING
        ComSignalAccess = ACCESS_UNCLEAR
        ComHandleId = 268
        ComSystemTemplateSystemSignalRef = VcuCan12TxMsg1_Sig0
      VCU_oATOM_CAN_XCP_Tx_ec11bff5 (ComIPduGroup): ComIPduGroupHandleId=4
      VcuCan12TxMsg1_Sig3_oVcuCan12TxMsg1_oATOM_CAN_XCP_64529c80_Tx (ComSignal):
        ComBitPosition = 48
        ComBitSize = 16
        ComSignalEndianness = LITTLE_ENDIAN
        ComSignalInitValue = 0
        ComSignalType = SINT16
        ComTimeout = 0
        ComTransferProperty = PENDING
        ComSignalAccess = ACCESS_UNCLEAR
        ComHandleId = 271
        ComSystemTemplateSystemSignalRef = VcuCan12TxMsg1_Sig3
    ComGeneral:
      ComConfigurationUseDet = true
      ComSafeBswChecks = false
      ComEnableSignalGroupArrayApi = false
      ComRetryFailedTransmitRequests = true
      ComSupportedIPduGroups = 15
      ComVersionInfoApi = false
      ComAdvancedIPduCallouts = true
      ComOptimizedIPduGroupHandling = false
      ComMetaDataSupport = false
      ComDeferredEventCacheSupport = false
      ComDescriptionGateway = false
      ComDescriptionRoutingCodeGeneration = false
      ComStrictRepetitionPeriod = false
      ComMixedModePeriodicSuppression = false
      ComSignalGateway = NONE
      ComUserCbkHeaderFile = Rte_Cbk.h
