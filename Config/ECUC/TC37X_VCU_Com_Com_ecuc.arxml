[part 2 of 2: package /ActiveEcuC]
AUTOSAR XML (schema 00048)
package /ActiveEcuC  (continued)
  module config Com: implementation-config-variant=VARIANT-PRE-COMPILE, module-description=Com_Impl  (continued)
    ComConfig: ComConfigurationId=0, ComRxDeferredNotificationCacheSize=1, ComRxImmediateNotificationCacheSize=0  (continued)
      IBS_Status_06_oATOM_CANFD_Matrix_CH_V600_202502_b3201aef_Rx (ComIPdu):
        ComIPduDirection = RECEIVE
        ComIPduType = NORMAL
        ComIPduHandleId = 19
        ComIPduSignalProcessing = DEFERRED
        ComIPduCancellationSupport = false
        ComIPduGroupRef = VCU_oATOM_CANFD_Matrix_CH_V600_202502_Rx_5e4659c4
        ComIPduSignalGroupRef = SG_IBS_Status_06_SigGroup_oIBS_Status_06_oATOM_CANFD_Matrix_CH_V600_202502_7b2b4097_Rx
        ComPduIdRef = IBS_Status_06_oATOM_CANFD_Matrix_CH_V600_202502_b3201aef_Rx
        ComIPduMainFunctionRef = ComMainFunctionRx
      SG_IBS_WheelSpeed_02_SigGroup_oIBS_WheelSpeed_02_oATOM_CANFD_Matrix_CH_V600_202502_2d752b6e_Rx (ComSignalGroup): ComTransferProperty=PENDING, ComSignalGroupAccess=ACCESS_UNCLEAR, ComHandleId=18, ComSystemTemplateSignalGroupRef=SG_IBS_WheelSpeed_02_SigGroup
        10 x ComGroupSignal, all with ComSignalEndianness=BIG_ENDIAN, ComSignalInitValue=0, ComSignalAccess=ACCESS_UNCLEAR:
          IBS_RRWheelSpeed_Fault_oIBS_WheelSpeed_02_oATOM_CANFD_Matrix_CH_V600_202502_be453909_Rx: ComBitPosition=23, ComBitSize=1, ComSignalType=BOOLEAN, ComHandleId=240, ComSystemTemplateSystemSignalRef=IBS_RRWheelSpeed_Fault
          IBS_RRWheelSpeed_oIBS_WheelSpeed_02_oATOM_CANFD_Matrix_CH_V600_202502_fce5b0f5_Rx: ComBitPosition=20, ComBitSize=13, ComSignalType=UINT16, ComHandleId=241, ComSystemTemplateSystemSignalRef=IBS_RRWheelSpeed
          IBS_RRMovingDirection_oIBS_WheelSpeed_02_oATOM_CANFD_Matrix_CH_V600_202502_1d72c7d4_Rx: ComBitPosition=22, ComBitSize=2, ComSignalType=UINT8, ComHandleId=238, ComSystemTemplateSystemSignalRef=IBS_RRMovingDirection
          Checksum_0B1_oIBS_WheelSpeed_02_oATOM_CANFD_Matrix_CH_V600_202502_65c4b71d_Rx: ComBitPosition=7, ComBitSize=8, ComSignalType=UINT8, ComHandleId=233, ComSystemTemplateSystemSignalRef=Checksum_0B1
          IBS_RLWheelPulseCounter_oIBS_WheelSpeed_02_oATOM_CANFD_Matrix_CH_V600_202502_296e9e60_Rx: ComBitPosition=63, ComBitSize=8, ComSignalType=UINT8, ComHandleId=235, ComSystemTemplateSystemSignalRef=IBS_RLWheelPulseCounter
          IBS_RRWheelPulseCounter_oIBS_WheelSpeed_02_oATOM_CANFD_Matrix_CH_V600_202502_31e56adc_Rx: ComBitPosition=39, ComBitSize=8, ComSignalType=UINT8, ComHandleId=239, ComSystemTemplateSystemSignalRef=IBS_RRWheelPulseCounter
          IBS_RLMovingDirection_oIBS_WheelSpeed_02_oATOM_CANFD_Matrix_CH_V600_202502_ad5dc1f0_Rx: ComBitPosition=46, ComBitSize=2, ComSignalType=UINT8, ComHandleId=234, ComSystemTemplateSystemSignalRef=IBS_RLMovingDirection
          IBS_RLWheelSpeed_oIBS_WheelSpeed_02_oATOM_CANFD_Matrix_CH_V600_202502_5459dc3a_Rx: ComBitPosition=44, ComBitSize=13, ComSignalType=UINT16, ComHandleId=237, ComSystemTemplateSystemSignalRef=IBS_RLWheelSpeed
          IBS_RLWheelSpeed_Fault_oIBS_WheelSpeed_02_oATOM_CANFD_Matrix_CH_V600_202502_82f6f2de_Rx: ComBitPosition=47, ComBitSize=1, ComSignalType=BOOLEAN, ComHandleId=236, ComSystemTemplateSystemSignalRef=IBS_RLWheelSpeed_Fault
          MessageCounter_0B1_oIBS_WheelSpeed_02_oATOM_CANFD_Matrix_CH_V600_202502_032bf6ee_Rx: ComBitPosition=11, ComBitSize=4, ComSignalType=UINT8, ComHandleId=242, ComSystemTemplateSystemSignalRef=MessageCounter_0B1
      IBS_APS_oATOM_CANFD_Matrix_CH_V600_202502_25d77553_Rx (ComIPdu):
        ComIPduDirection = RECEIVE
        ComIPduType = NORMAL
        ComIPduHandleId = 14
        ComIPduSignalProcessing = DEFERRED
        ComIPduCancellationSupport = false
        ComIPduGroupRef = VCU_oATOM_CANFD_Matrix_CH_V600_202502_Rx_5e4659c4
        ComIPduSignalGroupRef = SG_IBS_APS_SigGroup_oIBS_APS_oATOM_CANFD_Matrix_CH_V600_202502_91bbe9ec_Rx
        ComPduIdRef = IBS_APS_oATOM_CANFD_Matrix_CH_V600_202502_25d77553_Rx
        ComIPduMainFunctionRef = ComMainFunctionRx
      SG_ADCU_AEB_01_SigGroup_oADCU_AEB_01_oATOM_CANFD_Matrix_CH_V600_202502_50a93e3a_Rx (ComSignalGroup): ComTransferProperty=PENDING, ComSignalGroupAccess=ACCESS_UNCLEAR, ComHandleId=4, ComSystemTemplateSignalGroupRef=SG_ADCU_AEB_01_SigGroup
        11 x ComGroupSignal, all with ComSignalEndianness=BIG_ENDIAN, ComSignalInitValue=0, ComSignalAccess=ACCESS_UNCLEAR:
          ADCU_AEB_AWB_Level_oADCU_AEB_01_oATOM_CANFD_Matrix_CH_V600_202502_16b7390a_Rx: ComBitPosition=43, ComBitSize=3, ComSignalType=UINT8, ComHandleId=96, ComSystemTemplateSystemSignalRef=ADCU_AEB_AWB_Level
          ADCU_AEB_Prefill_CMD_oADCU_AEB_01_oATOM_CANFD_Matrix_CH_V600_202502_935b0159_Rx: ComBitPosition=55, ComBitSize=1, ComSignalType=BOOLEAN, ComHandleId=99, ComSystemTemplateSystemSignalRef=ADCU_AEB_Prefill_CMD
          ADCU_AEB_Stop_Req_oADCU_AEB_01_oATOM_CANFD_Matrix_CH_V600_202502_edd96c77_Rx: ComBitPosition=53, ComBitSize=1, ComSignalType=BOOLEAN, ComHandleId=101, ComSystemTemplateSystemSignalRef=ADCU_AEB_Stop_Req
          MessageCounter_0E2_oADCU_AEB_01_oATOM_CANFD_Matrix_CH_V600_202502_9953fa4a_Rx: ComBitPosition=11, ComBitSize=4, ComSignalType=UINT8, ComHandleId=104, ComSystemTemplateSystemSignalRef=MessageCounter_0E2
          ADCU_AEBWarningSts_oADCU_AEB_01_oATOM_CANFD_Matrix_CH_V600_202502_ce5fed0e_Rx: ComBitPosition=50, ComBitSize=3, ComSignalType=UINT8, ComHandleId=95, ComSystemTemplateSystemSignalRef=ADCU_AEBWarningSts
          ADCU_AEB_State_oADCU_AEB_01_oATOM_CANFD_Matrix_CH_V600_202502_040d6d85_Rx: ComBitPosition=18, ComBitSize=2, ComSignalType=UINT8, ComHandleId=100, ComSystemTemplateSystemSignalRef=ADCU_AEB_State
          ADCU_AEB_Decel_Cmd_oADCU_AEB_01_oATOM_CANFD_Matrix_CH_V600_202502_e2026fd4_Rx: ComBitPosition=39, ComBitSize=10, ComSignalType=SINT16, ComHandleId=98, ComSystemTemplateSystemSignalRef=ADCU_AEB_Decel_Cmd
          ADCU_FCW_State_oADCU_AEB_01_oATOM_CANFD_Matrix_CH_V600_202502_858628ce_Rx: ComBitPosition=20, ComBitSize=2, ComSignalType=UINT8, ComHandleId=102, ComSystemTemplateSystemSignalRef=ADCU_FCW_State
          Checksum_0E2_oADCU_AEB_01_oATOM_CANFD_Matrix_CH_V600_202502_3047b966_Rx: ComBitPosition=7, ComBitSize=8, ComSignalType=UINT8, ComHandleId=103, ComSystemTemplateSystemSignalRef=Checksum_0E2
          ADCU_AEB_AWB_Req_oADCU_AEB_01_oATOM_CANFD_Matrix_CH_V600_202502_52a850e5_Rx: ComBitPosition=54, ComBitSize=1, ComSignalType=BOOLEAN, ComHandleId=97, ComSystemTemplateSystemSignalRef=ADCU_AEB_AWB_Req
          ADCU_AEBReq_oADCU_AEB_01_oATOM_CANFD_Matrix_CH_V600_202502_cfcc0419_Rx: ComBitPosition=15, ComBitSize=1, ComSignalType=BOOLEAN, ComHandleId=94, ComSystemTemplateSystemSignalRef=ADCU_AEBReq
      SG_IBS_Status_01_SigGroup_oIBS_Status_01_oATOM_CANFD_Matrix_CH_V600_202502_bdf732ba_Rx (ComSignalGroup): ComTransferProperty=PENDING, ComSignalGroupAccess=ACCESS_UNCLEAR, ComHandleId=10, ComSystemTemplateSignalGroupRef=SG_IBS_Status_01_SigGroup
        7 x ComGroupSignal, all with ComSignalEndianness=BIG_ENDIAN, ComSignalAccess=ACCESS_UNCLEAR:
          IBS_BrakePushrodStroke_oIBS_Status_01_oATOM_CANFD_Matrix_CH_V600_202502_b9911368_Rx: ComBitPosition=55, ComBitSize=12, ComSignalInitValue=0, ComSignalType=SINT16, ComHandleId=145, ComSystemTemplateSystemSignalRef=IBS_BrakePushrodStroke
          MessageCounter_0B2_oIBS_Status_01_oATOM_CANFD_Matrix_CH_V600_202502_7bc88e71_Rx: ComBitPosition=11, ComBitSize=4, ComSignalInitValue=0, ComSignalType=UINT8, ComHandleId=148, ComSystemTemplateSystemSignalRef=MessageCounter_0B2
          IBS_BrakePedalStatus_oIBS_Status_01_oATOM_CANFD_Matrix_CH_V600_202502_c14952d9_Rx: ComBitPosition=23, ComBitSize=2, ComSignalInitValue=0, ComSignalType=UINT8, ComHandleId=144, ComSystemTemplateSystemSignalRef=IBS_BrakePedalStatus
          IBS_MasterCylinderPressure_oIBS_Status_01_oATOM_CANFD_Matrix_CH_V600_202502_b339468a_Rx: ComBitPosition=19, ComBitSize=12, ComSignalInitValue=0, ComSignalType=UINT16, ComHandleId=146, ComSystemTemplateSystemSignalRef=IBS_MasterCylinderPressure
          IBS_PlungerPressure_oIBS_Status_01_oATOM_CANFD_Matrix_CH_V600_202502_1a29f19b_Rx: ComBitPosition=36, ComBitSize=12, ComSignalInitValue=0, ComSignalType=SINT16, ComHandleId=147, ComSystemTemplateSystemSignalRef=IBS_PlungerPressure
          Checksum_0B2_oIBS_Status_01_oATOM_CANFD_Matrix_CH_V600_202502_ad2c5ce1_Rx: ComBitPosition=7, ComBitSize=8, ComSignalInitValue=0, ComSignalType=UINT8, ComHandleId=142, ComSystemTemplateSystemSignalRef=Checksum_0B2
          IBS_BrakePedalStatusValid_oIBS_Status_01_oATOM_CANFD_Matrix_CH_V600_202502_ba3a564c_Rx: ComBitPosition=21, ComBitSize=1, ComSignalInitValue=1, ComSignalType=BOOLEAN, ComHandleId=143, ComSystemTemplateSystemSignalRef=IBS_BrakePedalStatusValid
      VCU_03_oATOM_CANFD_Matrix_CH_V600_202502_d824d0f9_Tx (ComIPdu):
        ComIPduDirection = SEND
        ComIPduType = NORMAL
        ComIPduHandleId = 4
        ComIPduSignalProcessing = DEFERRED
        ComIPduCancellationSupport = false
        ComIPduGroupRef = VCU_oATOM_CANFD_Matrix_CH_V600_202502_Tx_081cfe42
        ComIPduSignalGroupRef = SG_VCU_03_SigGroup_oVCU_03_oATOM_CANFD_Matrix_CH_V600_202502_8990e3c1_Tx
        ComPduIdRef = VCU_03_oATOM_CANFD_Matrix_CH_V600_202502_d824d0f9_Tx
        ComIPduMainFunctionRef = ComMainFunctionTx
        ComTxIPdu: ComMinimumDelayTime=0, ComTxIPduUnusedAreasDefault=0
          ComTxModeTrue
            ComTxMode: ComTxModeMode=PERIODIC, ComTxModeTimeOffset=0, ComTxModeTimePeriod=0.1
          ComTxModeFalse
            ComTxMode: ComTxModeMode=PERIODIC, ComTxModeTimeOffset=0, ComTxModeTimePeriod=0.1
      SGW_17_oATOM_CANFD_Matrix_CH_V600_202502_9b3e5336_Rx (ComIPdu):
        ComIPduDirection = RECEIVE
        ComIPduType = NORMAL
        ComIPduHandleId = 26
        ComIPduSignalProcessing = DEFERRED
        ComIPduCancellationSupport = false
        ComIPduGroupRef = VCU_oATOM_CANFD_Matrix_CH_V600_202502_Rx_5e4659c4
        ComIPduSignalGroupRef = SG_SGW_17_SigGroup_oSGW_17_oATOM_CANFD_Matrix_CH_V600_202502_804294b2_Rx
        ComPduIdRef = SGW_17_oATOM_CANFD_Matrix_CH_V600_202502_9b3e5336_Rx
        ComIPduMainFunctionRef = ComMainFunctionRx
      3 x ComSignalGroup, all with ComTransferProperty=PENDING, ComSignalGroupAccess=ACCESS_UNCLEAR:
        SG_IBS_WheelSpeed_01_SigGroup_oIBS_WheelSpeed_01_oATOM_CANFD_Matrix_CH_V600_202502_5773aa13_Rx: ComHandleId=17, ComSystemTemplateSignalGroupRef=SG_IBS_WheelSpeed_01_SigGroup
          10 x ComGroupSignal, all with ComSignalEndianness=BIG_ENDIAN, ComSignalInitValue=0, ComSignalAccess=ACCESS_UNCLEAR:
            IBS_FLWheelSpeed_oIBS_WheelSpeed_01_oATOM_CANFD_Matrix_CH_V600_202502_d228a055_Rx: ComBitPosition=44, ComBitSize=13, ComSignalType=UINT16, ComHandleId=227, ComSystemTemplateSystemSignalRef=IBS_FLWheelSpeed
            IBS_FRMovingDirection_oIBS_WheelSpeed_01_oATOM_CANFD_Matrix_CH_V600_202502_be7c8b57_Rx: ComBitPosition=22, ComBitSize=2, ComSignalType=UINT8, ComHandleId=228, ComSystemTemplateSystemSignalRef=IBS_FRMovingDirection
            Checksum_0B0_oIBS_WheelSpeed_01_oATOM_CANFD_Matrix_CH_V600_202502_efb220b2_Rx: ComBitPosition=7, ComBitSize=8, ComSignalType=UINT8, ComHandleId=223, ComSystemTemplateSystemSignalRef=Checksum_0B0
            IBS_FLMovingDirection_oIBS_WheelSpeed_01_oATOM_CANFD_Matrix_CH_V600_202502_0e538d73_Rx: ComBitPosition=46, ComBitSize=2, ComSignalType=UINT8, ComHandleId=224, ComSystemTemplateSystemSignalRef=IBS_FLMovingDirection
            IBS_FRWheelSpeed_oIBS_WheelSpeed_01_oATOM_CANFD_Matrix_CH_V600_202502_7a94cc9a_Rx: ComBitPosition=20, ComBitSize=13, ComSignalType=UINT16, ComHandleId=231, ComSystemTemplateSystemSignalRef=IBS_FRWheelSpeed
            MessageCounter_0B0_oIBS_WheelSpeed_01_oATOM_CANFD_Matrix_CH_V600_202502_895d6141_Rx: ComBitPosition=11, ComBitSize=4, ComSignalType=UINT8, ComHandleId=232, ComSystemTemplateSystemSignalRef=MessageCounter_0B0
            IBS_FLWheelSpeed_Fault_oIBS_WheelSpeed_01_oATOM_CANFD_Matrix_CH_V600_202502_19d76bef_Rx: ComBitPosition=47, ComBitSize=1, ComSignalType=BOOLEAN, ComHandleId=226, ComSystemTemplateSystemSignalRef=IBS_FLWheelSpeed_Fault
            IBS_FRWheelSpeed_Fault_oIBS_WheelSpeed_01_oATOM_CANFD_Matrix_CH_V600_202502_2564a038_Rx: ComBitPosition=15, ComBitSize=1, ComSignalType=BOOLEAN, ComHandleId=230, ComSystemTemplateSystemSignalRef=IBS_FRWheelSpeed_Fault
            IBS_FRWheelPulseCounter_oIBS_WheelSpeed_01_oATOM_CANFD_Matrix_CH_V600_202502_8f930e98_Rx: ComBitPosition=39, ComBitSize=8, ComSignalType=UINT8, ComHandleId=229, ComSystemTemplateSystemSignalRef=IBS_FRWheelPulseCounter
            IBS_FLWheelPulseCounter_oIBS_WheelSpeed_01_oATOM_CANFD_Matrix_CH_V600_202502_9718fa24_Rx: ComBitPosition=63, ComBitSize=8, ComSignalType=UINT8, ComHandleId=225, ComSystemTemplateSystemSignalRef=IBS_FLWheelPulseCounter
        SG_IBS_VCU_MotorControl_SigGroup_oIBS_VCU_MotorControl_oATOM_CANFD_Matrix_CH_V600_202502_9a811a5b_Rx: ComHandleId=16, ComSystemTemplateSignalGroupRef=SG_IBS_VCU_MotorControl_SigGroup
          6 x ComGroupSignal, all with ComSignalEndianness=BIG_ENDIAN, ComSignalInitValue=0, ComSignalAccess=ACCESS_UNCLEAR:
            MessageCounter_090_oIBS_VCU_MotorControl_oATOM_CANFD_Matrix_CH_V600_202502_db5c1277_Rx: ComBitPosition=11, ComBitSize=4, ComSignalType=UINT8, ComHandleId=222, ComSystemTemplateSystemSignalRef=MessageCounter_090
            IBS_WLTorqueRedReq_oIBS_VCU_MotorControl_oATOM_CANFD_Matrix_CH_V600_202502_79bc7664_Rx: ComBitPosition=39, ComBitSize=16, ComSignalType=UINT16, ComHandleId=221, ComSystemTemplateSystemSignalRef=IBS_WLTorqueRedReq
            IBS_WLTorqueIncrReq_oIBS_VCU_MotorControl_oATOM_CANFD_Matrix_CH_V600_202502_6e9d7a41_Rx: ComBitPosition=55, ComBitSize=16, ComSignalType=UINT16, ComHandleId=219, ComSystemTemplateSystemSignalRef=IBS_WLTorqueIncrReq
            Checksum_090_oIBS_VCU_MotorControl_oATOM_CANFD_Matrix_CH_V600_202502_b5095e35_Rx: ComBitPosition=7, ComBitSize=8, ComSignalType=UINT8, ComHandleId=217, ComSystemTemplateSystemSignalRef=Checksum_090
            IBS_WLTorqueIncrReqSts_oIBS_VCU_MotorControl_oATOM_CANFD_Matrix_CH_V600_202502_f80f3ab5_Rx: ComBitPosition=14, ComBitSize=1, ComSignalType=BOOLEAN, ComHandleId=218, ComSystemTemplateSystemSignalRef=IBS_WLTorqueIncrReqSts
            IBS_WLTorqueRedReqSts_oIBS_VCU_MotorControl_oATOM_CANFD_Matrix_CH_V600_202502_2655e1fb_Rx: ComBitPosition=12, ComBitSize=1, ComSignalType=BOOLEAN, ComHandleId=220, ComSystemTemplateSystemSignalRef=IBS_WLTorqueRedReqSts
        SG_VCU_HMIsignals_02_SigGroup_oVCU_HMIsignals_02_oATOM_CANFD_Matrix_CH_V600_202502_b90a0cf2_Tx: ComHandleId=7, ComSystemTemplateSignalGroupRef=SG_VCU_HMIsignals_02_SigGroup
          9 x ComGroupSignal, all with ComSignalEndianness=BIG_ENDIAN, ComTransferProperty=PENDING, ComSignalAccess=ACCESS_UNCLEAR:
            VCU_Display_Cur_oVCU_HMIsignals_02_oATOM_CANFD_Matrix_CH_V600_202502_629aba80_Tx: ComBitPosition=25, ComBitSize=10, ComSignalInitValue=0, ComSignalType=UINT16, ComHandleId=161, ComSystemTemplateSystemSignalRef=VCU_Display_Cur
            MessageCounter_318_oVCU_HMIsignals_02_oATOM_CANFD_Matrix_CH_V600_202502_9aee7a8b_Tx: ComBitPosition=11, ComBitSize=4, ComSignalInitValue=0, ComSignalType=UINT8, ComHandleId=159, ComSystemTemplateSystemSignalRef=MessageCounter_318
            VCU_Display_Power_oVCU_HMIsignals_02_oATOM_CANFD_Matrix_CH_V600_202502_1364d55f_Tx: ComBitPosition=23, ComBitSize=12, ComSignalInitValue=0, ComSignalType=UINT16, ComHandleId=162, ComSystemTemplateSystemSignalRef=VCU_Display_Power
            VCU_ForwardVmaxAllowed_oVCU_HMIsignals_02_oATOM_CANFD_Matrix_CH_V600_202502_631e19bb_Tx: ComBitPosition=63, ComBitSize=8, ComSignalInitValue=0, ComSignalType=UINT8, ComHandleId=163, ComSystemTemplateSystemSignalRef=VCU_ForwardVmaxAllowed
            VCU_maxChargeSOC_oVCU_HMIsignals_02_oATOM_CANFD_Matrix_CH_V600_202502_b7e91aff_Tx: ComBitPosition=47, ComBitSize=8, ComSignalInitValue=255, ComSignalType=UINT8, ComHandleId=166, ComSystemTemplateSystemSignalRef=VCU_maxChargeSOC
            VCU_MCU_FaultLampReq_oVCU_HMIsignals_02_oATOM_CANFD_Matrix_CH_V600_202502_b94ce354_Tx: ComBitPosition=15, ComBitSize=2, ComSignalInitValue=0, ComSignalType=UINT8, ComHandleId=164, ComSystemTemplateSystemSignalRef=VCU_MCU_FaultLampReq
            VCU_SystemReady_oVCU_HMIsignals_02_oATOM_CANFD_Matrix_CH_V600_202502_3baa5f6f_Tx: ComBitPosition=27, ComBitSize=1, ComSignalInitValue=0, ComSignalType=BOOLEAN, ComHandleId=165, ComSystemTemplateSystemSignalRef=VCU_SystemReady
            Checksum_318_oVCU_HMIsignals_02_oATOM_CANFD_Matrix_CH_V600_202502_fc013b78_Tx: ComBitPosition=7, ComBitSize=8, ComSignalInitValue=0, ComSignalType=UINT8, ComHandleId=158, ComSystemTemplateSystemSignalRef=Checksum_318
            VCU_DischargeEndSoc_oVCU_HMIsignals_02_oATOM_CANFD_Matrix_CH_V600_202502_a47f7a1f_Tx: ComBitPosition=55, ComBitSize=8, ComSignalInitValue=50, ComSignalType=UINT8, ComHandleId=160, ComSystemTemplateSystemSignalRef=VCU_DischargeEndSoc
      IBS_Status_02_oATOM_CANFD_Matrix_CH_V600_202502_3bba494d_Rx (ComIPdu):
        ComIPduDirection = RECEIVE
        ComIPduType = NORMAL
        ComIPduHandleId = 16
        ComIPduSignalProcessing = DEFERRED
        ComIPduCancellationSupport = false
        ComIPduGroupRef = VCU_oATOM_CANFD_Matrix_CH_V600_202502_Rx_5e4659c4
        ComIPduSignalGroupRef = SG_IBS_Status_02_SigGroup_oIBS_Status_02_oATOM_CANFD_Matrix_CH_V600_202502_8df002b0_Rx
        ComPduIdRef = IBS_Status_02_oATOM_CANFD_Matrix_CH_V600_202502_3bba494d_Rx
        ComIPduMainFunctionRef = ComMainFunctionRx
      IBS_Torque_oATOM_CANFD_Matrix_CH_V600_202502_e4106cfa_Rx (ComIPdu):
        ComIPduDirection = RECEIVE
        ComIPduType = NORMAL
        ComIPduHandleId = 20
        ComIPduSignalProcessing = DEFERRED
        ComIPduCancellationSupport = false
        ComIPduGroupRef = VCU_oATOM_CANFD_Matrix_CH_V600_202502_Rx_5e4659c4
        ComIPduSignalGroupRef = SG_IBS_Torque_SigGroup_oIBS_Torque_oATOM_CANFD_Matrix_CH_V600_202502_5a2dd5ad_Rx
        ComPduIdRef = IBS_Torque_oATOM_CANFD_Matrix_CH_V600_202502_e4106cfa_Rx
        ComIPduMainFunctionRef = ComMainFunctionRx
      SG_VCU_02_SigGroup_oVCU_02_oATOM_CANFD_Matrix_CH_V600_202502_2fc20804_Tx (ComSignalGroup): ComTransferProperty=PENDING, ComSignalGroupAccess=ACCESS_UNCLEAR, ComHandleId=0, ComSystemTemplateSignalGroupRef=SG_VCU_02_SigGroup
        5 x ComGroupSignal, all with ComSignalEndianness=BIG_ENDIAN, ComTransferProperty=PENDING, ComSignalAccess=ACCESS_UNCLEAR:
          VCU_BS_IndicatorSts_oVCU_02_oATOM_CANFD_Matrix_CH_V600_202502_0d3265cb_Tx: ComBitPosition=31, ComBitSize=1, ComSignalInitValue=0, ComSignalType=BOOLEAN, ComHandleId=93, ComSystemTemplateSystemSignalRef=VCU_BS_IndicatorSts
          VCU_WakeUpStatus_oVCU_02_oATOM_CANFD_Matrix_CH_V600_202502_091aaa11_Tx: ComBitPosition=63, ComBitSize=8, ComSignalInitValue=0, ComSignalType=UINT8, ComHandleId=95, ComSystemTemplateSystemSignalRef=VCU_WakeUpStatus
          VCU_BS_Current_oVCU_02_oATOM_CANFD_Matrix_CH_V600_202502_55d19f8e_Tx: ComBitPosition=15, ComBitSize=14, ComSignalInitValue=0, ComSignalType=UINT16, ComHandleId=91, ComSystemTemplateSystemSignalRef=VCU_BS_Current
          VCU_BS_IBSBatSOC_oVCU_02_oATOM_CANFD_Matrix_CH_V600_202502_34765b89_Tx: ComBitPosition=7, ComBitSize=8, ComSignalInitValue=80, ComSignalType=UINT8, ComHandleId=92, ComSystemTemplateSystemSignalRef=VCU_BS_IBSBatSOC
          VCU_BS_LV_Batt_oVCU_02_oATOM_CANFD_Matrix_CH_V600_202502_41d6d523_Tx: ComBitPosition=47, ComBitSize=15, ComSignalInitValue=0, ComSignalType=UINT16, ComHandleId=94, ComSystemTemplateSystemSignalRef=VCU_BS_LV_Batt
      ADCU_AEB_01_oATOM_CANFD_Matrix_CH_V600_202502_73fc26ce_Rx (ComIPdu):
        ComIPduDirection = RECEIVE
        ComIPduType = NORMAL
        ComIPduHandleId = 4
        ComIPduSignalProcessing = DEFERRED
        ComIPduCancellationSupport = false
        ComIPduGroupRef = VCU_oATOM_CANFD_Matrix_CH_V600_202502_Rx_5e4659c4
        ComIPduSignalGroupRef = SG_ADCU_AEB_01_SigGroup_oADCU_AEB_01_oATOM_CANFD_Matrix_CH_V600_202502_50a93e3a_Rx
        ComPduIdRef = ADCU_AEB_01_oATOM_CANFD_Matrix_CH_V600_202502_73fc26ce_Rx
        ComIPduMainFunctionRef = ComMainFunctionRx
      IBS_Status_04_oATOM_CANFD_Matrix_CH_V600_202502_f76d333e_Rx (ComIPdu):
        ComIPduDirection = RECEIVE
        ComIPduType = NORMAL
        ComIPduHandleId = 18
        ComIPduSignalProcessing = DEFERRED
        ComIPduCancellationSupport = false
        ComIPduGroupRef = VCU_oATOM_CANFD_Matrix_CH_V600_202502_Rx_5e4659c4
        ComIPduSignalGroupRef = SG_IBS_Status_04_SigGroup_oIBS_Status_04_oATOM_CANFD_Matrix_CH_V600_202502_edfe62a4_Rx
        ComPduIdRef = IBS_Status_04_oATOM_CANFD_Matrix_CH_V600_202502_f76d333e_Rx
        ComIPduMainFunctionRef = ComMainFunctionRx
      SG_ACU_01_SigGroup_oACU_01_oATOM_CANFD_Matrix_CH_V600_202502_0a16dd9e_Rx (ComSignalGroup): ComTransferProperty=PENDING, ComSignalGroupAccess=ACCESS_UNCLEAR, ComHandleId=0, ComSystemTemplateSignalGroupRef=SG_ACU_01_SigGroup
        4 x ComGroupSignal, all with ComSignalEndianness=BIG_ENDIAN, ComSignalAccess=ACCESS_UNCLEAR:
          MessageCounter_0F5_oACU_01_oATOM_CANFD_Matrix_CH_V600_202502_e1f37972_Rx: ComBitPosition=11, ComBitSize=4, ComSignalInitValue=0, ComSignalType=UINT8, ComHandleId=63, ComSystemTemplateSystemSignalRef=MessageCounter_0F5
          ACU_YawRate_oACU_01_oATOM_CANFD_Matrix_CH_V600_202502_35ce62e9_Rx: ComBitPosition=23, ComBitSize=16, ComSignalInitValue=30000, ComSignalType=UINT16, ComHandleId=61, ComSystemTemplateSystemSignalRef=ACU_YawRate
          ACU_YawRateStatus_oACU_01_oATOM_CANFD_Matrix_CH_V600_202502_a5dd4854_Rx: ComBitPosition=39, ComBitSize=2, ComSignalInitValue=0, ComSignalType=UINT8, ComHandleId=60, ComSystemTemplateSystemSignalRef=ACU_YawRateStatus
          Checksum_0F5_oACU_01_oATOM_CANFD_Matrix_CH_V600_202502_21944b83_Rx: ComBitPosition=7, ComBitSize=8, ComSignalInitValue=0, ComSignalType=UINT8, ComHandleId=62, ComSystemTemplateSystemSignalRef=Checksum_0F5
      VCU_Chassis_01_oATOM_CANFD_Matrix_CH_V600_202502_d7fdb34f_Tx (ComIPdu):
        ComIPduDirection = SEND
        ComIPduType = NORMAL
        ComIPduHandleId = 8
        ComIPduSignalProcessing = DEFERRED
        ComIPduCancellationSupport = false
        ComIPduGroupRef = VCU_oATOM_CANFD_Matrix_CH_V600_202502_Tx_081cfe42
        ComIPduSignalGroupRef = SG_VCU_Chassis_01_SigGroup_oVCU_Chassis_01_oATOM_CANFD_Matrix_CH_V600_202502_52963860_Tx
        ComPduIdRef = VCU_Chassis_01_oATOM_CANFD_Matrix_CH_V600_202502_d7fdb34f_Tx
        ComIPduMainFunctionRef = ComMainFunctionTx
        ComTxIPdu: ComMinimumDelayTime=0, ComTxIPduUnusedAreasDefault=0
          ComTxModeTrue
            ComTxMode: ComTxModeMode=PERIODIC, ComTxModeTimeOffset=0, ComTxModeTimePeriod=0.02
          ComTxModeFalse
            ComTxMode: ComTxModeMode=PERIODIC, ComTxModeTimeOffset=0, ComTxModeTimePeriod=0.02
      VCU_AccPedal_oATOM_CANFD_Matrix_CH_V600_202502_0d0df7a0_Tx (ComIPdu):
        ComIPduDirection = SEND
        ComIPduType = NORMAL
        ComIPduHandleId = 6
        ComIPduSignalProcessing = DEFERRED
        ComIPduCancellationSupport = false
        ComIPduGroupRef = VCU_oATOM_CANFD_Matrix_CH_V600_202502_Tx_081cfe42
        ComIPduSignalGroupRef = SG_VCU_AccPedal_SigGroup_oVCU_AccPedal_oATOM_CANFD_Matrix_CH_V600_202502_aa50ac8d_Tx
        ComPduIdRef = VCU_AccPedal_oATOM_CANFD_Matrix_CH_V600_202502_0d0df7a0_Tx
        ComIPduMainFunctionRef = ComMainFunctionTx
        ComTxIPdu: ComMinimumDelayTime=0, ComTxIPduUnusedAreasDefault=0
          ComTxModeTrue
            ComTxMode: ComTxModeMode=PERIODIC, ComTxModeTimeOffset=0, ComTxModeTimePeriod=0.02
          ComTxModeFalse
            ComTxMode: ComTxModeMode=PERIODIC, ComTxModeTimeOffset=0, ComTxModeTimePeriod=0.02
      SG_ADCU_ACC_02_SigGroup_oADCU_ACC_02_oATOM_CANFD_Matrix_CH_V600_202502_1e479296_Rx (ComSignalGroup): ComTransferProperty=PENDING, ComSignalGroupAccess=ACCESS_UNCLEAR, ComHandleId=3, ComSystemTemplateSignalGroupRef=SG_ADCU_ACC_02_SigGroup
        5 x ComGroupSignal, all with ComSignalEndianness=BIG_ENDIAN, ComSignalInitValue=0, ComSignalType=UINT8, ComSignalAccess=ACCESS_UNCLEAR:
          MessageCounter_0E0_oADCU_ACC_02_oATOM_CANFD_Matrix_CH_V600_202502_982cdfbe_Rx: ComBitPosition=11, ComBitSize=4, ComHandleId=93, ComSystemTemplateSystemSignalRef=MessageCounter_0E0
          ADCU_ACC_Mode_oADCU_ACC_02_oATOM_CANFD_Matrix_CH_V600_202502_4b80afee_Rx: ComBitPosition=21, ComBitSize=3, ComHandleId=91, ComSystemTemplateSystemSignalRef=ADCU_ACC_Mode
          Checksum_0E0_oADCU_ACC_02_oATOM_CANFD_Matrix_CH_V600_202502_31389c92_Rx: ComBitPosition=7, ComBitSize=8, ComHandleId=92, ComSystemTemplateSystemSignalRef=Checksum_0E0
          ADCU_ACCDA_SYS_Failure_oADCU_ACC_02_oATOM_CANFD_Matrix_CH_V600_202502_0c0a67d0_Rx: ComBitPosition=23, ComBitSize=2, ComHandleId=90, ComSystemTemplateSystemSignalRef=ADCU_ACCDA_SYS_Failure
          ADCU_ACCDA_HandsOFF_Warning_oADCU_ACC_02_oATOM_CANFD_Matrix_CH_V600_202502_cdbbce90_Rx: ComBitPosition=18, ComBitSize=3, ComHandleId=89, ComSystemTemplateSystemSignalRef=ADCU_ACCDA_HandsOFF_Warning
      VCU_oATOM_CANFD_Matrix_CH_V600_202502_Rx_5e4659c4 (ComIPduGroup): ComIPduGroupHandleId=0
      SG_VCU_Chassis_01_SigGroup_oVCU_Chassis_01_oATOM_CANFD_Matrix_CH_V600_202502_52963860_Tx (ComSignalGroup): ComTransferProperty=PENDING, ComSignalGroupAccess=ACCESS_UNCLEAR, ComHandleId=5, ComSystemTemplateSignalGroupRef=SG_VCU_Chassis_01_SigGroup
        15 x ComGroupSignal, all with ComSignalEndianness=BIG_ENDIAN, ComSignalInitValue=0, ComTransferProperty=PENDING, ComSignalAccess=ACCESS_UNCLEAR:
          VCU_ADASOverride_oVCU_Chassis_01_oATOM_CANFD_Matrix_CH_V600_202502_0c002a43_Tx: ComBitPosition=44, ComBitSize=1, ComSignalType=BOOLEAN, ComHandleId=131, ComSystemTemplateSystemSignalRef=VCU_ADASOverride
          VCU_TorqueRequestActive_oVCU_Chassis_01_oATOM_CANFD_Matrix_CH_V600_202502_24abcc5b_Tx: ComBitPosition=12, ComBitSize=1, ComSignalType=BOOLEAN, ComHandleId=142, ComSystemTemplateSystemSignalRef=VCU_TorqueRequestActive
          VCU_RegenTorqueCapValid_oVCU_Chassis_01_oATOM_CANFD_Matrix_CH_V600_202502_5eaff4d8_Tx: ComBitPosition=15, ComBitSize=1, ComSignalType=BOOLEAN, ComHandleId=140, ComSystemTemplateSystemSignalRef=VCU_RegenTorqueCapValid
          VCU_RegStatus_oVCU_Chassis_01_oATOM_CANFD_Matrix_CH_V600_202502_6d4e3983_Tx: ComBitPosition=63, ComBitSize=3, ComSignalType=UINT8, ComHandleId=139, ComSystemTemplateSystemSignalRef=VCU_RegStatus
          VCU_DecelerationReqactive_oVCU_Chassis_01_oATOM_CANFD_Matrix_CH_V600_202502_29147867_Tx: ComBitPosition=40, ComBitSize=1, ComSignalType=BOOLEAN, ComHandleId=136, ComSystemTemplateSystemSignalRef=VCU_DecelerationReqactive
          VCU_TorqueRequestAvailable_oVCU_Chassis_01_oATOM_CANFD_Matrix_CH_V600_202502_22997d3f_Tx: ComBitPosition=13, ComBitSize=1, ComSignalType=BOOLEAN, ComHandleId=143, ComSystemTemplateSystemSignalRef=VCU_TorqueRequestAvailable
          VCU_APSTorqueRequestActive_oVCU_Chassis_01_oATOM_CANFD_Matrix_CH_V600_202502_c8f21b10_Tx: ComBitPosition=43, ComBitSize=1, ComSignalType=BOOLEAN, ComHandleId=132, ComSystemTemplateSystemSignalRef=VCU_APSTorqueRequestActive
          VCU_EnergyManagementWarn_oVCU_Chassis_01_oATOM_CANFD_Matrix_CH_V600_202502_4b7de956_Tx: ComBitPosition=58, ComBitSize=2, ComSignalType=UINT8, ComHandleId=138, ComSystemTemplateSystemSignalRef=VCU_EnergyManagementWarn
          Checksum_0D3_oVCU_Chassis_01_oATOM_CANFD_Matrix_CH_V600_202502_090e4c9b_Tx: ComBitPosition=7, ComBitSize=8, ComSignalType=UINT8, ComHandleId=129, ComSystemTemplateSystemSignalRef=Checksum_0D3
          VCU_APSTorqueRequestAvailable_oVCU_Chassis_01_oATOM_CANFD_Matrix_CH_V600_202502_8298a57a_Tx: ComBitPosition=42, ComBitSize=1, ComSignalType=BOOLEAN, ComHandleId=133, ComSystemTemplateSystemSignalRef=VCU_APSTorqueRequestAvailable
          VCU_RegenTorqueCap_oVCU_Chassis_01_oATOM_CANFD_Matrix_CH_V600_202502_a5a4bebf_Tx: ComBitPosition=23, ComBitSize=16, ComSignalType=UINT16, ComHandleId=141, ComSystemTemplateSystemSignalRef=VCU_RegenTorqueCap
          MessageCounter_0D3_oVCU_Chassis_01_oATOM_CANFD_Matrix_CH_V600_202502_f9d73b0d_Tx: ComBitPosition=11, ComBitSize=4, ComSignalType=UINT8, ComHandleId=130, ComSystemTemplateSystemSignalRef=MessageCounter_0D3
          VCU_DriverTorqueRequest_oVCU_Chassis_01_oATOM_CANFD_Matrix_CH_V600_202502_f98385dc_Tx: ComBitPosition=39, ComBitSize=11, ComSignalType=UINT16, ComHandleId=137, ComSystemTemplateSystemSignalRef=VCU_DriverTorqueRequest
          VCU_BrakeCompensateWarn_oVCU_Chassis_01_oATOM_CANFD_Matrix_CH_V600_202502_8427f667_Tx: ComBitPosition=60, ComBitSize=2, ComSignalType=UINT8, ComHandleId=134, ComSystemTemplateSystemSignalRef=VCU_BrakeCompensateWarn
          VCU_DecelerationReq_oVCU_Chassis_01_oATOM_CANFD_Matrix_CH_V600_202502_22f1bc0a_Tx: ComBitPosition=55, ComBitSize=8, ComSignalType=UINT8, ComHandleId=135, ComSystemTemplateSystemSignalRef=VCU_DecelerationReq
      IBS_ACC_oATOM_CANFD_Matrix_CH_V600_202502_ef8c28ba_Rx (ComIPdu):
        ComIPduDirection = RECEIVE
        ComIPduType = NORMAL
        ComIPduHandleId = 13
        ComIPduSignalProcessing = DEFERRED
        ComIPduCancellationSupport = false
        ComIPduGroupRef = VCU_oATOM_CANFD_Matrix_CH_V600_202502_Rx_5e4659c4
        ComIPduSignalGroupRef = SG_IBS_ACC_SigGroup_oIBS_ACC_oATOM_CANFD_Matrix_CH_V600_202502_c31bc8ab_Rx
        ComPduIdRef = IBS_ACC_oATOM_CANFD_Matrix_CH_V600_202502_ef8c28ba_Rx
        ComIPduMainFunctionRef = ComMainFunctionRx
      SG_SGW_17_SigGroup_oSGW_17_oATOM_CANFD_Matrix_CH_V600_202502_804294b2_Rx (ComSignalGroup): ComTransferProperty=PENDING, ComSignalGroupAccess=ACCESS_UNCLEAR, ComHandleId=19, ComSystemTemplateSignalGroupRef=SG_SGW_17_SigGroup
        SGW_BLESystemReadyReq_oSGW_17_oATOM_CANFD_Matrix_CH_V600_202502_359ce2fd_Rx (ComGroupSignal):
          ComBitPosition = 3
          ComBitSize = 2
          ComSignalEndianness = BIG_ENDIAN
          ComSignalInitValue = 0
          ComSignalType = UINT8
          ComSignalAccess = ACCESS_UNCLEAR
          ComHandleId = 243
          ComSystemTemplateSystemSignalRef = SGW_BLESystemReadyReq
      VCU_IBS_01_oATOM_CANFD_Matrix_CH_V600_202502_4c086bc0_Tx (ComIPdu):
        ComIPduDirection = SEND
        ComIPduType = NORMAL
        ComIPduHandleId = 13
        ComIPduSignalProcessing = DEFERRED
        ComIPduCancellationSupport = false
        ComIPduGroupRef = VCU_oATOM_CANFD_Matrix_CH_V600_202502_Tx_081cfe42
        ComIPduSignalGroupRef = SG_VCU_IBS_01_SigGroup_oVCU_IBS_01_oATOM_CANFD_Matrix_CH_V600_202502_f0f49d09_Tx
        ComPduIdRef = VCU_IBS_01_oATOM_CANFD_Matrix_CH_V600_202502_4c086bc0_Tx
        ComIPduMainFunctionRef = ComMainFunctionTx
        ComTxIPdu: ComMinimumDelayTime=0, ComTxIPduUnusedAreasDefault=0
          ComTxModeTrue
            ComTxMode: ComTxModeMode=PERIODIC, ComTxModeTimeOffset=0, ComTxModeTimePeriod=0.01
          ComTxModeFalse
            ComTxMode: ComTxModeMode=PERIODIC, ComTxModeTimeOffset=0, ComTxModeTimePeriod=0.01
      SG_IBS_ACC_SigGroup_oIBS_ACC_oATOM_CANFD_Matrix_CH_V600_202502_c31bc8ab_Rx (ComSignalGroup): ComTransferProperty=PENDING, ComSignalGroupAccess=ACCESS_UNCLEAR, ComHandleId=8, ComSystemTemplateSignalGroupRef=SG_IBS_ACC_SigGroup
        12 x ComGroupSignal, all with ComSignalEndianness=BIG_ENDIAN, ComSignalInitValue=0, ComSignalAccess=ACCESS_UNCLEAR:
          IBS_VehicleStandstill_oIBS_ACC_oATOM_CANFD_Matrix_CH_V600_202502_e5c3fb2c_Rx: ComBitPosition=44, ComBitSize=2, ComSignalType=UINT8, ComHandleId=126, ComSystemTemplateSystemSignalRef=IBS_VehicleStandstill
          IBS_CddActive_oIBS_ACC_oATOM_CANFD_Matrix_CH_V600_202502_cd634808_Rx: ComBitPosition=45, ComBitSize=1, ComSignalType=BOOLEAN, ComHandleId=122, ComSystemTemplateSystemSignalRef=IBS_CddActive
          IBS_VlcActive_oIBS_ACC_oATOM_CANFD_Matrix_CH_V600_202502_3fa05f6d_Rx: ComBitPosition=40, ComBitSize=1, ComSignalType=BOOLEAN, ComHandleId=127, ComSystemTemplateSystemSignalRef=IBS_VlcActive
          IBS_VlcError_oIBS_ACC_oATOM_CANFD_Matrix_CH_V600_202502_b4ad3ada_Rx: ComBitPosition=41, ComBitSize=1, ComSignalType=BOOLEAN, ComHandleId=129, ComSystemTemplateSystemSignalRef=IBS_VlcError
          IBS_WLTorqueVLCReqValid_oIBS_ACC_oATOM_CANFD_Matrix_CH_V600_202502_d640a38d_Rx: ComBitPosition=31, ComBitSize=2, ComSignalType=UINT8, ComHandleId=130, ComSystemTemplateSystemSignalRef=IBS_WLTorqueVLCReqValid
          IBS_VehicleStandstill_Valid_oIBS_ACC_oATOM_CANFD_Matrix_CH_V600_202502_8e482947_Rx: ComBitPosition=23, ComBitSize=1, ComSignalType=BOOLEAN, ComHandleId=125, ComSystemTemplateSystemSignalRef=IBS_VehicleStandstill_Valid
          IBS_CddError_oIBS_ACC_oATOM_CANFD_Matrix_CH_V600_202502_15ba1189_Rx: ComBitPosition=46, ComBitSize=1, ComSignalType=BOOLEAN, ComHandleId=124, ComSystemTemplateSystemSignalRef=IBS_CddError
          Checksum_0B8_oIBS_ACC_oATOM_CANFD_Matrix_CH_V600_202502_ea42d99c_Rx: ComBitPosition=7, ComBitSize=8, ComSignalType=UINT8, ComHandleId=121, ComSystemTemplateSystemSignalRef=Checksum_0B8
          IBS_VlcAvalible_oIBS_ACC_oATOM_CANFD_Matrix_CH_V600_202502_5ec40897_Rx: ComBitPosition=42, ComBitSize=1, ComSignalType=BOOLEAN, ComHandleId=128, ComSystemTemplateSystemSignalRef=IBS_VlcAvalible
          IBS_CddAvailable_oIBS_ACC_oATOM_CANFD_Matrix_CH_V600_202502_694f6a44_Rx: ComBitPosition=47, ComBitSize=1, ComSignalType=BOOLEAN, ComHandleId=123, ComSystemTemplateSystemSignalRef=IBS_CddAvailable
          MessageCounter_0B8_oIBS_ACC_oATOM_CANFD_Matrix_CH_V600_202502_20387c24_Rx: ComBitPosition=11, ComBitSize=4, ComSignalType=UINT8, ComHandleId=132, ComSystemTemplateSystemSignalRef=MessageCounter_0B8
          IBS_WLTorqueVLCReq_oIBS_ACC_oATOM_CANFD_Matrix_CH_V600_202502_e5232329_Rx: ComBitPosition=55, ComBitSize=16, ComSignalType=SINT16, ComHandleId=131, ComSystemTemplateSystemSignalRef=IBS_WLTorqueVLCReq
      IBS_WheelSpeed_01_oATOM_CANFD_Matrix_CH_V600_202502_1c45b3ee_Rx (ComIPdu):
        ComIPduDirection = RECEIVE
        ComIPduType = NORMAL
        ComIPduHandleId = 22
        ComIPduSignalProcessing = DEFERRED
        ComIPduCancellationSupport = false
        ComIPduGroupRef = VCU_oATOM_CANFD_Matrix_CH_V600_202502_Rx_5e4659c4
        ComIPduSignalGroupRef = SG_IBS_WheelSpeed_01_SigGroup_oIBS_WheelSpeed_01_oATOM_CANFD_Matrix_CH_V600_202502_5773aa13_Rx
        ComPduIdRef = IBS_WheelSpeed_01_oATOM_CANFD_Matrix_CH_V600_202502_1c45b3ee_Rx
        ComIPduMainFunctionRef = ComMainFunctionRx
      SG_ACU_02_SigGroup_oACU_02_oATOM_CANFD_Matrix_CH_V600_202502_3b90e790_Rx (ComSignalGroup): ComTransferProperty=PENDING, ComSignalGroupAccess=ACCESS_UNCLEAR, ComHandleId=1, ComSystemTemplateSignalGroupRef=SG_ACU_02_SigGroup
        6 x ComGroupSignal, all with ComSignalEndianness=BIG_ENDIAN, ComSignalAccess=ACCESS_UNCLEAR:
          ACU_LgtA_oACU_02_oATOM_CANFD_Matrix_CH_V600_202502_7ce5ad57_Rx: ComBitPosition=37, ComBitSize=14, ComSignalInitValue=4905, ComSignalType=UINT16, ComHandleId=67, ComSystemTemplateSystemSignalRef=ACU_LgtA
          MessageCounter_0F6_oACU_02_oATOM_CANFD_Matrix_CH_V600_202502_a3145c66_Rx: ComBitPosition=11, ComBitSize=4, ComSignalInitValue=0, ComSignalType=UINT8, ComHandleId=69, ComSystemTemplateSystemSignalRef=MessageCounter_0F6
          ACU_LatAStatus_oACU_02_oATOM_CANFD_Matrix_CH_V600_202502_5faf7139_Rx: ComBitPosition=23, ComBitSize=2, ComSignalInitValue=0, ComSignalType=UINT8, ComHandleId=64, ComSystemTemplateSystemSignalRef=ACU_LatAStatus
          Checksum_0F6_oACU_02_oATOM_CANFD_Matrix_CH_V600_202502_63736e97_Rx: ComBitPosition=7, ComBitSize=8, ComSignalInitValue=0, ComSignalType=UINT8, ComHandleId=68, ComSystemTemplateSystemSignalRef=Checksum_0F6
          ACU_LatA_oACU_02_oATOM_CANFD_Matrix_CH_V600_202502_0373507d_Rx: ComBitPosition=21, ComBitSize=14, ComSignalInitValue=4905, ComSignalType=UINT16, ComHandleId=65, ComSystemTemplateSystemSignalRef=ACU_LatA
          ACU_LgtAStatus_oACU_02_oATOM_CANFD_Matrix_CH_V600_202502_8eba5290_Rx: ComBitPosition=39, ComBitSize=2, ComSignalInitValue=0, ComSignalType=UINT8, ComHandleId=66, ComSystemTemplateSystemSignalRef=ACU_LgtAStatus
      SG_IBS_Torque_SigGroup_oIBS_Torque_oATOM_CANFD_Matrix_CH_V600_202502_5a2dd5ad_Rx (ComSignalGroup): ComTransferProperty=PENDING, ComSignalGroupAccess=ACCESS_UNCLEAR, ComHandleId=15, ComSystemTemplateSignalGroupRef=SG_IBS_Torque_SigGroup
        9 x ComGroupSignal, all with ComSignalEndianness=BIG_ENDIAN, ComSignalInitValue=0, ComSignalAccess=ACCESS_UNCLEAR:
          IBS_RBSStatus_oIBS_Torque_oATOM_CANFD_Matrix_CH_V600_202502_dc8e16c0_Rx: ComBitPosition=13, ComBitSize=1, ComSignalType=BOOLEAN, ComHandleId=209, ComSystemTemplateSystemSignalRef=IBS_RBSStatus
          IBS_TargetGearReq_oIBS_Torque_oATOM_CANFD_Matrix_CH_V600_202502_35085f4b_Rx: ComBitPosition=23, ComBitSize=3, ComSignalType=UINT8, ComHandleId=210, ComSystemTemplateSystemSignalRef=IBS_TargetGearReq
          IBS_WLTorqueAPSReq_oIBS_Torque_oATOM_CANFD_Matrix_CH_V600_202502_1036d2a9_Rx: ComBitPosition=55, ComBitSize=16, ComSignalType=UINT16, ComHandleId=213, ComSystemTemplateSystemSignalRef=IBS_WLTorqueAPSReq
          Checksum_0B9_oIBS_Torque_oATOM_CANFD_Matrix_CH_V600_202502_c0d26283_Rx: ComBitPosition=7, ComBitSize=8, ComSignalType=UINT8, ComHandleId=208, ComSystemTemplateSystemSignalRef=Checksum_0B9
          IBS_VCU_DecelerationReqActive_oIBS_Torque_oATOM_CANFD_Matrix_CH_V600_202502_5138c66a_Rx: ComBitPosition=12, ComBitSize=1, ComSignalType=BOOLEAN, ComHandleId=211, ComSystemTemplateSystemSignalRef=IBS_VCU_DecelerationReqActive
          IBS_WLTorqueRBSReq_oIBS_Torque_oATOM_CANFD_Matrix_CH_V600_202502_dae1e9b7_Rx: ComBitPosition=31, ComBitSize=16, ComSignalType=UINT16, ComHandleId=215, ComSystemTemplateSystemSignalRef=IBS_WLTorqueRBSReq
          IBS_WLTorqueAPSReqValid_oIBS_Torque_oATOM_CANFD_Matrix_CH_V600_202502_406d9ee6_Rx: ComBitPosition=45, ComBitSize=2, ComSignalType=UINT8, ComHandleId=212, ComSystemTemplateSystemSignalRef=IBS_WLTorqueAPSReqValid
          MessageCounter_0B9_oIBS_Torque_oATOM_CANFD_Matrix_CH_V600_202502_683f1d6f_Rx: ComBitPosition=11, ComBitSize=4, ComSignalType=UINT8, ComHandleId=216, ComSystemTemplateSystemSignalRef=MessageCounter_0B9
          IBS_WLTorqueRBSReqValid_oIBS_Torque_oATOM_CANFD_Matrix_CH_V600_202502_0144d4d4_Rx: ComBitPosition=15, ComBitSize=2, ComSignalType=UINT8, ComHandleId=214, ComSystemTemplateSystemSignalRef=IBS_WLTorqueRBSReqValid
      VCU_HMIsignals_01_oATOM_CANFD_Matrix_CH_V600_202502_f29a9fcc_Tx (ComIPdu):
        ComIPduDirection = SEND
        ComIPduType = NORMAL
        ComIPduHandleId = 11
        ComIPduSignalProcessing = DEFERRED
        ComIPduCancellationSupport = false
        ComIPduGroupRef = VCU_oATOM_CANFD_Matrix_CH_V600_202502_Tx_081cfe42
        ComIPduSignalGroupRef = SG_VCU_HMIsignals_01_SigGroup_oVCU_HMIsignals_01_oATOM_CANFD_Matrix_CH_V600_202502_c30c8d8f_Tx
        ComPduIdRef = VCU_HMIsignals_01_oATOM_CANFD_Matrix_CH_V600_202502_f29a9fcc_Tx
        ComIPduMainFunctionRef = ComMainFunctionTx
        ComTxIPdu: ComMinimumDelayTime=0, ComTxIPduUnusedAreasDefault=0
          ComTxModeTrue
            ComTxMode: ComTxModeMode=PERIODIC, ComTxModeTimeOffset=0, ComTxModeTimePeriod=0.2
          ComTxModeFalse
            ComTxMode: ComTxModeMode=PERIODIC, ComTxModeTimeOffset=0, ComTxModeTimePeriod=0.2
      ADCU_DA_oATOM_CANFD_Matrix_CH_V600_202502_c19ff818_Rx (ComIPdu):
        ComIPduDirection = RECEIVE
        ComIPduType = NORMAL
        ComIPduHandleId = 7
        ComIPduSignalProcessing = DEFERRED
        ComIPduCancellationSupport = false
        ComIPduGroupRef = VCU_oATOM_CANFD_Matrix_CH_V600_202502_Rx_5e4659c4
        ComIPduSignalGroupRef = SG_ADCU_DA_SigGroup_oADCU_DA_oATOM_CANFD_Matrix_CH_V600_202502_4133b6dd_Rx
        ComPduIdRef = ADCU_DA_oATOM_CANFD_Matrix_CH_V600_202502_c19ff818_Rx
        ComIPduMainFunctionRef = ComMainFunctionRx
      SG_IBS_Status_03_SigGroup_oIBS_Status_03_oATOM_CANFD_Matrix_CH_V600_202502_2b221089_Rx (ComSignalGroup): ComTransferProperty=PENDING, ComSignalGroupAccess=ACCESS_UNCLEAR, ComHandleId=12, ComSystemTemplateSignalGroupRef=SG_IBS_Status_03_SigGroup
        16 x ComGroupSignal, all with ComSignalEndianness=BIG_ENDIAN, ComSignalInitValue=0, ComSignalAccess=ACCESS_UNCLEAR:
          IBS_EBDFault_oIBS_Status_03_oATOM_CANFD_Matrix_CH_V600_202502_dad1ab7b_Rx: ComBitPosition=36, ComBitSize=1, ComSignalType=BOOLEAN, ComHandleId=174, ComSystemTemplateSystemSignalRef=IBS_EBDFault
          IBS_EPBTextdisplay_oIBS_Status_03_oATOM_CANFD_Matrix_CH_V600_202502_e8354645_Rx: ComBitPosition=15, ComBitSize=3, ComSignalType=UINT8, ComHandleId=175, ComSystemTemplateSystemSignalRef=IBS_EPBTextdisplay
          IBS_VehicleSpeedValid_oIBS_Status_03_oATOM_CANFD_Matrix_CH_V600_202502_317a0a26_Rx: ComBitPosition=39, ComBitSize=1, ComSignalType=BOOLEAN, ComHandleId=180, ComSystemTemplateSystemSignalRef=IBS_VehicleSpeedValid
          IBS_ABSActive_oIBS_Status_03_oATOM_CANFD_Matrix_CH_V600_202502_bc82dc5c_Rx: ComBitPosition=33, ComBitSize=1, ComSignalType=BOOLEAN, ComHandleId=170, ComSystemTemplateSystemSignalRef=IBS_ABSActive
          IBS_VDCFault_oIBS_Status_03_oATOM_CANFD_Matrix_CH_V600_202502_01868c54_Rx: ComBitPosition=35, ComBitSize=1, ComSignalType=BOOLEAN, ComHandleId=179, ComSystemTemplateSystemSignalRef=IBS_VDCFault
          IBS_SystemStatus_oIBS_Status_03_oATOM_CANFD_Matrix_CH_V600_202502_306130d0_Rx: ComBitPosition=26, ComBitSize=3, ComSignalType=UINT8, ComHandleId=176, ComSystemTemplateSystemSignalRef=IBS_SystemStatus
          MessageCounter_0B4_oIBS_Status_03_oATOM_CANFD_Matrix_CH_V600_202502_91c1ff04_Rx: ComBitPosition=11, ComBitSize=4, ComSignalType=UINT8, ComHandleId=182, ComSystemTemplateSystemSignalRef=MessageCounter_0B4
          IBS_ABPActive_oIBS_Status_03_oATOM_CANFD_Matrix_CH_V600_202502_9a3de825_Rx: ComBitPosition=32, ComBitSize=1, ComSignalType=BOOLEAN, ComHandleId=168, ComSystemTemplateSystemSignalRef=IBS_ABPActive
          IBS_VehicleSpeed_oIBS_Status_03_oATOM_CANFD_Matrix_CH_V600_202502_5ce10c83_Rx: ComBitPosition=23, ComBitSize=13, ComSignalType=UINT16, ComHandleId=181, ComSystemTemplateSystemSignalRef=IBS_VehicleSpeed
          IBS_ABSFault_oIBS_Status_03_oATOM_CANFD_Matrix_CH_V600_202502_1bd8c058_Rx: ComBitPosition=38, ComBitSize=1, ComSignalType=BOOLEAN, ComHandleId=171, ComSystemTemplateSystemSignalRef=IBS_ABSFault
          Checksum_0B4_oIBS_Status_03_oATOM_CANFD_Matrix_CH_V600_202502_47252d94_Rx: ComBitPosition=7, ComBitSize=8, ComSignalType=UINT8, ComHandleId=167, ComSystemTemplateSystemSignalRef=Checksum_0B4
          IBS_EBDActive_oIBS_Status_03_oATOM_CANFD_Matrix_CH_V600_202502_1e24a445_Rx: ComBitPosition=37, ComBitSize=1, ComSignalType=BOOLEAN, ComHandleId=173, ComSystemTemplateSystemSignalRef=IBS_EBDActive
          IBS_VCU_DecelerationRequest_Available_oIBS_Status_03_oATOM_CANFD_Matrix_CH_V600_202502_227d55b1_Rx: ComBitPosition=45, ComBitSize=4, ComSignalType=UINT8, ComHandleId=178, ComSystemTemplateSystemSignalRef=IBS_VCU_DecelerationRequest_Available
          IBS_DTCFault_oIBS_Status_03_oATOM_CANFD_Matrix_CH_V600_202502_632f33ac_Rx: ComBitPosition=46, ComBitSize=1, ComSignalType=BOOLEAN, ComHandleId=172, ComSystemTemplateSystemSignalRef=IBS_DTCFault
          IBS_ABPAvailable_oIBS_Status_03_oATOM_CANFD_Matrix_CH_V600_202502_7eb6cd8c_Rx: ComBitPosition=47, ComBitSize=1, ComSignalType=BOOLEAN, ComHandleId=169, ComSystemTemplateSystemSignalRef=IBS_ABPAvailable
          IBS_TCSFault_oIBS_Status_03_oATOM_CANFD_Matrix_CH_V600_202502_2d90687a_Rx: ComBitPosition=34, ComBitSize=1, ComSignalType=BOOLEAN, ComHandleId=177, ComSystemTemplateSystemSignalRef=IBS_TCSFault
      3 x ComIPdu, all with ComIPduDirection=SEND, ComIPduType=NORMAL, ComIPduSignalProcessing=DEFERRED, ComIPduCancellationSupport=false, ComIPduGroupRef=VCU_oATOM_CANFD_Matrix_CH_V600_202502_Tx_081cfe42, ComIPduMainFunctionRef=ComMainFunctionTx:
        VCU_04_oATOM_CANFD_Matrix_CH_V600_202502_db6dbd42_Tx: ComIPduHandleId=5, ComIPduSignalGroupRef=SG_VCU_04_SigGroup_oVCU_04_oATOM_CANFD_Matrix_CH_V600_202502_4cce7c18_Tx, ComPduIdRef=VCU_04_oATOM_CANFD_Matrix_CH_V600_202502_db6dbd42_Tx
          ComTxIPdu: ComMinimumDelayTime=0, ComTxIPduUnusedAreasDefault=0
            ComTxModeTrue
              ComTxMode: ComTxModeMode=PERIODIC, ComTxModeTimeOffset=0, ComTxModeTimePeriod=0.1
            ComTxModeFalse
              ComTxMode: ComTxModeMode=PERIODIC, ComTxModeTimeOffset=0, ComTxModeTimePeriod=0.1
        VCU_02_oATOM_CANFD_Matrix_CH_V600_202502_17bac731_Tx: ComIPduHandleId=3, ComIPduSignalGroupRef=SG_VCU_02_SigGroup_oVCU_02_oATOM_CANFD_Matrix_CH_V600_202502_2fc20804_Tx, ComPduIdRef=VCU_02_oATOM_CANFD_Matrix_CH_V600_202502_17bac731_Tx
          ComTxIPdu: ComMinimumDelayTime=0, ComTxIPduUnusedAreasDefault=0
            ComTxModeTrue
              ComTxMode: ComTxModeMode=PERIODIC, ComTxModeTimeOffset=0, ComTxModeTimePeriod=0.2
            ComTxModeFalse
              ComTxMode: ComTxModeMode=PERIODIC, ComTxModeTimeOffset=0, ComTxModeTimePeriod=0.2
        VCU_HMIsignals_02_oATOM_CANFD_Matrix_CH_V600_202502_7949a1d5_Tx: ComIPduHandleId=12, ComIPduSignalGroupRef=SG_VCU_HMIsignals_02_SigGroup_oVCU_HMIsignals_02_oATOM_CANFD_Matrix_CH_V600_202502_b90a0cf2_Tx, ComPduIdRef=VCU_HMIsignals_02_oATOM_CANFD_Matrix_CH_V600_202502_7949a1d5_Tx
          ComTxIPdu: ComMinimumDelayTime=0, ComTxIPduUnusedAreasDefault=0
            ComTxModeTrue
              ComTxMode: ComTxModeMode=PERIODIC, ComTxModeTimeOffset=0, ComTxModeTimePeriod=0.2
            ComTxModeFalse
              ComTxMode: ComTxModeMode=PERIODIC, ComTxModeTimeOffset=0, ComTxModeTimePeriod=0.2
      SG_VCU_BMS_SigGroup_oVCU_BMS_oATOM_CANFD_Matrix_CH_V600_202502_d27feb30_Tx (ComSignalGroup): ComTransferProperty=PENDING, ComSignalGroupAccess=ACCESS_UNCLEAR, ComHandleId=4, ComSystemTemplateSignalGroupRef=SG_VCU_BMS_SigGroup
        13 x ComGroupSignal, all with ComSignalEndianness=BIG_ENDIAN, ComTransferProperty=PENDING, ComSignalAccess=ACCESS_UNCLEAR:
          VCU_BMSTargetThermLevel_oVCU_BMS_oATOM_CANFD_Matrix_CH_V600_202502_9ec34af1_Tx: ComBitPosition=55, ComBitSize=2, ComSignalInitValue=0, ComSignalType=UINT8, ComHandleId=119, ComSystemTemplateSystemSignalRef=VCU_BMSTargetThermLevel
          VCU_IsoMeasurementSwitch_oVCU_BMS_oATOM_CANFD_Matrix_CH_V600_202502_d7a76412_Tx: ComBitPosition=14, ComBitSize=1, ComSignalInitValue=1, ComSignalType=BOOLEAN, ComHandleId=124, ComSystemTemplateSystemSignalRef=VCU_IsoMeasurementSwitch
          VCU_HVStatus_oVCU_BMS_oATOM_CANFD_Matrix_CH_V600_202502_aebb67ba_Tx: ComBitPosition=31, ComBitSize=4, ComSignalInitValue=0, ComSignalType=UINT8, ComHandleId=123, ComSystemTemplateSystemSignalRef=VCU_HVStatus
          Checksum_0D1_oVCU_BMS_oATOM_CANFD_Matrix_CH_V600_202502_c848143c_Tx: ComBitPosition=7, ComBitSize=8, ComSignalInitValue=0, ComSignalType=UINT8, ComHandleId=116, ComSystemTemplateSystemSignalRef=Checksum_0D1
          VCU_ChargeStatus_oVCU_BMS_oATOM_CANFD_Matrix_CH_V600_202502_17f7901d_Tx: ComBitPosition=27, ComBitSize=4, ComSignalInitValue=0, ComSignalType=UINT8, ComHandleId=121, ComSystemTemplateSystemSignalRef=VCU_ChargeStatus
          VCU_RequestedModeBMS_oVCU_BMS_oATOM_CANFD_Matrix_CH_V600_202502_a3197c92_Tx: ComBitPosition=23, ComBitSize=3, ComSignalInitValue=0, ComSignalType=UINT8, ComHandleId=128, ComSystemTemplateSystemSignalRef=VCU_RequestedModeBMS
          VCU_BMS_Control_of_PosRelay_oVCU_BMS_oATOM_CANFD_Matrix_CH_V600_202502_cab9d256_Tx: ComBitPosition=53, ComBitSize=2, ComSignalInitValue=0, ComSignalType=UINT8, ComHandleId=120, ComSystemTemplateSystemSignalRef=VCU_BMS_Control_of_PosRelay
          VCU_RegenBrakeLightRequest_oVCU_BMS_oATOM_CANFD_Matrix_CH_V600_202502_9537c5ed_Tx: ComBitPosition=40, ComBitSize=1, ComSignalInitValue=0, ComSignalType=BOOLEAN, ComHandleId=127, ComSystemTemplateSystemSignalRef=VCU_RegenBrakeLightRequest
          VCU_ActDriveMode_oVCU_BMS_oATOM_CANFD_Matrix_CH_V600_202502_c1c6ace2_Tx: ComBitPosition=37, ComBitSize=3, ComSignalInitValue=0, ComSignalType=UINT8, ComHandleId=118, ComSystemTemplateSystemSignalRef=VCU_ActDriveMode
          VCU_LimitLevel_oVCU_BMS_oATOM_CANFD_Matrix_CH_V600_202502_944086eb_Tx: ComBitPosition=39, ComBitSize=2, ComSignalInitValue=0, ComSignalType=UINT8, ComHandleId=125, ComSystemTemplateSystemSignalRef=VCU_LimitLevel
          VCU_RegenBrakeLightReqVld_oVCU_BMS_oATOM_CANFD_Matrix_CH_V600_202502_b28083e9_Tx: ComBitPosition=41, ComBitSize=1, ComSignalInitValue=0, ComSignalType=BOOLEAN, ComHandleId=126, ComSystemTemplateSystemSignalRef=VCU_RegenBrakeLightReqVld
          MessageCounter_0D1_oVCU_BMS_oATOM_CANFD_Matrix_CH_V600_202502_0232b184_Tx: ComBitPosition=11, ComBitSize=4, ComSignalInitValue=0, ComSignalType=UINT8, ComHandleId=117, ComSystemTemplateSystemSignalRef=MessageCounter_0D1
          VCU_DrvModSwitchWarn_oVCU_BMS_oATOM_CANFD_Matrix_CH_V600_202502_8a817be7_Tx: ComBitPosition=34, ComBitSize=3, ComSignalInitValue=0, ComSignalType=UINT8, ComHandleId=122, ComSystemTemplateSystemSignalRef=VCU_DrvModSwitchWarn
      SG_VCU_03_SigGroup_oVCU_03_oATOM_CANFD_Matrix_CH_V600_202502_8990e3c1_Tx (ComSignalGroup): ComTransferProperty=PENDING, ComSignalGroupAccess=ACCESS_UNCLEAR, ComHandleId=1, ComSystemTemplateSignalGroupRef=SG_VCU_03_SigGroup
        5 x ComGroupSignal, all with ComSignalEndianness=BIG_ENDIAN, ComSignalInitValue=0, ComTransferProperty=PENDING, ComSignalAccess=ACCESS_UNCLEAR:
          VCU_ChargeProcessComment_oVCU_03_oATOM_CANFD_Matrix_CH_V600_202502_b076f405_Tx: ComBitPosition=25, ComBitSize=2, ComSignalType=UINT8, ComHandleId=97, ComSystemTemplateSystemSignalRef=VCU_ChargeProcessComment
          VCU_DCFCCurrent_oVCU_03_oATOM_CANFD_Matrix_CH_V600_202502_54508868_Tx: ComBitPosition=23, ComBitSize=10, ComSignalType=UINT16, ComHandleId=98, ComSystemTemplateSystemSignalRef=VCU_DCFCCurrent
          VCU_BrakeCompensateStatus_oVCU_03_oATOM_CANFD_Matrix_CH_V600_202502_aada4313_Tx: ComBitPosition=27, ComBitSize=2, ComSignalType=UINT8, ComHandleId=96, ComSystemTemplateSystemSignalRef=VCU_BrakeCompensateStatus
          VCU_MemoryChargeFault_oVCU_03_oATOM_CANFD_Matrix_CH_V600_202502_cb765ea4_Tx: ComBitPosition=59, ComBitSize=1, ComSignalType=BOOLEAN, ComHandleId=100, ComSystemTemplateSystemSignalRef=VCU_MemoryChargeFault
          VCU_EnergyV2L_oVCU_03_oATOM_CANFD_Matrix_CH_V600_202502_5ef6f2f0_Tx: ComBitPosition=55, ComBitSize=12, ComSignalType=UINT16, ComHandleId=99, ComSystemTemplateSystemSignalRef=VCU_EnergyV2L
      ACU_02_oATOM_CANFD_Matrix_CH_V600_202502_19603798_Rx (ComIPdu):
        ComIPduDirection = RECEIVE
        ComIPduType = NORMAL
        ComIPduHandleId = 1
        ComIPduSignalProcessing = DEFERRED
        ComIPduCancellationSupport = false
        ComIPduGroupRef = VCU_oATOM_CANFD_Matrix_CH_V600_202502_Rx_5e4659c4
        ComIPduSignalGroupRef = SG_ACU_02_SigGroup_oACU_02_oATOM_CANFD_Matrix_CH_V600_202502_3b90e790_Rx
        ComPduIdRef = ACU_02_oATOM_CANFD_Matrix_CH_V600_202502_19603798_Rx
        ComIPduMainFunctionRef = ComMainFunctionRx
      IBS_Status_03_oATOM_CANFD_Matrix_CH_V600_202502_f4245e85_Rx (ComIPdu):
        ComIPduDirection = RECEIVE
        ComIPduType = NORMAL
        ComIPduHandleId = 17
        ComIPduSignalProcessing = DEFERRED
        ComIPduCancellationSupport = false
        ComIPduGroupRef = VCU_oATOM_CANFD_Matrix_CH_V600_202502_Rx_5e4659c4
        ComIPduSignalGroupRef = SG_IBS_Status_03_SigGroup_oIBS_Status_03_oATOM_CANFD_Matrix_CH_V600_202502_2b221089_Rx
        ComPduIdRef = IBS_Status_03_oATOM_CANFD_Matrix_CH_V600_202502_f4245e85_Rx
        ComIPduMainFunctionRef = ComMainFunctionRx
      SG_ADCU_APS_01_SigGroup_oADCU_APS_01_oATOM_CANFD_Matrix_CH_V600_202502_c590572d_Rx (ComSignalGroup): ComTransferProperty=PENDING, ComSignalGroupAccess=ACCESS_UNCLEAR, ComHandleId=5, ComSystemTemplateSignalGroupRef=SG_ADCU_APS_01_SigGroup
        12 x ComGroupSignal, all with ComSignalEndianness=BIG_ENDIAN, ComSignalInitValue=0, ComSignalAccess=ACCESS_UNCLEAR:
          ADCU_APS_Stop_Req_oADCU_APS_01_oATOM_CANFD_Matrix_CH_V600_202502_cd03c7ef_Rx: ComBitPosition=33, ComBitSize=2, ComSignalType=UINT8, ComHandleId=111, ComSystemTemplateSystemSignalRef=ADCU_APS_Stop_Req
          ADCU_Parking_Mode_oADCU_APS_01_oATOM_CANFD_Matrix_CH_V600_202502_c6e9f3f9_Rx: ComBitPosition=55, ComBitSize=4, ComSignalType=UINT8, ComHandleId=113, ComSystemTemplateSystemSignalRef=ADCU_Parking_Mode
          ADCU_APSCrlModeReq_oADCU_APS_01_oATOM_CANFD_Matrix_CH_V600_202502_589f1c09_Rx: ComBitPosition=15, ComBitSize=2, ComSignalType=UINT8, ComHandleId=106, ComSystemTemplateSystemSignalRef=ADCU_APSCrlModeReq
          ADCU_APSCrlReq_oADCU_APS_01_oATOM_CANFD_Matrix_CH_V600_202502_da787726_Rx: ComBitPosition=23, ComBitSize=2, ComSignalType=UINT8, ComHandleId=107, ComSystemTemplateSystemSignalRef=ADCU_APSCrlReq
          MessageCounter_0E4_oADCU_APS_01_oATOM_CANFD_Matrix_CH_V600_202502_b0a71257_Rx: ComBitPosition=11, ComBitSize=4, ComSignalType=UINT8, ComHandleId=116, ComSystemTemplateSystemSignalRef=MessageCounter_0E4
          Checksum_0E4_oADCU_APS_01_oATOM_CANFD_Matrix_CH_V600_202502_19b3517b_Rx: ComBitPosition=7, ComBitSize=8, ComSignalType=UINT8, ComHandleId=115, ComSystemTemplateSystemSignalRef=Checksum_0E4
          ADCU_APSComfBrkReq_oADCU_APS_01_oATOM_CANFD_Matrix_CH_V600_202502_b25663d8_Rx: ComBitPosition=42, ComBitSize=2, ComSignalType=UINT8, ComHandleId=105, ComSystemTemplateSystemSignalRef=ADCU_APSComfBrkReq
          ADCU_APSCrlTypReq_oADCU_APS_01_oATOM_CANFD_Matrix_CH_V600_202502_25dd00be_Rx: ComBitPosition=13, ComBitSize=2, ComSignalType=UINT8, ComHandleId=108, ComSystemTemplateSystemSignalRef=ADCU_APSCrlTypReq
          ADCU_TargetGear_oADCU_APS_01_oATOM_CANFD_Matrix_CH_V600_202502_dbe43087_Rx: ComBitPosition=39, ComBitSize=3, ComSignalType=UINT8, ComHandleId=114, ComSystemTemplateSystemSignalRef=ADCU_TargetGear
          ADCU_APSDistanceStop_oADCU_APS_01_oATOM_CANFD_Matrix_CH_V600_202502_5af9bfc0_Rx: ComBitPosition=19, ComBitSize=12, ComSignalType=UINT16, ComHandleId=109, ComSystemTemplateSystemSignalRef=ADCU_APSDistanceStop
          ADCU_APSMaxSpeedReq_oADCU_APS_01_oATOM_CANFD_Matrix_CH_V600_202502_afdb21bd_Rx: ComBitPosition=47, ComBitSize=5, ComSignalType=UINT8, ComHandleId=110, ComSystemTemplateSystemSignalRef=ADCU_APSMaxSpeedReq
          ADCU_Parking_CtrlSts_oADCU_APS_01_oATOM_CANFD_Matrix_CH_V600_202502_c95774a6_Rx: ComBitPosition=35, ComBitSize=2, ComSignalType=UINT8, ComHandleId=112, ComSystemTemplateSystemSignalRef=ADCU_Parking_CtrlSts
      ADCU_ACC_02_oATOM_CANFD_Matrix_CH_V600_202502_09e0da82_Rx (ComIPdu):
        ComIPduDirection = RECEIVE
        ComIPduType = NORMAL
        ComIPduHandleId = 3
        ComIPduSignalProcessing = DEFERRED
        ComIPduCancellationSupport = false
        ComIPduGroupRef = VCU_oATOM_CANFD_Matrix_CH_V600_202502_Rx_5e4659c4
        ComIPduSignalGroupRef = SG_ADCU_ACC_02_SigGroup_oADCU_ACC_02_oATOM_CANFD_Matrix_CH_V600_202502_1e479296_Rx
        ComPduIdRef = ADCU_ACC_02_oATOM_CANFD_Matrix_CH_V600_202502_09e0da82_Rx
        ComIPduMainFunctionRef = ComMainFunctionRx
      SG_VCU_PlugInChrgInfo_SigGroup_oVCU_PlugInChrgInfo_oATOM_CANFD_Matrix_CH_V600_202502_c285d340_Tx (ComSignalGroup): ComTransferProperty=PENDING, ComSignalGroupAccess=ACCESS_UNCLEAR, ComHandleId=10, ComSystemTemplateSignalGroupRef=SG_VCU_PlugInChrgInfo_SigGroup
        4 x ComGroupSignal, all with ComSignalEndianness=BIG_ENDIAN, ComSignalInitValue=0, ComTransferProperty=PENDING, ComSignalAccess=ACCESS_UNCLEAR:
          VCU_ChargeEndReason_oVCU_PlugInChrgInfo_oATOM_CANFD_Matrix_CH_V600_202502_86604033_Tx: ComBitPosition=36, ComBitSize=2, ComSignalType=UINT8, ComHandleId=185, ComSystemTemplateSystemSignalRef=VCU_ChargeEndReason
          VCU_HVConnectFault_oVCU_PlugInChrgInfo_oATOM_CANFD_Matrix_CH_V600_202502_ad3614da_Tx: ComBitPosition=37, ComBitSize=1, ComSignalType=BOOLEAN, ComHandleId=187, ComSystemTemplateSystemSignalRef=VCU_HVConnectFault
          VCU_DischargeEndReason_oVCU_PlugInChrgInfo_oATOM_CANFD_Matrix_CH_V600_202502_a9c41ef6_Tx: ComBitPosition=34, ComBitSize=2, ComSignalType=UINT8, ComHandleId=186, ComSystemTemplateSystemSignalRef=VCU_DischargeEndReason
          VCU_RemainChrgTime_oVCU_PlugInChrgInfo_oATOM_CANFD_Matrix_CH_V600_202502_deed3006_Tx: ComBitPosition=7, ComBitSize=12, ComSignalType=UINT16, ComHandleId=188, ComSystemTemplateSystemSignalRef=VCU_RemainChrgTime
      4 x ComIPdu, all with ComIPduType=NORMAL, ComIPduSignalProcessing=DEFERRED, ComIPduCancellationSupport=false:
        IBS_VCU_MotorControl_oATOM_CANFD_Matrix_CH_V600_202502_d229d0d9_Rx: ComIPduDirection=RECEIVE, ComIPduHandleId=21, ComIPduGroupRef=VCU_oATOM_CANFD_Matrix_CH_V600_202502_Rx_5e4659c4, ComIPduSignalGroupRef=SG_IBS_VCU_MotorControl_SigGroup_oIBS_VCU_MotorControl_oATOM_CANFD_Matrix_CH_V600_202502_9a811a5b_Rx, ComPduIdRef=IBS_VCU_MotorControl_oATOM_CANFD_Matrix_CH_V600_202502_d229d0d9_Rx, ComIPduMainFunctionRef=ComMainFunctionRx
        IBS_Status_01_oATOM_CANFD_Matrix_CH_V600_202502_b0697754_Rx: ComIPduDirection=RECEIVE, ComIPduHandleId=15, ComIPduGroupRef=VCU_oATOM_CANFD_Matrix_CH_V600_202502_Rx_5e4659c4, ComIPduSignalGroupRef=SG_IBS_Status_01_SigGroup_oIBS_Status_01_oATOM_CANFD_Matrix_CH_V600_202502_bdf732ba_Rx, ComPduIdRef=IBS_Status_01_oATOM_CANFD_Matrix_CH_V600_202502_b0697754_Rx, ComIPduMainFunctionRef=ComMainFunctionRx
        VCU_MCU_03_oATOM_CANFD_Matrix_CH_V600_202502_0d9d0aa9_Tx: ComIPduDirection=SEND, ComIPduHandleId=14, ComIPduGroupRef=VCU_oATOM_CANFD_Matrix_CH_V600_202502_Tx_081cfe42, ComIPduSignalGroupRef=SG_VCU_MCU_03_SigGroup_oVCU_MCU_03_oATOM_CANFD_Matrix_CH_V600_202502_c0057d9b_Tx, ComPduIdRef=VCU_MCU_03_oATOM_CANFD_Matrix_CH_V600_202502_0d9d0aa9_Tx, ComIPduMainFunctionRef=ComMainFunctionTx
          ComTxIPdu: ComMinimumDelayTime=0, ComTxIPduUnusedAreasDefault=0
            ComTxModeTrue
              ComTxMode: ComTxModeMode=PERIODIC, ComTxModeTimeOffset=0, ComTxModeTimePeriod=0.01
            ComTxModeFalse
              ComTxMode: ComTxModeMode=PERIODIC, ComTxModeTimeOffset=0, ComTxModeTimePeriod=0.01
        ACU_01_oATOM_CANFD_Matrix_CH_V600_202502_92b30981_Rx: ComIPduDirection=RECEIVE, ComIPduHandleId=0, ComIPduGroupRef=VCU_oATOM_CANFD_Matrix_CH_V600_202502_Rx_5e4659c4, ComIPduSignalGroupRef=SG_ACU_01_SigGroup_oACU_01_oATOM_CANFD_Matrix_CH_V600_202502_0a16dd9e_Rx, ComPduIdRef=ACU_01_oATOM_CANFD_Matrix_CH_V600_202502_92b30981_Rx, ComIPduMainFunctionRef=ComMainFunctionRx
      SG_ADCU_DA_SigGroup_oADCU_DA_oATOM_CANFD_Matrix_CH_V600_202502_4133b6dd_Rx (ComSignalGroup): ComTransferProperty=PENDING, ComSignalGroupAccess=ACCESS_UNCLEAR, ComHandleId=7, ComSystemTemplateSignalGroupRef=SG_ADCU_DA_SigGroup
        3 x ComGroupSignal, all with ComSignalEndianness=BIG_ENDIAN, ComSignalInitValue=0, ComSignalType=UINT8, ComSignalAccess=ACCESS_UNCLEAR:
          Checksum_0E6_oADCU_DA_oATOM_CANFD_Matrix_CH_V600_202502_6e918845_Rx: ComBitPosition=7, ComBitSize=8, ComHandleId=119, ComSystemTemplateSystemSignalRef=Checksum_0E6
          ADCU_DA_Mode_oADCU_DA_oATOM_CANFD_Matrix_CH_V600_202502_98abcb34_Rx: ComBitPosition=23, ComBitSize=3, ComHandleId=118, ComSystemTemplateSystemSignalRef=ADCU_DA_Mode
          MessageCounter_0E6_oADCU_DA_oATOM_CANFD_Matrix_CH_V600_202502_a4eb2dfd_Rx: ComBitPosition=11, ComBitSize=4, ComHandleId=120, ComSystemTemplateSystemSignalRef=MessageCounter_0E6
      ADCU_APS_01_oATOM_CANFD_Matrix_CH_V600_202502_d7aca41b_Rx (ComIPdu):
        ComIPduDirection = RECEIVE
        ComIPduType = NORMAL
        ComIPduHandleId = 5
        ComIPduSignalProcessing = DEFERRED
        ComIPduCancellationSupport = false
        ComIPduGroupRef = VCU_oATOM_CANFD_Matrix_CH_V600_202502_Rx_5e4659c4
        ComIPduSignalGroupRef = SG_ADCU_APS_01_SigGroup_oADCU_APS_01_oATOM_CANFD_Matrix_CH_V600_202502_c590572d_Rx
        ComPduIdRef = ADCU_APS_01_oATOM_CANFD_Matrix_CH_V600_202502_d7aca41b_Rx
        ComIPduMainFunctionRef = ComMainFunctionRx
      ACU_info_oATOM_CANFD_Matrix_CH_V600_202502_c3757d77_Rx (ComIPdu):
        ComIPduDirection = RECEIVE
        ComIPduType = NORMAL
        ComIPduHandleId = 2
        ComIPduSignalProcessing = DEFERRED
        ComIPduCancellationSupport = false
        ComIPduGroupRef = VCU_oATOM_CANFD_Matrix_CH_V600_202502_Rx_5e4659c4
        ComIPduSignalGroupRef = SG_ACU_info_SigGroup_oACU_info_oATOM_CANFD_Matrix_CH_V600_202502_5b63ef23_Rx
        ComPduIdRef = ACU_info_oATOM_CANFD_Matrix_CH_V600_202502_c3757d77_Rx
        ComIPduMainFunctionRef = ComMainFunctionRx
      VCU_oATOM_CANFD_Matrix_CH_V600_202502_Tx_081cfe42 (ComIPduGroup): ComIPduGroupHandleId=1
      4 x ComIPdu, all with ComIPduType=NORMAL, ComIPduSignalProcessing=DEFERRED, ComIPduCancellationSupport=false:
        ADCU_APS_02_oATOM_CANFD_Matrix_CH_V600_202502_5c7f9a02_Rx: ComIPduDirection=RECEIVE, ComIPduHandleId=6, ComIPduGroupRef=VCU_oATOM_CANFD_Matrix_CH_V600_202502_Rx_5e4659c4, ComIPduSignalGroupRef=SG_ADCU_APS_02_SigGroup_oADCU_APS_02_oATOM_CANFD_Matrix_CH_V600_202502_67bc1f98_Rx, ComPduIdRef=ADCU_APS_02_oATOM_CANFD_Matrix_CH_V600_202502_5c7f9a02_Rx, ComIPduMainFunctionRef=ComMainFunctionRx
        IBS_WheelSpeed_02_oATOM_CANFD_Matrix_CH_V600_202502_97968df7_Rx: ComIPduDirection=RECEIVE, ComIPduHandleId=23, ComIPduGroupRef=VCU_oATOM_CANFD_Matrix_CH_V600_202502_Rx_5e4659c4, ComIPduSignalGroupRef=SG_IBS_WheelSpeed_02_SigGroup_oIBS_WheelSpeed_02_oATOM_CANFD_Matrix_CH_V600_202502_2d752b6e_Rx, ComPduIdRef=IBS_WheelSpeed_02_oATOM_CANFD_Matrix_CH_V600_202502_97968df7_Rx, ComIPduMainFunctionRef=ComMainFunctionRx
        VCU_PlugInChrgInfo_oATOM_CANFD_Matrix_CH_V600_202502_20405e82_Tx: ComIPduDirection=SEND, ComIPduHandleId=15, ComIPduGroupRef=VCU_oATOM_CANFD_Matrix_CH_V600_202502_Tx_081cfe42, ComIPduSignalGroupRef=SG_VCU_PlugInChrgInfo_SigGroup_oVCU_PlugInChrgInfo_oATOM_CANFD_Matrix_CH_V600_202502_c285d340_Tx, ComPduIdRef=VCU_PlugInChrgInfo_oATOM_CANFD_Matrix_CH_V600_202502_20405e82_Tx, ComIPduMainFunctionRef=ComMainFunctionTx
          ComTxIPdu: ComMinimumDelayTime=0, ComTxIPduUnusedAreasDefault=0
            ComTxModeTrue
              ComTxMode: ComTxModeMode=PERIODIC, ComTxModeTimeOffset=0, ComTxModeTimePeriod=0.2
            ComTxModeFalse
              ComTxMode: ComTxModeMode=PERIODIC, ComTxModeTimeOffset=0, ComTxModeTimePeriod=0.2
        VCU_BMS_oATOM_CANFD_Matrix_CH_V600_202502_1208e503_Tx: ComIPduDirection=SEND, ComIPduHandleId=7, ComIPduGroupRef=VCU_oATOM_CANFD_Matrix_CH_V600_202502_Tx_081cfe42, ComIPduSignalGroupRef=SG_VCU_BMS_SigGroup_oVCU_BMS_oATOM_CANFD_Matrix_CH_V600_202502_d27feb30_Tx, ComPduIdRef=VCU_BMS_oATOM_CANFD_Matrix_CH_V600_202502_1208e503_Tx, ComIPduMainFunctionRef=ComMainFunctionTx
          ComTxIPdu: ComMinimumDelayTime=0, ComTxIPduUnusedAreasDefault=0
            ComTxModeTrue
              ComTxMode: ComTxModeMode=PERIODIC, ComTxModeTimeOffset=0, ComTxModeTimePeriod=0.02
            ComTxModeFalse
              ComTxMode: ComTxModeMode=PERIODIC, ComTxModeTimeOffset=0, ComTxModeTimePeriod=0.02
      SG_IBS_APS_SigGroup_oIBS_APS_oATOM_CANFD_Matrix_CH_V600_202502_91bbe9ec_Rx (ComSignalGroup): ComTransferProperty=PENDING, ComSignalGroupAccess=ACCESS_UNCLEAR, ComHandleId=9, ComSystemTemplateSignalGroupRef=SG_IBS_APS_SigGroup
        9 x ComGroupSignal, all with ComSignalEndianness=BIG_ENDIAN, ComSignalInitValue=0, ComSignalType=UINT8, ComSignalAccess=ACCESS_UNCLEAR:
          IBS_APSCrlReqEcho_oIBS_APS_oATOM_CANFD_Matrix_CH_V600_202502_7e0dcab4_Rx: ComBitPosition=19, ComBitSize=2, ComHandleId=135, ComSystemTemplateSystemSignalRef=IBS_APSCrlReqEcho
          IBS_APSTrqReqActive_oIBS_APS_oATOM_CANFD_Matrix_CH_V600_202502_95892cb5_Rx: ComBitPosition=27, ComBitSize=2, ComHandleId=138, ComSystemTemplateSystemSignalRef=IBS_APSTrqReqActive
          IBS_APSEmergenyAvl_oIBS_APS_oATOM_CANFD_Matrix_CH_V600_202502_98e19592_Rx: ComBitPosition=29, ComBitSize=2, ComHandleId=136, ComSystemTemplateSystemSignalRef=IBS_APSEmergenyAvl
          MessageCounter_0B7_oIBS_APS_oATOM_CANFD_Matrix_CH_V600_202502_b68b4db2_Rx: ComBitPosition=11, ComBitSize=4, ComHandleId=141, ComSystemTemplateSystemSignalRef=MessageCounter_0B7
          IBS_APSModeEcho_oIBS_APS_oATOM_CANFD_Matrix_CH_V600_202502_b13c14e1_Rx: ComBitPosition=17, ComBitSize=2, ComHandleId=137, ComSystemTemplateSystemSignalRef=IBS_APSModeEcho
          IBS_APS_Avl_oIBS_APS_oATOM_CANFD_Matrix_CH_V600_202502_912b9c67_Rx: ComBitPosition=23, ComBitSize=2, ComHandleId=139, ComSystemTemplateSystemSignalRef=IBS_APS_Avl
          IBS_APSComfortAvl_oIBS_APS_oATOM_CANFD_Matrix_CH_V600_202502_761e7ded_Rx: ComBitPosition=31, ComBitSize=2, ComHandleId=134, ComSystemTemplateSystemSignalRef=IBS_APSComfortAvl
          Checksum_0B7_oIBS_APS_oATOM_CANFD_Matrix_CH_V600_202502_7cf1e80a_Rx: ComBitPosition=7, ComBitSize=8, ComHandleId=133, ComSystemTemplateSystemSignalRef=Checksum_0B7
          IBS_BrakeTypEcho_oIBS_APS_oATOM_CANFD_Matrix_CH_V600_202502_efa1b54d_Rx: ComBitPosition=21, ComBitSize=2, ComHandleId=140, ComSystemTemplateSystemSignalRef=IBS_BrakeTypEcho
      8 x ComSignal, all with ComBitSize=16, ComSignalEndianness=LITTLE_ENDIAN, ComSignalInitValue=0, ComSignalType=SINT16, ComTimeout=0, ComTransferProperty=PENDING, ComSignalAccess=ACCESS_UNCLEAR:
        AN47_oVcuAdcTxG8Msg3_oTC37X_VCU_CAN01_0b796cfb_Tx: ComBitPosition=48, ComHandleId=47, ComSystemTemplateSystemSignalRef=AN47
        AN30_oVcuAdcTxG3Msg1_oTC37X_VCU_CAN01_72505601_Tx: ComBitPosition=32, ComHandleId=30, ComSystemTemplateSystemSignalRef=AN30
        AN12_oVcuAdcTxG1Msg1_oTC37X_VCU_CAN01_5149143c_Tx: ComBitPosition=0, ComHandleId=12, ComSystemTemplateSystemSignalRef=AN12
        AN7_oVcuAdcTxG0Msg1_oTC37X_VCU_CAN01_762c0b63_Tx: ComBitPosition=48, ComHandleId=7, ComSystemTemplateSystemSignalRef=AN7
        AN11_oVcuAdcTxG1Msg0_oTC37X_VCU_CAN01_d39d5187_Tx: ComBitPosition=48, ComHandleId=11, ComSystemTemplateSystemSignalRef=AN11
        AN0_oVcuAdcTxG0Msg0_oTC37X_VCU_CAN01_66f10a00_Tx: ComBitPosition=0, ComHandleId=0, ComSystemTemplateSystemSignalRef=AN0
        AN31_oVcuAdcTxG3Msg1_oTC37X_VCU_CAN01_56d20737_Tx: ComBitPosition=48, ComHandleId=31, ComSystemTemplateSystemSignalRef=AN31
        AN34_oVcuAdcTxG8Msg0_oTC37X_VCU_CAN01_8f302f78_Tx: ComBitPosition=32, ComHandleId=34, ComSystemTemplateSystemSignalRef=AN34
      VcuAdcTxG2Msg0_oTC37X_VCU_CAN01_79c816e8_Tx (ComIPdu):
        ComIPduDirection = SEND
        ComIPduType = NORMAL
        ComIPduHandleId = 21
        ComIPduSignalProcessing = DEFERRED
        ComIPduCancellationSupport = false
        ComIPduGroupRef = VCU_oTC37X_VCU_CAN01_Tx_4e6d6cda
        ComIPduSignalRef = AN16_oVcuAdcTxG2Msg0_oTC37X_VCU_CAN01_156a4b45_Tx
        ComIPduSignalRef = AN17_oVcuAdcTxG2Msg0_oTC37X_VCU_CAN01_31e81a73_Tx
        ComIPduSignalRef = AN18_oVcuAdcTxG2Msg0_oTC37X_VCU_CAN01_31042200_Tx
        ComIPduSignalRef = AN19_oVcuAdcTxG2Msg0_oTC37X_VCU_CAN01_15867336_Tx
        ComPduIdRef = VcuAdcTxG2Msg0_oTC37X_VCU_CAN01_79c816e8_Tx
        ComIPduMainFunctionRef = ComMainFunctionTx
        ComTxIPdu: ComMinimumDelayTime=0, ComTxIPduUnusedAreasDefault=0
          ComTxModeTrue
            ComTxMode: ComTxModeMode=PERIODIC, ComTxModeTimeOffset=0, ComTxModeTimePeriod=0.5
          ComTxModeFalse
            ComTxMode: ComTxModeMode=PERIODIC, ComTxModeTimeOffset=0, ComTxModeTimePeriod=0.5
      AN23_oVcuAdcTxG2Msg1_oTC37X_VCU_CAN01_c760d653_Tx (ComSignal):
        ComBitPosition = 48
        ComBitSize = 16
        ComSignalEndianness = LITTLE_ENDIAN
        ComSignalInitValue = 0
        ComSignalType = SINT16
        ComTimeout = 0
        ComTransferProperty = PENDING
        ComSignalAccess = ACCESS_UNCLEAR
        ComHandleId = 23
        ComSystemTemplateSystemSignalRef = AN23
      VcuAdcTxG3Msg1_oTC37X_VCU_CAN01_81b2c4c9_Tx (ComIPdu):
        ComIPduDirection = SEND
        ComIPduType = NORMAL
        ComIPduHandleId = 24
        ComIPduSignalProcessing = DEFERRED
        ComIPduCancellationSupport = false
        ComIPduGroupRef = VCU_oTC37X_VCU_CAN01_Tx_4e6d6cda
        ComIPduSignalRef = AN28_oVcuAdcTxG3Msg1_oTC37X_VCU_CAN01_42adce38_Tx
        ComIPduSignalRef = AN29_oVcuAdcTxG3Msg1_oTC37X_VCU_CAN01_662f9f0e_Tx
        ComIPduSignalRef = AN30_oVcuAdcTxG3Msg1_oTC37X_VCU_CAN01_72505601_Tx
        ComIPduSignalRef = AN31_oVcuAdcTxG3Msg1_oTC37X_VCU_CAN01_56d20737_Tx
        ComPduIdRef = VcuAdcTxG3Msg1_oTC37X_VCU_CAN01_81b2c4c9_Tx
        ComIPduMainFunctionRef = ComMainFunctionTx
        ComTxIPdu: ComMinimumDelayTime=0, ComTxIPduUnusedAreasDefault=0
          ComTxModeTrue
            ComTxMode: ComTxModeMode=PERIODIC, ComTxModeTimeOffset=0, ComTxModeTimePeriod=0.5
          ComTxModeFalse
            ComTxMode: ComTxModeMode=PERIODIC, ComTxModeTimeOffset=0, ComTxModeTimePeriod=0.5
      4 x ComSignal, all with ComBitSize=16, ComSignalEndianness=LITTLE_ENDIAN, ComSignalInitValue=0, ComSignalType=SINT16, ComTimeout=0, ComTransferProperty=PENDING, ComSignalAccess=ACCESS_UNCLEAR:
        AN40_oVcuAdcTxG8Msg2_oTC37X_VCU_CAN01_1ba46d98_Tx: ComBitPosition=0, ComHandleId=40, ComSystemTemplateSystemSignalRef=AN40
        AN15_oVcuAdcTxG1Msg1_oTC37X_VCU_CAN01_aec6a3be_Tx: ComBitPosition=48, ComHandleId=15, ComSystemTemplateSystemSignalRef=AN15
        AN32_oVcuAdcTxG8Msg0_oTC37X_VCU_CAN01_543dc9cc_Tx: ComBitPosition=0, ComHandleId=32, ComSystemTemplateSystemSignalRef=AN32
        AN44_oVcuAdcTxG8Msg3_oTC37X_VCU_CAN01_66ff9fa1_Tx: ComBitPosition=0, ComHandleId=44, ComSystemTemplateSystemSignalRef=AN44
      VcuAdcTxG0Msg0_oTC37X_VCU_CAN01_5798df68_Tx (ComIPdu):
        ComIPduDirection = SEND
        ComIPduType = NORMAL
        ComIPduHandleId = 17
        ComIPduSignalProcessing = DEFERRED
        ComIPduCancellationSupport = false
        ComIPduGroupRef = VCU_oTC37X_VCU_CAN01_Tx_4e6d6cda
        ComIPduSignalRef = AN0_oVcuAdcTxG0Msg0_oTC37X_VCU_CAN01_66f10a00_Tx
        ComIPduSignalRef = AN1_oVcuAdcTxG0Msg0_oTC37X_VCU_CAN01_42735b36_Tx
        ComIPduSignalRef = AN2_oVcuAdcTxG0Msg0_oTC37X_VCU_CAN01_2ff5a86c_Tx
        ComIPduSignalRef = AN3_oVcuAdcTxG0Msg0_oTC37X_VCU_CAN01_0b77f95a_Tx
        ComPduIdRef = VcuAdcTxG0Msg0_oTC37X_VCU_CAN01_5798df68_Tx
        ComIPduMainFunctionRef = ComMainFunctionTx
        ComTxIPdu: ComMinimumDelayTime=0, ComTxIPduUnusedAreasDefault=0
          ComTxModeTrue
            ComTxMode: ComTxModeMode=PERIODIC, ComTxModeTimeOffset=0, ComTxModeTimePeriod=0.5
          ComTxModeFalse
            ComTxMode: ComTxModeMode=PERIODIC, ComTxModeTimeOffset=0, ComTxModeTimePeriod=0.5
      3 x ComSignal, all with ComBitSize=16, ComSignalEndianness=LITTLE_ENDIAN, ComSignalInitValue=0, ComSignalType=SINT16, ComTimeout=0, ComTransferProperty=PENDING, ComSignalAccess=ACCESS_UNCLEAR:
        AN29_oVcuAdcTxG3Msg1_oTC37X_VCU_CAN01_662f9f0e_Tx: ComBitPosition=16, ComHandleId=29, ComSystemTemplateSystemSignalRef=AN29
        AN24_oVcuAdcTxG3Msg0_oTC37X_VCU_CAN01_c095b3f0_Tx: ComBitPosition=0, ComHandleId=24, ComSystemTemplateSystemSignalRef=AN24
        AN22_oVcuAdcTxG2Msg1_oTC37X_VCU_CAN01_e3e28765_Tx: ComBitPosition=32, ComHandleId=22, ComSystemTemplateSystemSignalRef=AN22
      VcuAdcTxG3Msg0_oTC37X_VCU_CAN01_6ee07228_Tx (ComIPdu):
        ComIPduDirection = SEND
        ComIPduType = NORMAL
        ComIPduHandleId = 23
        ComIPduSignalProcessing = DEFERRED
        ComIPduCancellationSupport = false
        ComIPduGroupRef = VCU_oTC37X_VCU_CAN01_Tx_4e6d6cda
        ComIPduSignalRef = AN24_oVcuAdcTxG3Msg0_oTC37X_VCU_CAN01_c095b3f0_Tx
        ComIPduSignalRef = AN25_oVcuAdcTxG3Msg0_oTC37X_VCU_CAN01_e417e2c6_Tx
        ComIPduSignalRef = AN26_oVcuAdcTxG3Msg0_oTC37X_VCU_CAN01_8991119c_Tx
        ComIPduSignalRef = AN27_oVcuAdcTxG3Msg0_oTC37X_VCU_CAN01_ad1340aa_Tx
        ComPduIdRef = VcuAdcTxG3Msg0_oTC37X_VCU_CAN01_6ee07228_Tx
        ComIPduMainFunctionRef = ComMainFunctionTx
        ComTxIPdu: ComMinimumDelayTime=0, ComTxIPduUnusedAreasDefault=0
          ComTxModeTrue
            ComTxMode: ComTxModeMode=PERIODIC, ComTxModeTimeOffset=0, ComTxModeTimePeriod=0.5
          ComTxModeFalse
            ComTxMode: ComTxModeMode=PERIODIC, ComTxModeTimeOffset=0, ComTxModeTimePeriod=0.5
      4 x ComSignal, all with ComBitSize=16, ComSignalEndianness=LITTLE_ENDIAN, ComSignalInitValue=0, ComSignalType=SINT16, ComTimeout=0, ComTransferProperty=PENDING, ComSignalAccess=ACCESS_UNCLEAR:
        AN27_oVcuAdcTxG3Msg0_oTC37X_VCU_CAN01_ad1340aa_Tx: ComBitPosition=48, ComHandleId=27, ComSystemTemplateSystemSignalRef=AN27
        AN8_oVcuAdcTxG1Msg0_oTC37X_VCU_CAN01_8ebae131_Tx: ComBitPosition=0, ComHandleId=8, ComSystemTemplateSystemSignalRef=AN8
        AN5_oVcuAdcTxG0Msg1_oTC37X_VCU_CAN01_3f28a90f_Tx: ComBitPosition=16, ComHandleId=5, ComSystemTemplateSystemSignalRef=AN5
        AN18_oVcuAdcTxG2Msg0_oTC37X_VCU_CAN01_31042200_Tx: ComBitPosition=32, ComHandleId=18, ComSystemTemplateSystemSignalRef=AN18
      VcuAdcTxG0Msg1_oTC37X_VCU_CAN01_b8ca6989_Tx (ComIPdu):
        ComIPduDirection = SEND
        ComIPduType = NORMAL
        ComIPduHandleId = 18
        ComIPduSignalProcessing = DEFERRED
        ComIPduCancellationSupport = false
        ComIPduGroupRef = VCU_oTC37X_VCU_CAN01_Tx_4e6d6cda
        ComIPduSignalRef = AN4_oVcuAdcTxG0Msg1_oTC37X_VCU_CAN01_1baaf839_Tx
        ComIPduSignalRef = AN5_oVcuAdcTxG0Msg1_oTC37X_VCU_CAN01_3f28a90f_Tx
        ComIPduSignalRef = AN6_oVcuAdcTxG0Msg1_oTC37X_VCU_CAN01_52ae5a55_Tx
        ComIPduSignalRef = AN7_oVcuAdcTxG0Msg1_oTC37X_VCU_CAN01_762c0b63_Tx
        ComPduIdRef = VcuAdcTxG0Msg1_oTC37X_VCU_CAN01_b8ca6989_Tx
        ComIPduMainFunctionRef = ComMainFunctionTx
        ComTxIPdu: ComMinimumDelayTime=0, ComTxIPduUnusedAreasDefault=0
          ComTxModeTrue
            ComTxMode: ComTxModeMode=PERIODIC, ComTxModeTimeOffset=0, ComTxModeTimePeriod=0.5
          ComTxModeFalse
            ComTxMode: ComTxModeMode=PERIODIC, ComTxModeTimeOffset=0, ComTxModeTimePeriod=0.5
      5 x ComSignal, all with ComBitSize=16, ComSignalEndianness=LITTLE_ENDIAN, ComSignalInitValue=0, ComSignalType=SINT16, ComTimeout=0, ComTransferProperty=PENDING, ComSignalAccess=ACCESS_UNCLEAR:
        AN38_oVcuAdcTxG8Msg1_oTC37X_VCU_CAN01_0d0852b0_Tx: ComBitPosition=32, ComHandleId=38, ComSystemTemplateSystemSignalRef=AN38
        AN26_oVcuAdcTxG3Msg0_oTC37X_VCU_CAN01_8991119c_Tx: ComBitPosition=32, ComHandleId=26, ComSystemTemplateSystemSignalRef=AN26
        AN16_oVcuAdcTxG2Msg0_oTC37X_VCU_CAN01_156a4b45_Tx: ComBitPosition=0, ComHandleId=16, ComSystemTemplateSystemSignalRef=AN16
        AN21_oVcuAdcTxG2Msg1_oTC37X_VCU_CAN01_8e64743f_Tx: ComBitPosition=16, ComHandleId=21, ComSystemTemplateSystemSignalRef=AN21
        AN1_oVcuAdcTxG0Msg0_oTC37X_VCU_CAN01_42735b36_Tx: ComBitPosition=16, ComHandleId=1, ComSystemTemplateSystemSignalRef=AN1
      VcuAdcTxG8Msg0_oTC37X_VCU_CAN01_eedbf968_Tx (ComIPdu):
        ComIPduDirection = SEND
        ComIPduType = NORMAL
        ComIPduHandleId = 25
        ComIPduSignalProcessing = DEFERRED
        ComIPduCancellationSupport = false
        ComIPduGroupRef = VCU_oTC37X_VCU_CAN01_Tx_4e6d6cda
        ComIPduSignalRef = AN32_oVcuAdcTxG8Msg0_oTC37X_VCU_CAN01_543dc9cc_Tx
        ComIPduSignalRef = AN33_oVcuAdcTxG8Msg0_oTC37X_VCU_CAN01_70bf98fa_Tx
        ComIPduSignalRef = AN34_oVcuAdcTxG8Msg0_oTC37X_VCU_CAN01_8f302f78_Tx
        ComIPduSignalRef = AN35_oVcuAdcTxG8Msg0_oTC37X_VCU_CAN01_abb27e4e_Tx
        ComPduIdRef = VcuAdcTxG8Msg0_oTC37X_VCU_CAN01_eedbf968_Tx
        ComIPduMainFunctionRef = ComMainFunctionTx
        ComTxIPdu: ComMinimumDelayTime=0, ComTxIPduUnusedAreasDefault=0
          ComTxModeTrue
            ComTxMode: ComTxModeMode=PERIODIC, ComTxModeTimeOffset=0, ComTxModeTimePeriod=0.5
          ComTxModeFalse
            ComTxMode: ComTxModeMode=PERIODIC, ComTxModeTimeOffset=0, ComTxModeTimePeriod=0.5
      AN35_oVcuAdcTxG8Msg0_oTC37X_VCU_CAN01_abb27e4e_Tx (ComSignal):
        ComBitPosition = 48
        ComBitSize = 16
        ComSignalEndianness = LITTLE_ENDIAN
        ComSignalInitValue = 0
        ComSignalType = SINT16
        ComTimeout = 0
        ComTransferProperty = PENDING
        ComSignalAccess = ACCESS_UNCLEAR
        ComHandleId = 35
        ComSystemTemplateSystemSignalRef = AN35
      VcuAdcTxG1Msg0_oTC37X_VCU_CAN01_40b0bba8_Tx (ComIPdu):
        ComIPduDirection = SEND
        ComIPduType = NORMAL
        ComIPduHandleId = 19
        ComIPduSignalProcessing = DEFERRED
        ComIPduCancellationSupport = false
        ComIPduGroupRef = VCU_oTC37X_VCU_CAN01_Tx_4e6d6cda
        ComIPduSignalRef = AN10_oVcuAdcTxG1Msg0_oTC37X_VCU_CAN01_f71f00b1_Tx
        ComIPduSignalRef = AN11_oVcuAdcTxG1Msg0_oTC37X_VCU_CAN01_d39d5187_Tx
        ComIPduSignalRef = AN8_oVcuAdcTxG1Msg0_oTC37X_VCU_CAN01_8ebae131_Tx
        ComIPduSignalRef = AN9_oVcuAdcTxG1Msg0_oTC37X_VCU_CAN01_aa38b007_Tx
        ComPduIdRef = VcuAdcTxG1Msg0_oTC37X_VCU_CAN01_40b0bba8_Tx
        ComIPduMainFunctionRef = ComMainFunctionTx
        ComTxIPdu: ComMinimumDelayTime=0, ComTxIPduUnusedAreasDefault=0
          ComTxModeTrue
            ComTxMode: ComTxModeMode=PERIODIC, ComTxModeTimeOffset=0, ComTxModeTimePeriod=0.5
          ComTxModeFalse
            ComTxMode: ComTxModeMode=PERIODIC, ComTxModeTimeOffset=0, ComTxModeTimePeriod=0.5
      3 x ComSignal, all with ComBitSize=16, ComSignalEndianness=LITTLE_ENDIAN, ComSignalInitValue=0, ComSignalType=SINT16, ComTimeout=0, ComTransferProperty=PENDING, ComSignalAccess=ACCESS_UNCLEAR:
        AN36_oVcuAdcTxG8Msg1_oTC37X_VCU_CAN01_29663bf5_Tx: ComBitPosition=0, ComHandleId=36, ComSystemTemplateSystemSignalRef=AN36
        AN20_oVcuAdcTxG2Msg1_oTC37X_VCU_CAN01_aae62509_Tx: ComBitPosition=0, ComHandleId=20, ComSystemTemplateSystemSignalRef=AN20
        AN10_oVcuAdcTxG1Msg0_oTC37X_VCU_CAN01_f71f00b1_Tx: ComBitPosition=32, ComHandleId=10, ComSystemTemplateSystemSignalRef=AN10
      VcuAdcTxG2Msg1_oTC37X_VCU_CAN01_969aa009_Tx (ComIPdu):
        ComIPduDirection = SEND
        ComIPduType = NORMAL
        ComIPduHandleId = 22
        ComIPduSignalProcessing = DEFERRED
        ComIPduCancellationSupport = false
        ComIPduGroupRef = VCU_oTC37X_VCU_CAN01_Tx_4e6d6cda
        ComIPduSignalRef = AN20_oVcuAdcTxG2Msg1_oTC37X_VCU_CAN01_aae62509_Tx
        ComIPduSignalRef = AN21_oVcuAdcTxG2Msg1_oTC37X_VCU_CAN01_8e64743f_Tx
        ComIPduSignalRef = AN22_oVcuAdcTxG2Msg1_oTC37X_VCU_CAN01_e3e28765_Tx
        ComIPduSignalRef = AN23_oVcuAdcTxG2Msg1_oTC37X_VCU_CAN01_c760d653_Tx
        ComPduIdRef = VcuAdcTxG2Msg1_oTC37X_VCU_CAN01_969aa009_Tx
        ComIPduMainFunctionRef = ComMainFunctionTx
        ComTxIPdu: ComMinimumDelayTime=0, ComTxIPduUnusedAreasDefault=0
          ComTxModeTrue
            ComTxMode: ComTxModeMode=PERIODIC, ComTxModeTimeOffset=0, ComTxModeTimePeriod=0.5
          ComTxModeFalse
            ComTxMode: ComTxModeMode=PERIODIC, ComTxModeTimeOffset=0, ComTxModeTimePeriod=0.5
      AN28_oVcuAdcTxG3Msg1_oTC37X_VCU_CAN01_42adce38_Tx (ComSignal):
        ComBitPosition = 0
        ComBitSize = 16
        ComSignalEndianness = LITTLE_ENDIAN
        ComSignalInitValue = 0
        ComSignalType = SINT16
        ComTimeout = 0
        ComTransferProperty = PENDING
        ComSignalAccess = ACCESS_UNCLEAR
        ComHandleId = 28
        ComSystemTemplateSystemSignalRef = AN28
      AN43_oVcuAdcTxG8Msg2_oTC37X_VCU_CAN01_76229ec2_Tx (ComSignal):
        ComBitPosition = 48
        ComBitSize = 16
        ComSignalEndianness = LITTLE_ENDIAN
        ComSignalInitValue = 0
        ComSignalType = SINT16
        ComTimeout = 0
        ComTransferProperty = PENDING
        ComSignalAccess = ACCESS_UNCLEAR
        ComHandleId = 43
        ComSystemTemplateSystemSignalRef = AN43
      VcuAdcTxG8Msg1_oTC37X_VCU_CAN01_01894f89_Tx (ComIPdu):
        ComIPduDirection = SEND
        ComIPduType = NORMAL
        ComIPduHandleId = 26
        ComIPduSignalProcessing = DEFERRED
        ComIPduCancellationSupport = false
        ComIPduGroupRef = VCU_oTC37X_VCU_CAN01_Tx_4e6d6cda
        ComIPduSignalRef = AN36_oVcuAdcTxG8Msg1_oTC37X_VCU_CAN01_29663bf5_Tx
        ComIPduSignalRef = AN37_oVcuAdcTxG8Msg1_oTC37X_VCU_CAN01_0de46ac3_Tx
        ComIPduSignalRef = AN38_oVcuAdcTxG8Msg1_oTC37X_VCU_CAN01_0d0852b0_Tx
        ComIPduSignalRef = AN39_oVcuAdcTxG8Msg1_oTC37X_VCU_CAN01_298a0386_Tx
        ComPduIdRef = VcuAdcTxG8Msg1_oTC37X_VCU_CAN01_01894f89_Tx
        ComIPduMainFunctionRef = ComMainFunctionTx
        ComTxIPdu: ComMinimumDelayTime=0, ComTxIPduUnusedAreasDefault=0
          ComTxModeTrue
            ComTxMode: ComTxModeMode=PERIODIC, ComTxModeTimeOffset=0, ComTxModeTimePeriod=0.5
          ComTxModeFalse
            ComTxMode: ComTxModeMode=PERIODIC, ComTxModeTimeOffset=0, ComTxModeTimePeriod=0.5
      3 x ComSignal, all with ComBitSize=16, ComSignalEndianness=LITTLE_ENDIAN, ComSignalInitValue=0, ComSignalType=SINT16, ComTimeout=0, ComTransferProperty=PENDING, ComSignalAccess=ACCESS_UNCLEAR:
        AN33_oVcuAdcTxG8Msg0_oTC37X_VCU_CAN01_70bf98fa_Tx: ComBitPosition=16, ComHandleId=33, ComSystemTemplateSystemSignalRef=AN33
        AN25_oVcuAdcTxG3Msg0_oTC37X_VCU_CAN01_e417e2c6_Tx: ComBitPosition=16, ComHandleId=25, ComSystemTemplateSystemSignalRef=AN25
        AN3_oVcuAdcTxG0Msg0_oTC37X_VCU_CAN01_0b77f95a_Tx: ComBitPosition=48, ComHandleId=3, ComSystemTemplateSystemSignalRef=AN3
      VcuAdcTxG8Msg2_oTC37X_VCU_CAN01_eb0f92eb_Tx (ComIPdu):
        ComIPduDirection = SEND
        ComIPduType = NORMAL
        ComIPduHandleId = 27
        ComIPduSignalProcessing = DEFERRED
        ComIPduCancellationSupport = false
        ComIPduGroupRef = VCU_oTC37X_VCU_CAN01_Tx_4e6d6cda
        ComIPduSignalRef = AN40_oVcuAdcTxG8Msg2_oTC37X_VCU_CAN01_1ba46d98_Tx
        ComIPduSignalRef = AN41_oVcuAdcTxG8Msg2_oTC37X_VCU_CAN01_3f263cae_Tx
        ComIPduSignalRef = AN42_oVcuAdcTxG8Msg2_oTC37X_VCU_CAN01_52a0cff4_Tx
        ComIPduSignalRef = AN43_oVcuAdcTxG8Msg2_oTC37X_VCU_CAN01_76229ec2_Tx
        ComPduIdRef = VcuAdcTxG8Msg2_oTC37X_VCU_CAN01_eb0f92eb_Tx
        ComIPduMainFunctionRef = ComMainFunctionTx
        ComTxIPdu: ComMinimumDelayTime=0, ComTxIPduUnusedAreasDefault=0
          ComTxModeTrue
            ComTxMode: ComTxModeMode=PERIODIC, ComTxModeTimeOffset=0, ComTxModeTimePeriod=0.5
          ComTxModeFalse
            ComTxMode: ComTxModeMode=PERIODIC, ComTxModeTimeOffset=0, ComTxModeTimePeriod=0.5
      6 x ComSignal, all with ComBitSize=16, ComSignalEndianness=LITTLE_ENDIAN, ComSignalInitValue=0, ComSignalType=SINT16, ComTimeout=0, ComTransferProperty=PENDING, ComSignalAccess=ACCESS_UNCLEAR:
        AN6_oVcuAdcTxG0Msg1_oTC37X_VCU_CAN01_52ae5a55_Tx: ComBitPosition=32, ComHandleId=6, ComSystemTemplateSystemSignalRef=AN6
        AN19_oVcuAdcTxG2Msg0_oTC37X_VCU_CAN01_15867336_Tx: ComBitPosition=48, ComHandleId=19, ComSystemTemplateSystemSignalRef=AN19
        AN45_oVcuAdcTxG8Msg3_oTC37X_VCU_CAN01_427dce97_Tx: ComBitPosition=16, ComHandleId=45, ComSystemTemplateSystemSignalRef=AN45
        AN46_oVcuAdcTxG8Msg3_oTC37X_VCU_CAN01_2ffb3dcd_Tx: ComBitPosition=32, ComHandleId=46, ComSystemTemplateSystemSignalRef=AN46
        AN39_oVcuAdcTxG8Msg1_oTC37X_VCU_CAN01_298a0386_Tx: ComBitPosition=48, ComHandleId=39, ComSystemTemplateSystemSignalRef=AN39
        AN37_oVcuAdcTxG8Msg1_oTC37X_VCU_CAN01_0de46ac3_Tx: ComBitPosition=16, ComHandleId=37, ComSystemTemplateSystemSignalRef=AN37
      VcuAdcTxG8Msg3_oTC37X_VCU_CAN01_045d240a_Tx (ComIPdu):
        ComIPduDirection = SEND
        ComIPduType = NORMAL
        ComIPduHandleId = 28
        ComIPduSignalProcessing = DEFERRED
        ComIPduCancellationSupport = false
        ComIPduGroupRef = VCU_oTC37X_VCU_CAN01_Tx_4e6d6cda
        ComIPduSignalRef = AN44_oVcuAdcTxG8Msg3_oTC37X_VCU_CAN01_66ff9fa1_Tx
        ComIPduSignalRef = AN45_oVcuAdcTxG8Msg3_oTC37X_VCU_CAN01_427dce97_Tx
        ComIPduSignalRef = AN46_oVcuAdcTxG8Msg3_oTC37X_VCU_CAN01_2ffb3dcd_Tx
        ComIPduSignalRef = AN47_oVcuAdcTxG8Msg3_oTC37X_VCU_CAN01_0b796cfb_Tx
        ComPduIdRef = VcuAdcTxG8Msg3_oTC37X_VCU_CAN01_045d240a_Tx
        ComIPduMainFunctionRef = ComMainFunctionTx
        ComTxIPdu: ComMinimumDelayTime=0, ComTxIPduUnusedAreasDefault=0
          ComTxModeTrue
            ComTxMode: ComTxModeMode=PERIODIC, ComTxModeTimeOffset=0, ComTxModeTimePeriod=0.5
          ComTxModeFalse
            ComTxMode: ComTxModeMode=PERIODIC, ComTxModeTimeOffset=0, ComTxModeTimePeriod=0.5
      6 x ComSignal, all with ComBitSize=16, ComSignalEndianness=LITTLE_ENDIAN, ComSignalInitValue=0, ComSignalType=SINT16, ComTimeout=0, ComTransferProperty=PENDING, ComSignalAccess=ACCESS_UNCLEAR:
        AN17_oVcuAdcTxG2Msg0_oTC37X_VCU_CAN01_31e81a73_Tx: ComBitPosition=16, ComHandleId=17, ComSystemTemplateSystemSignalRef=AN17
        AN2_oVcuAdcTxG0Msg0_oTC37X_VCU_CAN01_2ff5a86c_Tx: ComBitPosition=32, ComHandleId=2, ComSystemTemplateSystemSignalRef=AN2
        AN14_oVcuAdcTxG1Msg1_oTC37X_VCU_CAN01_8a44f288_Tx: ComBitPosition=32, ComHandleId=14, ComSystemTemplateSystemSignalRef=AN14
        AN4_oVcuAdcTxG0Msg1_oTC37X_VCU_CAN01_1baaf839_Tx: ComBitPosition=0, ComHandleId=4, ComSystemTemplateSystemSignalRef=AN4
        AN9_oVcuAdcTxG1Msg0_oTC37X_VCU_CAN01_aa38b007_Tx: ComBitPosition=16, ComHandleId=9, ComSystemTemplateSystemSignalRef=AN9
        AN41_oVcuAdcTxG8Msg2_oTC37X_VCU_CAN01_3f263cae_Tx: ComBitPosition=16, ComHandleId=41, ComSystemTemplateSystemSignalRef=AN41
      VcuAdcTxG1Msg1_oTC37X_VCU_CAN01_afe20d49_Tx (ComIPdu):
        ComIPduDirection = SEND
        ComIPduType = NORMAL
        ComIPduHandleId = 20
        ComIPduSignalProcessing = DEFERRED
        ComIPduCancellationSupport = false
        ComIPduGroupRef = VCU_oTC37X_VCU_CAN01_Tx_4e6d6cda
        ComIPduSignalRef = AN12_oVcuAdcTxG1Msg1_oTC37X_VCU_CAN01_5149143c_Tx
        ComIPduSignalRef = AN13_oVcuAdcTxG1Msg1_oTC37X_VCU_CAN01_75cb450a_Tx
        ComIPduSignalRef = AN14_oVcuAdcTxG1Msg1_oTC37X_VCU_CAN01_8a44f288_Tx
        ComIPduSignalRef = AN15_oVcuAdcTxG1Msg1_oTC37X_VCU_CAN01_aec6a3be_Tx
        ComPduIdRef = VcuAdcTxG1Msg1_oTC37X_VCU_CAN01_afe20d49_Tx
        ComIPduMainFunctionRef = ComMainFunctionTx
        ComTxIPdu: ComMinimumDelayTime=0, ComTxIPduUnusedAreasDefault=0
          ComTxModeTrue
            ComTxMode: ComTxModeMode=PERIODIC, ComTxModeTimeOffset=0, ComTxModeTimePeriod=0.5
          ComTxModeFalse
            ComTxMode: ComTxModeMode=PERIODIC, ComTxModeTimeOffset=0, ComTxModeTimePeriod=0.5
      AN42_oVcuAdcTxG8Msg2_oTC37X_VCU_CAN01_52a0cff4_Tx (ComSignal):
        ComBitPosition = 32
        ComBitSize = 16
        ComSignalEndianness = LITTLE_ENDIAN
        ComSignalInitValue = 0
        ComSignalType = SINT16
        ComTimeout = 0
        ComTransferProperty = PENDING
        ComSignalAccess = ACCESS_UNCLEAR
        ComHandleId = 42
        ComSystemTemplateSystemSignalRef = AN42
      AN13_oVcuAdcTxG1Msg1_oTC37X_VCU_CAN01_75cb450a_Tx (ComSignal):
        ComBitPosition = 16
        ComBitSize = 16
        ComSignalEndianness = LITTLE_ENDIAN
        ComSignalInitValue = 0
        ComSignalType = SINT16
        ComTimeout = 0
        ComTransferProperty = PENDING
        ComSignalAccess = ACCESS_UNCLEAR
        ComHandleId = 13
        ComSystemTemplateSystemSignalRef = AN13
      VcuRxCtrlMsg0_oTC37X_VCU_CAN01_b24a2ab4_Rx (ComIPdu):
        ComIPduDirection = RECEIVE
        ComIPduType = NORMAL
        ComIPduHandleId = 32
        ComIPduSignalProcessing = DEFERRED
        ComIPduCancellationSupport = false
        ComIPduGroupRef = VCU_oTC37X_VCU_CAN01_Rx_1837cb5c
        ComIPduSignalRef = Tle888qk_Out21BriCfg_oVcuRxCtrlMsg0_oTC37X_VCU_CAN01_f4735e02_Rx
        ComIPduSignalRef = Tle888qk_Out21_En_oVcuRxCtrlMsg0_oTC37X_VCU_CAN01_fce8b2a9_Rx
        ComIPduSignalRef = Tle888qk_Out22BriCfg_oVcuRxCtrlMsg0_oTC37X_VCU_CAN01_27e842f9_Rx
        ComIPduSignalRef = Tle888qk_Out22_En_oVcuRxCtrlMsg0_oTC37X_VCU_CAN01_9808c957_Rx
        ComIPduSignalRef = Tle888qk_Out23BriCfg_oVcuRxCtrlMsg0_oTC37X_VCU_CAN01_69614950_Rx
        ComIPduSignalRef = Tle888qk_Out23_En_oVcuRxCtrlMsg0_oTC37X_VCU_CAN01_0d781dc2_Rx
        ComIPduSignalRef = Tle888qk_Out24BriCfg_oVcuRxCtrlMsg0_oTC37X_VCU_CAN01_5baf7d4e_Rx
        ComIPduSignalRef = Tle888qk_Out24_En_oVcuRxCtrlMsg0_oTC37X_VCU_CAN01_51c83eab_Rx
        ComPduIdRef = VcuRxCtrlMsg0_oTC37X_VCU_CAN01_b24a2ab4_Rx
        ComIPduMainFunctionRef = ComMainFunctionRx
      16 x ComSignal, all with ComBitSize=8, ComSignalEndianness=LITTLE_ENDIAN, ComSignalInitValue=0, ComSignalType=SINT8, ComTimeout=0, ComSignalAccess=ACCESS_UNCLEAR:
        Tle888qk_Out24_En_oVcuRxCtrlMsg0_oTC37X_VCU_CAN01_51c83eab_Rx: ComBitPosition=24, ComHandleId=255, ComSystemTemplateSystemSignalRef=Tle888qk_Out24_En
        Tle888qk_Out23_En_oVcuRxCtrlMsg0_oTC37X_VCU_CAN01_0d781dc2_Rx: ComBitPosition=16, ComHandleId=253, ComSystemTemplateSystemSignalRef=Tle888qk_Out23_En
        Tle888qk_Out22_En_oVcuRxCtrlMsg0_oTC37X_VCU_CAN01_9808c957_Rx: ComBitPosition=8, ComHandleId=251, ComSystemTemplateSystemSignalRef=Tle888qk_Out22_En
        Tle888qk_Out21_En_oVcuRxCtrlMsg0_oTC37X_VCU_CAN01_fce8b2a9_Rx: ComBitPosition=0, ComHandleId=249, ComNotification=Rte_COMCbk_Tle888qk_Out21_En_oVcuRxCtrlMsg0_oTC37X_VCU_CAN01_fce8b2a9_Rx, ComSystemTemplateSystemSignalRef=Tle888qk_Out21_En
        Bts7xx_HS3_En_oVcuRxCtrlMsg1_oTC37X_VCU_CAN01_21f98557_Rx: ComBitPosition=48, ComHandleId=5, ComSystemTemplateSystemSignalRef=Bts7xx_HS3_En
        Bts7xx_HS1_En_oVcuRxCtrlMsg1_oTC37X_VCU_CAN01_d0692a3c_Rx: ComBitPosition=32, ComHandleId=3, ComNotification=Rte_COMCbk_Bts7xx_HS1_En_oVcuRxCtrlMsg1_oTC37X_VCU_CAN01_d0692a3c_Rx, ComSystemTemplateSystemSignalRef=Bts7xx_HS1_En
        Tle888qk_Out22BriCfg_oVcuRxCtrlMsg0_oTC37X_VCU_CAN01_27e842f9_Rx: ComBitPosition=40, ComHandleId=250, ComSystemTemplateSystemSignalRef=Tle888qk_Out22BriCfg
        Bts7xx_HS4_En_oVcuRxCtrlMsg1_oTC37X_VCU_CAN01_7d49a63e_Rx: ComBitPosition=56, ComHandleId=6, ComSystemTemplateSystemSignalRef=Bts7xx_HS4_En
        Tle888qk_Out21BriCfg_oVcuRxCtrlMsg0_oTC37X_VCU_CAN01_f4735e02_Rx: ComBitPosition=32, ComHandleId=248, ComSystemTemplateSystemSignalRef=Tle888qk_Out21BriCfg
        Tle888qk_Out23BriCfg_oVcuRxCtrlMsg0_oTC37X_VCU_CAN01_69614950_Rx: ComBitPosition=48, ComHandleId=252, ComSystemTemplateSystemSignalRef=Tle888qk_Out23BriCfg
        Bts7xx_HS2_En_oVcuRxCtrlMsg1_oTC37X_VCU_CAN01_b48951c2_Rx: ComBitPosition=40, ComHandleId=4, ComSystemTemplateSystemSignalRef=Bts7xx_HS2_En
        Tle9201_Dir_oVcuRxCtrlMsg1_oTC37X_VCU_CAN01_4c38edaa_Rx: ComBitPosition=24, ComHandleId=257, ComSystemTemplateSystemSignalRef=Tle9201_Dir
        Tle4252d_en_oVcuRxCtrlMsg1_oTC37X_VCU_CAN01_24c739a8_Rx: ComBitPosition=0, ComHandleId=256, ComSystemTemplateSystemSignalRef=Tle4252d_en
        Tle9201_Pwm_oVcuRxCtrlMsg1_oTC37X_VCU_CAN01_bf73fa17_Rx: ComBitPosition=16, ComHandleId=259, ComSystemTemplateSystemSignalRef=Tle9201_Pwm
        Tle888qk_Out24BriCfg_oVcuRxCtrlMsg0_oTC37X_VCU_CAN01_5baf7d4e_Rx: ComBitPosition=56, ComHandleId=254, ComSystemTemplateSystemSignalRef=Tle888qk_Out24BriCfg
        Tle9201_Dis_oVcuRxCtrlMsg1_oTC37X_VCU_CAN01_7aca7d59_Rx: ComBitPosition=8, ComHandleId=258, ComSystemTemplateSystemSignalRef=Tle9201_Dis
      VcuRxCtrlMsg1_oTC37X_VCU_CAN01_5d189c55_Rx (ComIPdu):
        ComIPduDirection = RECEIVE
        ComIPduType = NORMAL
        ComIPduHandleId = 33
        ComIPduSignalProcessing = DEFERRED
        ComIPduCancellationSupport = false
        ComIPduGroupRef = VCU_oTC37X_VCU_CAN01_Rx_1837cb5c
        ComIPduSignalRef = Bts7xx_HS1_En_oVcuRxCtrlMsg1_oTC37X_VCU_CAN01_d0692a3c_Rx
        ComIPduSignalRef = Bts7xx_HS2_En_oVcuRxCtrlMsg1_oTC37X_VCU_CAN01_b48951c2_Rx
        ComIPduSignalRef = Bts7xx_HS3_En_oVcuRxCtrlMsg1_oTC37X_VCU_CAN01_21f98557_Rx
        ComIPduSignalRef = Bts7xx_HS4_En_oVcuRxCtrlMsg1_oTC37X_VCU_CAN01_7d49a63e_Rx
        ComIPduSignalRef = Tle4252d_en_oVcuRxCtrlMsg1_oTC37X_VCU_CAN01_24c739a8_Rx
        ComIPduSignalRef = Tle9201_Dir_oVcuRxCtrlMsg1_oTC37X_VCU_CAN01_4c38edaa_Rx
        ComIPduSignalRef = Tle9201_Dis_oVcuRxCtrlMsg1_oTC37X_VCU_CAN01_7aca7d59_Rx
        ComIPduSignalRef = Tle9201_Pwm_oVcuRxCtrlMsg1_oTC37X_VCU_CAN01_bf73fa17_Rx
        ComPduIdRef = VcuRxCtrlMsg1_oTC37X_VCU_CAN01_5d189c55_Rx
        ComIPduMainFunctionRef = ComMainFunctionRx
      Tle888qk_Lout14_En_oVcuRxCtrlMsg2_oTC37X_VCU_CAN01_a11e1e88_Rx (ComSignal):
        ComBitPosition = 16
        ComBitSize = 8
        ComSignalEndianness = LITTLE_ENDIAN
        ComSignalInitValue = 0
        ComSignalType = SINT8
        ComTimeout = 0
        ComSignalAccess = ACCESS_UNCLEAR
        ComHandleId = 246
        ComSystemTemplateSystemSignalRef = Tle888qk_Lout14_En
      EXT_PWM_IN2_Period_oVcuMeasurementMsg0_oTC37X_VCU_CAN01_fba12e71_Tx (ComSignal):
        ComBitPosition = 24
        ComBitSize = 16
        ComSignalEndianness = LITTLE_ENDIAN
        ComSignalInitValue = 0
        ComSignalType = SINT16
        ComTimeout = 0
        ComTransferProperty = PENDING
        ComSignalAccess = ACCESS_UNCLEAR
        ComHandleId = 89
        ComSystemTemplateSystemSignalRef = EXT_PWM_IN2_Period
      VcuMeasurementMsg0_oTC37X_VCU_CAN01_0deb23c3_Tx (ComIPdu):
        ComIPduDirection = SEND
        ComIPduType = NORMAL
        ComIPduHandleId = 33
        ComIPduSignalProcessing = DEFERRED
        ComIPduCancellationSupport = false
        ComIPduGroupRef = VCU_oTC37X_VCU_CAN01_Tx_4e6d6cda
        ComIPduSignalRef = EXT_PWM_IN1_Duty_oVcuMeasurementMsg0_oTC37X_VCU_CAN01_92760a96_Tx
        ComIPduSignalRef = EXT_PWM_IN1_Period_oVcuMeasurementMsg0_oTC37X_VCU_CAN01_c46a50e4_Tx
        ComIPduSignalRef = EXT_PWM_IN2_Duty_oVcuMeasurementMsg0_oTC37X_VCU_CAN01_5b42119b_Tx
        ComIPduSignalRef = EXT_PWM_IN2_Period_oVcuMeasurementMsg0_oTC37X_VCU_CAN01_fba12e71_Tx
        ComIPduSignalRef = Ext_IN2_oVcuMeasurementMsg0_oTC37X_VCU_CAN01_a925e19e_Tx
        ComPduIdRef = VcuMeasurementMsg0_oTC37X_VCU_CAN01_0deb23c3_Tx
        ComIPduMainFunctionRef = ComMainFunctionTx
        ComTxIPdu: ComMinimumDelayTime=0, ComTxIPduUnusedAreasDefault=0
          ComTxModeTrue
            ComTxMode: ComTxModeMode=PERIODIC, ComTxModeTimeOffset=0, ComTxModeTimePeriod=0.5
          ComTxModeFalse
            ComTxMode: ComTxModeMode=PERIODIC, ComTxModeTimeOffset=0, ComTxModeTimePeriod=0.5
      EXT_PWM_IN1_Duty_oVcuMeasurementMsg0_oTC37X_VCU_CAN01_92760a96_Tx (ComSignal):
        ComBitPosition = 16
        ComBitSize = 8
        ComSignalEndianness = LITTLE_ENDIAN
        ComSignalInitValue = 0
        ComSignalType = SINT8
        ComTimeout = 0
        ComTransferProperty = PENDING
        ComSignalAccess = ACCESS_UNCLEAR
        ComHandleId = 86
        ComSystemTemplateSystemSignalRef = EXT_PWM_IN1_Duty
      EXT_PWM_IN1_Period_oVcuMeasurementMsg0_oTC37X_VCU_CAN01_c46a50e4_Tx (ComSignal):
        ComBitPosition = 0
        ComBitSize = 16
        ComSignalEndianness = LITTLE_ENDIAN
        ComSignalInitValue = 0
        ComSignalType = SINT16
        ComTimeout = 0
        ComTransferProperty = PENDING
        ComSignalAccess = ACCESS_UNCLEAR
        ComHandleId = 87
        ComSystemTemplateSystemSignalRef = EXT_PWM_IN1_Period
      VcuRxCtrlMsg2_oTC37X_VCU_CAN01_b79e4137_Rx (ComIPdu):
        ComIPduDirection = RECEIVE
        ComIPduType = NORMAL
        ComIPduHandleId = 34
        ComIPduSignalProcessing = DEFERRED
        ComIPduCancellationSupport = false
        ComIPduGroupRef = VCU_oTC37X_VCU_CAN01_Rx_1837cb5c
        ComIPduSignalRef = Tle888qk_Lout14_En_oVcuRxCtrlMsg2_oTC37X_VCU_CAN01_a11e1e88_Rx
        ComIPduSignalRef = Tle888qk_Lout16_En_oVcuRxCtrlMsg2_oTC37X_VCU_CAN01_508eb1e3_Rx
        ComIPduSignalRef = Tle888qk_Lout1_En_oVcuRxCtrlMsg2_oTC37X_VCU_CAN01_0e3571fa_Rx
        ComIPduSignalRef = Tle888qk_Lout8_En_oVcuRxCtrlMsg2_oTC37X_VCU_CAN01_ebe51441_Rx
        ComPduIdRef = VcuRxCtrlMsg2_oTC37X_VCU_CAN01_b79e4137_Rx
        ComIPduMainFunctionRef = ComMainFunctionRx
      5 x ComSignal, all with ComBitSize=8, ComSignalEndianness=LITTLE_ENDIAN, ComSignalInitValue=0, ComSignalType=SINT8, ComTimeout=0, ComSignalAccess=ACCESS_UNCLEAR:
        Tle888qk_Lout8_En_oVcuRxCtrlMsg2_oTC37X_VCU_CAN01_ebe51441_Rx: ComBitPosition=8, ComHandleId=245, ComSystemTemplateSystemSignalRef=Tle888qk_Lout8_En
        EXT_PWM_IN2_Duty_oVcuMeasurementMsg0_oTC37X_VCU_CAN01_5b42119b_Tx: ComBitPosition=40, ComTransferProperty=PENDING, ComHandleId=88, ComSystemTemplateSystemSignalRef=EXT_PWM_IN2_Duty
        Tle888qk_Lout16_En_oVcuRxCtrlMsg2_oTC37X_VCU_CAN01_508eb1e3_Rx: ComBitPosition=24, ComHandleId=247, ComSystemTemplateSystemSignalRef=Tle888qk_Lout16_En
        Ext_IN2_oVcuMeasurementMsg0_oTC37X_VCU_CAN01_a925e19e_Tx: ComBitPosition=48, ComTransferProperty=PENDING, ComHandleId=90, ComSystemTemplateSystemSignalRef=Ext_IN2
        Tle888qk_Lout1_En_oVcuRxCtrlMsg2_oTC37X_VCU_CAN01_0e3571fa_Rx: ComBitPosition=0, ComHandleId=244, ComNotification=Rte_COMCbk_Tle888qk_Lout1_En_oVcuRxCtrlMsg2_oTC37X_VCU_CAN01_0e3571fa_Rx, ComSystemTemplateSystemSignalRef=Tle888qk_Lout1_En
      VCU_oLIN02_Rx_e19434d8 (ComIPduGroup): ComIPduGroupHandleId=6
      Vcu_Lin3_RxMsg1_oLIN02_ac0c37a7_Rx (ComIPdu):
        ComIPduDirection = RECEIVE
        ComIPduType = NORMAL
        ComIPduHandleId = 41
        ComIPduSignalProcessing = DEFERRED
        ComIPduCancellationSupport = false
        ComIPduGroupRef = VCU_oLIN02_Rx_e19434d8
        ComIPduSignalRef = Vcu_Lin3_RxMsg1_Sig0_oVcu_Lin3_RxMsg1_oLIN02_be2252cb_Rx
        ComIPduSignalRef = Vcu_Lin3_RxMsg1_Sig1_oVcu_Lin3_RxMsg1_oLIN02_1ba9c2c5_Rx
        ComIPduSignalRef = Vcu_Lin3_RxMsg2_Sig2_oVcu_Lin3_RxMsg1_oLIN02_6ae5518e_Rx
        ComIPduSignalRef = Vcu_Lin3_RxMsg2_Sig3_oVcu_Lin3_RxMsg1_oLIN02_cf6ec180_Rx
        ComPduIdRef = Vcu_Lin3_RxMsg1_oLIN02_ac0c37a7_Rx
        ComIPduMainFunctionRef = ComMainFunctionRx
      Vcu_Lin3_TxMsg1_Sig3_oVcu_Lin3_TxMsg1_oLIN02_e7fd4136_Tx (ComSignal):
        ComBitPosition = 24
        ComBitSize = 8
        ComSignalEndianness = LITTLE_ENDIAN
        ComSignalInitValue = 0
        ComSignalType = UINT8
        ComSignalAccess = ACCESS_UNCLEAR
        ComHandleId = 235
        ComTransferProperty = PENDING
        ComSystemTemplateSystemSignalRef = Vcu_Lin3_TxMsg1_Sig3
      Vcu_Lin3_RxMsg2_oLIN02_22833044_Rx (ComIPdu):
        ComIPduDirection = RECEIVE
        ComIPduType = NORMAL
        ComIPduHandleId = 42
        ComIPduSignalProcessing = DEFERRED
        ComIPduCancellationSupport = false
        ComIPduGroupRef = VCU_oLIN02_Rx_e19434d8
        ComIPduSignalRef = Vcu_Lin3_RxMsg2_Sig0_oVcu_Lin3_RxMsg2_oLIN02_740c7030_Rx
        ComIPduSignalRef = Vcu_Lin3_RxMsg2_Sig1_oVcu_Lin3_RxMsg2_oLIN02_d187e03e_Rx
        ComIPduSignalRef = Vcu_Lin3_RxMsg2_Sig2_oVcu_Lin3_RxMsg2_oLIN02_e46a566d_Rx
        ComIPduSignalRef = Vcu_Lin3_RxMsg2_Sig3_oVcu_Lin3_RxMsg2_oLIN02_41e1c663_Rx
        ComPduIdRef = Vcu_Lin3_RxMsg2_oLIN02_22833044_Rx
        ComIPduMainFunctionRef = ComMainFunctionRx
      Vcu_Lin3_TxMsg2_oLIN02_8266ef99_Tx (ComIPdu):
        ComIPduDirection = SEND
        ComIPduType = NORMAL
        ComIPduHandleId = 47
        ComIPduSignalProcessing = DEFERRED
        ComIPduCancellationSupport = false
        ComIPduGroupRef = VCU_oLIN02_Tx_b7ce935e
        ComIPduSignalRef = Vcu_Lin3_TxMsg2_Sig0_oVcu_Lin3_TxMsg2_oLIN02_183ed59e_Tx
        ComIPduSignalRef = Vcu_Lin3_TxMsg2_Sig1_oVcu_Lin3_TxMsg2_oLIN02_bdb54590_Tx
        ComIPduSignalRef = Vcu_Lin3_TxMsg2_Sig2_oVcu_Lin3_TxMsg2_oLIN02_8858f3c3_Tx
        ComIPduSignalRef = Vcu_Lin3_TxMsg2_Sig3_oVcu_Lin3_TxMsg2_oLIN02_2dd363cd_Tx
        ComPduIdRef = Vcu_Lin3_TxMsg2_oLIN02_8266ef99_Tx
        ComIPduMainFunctionRef = ComMainFunctionTx
        ComTxIPdu: ComTxIPduUnusedAreasDefault=255, ComMinimumDelayTime=0
          ComTxModeTrue
            ComTxMode: ComTxModeMode=NONE
          ComTxModeFalse
            ComTxMode: ComTxModeMode=NONE
      4 x ComSignal, all with ComBitSize=8, ComSignalEndianness=LITTLE_ENDIAN, ComSignalInitValue=0, ComSignalType=UINT8, ComSignalAccess=ACCESS_UNCLEAR:
        Vcu_Lin3_TxMsg1_Sig2_oVcu_Lin3_TxMsg1_oLIN02_4276d138_Tx: ComBitPosition=16, ComHandleId=234, ComTransferProperty=PENDING, ComSystemTemplateSystemSignalRef=Vcu_Lin3_TxMsg1_Sig2
        Vcu_Lin3_RxMsg2_Sig2_oVcu_Lin3_RxMsg2_oLIN02_e46a566d_Rx: ComBitPosition=16, ComHandleId=305, ComSystemTemplateSystemSignalRef=Vcu_Lin3_RxMsg2_Sig2
        Vcu_Lin3_RxMsg2_Sig0_oVcu_Lin3_RxMsg2_oLIN02_740c7030_Rx: ComBitPosition=0, ComHandleId=302, ComSystemTemplateSystemSignalRef=Vcu_Lin3_RxMsg2_Sig0
        Vcu_Lin3_RxMsg1_Sig1_oVcu_Lin3_RxMsg1_oLIN02_1ba9c2c5_Rx: ComBitPosition=0, ComHandleId=301, ComSystemTemplateSystemSignalRef=Vcu_Lin3_RxMsg1_Sig1
      Vcu_Lin3_TxMsg1_oLIN02_0ce9e87a_Tx (ComIPdu):
        ComIPduDirection = SEND
        ComIPduType = NORMAL
        ComIPduHandleId = 46
        ComIPduSignalProcessing = DEFERRED
        ComIPduCancellationSupport = false
        ComIPduGroupRef = VCU_oLIN02_Tx_b7ce935e
        ComIPduSignalRef = Vcu_Lin3_TxMsg1_Sig0_oVcu_Lin3_TxMsg1_oLIN02_d210f765_Tx
        ComIPduSignalRef = Vcu_Lin3_TxMsg1_Sig1_oVcu_Lin3_TxMsg1_oLIN02_779b676b_Tx
        ComIPduSignalRef = Vcu_Lin3_TxMsg1_Sig2_oVcu_Lin3_TxMsg1_oLIN02_4276d138_Tx
        ComIPduSignalRef = Vcu_Lin3_TxMsg1_Sig3_oVcu_Lin3_TxMsg1_oLIN02_e7fd4136_Tx
        ComPduIdRef = Vcu_Lin3_TxMsg1_oLIN02_0ce9e87a_Tx
        ComIPduMainFunctionRef = ComMainFunctionTx
        ComTxIPdu: ComTxIPduUnusedAreasDefault=255, ComMinimumDelayTime=0
          ComTxModeTrue
            ComTxMode: ComTxModeMode=NONE
          ComTxModeFalse
            ComTxMode: ComTxModeMode=NONE
      VCU_oLIN02_Tx_b7ce935e (ComIPduGroup): ComIPduGroupHandleId=7
      11 x ComSignal, all with ComBitSize=8, ComSignalEndianness=LITTLE_ENDIAN, ComSignalInitValue=0, ComSignalType=UINT8, ComSignalAccess=ACCESS_UNCLEAR:
        Vcu_Lin3_TxMsg2_Sig3_oVcu_Lin3_TxMsg2_oLIN02_2dd363cd_Tx: ComBitPosition=24, ComHandleId=239, ComTransferProperty=PENDING, ComSystemTemplateSystemSignalRef=Vcu_Lin3_TxMsg2_Sig3
        Vcu_Lin3_TxMsg2_Sig2_oVcu_Lin3_TxMsg2_oLIN02_8858f3c3_Tx: ComBitPosition=16, ComHandleId=238, ComTransferProperty=PENDING, ComSystemTemplateSystemSignalRef=Vcu_Lin3_TxMsg2_Sig2
        Vcu_Lin3_RxMsg2_Sig2_oVcu_Lin3_RxMsg1_oLIN02_6ae5518e_Rx: ComBitPosition=16, ComHandleId=304, ComSystemTemplateSystemSignalRef=Vcu_Lin3_RxMsg2_Sig2
        Vcu_Lin3_RxMsg2_Sig3_oVcu_Lin3_RxMsg2_oLIN02_41e1c663_Rx: ComBitPosition=32, ComHandleId=307, ComSystemTemplateSystemSignalRef=Vcu_Lin3_RxMsg2_Sig3
        Vcu_Lin3_TxMsg2_Sig0_oVcu_Lin3_TxMsg2_oLIN02_183ed59e_Tx: ComBitPosition=0, ComHandleId=236, ComTransferProperty=PENDING, ComSystemTemplateSystemSignalRef=Vcu_Lin3_TxMsg2_Sig0
        Vcu_Lin3_RxMsg1_Sig0_oVcu_Lin3_RxMsg1_oLIN02_be2252cb_Rx: ComBitPosition=8, ComHandleId=300, ComSystemTemplateSystemSignalRef=Vcu_Lin3_RxMsg1_Sig0
        Vcu_Lin3_TxMsg1_Sig1_oVcu_Lin3_TxMsg1_oLIN02_779b676b_Tx: ComBitPosition=8, ComHandleId=233, ComTransferProperty=PENDING, ComSystemTemplateSystemSignalRef=Vcu_Lin3_TxMsg1_Sig1
        Vcu_Lin3_RxMsg2_Sig1_oVcu_Lin3_RxMsg2_oLIN02_d187e03e_Rx: ComBitPosition=8, ComHandleId=303, ComSystemTemplateSystemSignalRef=Vcu_Lin3_RxMsg2_Sig1
        Vcu_Lin3_TxMsg2_Sig1_oVcu_Lin3_TxMsg2_oLIN02_bdb54590_Tx: ComBitPosition=8, ComHandleId=237, ComTransferProperty=PENDING, ComSystemTemplateSystemSignalRef=Vcu_Lin3_TxMsg2_Sig1
        Vcu_Lin3_RxMsg2_Sig3_oVcu_Lin3_RxMsg1_oLIN02_cf6ec180_Rx: ComBitPosition=24, ComHandleId=306, ComSystemTemplateSystemSignalRef=Vcu_Lin3_RxMsg2_Sig3
        Vcu_Lin3_TxMsg1_Sig0_oVcu_Lin3_TxMsg1_oLIN02_d210f765_Tx: ComBitPosition=0, ComHandleId=232, ComTransferProperty=PENDING, ComSystemTemplateSystemSignalRef=Vcu_Lin3_TxMsg1_Sig0
    ComGeneral:
      ComConfigurationUseDet = true
      ComSafeBswChecks = false
      ComEnableSignalGroupArrayApi = false
      ComRetryFailedTransmitRequests = true
      ComSupportedIPduGroups = 16
      ComVersionInfoApi = false
      ComAdvancedIPduCallouts = true
      ComOptimizedIPduGroupHandling = false
      ComMetaDataSupport = false
      ComDeferredEventCacheSupport = false
      ComDescriptionGateway = false
      ComDescriptionRoutingCodeGeneration = false
      ComStrictRepetitionPeriod = false
      ComMixedModePeriodicSuppression = false
      ComSignalGateway = NONE
      ComUserCbkHeaderFile = Rte_Cbk.h
      ComUserCbkHeaderFile = Appl_Cbk.h
