AUTOSAR XML (schema 00048)
package /ActiveEcuC
  module config CanIf: implementation-config-variant=VARIANT-PRE-COMPILE, module-description=CanIf_Impl
    CanIfCtrlDrvCfg_7d254554 (CanIfCtrlDrvCfg): CanIfCtrlDrvTxCancellation=false, CanIfCtrlDrvInitHohConfigRef=CanIfInitHohCfg, CanIfCtrlDrvNameRef=CanGeneral
      CT_TC37X_VCU_CAN00_22cb8fec (CanIfCtrlCfg): CanIfCtrlId=0, CanIfCtrlWakeupSupport=false, CanIfCtrlJ1939DynAddrSupport=DISABLED, CanIfCtrlCanCtrlRef=CT_TC37X_VCU_CAN00_22cb8fec
    CanIfDispatchCfg:
      CanIfDispatchUserCtrlBusOffName = CanSM_ControllerBusOff
      CanIfDispatchUserCtrlBusOffUL = CAN_SM
      CanIfDispatchUserCtrlModeIndicationName = CanSM_ControllerModeIndication
      CanIfDispatchUserCtrlModeIndicationUL = CAN_SM
    CanIfInitCfg
      CanIfInitHohCfg: CanIfInitRefCfgSet=CanConfigSet
        CN_TC37X_VCU_CAN00_c052b9c5_Rx (CanIfHrhCfg): CanIfHrhSoftwareFilter=true, CanIfHrhCanCtrlIdRef=CT_TC37X_VCU_CAN00_22cb8fec, CanIfHrhIdSymRef=CN_TC37X_VCU_CAN00_c052b9c5_Rx
        CN_TC37X_VCU_CAN00_07b6c9c8_Tx (CanIfHthCfg): CanIfHthCanCtrlIdRef=CT_TC37X_VCU_CAN00_22cb8fec, CanIfHthIdSymRef=CN_TC37X_VCU_CAN00_07b6c9c8_Tx
      VcuTxMsg1_oTC37X_VCU_CAN00_78140f53_Tx (CanIfTxPduCfg):
        CanIfTxPduCanId = 256
        CanIfTxPduCanIdType = STANDARD_FD_CAN
        CanIfTxPduDlc = 8
        CanIfTxPduUserTxConfirmationName = NULL_PTR
        CanIfTxPduUserTxConfirmationUL = NONE
        CanIfTxPduId = 2
        CanIfTxPduReadNotifyStatus = false
        CanIfTxPduType = STATIC
        CanIfTxPduTruncation = true
        CanIfTxPduBufferRef = CHNL_d841867f
        CanIfTxPduRef = VcuTxMsg1_oTC37X_VCU_CAN00_c82dd125_Tx
      3 x CanIfRxPduCfg, all with CanIfRxPduCanIdType=STANDARD_CAN, CanIfRxPduDlc=8, CanIfRxPduReadData=false, CanIfRxPduReadNotifyStatus=false, CanIfRxPduDlcCheck=true, CanIfRxPduHrhIdRef=CN_TC37X_VCU_CAN00_c052b9c5_Rx:
        VcuRxMsg1_oTC37X_VCU_CAN00_c149044d_Rx: CanIfRxPduCanId=512, CanIfRxPduUserRxIndicationName=PduR_CanIfRxIndication, CanIfRxPduUserRxIndicationUL=PDUR, CanIfRxPduId=2, CanIfRxPduRef=VcuRxMsg1_oTC37X_VCU_CAN00_4589bbed_Rx
        VCU_Rx_500h_NM_oTC37X_VCU_CAN00_2f971b6a_Rx: CanIfRxPduCanId=1280, CanIfRxPduUserRxIndicationName=CanNm_RxIndication, CanIfRxPduUserRxIndicationUL=CAN_NM, CanIfRxPduId=0, CanIfRxPduRef=VCU_Rx_500h_NM_oTC37X_VCU_CAN00_c4b96e15_Rx
        VcuRxMsg2_oTC37X_VCU_CAN00_de1782b6_Rx: CanIfRxPduCanId=513, CanIfRxPduUserRxIndicationName=PduR_CanIfRxIndication, CanIfRxPduUserRxIndicationUL=PDUR, CanIfRxPduId=1, CanIfRxPduRef=VcuRxMsg2_oTC37X_VCU_CAN00_8cbda0e0_Rx
      CHNL_d841867f (CanIfBufferCfg):
        CanIfBufferSize = 0
        CanIfTxBufferHandlingType = NONE
        CanIfTxBufferMappedTxPdus = 3
        CanIfTxBufferMaxPduLength = 8
        CanIfBufferHthRef = CN_TC37X_VCU_CAN00_07b6c9c8_Tx
      VCU_Tx_51Ch_NM_oTC37X_VCU_CAN00_560cc988_Tx (CanIfTxPduCfg):
        CanIfTxPduCanId = 1308
        CanIfTxPduCanIdType = STANDARD_FD_CAN
        CanIfTxPduDlc = 8
        CanIfTxPduUserTxConfirmationName = CanNm_TxConfirmation
        CanIfTxPduUserTxConfirmationUL = CAN_NM
        CanIfTxPduId = 0
        CanIfTxPduReadNotifyStatus = false
        CanIfTxPduType = STATIC
        CanIfTxPduTruncation = true
        CanIfTxPduBufferRef = CHNL_d841867f
        CanIfTxPduRef = VCU_Tx_51Ch_NM_oTC37X_VCU_CAN00_0aa0ce62_Tx
      VcuTxMsg2_oTC37X_VCU_CAN00_674a89a8_Tx (CanIfTxPduCfg):
        CanIfTxPduCanId = 257
        CanIfTxPduCanIdType = STANDARD_FD_CAN
        CanIfTxPduDlc = 8
        CanIfTxPduUserTxConfirmationName = NULL_PTR
        CanIfTxPduUserTxConfirmationUL = NONE
        CanIfTxPduId = 1
        CanIfTxPduReadNotifyStatus = false
        CanIfTxPduType = STATIC
        CanIfTxPduTruncation = true
        CanIfTxPduBufferRef = CHNL_d841867f
        CanIfTxPduRef = VcuTxMsg2_oTC37X_VCU_CAN00_0119ca28_Tx
    CanIfPrivateCfg:
      CanIfPrivateSoftwareFilterType = LINEAR
      CanIfPrivateDlcCheck = true
      CanIfSupportTTCAN = false
      CanIfTransceiverMapping = false
      CanIfTransceiverHandling = false
      CanIfSupportExtendedIds = false
      CanIfSupportNmOsek = false
      CanIfTxBufferType = NONE
      CanIfWakeupSupport = false
      CanIfStaticFdTxBufferSupport = false
      CanIfRxSearchConsiderMsgType = false
      CanIfTxBufferFifoSupport = false
      CanIfSetPduReceptionModeSupport = false
      CanIfCheckWakeupCanRetType = false
      CanIfDataChecksumRxSupport = false
      CanIfDataChecksumTxSupport = false
    CanIfPublicCfg:
      CanIfPublicPnSupport = false
      CanIfPublicCancelTransmitSupport = false
      CanIfPublicDevErrorDetect = true
      CanIfPublicHandleTypeEnum = UINT8
      CanIfPublicMultipleDrvSupport = false
      CanIfPublicNumberOfCanHwUnits = 1
      CanIfPublicReadRxPduDataApi = false
      CanIfPublicReadRxPduNotifyStatusApi = false
      CanIfPublicReadTxPduNotifyStatusApi = false
      CanIfPublicSetDynamicTxIdApi = false
      CanIfPublicTxBuffering = false
      CanIfPublicTxConfirmPollingSupport = false
      CanIfPublicVersionInfoApi = false
      CanIfPublicWakeupCheckValidSupport = false
      CanIfPnWakeupTxPduFilterSupport = false
      CanIfPnTrcvHandlingSupport = false
      CanIfJ1939DynAddrSupport = DISABLED
      CanIfSafeBswChecks = false
      CanIfBusMirroringSupport = false
      CanIfEnableSecurityEventReporting = false
      CanIfSupportCanDrvAsr440 = false
      CanIfSetBaudrateApi = false
