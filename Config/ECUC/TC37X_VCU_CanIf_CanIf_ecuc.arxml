AUTOSAR XML (schema 00048)
package /ActiveEcuC
  module config CanIf: implementation-config-variant=VARIANT-PRE-COMPILE, module-description=CanIf_Impl
    CanIfCtrlDrvCfg_7d254554 (CanIfCtrlDrvCfg): CanIfCtrlDrvTxCancellation=false, CanIfCtrlDrvInitHohConfigRef=CanIfInitHohCfg, CanIfCtrlDrvNameRef=CanGeneral
      CT_TC37X_VCU_CAN00_22cb8fec (CanIfCtrlCfg): CanIfCtrlId=0, CanIfCtrlWakeupSupport=false, CanIfCtrlJ1939DynAddrSupport=DISABLED, CanIfCtrlCanCtrlRef=CT_TC37X_VCU_CAN00_22cb8fec
      CT_TC37X_VCU_CAN01_55ccbf7a (CanIfCtrlCfg): CanIfCtrlId=1, CanIfCtrlWakeupSupport=false, CanIfCtrlJ1939DynAddrSupport=DISABLED, CanIfCtrlCanCtrlRef=CT_TC37X_VCU_CAN01_55ccbf7a
    CanIfDispatchCfg:
      CanIfDispatchUserCtrlBusOffName = CanSM_ControllerBusOff
      CanIfDispatchUserCtrlBusOffUL = CAN_SM
      CanIfDispatchUserCtrlModeIndicationName = CanSM_ControllerModeIndication
      CanIfDispatchUserCtrlModeIndicationUL = CAN_SM
    CanIfInitCfg
      CanIfInitHohCfg: CanIfInitRefCfgSet=CanConfigSet
        CN_TC37X_VCU_CAN00_c052b9c5_Rx (CanIfHrhCfg): CanIfHrhSoftwareFilter=true, CanIfHrhCanCtrlIdRef=CT_TC37X_VCU_CAN00_22cb8fec, CanIfHrhIdSymRef=CN_TC37X_VCU_CAN00_c052b9c5_Rx
        CN_TC37X_VCU_CAN00_07b6c9c8_Tx (CanIfHthCfg): CanIfHthCanCtrlIdRef=CT_TC37X_VCU_CAN00_22cb8fec, CanIfHthIdSymRef=CN_TC37X_VCU_CAN00_07b6c9c8_Tx
        CanIfHrhCfg_VcuRxMsg1_oTC37X_VCU_CAN00_c149044d_Rx (CanIfHrhCfg):
          CanIfHrhSoftwareFilter = false
          CanIfHrhCanCtrlIdRef = CT_TC37X_VCU_CAN00_22cb8fec
          CanIfHrhIdSymRef = CanHardwareObject_VcuRxMsg1_oTC37X_VCU_CAN00_c149044d_Rx
        CanIfHrhCfg_VcuRxMsg2_oTC37X_VCU_CAN00_de1782b6_Rx (CanIfHrhCfg):
          CanIfHrhSoftwareFilter = false
          CanIfHrhCanCtrlIdRef = CT_TC37X_VCU_CAN00_22cb8fec
          CanIfHrhIdSymRef = CanHardwareObject_VcuRxMsg2_oTC37X_VCU_CAN00_de1782b6_Rx
        CanIfHthCfg_51Ch_NM (CanIfHthCfg): CanIfHthCanCtrlIdRef=CT_TC37X_VCU_CAN00_22cb8fec, CanIfHthIdSymRef=CanHardwareObject_TX0
        CN_TC37X_VCU_CAN01_2f90d2fb_Rx (CanIfHrhCfg): CanIfHrhSoftwareFilter=true, CanIfHrhCanCtrlIdRef=CT_TC37X_VCU_CAN01_55ccbf7a, CanIfHrhIdSymRef=CN_TC37X_VCU_CAN01_2f90d2fb_Rx
        CN_TC37X_VCU_CAN01_70b1f95e_Tx (CanIfHthCfg): CanIfHthCanCtrlIdRef=CT_TC37X_VCU_CAN01_55ccbf7a, CanIfHthIdSymRef=CN_TC37X_VCU_CAN01_70b1f95e_Tx
      VcuTxMsg1_oTC37X_VCU_CAN00_78140f53_Tx (CanIfTxPduCfg):
        CanIfTxPduCanId = 256
        CanIfTxPduCanIdType = STANDARD_CAN
        CanIfTxPduDlc = 8
        CanIfTxPduUserTxConfirmationName = NULL_PTR
        CanIfTxPduUserTxConfirmationUL = NONE
        CanIfTxPduId = 5
        CanIfTxPduReadNotifyStatus = false
        CanIfTxPduType = STATIC
        CanIfTxPduTruncation = true
        CanIfTxPduBufferRef = CHNL_d841867f
        CanIfTxPduRef = VcuTxMsg1_oTC37X_VCU_CAN00_c82dd125_Tx
      VcuRxMsg1_oTC37X_VCU_CAN00_c149044d_Rx (CanIfRxPduCfg):
        CanIfRxPduCanId = 512
        CanIfRxPduCanIdType = STANDARD_CAN
        CanIfRxPduDlc = 8
        CanIfRxPduUserRxIndicationName = PduR_CanIfRxIndication
        CanIfRxPduUserRxIndicationUL = PDUR
        CanIfRxPduId = 5
        CanIfRxPduReadData = false
        CanIfRxPduReadNotifyStatus = false
        CanIfRxPduDlcCheck = true
        CanIfRxPduHrhIdRef = CanIfHrhCfg_VcuRxMsg1_oTC37X_VCU_CAN00_c149044d_Rx
        CanIfRxPduRef = VcuRxMsg1_oTC37X_VCU_CAN00_4589bbed_Rx
      VcuRxMsg2_oTC37X_VCU_CAN00_de1782b6_Rx (CanIfRxPduCfg):
        CanIfRxPduCanId = 513
        CanIfRxPduCanIdType = STANDARD_CAN
        CanIfRxPduDlc = 8
        CanIfRxPduUserRxIndicationName = PduR_CanIfRxIndication
        CanIfRxPduUserRxIndicationUL = PDUR
        CanIfRxPduId = 4
        CanIfRxPduReadData = false
        CanIfRxPduReadNotifyStatus = false
        CanIfRxPduDlcCheck = true
        CanIfRxPduHrhIdRef = CanIfHrhCfg_VcuRxMsg2_oTC37X_VCU_CAN00_de1782b6_Rx
        CanIfRxPduRef = VcuRxMsg2_oTC37X_VCU_CAN00_8cbda0e0_Rx
      CHNL_d841867f (CanIfBufferCfg):
        CanIfBufferSize = 0
        CanIfTxBufferHandlingType = NONE
        CanIfTxBufferMappedTxPdus = 6
        CanIfTxBufferMaxPduLength = 8
        CanIfBufferHthRef = CN_TC37X_VCU_CAN00_07b6c9c8_Tx
      VCU_Tx_51Ch_NM_oTC37X_VCU_CAN00_560cc988_Tx (CanIfTxPduCfg):
        CanIfTxPduCanId = 1308
        CanIfTxPduCanIdType = STANDARD_CAN
        CanIfTxPduDlc = 8
        CanIfTxPduUserTxConfirmationName = CanNm_TxConfirmation
        CanIfTxPduUserTxConfirmationUL = CAN_NM
        CanIfTxPduId = 6
        CanIfTxPduReadNotifyStatus = false
        CanIfTxPduType = STATIC
        CanIfTxPduTruncation = true
        CanIfTxPduBufferRef = CanIfBufferCfg_51Ch_NM
        CanIfTxPduRef = VCU_Tx_51Ch_NM_oTC37X_VCU_CAN00_0aa0ce62_Tx
      VcuTxMsg2_oTC37X_VCU_CAN00_674a89a8_Tx (CanIfTxPduCfg):
        CanIfTxPduCanId = 257
        CanIfTxPduCanIdType = STANDARD_CAN
        CanIfTxPduDlc = 8
        CanIfTxPduUserTxConfirmationName = NULL_PTR
        CanIfTxPduUserTxConfirmationUL = NONE
        CanIfTxPduId = 4
        CanIfTxPduReadNotifyStatus = false
        CanIfTxPduType = STATIC
        CanIfTxPduTruncation = true
        CanIfTxPduBufferRef = CHNL_d841867f
        CanIfTxPduRef = VcuTxMsg2_oTC37X_VCU_CAN00_0119ca28_Tx
      CanIfBufferCfg_51Ch_NM (CanIfBufferCfg): CanIfBufferSize=0, CanIfTxBufferHandlingType=NONE, CanIfTxBufferMappedTxPdus=1, CanIfTxBufferMaxPduLength=8, CanIfBufferHthRef=CanIfHthCfg_51Ch_NM
      VCU_Rx_500h_NM_oTC37X_VCU_CAN00_2f971b6a_Rx (CanIfRxPduCfg):
        CanIfRxPduCanId = 1280
        CanIfRxPduCanIdType = STANDARD_CAN
        CanIfRxPduDlc = 8
        CanIfRxPduUserRxIndicationName = CanNm_RxIndication
        CanIfRxPduUserRxIndicationUL = CAN_NM
        CanIfRxPduId = 3
        CanIfRxPduReadData = false
        CanIfRxPduReadNotifyStatus = false
        CanIfRxPduDlcCheck = true
        CanIfRxPduHrhIdRef = CN_TC37X_VCU_CAN00_c052b9c5_Rx
        CanIfRxPduRef = VCU_Rx_500h_NM_oTC37X_VCU_CAN00_c4b96e15_Rx
      XCP_Response_oTC37X_VCU_CAN00_933a9e7a_Tx (CanIfTxPduCfg):
        CanIfTxPduCanId = 1543
        CanIfTxPduCanIdType = STANDARD_CAN
        CanIfTxPduDlc = 8
        CanIfTxPduUserTxConfirmationName = Xcp_CanIfTxConfirmation
        CanIfTxPduUserTxConfirmationUL = XCP
        CanIfTxPduId = 1
        CanIfTxPduReadNotifyStatus = false
        CanIfTxPduType = STATIC
        CanIfTxPduTruncation = true
        CanIfTxPduBufferRef = CHNL_d841867f
        CanIfTxPduRef = XCP_Response_oTC37X_VCU_CAN00_34d2da2d_Tx
      XCP_Request_oTC37X_VCU_CAN00_e22de59e_Rx (CanIfRxPduCfg):
        CanIfRxPduCanId = 1542
        CanIfRxPduCanIdType = STANDARD_CAN
        CanIfRxPduDlc = 8
        CanIfRxPduUserRxIndicationName = Xcp_CanIfRxIndication
        CanIfRxPduUserRxIndicationUL = XCP
        CanIfRxPduId = 2
        CanIfRxPduReadData = false
        CanIfRxPduReadNotifyStatus = false
        CanIfRxPduDlcCheck = true
        CanIfRxPduHrhIdRef = CN_TC37X_VCU_CAN00_c052b9c5_Rx
        CanIfRxPduRef = XCP_Request_oTC37X_VCU_CAN00_3c25b45e_Rx
      Vcu_Uds_Func_Request_Tp_oTC37X_VCU_CAN00_b229a038_Rx (CanIfRxPduCfg):
        CanIfRxPduCanId = 1792
        CanIfRxPduCanIdType = STANDARD_CAN
        CanIfRxPduDlc = 8
        CanIfRxPduUserRxIndicationName = CanTp_RxIndication
        CanIfRxPduUserRxIndicationType = PDUID_PDUINFOPTR
        CanIfRxPduUserRxIndicationUL = CAN_TP
        CanIfRxPduId = 1
        CanIfRxPduReadData = false
        CanIfRxPduReadNotifyStatus = false
        CanIfRxPduDlcCheck = true
        CanIfRxPduHrhIdRef = CN_TC37X_VCU_CAN00_c052b9c5_Rx
        CanIfRxPduRef = Vcu_Uds_Func_Request_Tp_oTC37X_VCU_CAN00_3dbedef7_Rx
      Vcu_Uds_Response_Tp_oTC37X_VCU_CAN00_2ff8982b_Tx (CanIfTxPduCfg):
        CanIfTxPduCanId = 1921
        CanIfTxPduCanIdType = STANDARD_CAN
        CanIfTxPduDlc = 8
        CanIfTxPduUserTxConfirmationName = CanTp_TxConfirmation
        CanIfTxPduUserTxConfirmationUL = CAN_TP
        CanIfTxPduId = 0
        CanIfTxPduReadNotifyStatus = false
        CanIfTxPduType = STATIC
        CanIfTxPduTruncation = true
        CanIfTxPduBufferRef = CHNL_d841867f
        CanIfTxPduRef = Vcu_Uds_Response_Tp_oTC37X_VCU_CAN00_834178f3_Tx
      Vcu_Uds_Phy_Request_Tp_oTC37X_VCU_CAN00_fc9370a6_Rx (CanIfRxPduCfg):
        CanIfRxPduCanId = 1793
        CanIfRxPduCanIdType = STANDARD_CAN
        CanIfRxPduDlc = 8
        CanIfRxPduUserRxIndicationName = CanTp_RxIndication
        CanIfRxPduUserRxIndicationType = PDUID_PDUINFOPTR
        CanIfRxPduUserRxIndicationUL = CAN_TP
        CanIfRxPduId = 0
        CanIfRxPduReadData = false
        CanIfRxPduReadNotifyStatus = false
        CanIfRxPduDlcCheck = true
        CanIfRxPduHrhIdRef = CN_TC37X_VCU_CAN00_c052b9c5_Rx
        CanIfRxPduRef = Vcu_Uds_Phy_Request_Tp_oTC37X_VCU_CAN00_58c52463_Rx
      CHNL_131d55da (CanIfBufferCfg):
        CanIfBufferSize = 0
        CanIfTxBufferHandlingType = NONE
        CanIfTxBufferMappedTxPdus = 3
        CanIfTxBufferMaxPduLength = 8
        CanIfBufferHthRef = CN_TC37X_VCU_CAN01_70b1f95e_Tx
      VCU_Tx_51Ch_NM_oTC37X_VCU_CAN01_587183bc_Tx (CanIfTxPduCfg):
        CanIfTxPduCanId = 1308
        CanIfTxPduCanIdType = STANDARD_CAN
        CanIfTxPduDlc = 8
        CanIfTxPduUserTxConfirmationName = CanNm_TxConfirmation
        CanIfTxPduUserTxConfirmationUL = CAN_NM
        CanIfTxPduId = 7
        CanIfTxPduReadNotifyStatus = false
        CanIfTxPduType = STATIC
        CanIfTxPduTruncation = true
        CanIfTxPduBufferRef = CHNL_131d55da
        CanIfTxPduRef = VCU_Tx_51Ch_NM_oTC37X_VCU_CAN01_9aba5863_Tx
      VCU_Rx_500h_NM_oTC37X_VCU_CAN01_21ea515e_Rx (CanIfRxPduCfg):
        CanIfRxPduCanId = 1280
        CanIfRxPduCanIdType = STANDARD_CAN
        CanIfRxPduDlc = 8
        CanIfRxPduUserRxIndicationName = CanNm_RxIndication
        CanIfRxPduUserRxIndicationUL = CAN_NM
        CanIfRxPduId = 6
        CanIfRxPduReadData = false
        CanIfRxPduReadNotifyStatus = false
        CanIfRxPduDlcCheck = true
        CanIfRxPduHrhIdRef = CN_TC37X_VCU_CAN01_2f90d2fb_Rx
        CanIfRxPduRef = VCU_Rx_500h_NM_oTC37X_VCU_CAN01_54a3f814_Rx
      VcuRxMsg4_oTC37X_VCU_CAN01_1d60377a_Rx (CanIfRxPduCfg):
        CanIfRxPduCanId = 515
        CanIfRxPduCanIdType = STANDARD_CAN
        CanIfRxPduDlc = 8
        CanIfRxPduUserRxIndicationName = PduR_CanIfRxIndication
        CanIfRxPduUserRxIndicationUL = PDUR
        CanIfRxPduId = 7
        CanIfRxPduReadData = false
        CanIfRxPduReadNotifyStatus = false
        CanIfRxPduDlcCheck = true
        CanIfRxPduHrhIdRef = CN_TC37X_VCU_CAN01_2f90d2fb_Rx
        CanIfRxPduRef = VcuRxMsg4_oTC37X_VCU_CAN01_55be06ba_Rx
      VcuAdcTxMsg2_oTC37X_VCU_CAN01_fa8a8e09_Tx (CanIfTxPduCfg):
        CanIfTxPduCanId = 259
        CanIfTxPduCanIdType = STANDARD_CAN
        CanIfTxPduDlc = 8
        CanIfTxPduUserTxConfirmationName = NULL_PTR
        CanIfTxPduUserTxConfirmationUL = NONE
        CanIfTxPduId = 8
        CanIfTxPduReadNotifyStatus = false
        CanIfTxPduType = STATIC
        CanIfTxPduTruncation = true
        CanIfTxPduBufferRef = CHNL_131d55da
        CanIfTxPduRef = VcuAdcTxMsg2_oTC37X_VCU_CAN01_afb1dcb2_Tx
      VcuRxMsg3_oTC37X_VCU_CAN01_29174725_Rx (CanIfRxPduCfg):
        CanIfRxPduCanId = 514
        CanIfRxPduCanIdType = STANDARD_CAN
        CanIfRxPduDlc = 8
        CanIfRxPduUserRxIndicationName = PduR_CanIfRxIndication
        CanIfRxPduUserRxIndicationUL = PDUR
        CanIfRxPduId = 8
        CanIfRxPduReadData = false
        CanIfRxPduReadNotifyStatus = false
        CanIfRxPduDlcCheck = true
        CanIfRxPduHrhIdRef = CN_TC37X_VCU_CAN01_2f90d2fb_Rx
        CanIfRxPduRef = VcuRxMsg3_oTC37X_VCU_CAN01_5bb4c01a_Rx
      3 x CanIfTxPduCfg, all with CanIfTxPduCanIdType=STANDARD_CAN, CanIfTxPduDlc=8, CanIfTxPduUserTxConfirmationName=NULL_PTR, CanIfTxPduUserTxConfirmationUL=NONE, CanIfTxPduReadNotifyStatus=false, CanIfTxPduType=STATIC, CanIfTxPduTruncation=true:
        VcuAdcTxMsg1_oTC37X_VCU_CAN01_29adaf4d_Tx: CanIfTxPduCanId=258, CanIfTxPduId=9, CanIfTxPduBufferRef=CHNL_131d55da, CanIfTxPduRef=VcuAdcTxMsg1_oTC37X_VCU_CAN01_6685c7bf_Tx
        VcuTxIoMsg1_oTC37X_VCU_CAN00_644aaa1f_Tx: CanIfTxPduCanId=260, CanIfTxPduId=3, CanIfTxPduBufferRef=CHNL_d841867f, CanIfTxPduRef=VcuTxIoMsg1_oTC37X_VCU_CAN00_869e33bc_Tx
        VcuTxIoMsg2_oTC37X_VCU_CAN00_0c9644c1_Tx: CanIfTxPduCanId=261, CanIfTxPduId=2, CanIfTxPduBufferRef=CHNL_d841867f, CanIfTxPduRef=VcuTxIoMsg2_oTC37X_VCU_CAN00_4faa28b1_Tx
    CanIfPrivateCfg:
      CanIfPrivateSoftwareFilterType = LINEAR
      CanIfPrivateDlcCheck = true
      CanIfSupportTTCAN = false
      CanIfTransceiverMapping = false
      CanIfTransceiverHandling = false
      CanIfSupportExtendedIds = false
      CanIfSupportNmOsek = false
      CanIfTxBufferType = NONE
      CanIfWakeupSupport = false
      CanIfStaticFdTxBufferSupport = false
      CanIfRxSearchConsiderMsgType = false
      CanIfTxBufferFifoSupport = false
      CanIfSetPduReceptionModeSupport = false
      CanIfCheckWakeupCanRetType = false
      CanIfDataChecksumRxSupport = false
      CanIfDataChecksumTxSupport = false
    CanIfPublicCfg:
      CanIfPublicPnSupport = false
      CanIfPublicCancelTransmitSupport = false
      CanIfPublicDevErrorDetect = true
      CanIfPublicHandleTypeEnum = UINT8
      CanIfPublicMultipleDrvSupport = false
      CanIfPublicNumberOfCanHwUnits = 1
      CanIfPublicReadRxPduDataApi = false
      CanIfPublicReadRxPduNotifyStatusApi = false
      CanIfPublicReadTxPduNotifyStatusApi = false
      CanIfPublicSetDynamicTxIdApi = false
      CanIfPublicTxBuffering = false
      CanIfPublicTxConfirmPollingSupport = false
      CanIfPublicVersionInfoApi = false
      CanIfPublicWakeupCheckValidSupport = false
      CanIfPnWakeupTxPduFilterSupport = false
      CanIfPnTrcvHandlingSupport = false
      CanIfJ1939DynAddrSupport = DISABLED
      CanIfSafeBswChecks = false
      CanIfBusMirroringSupport = false
      CanIfEnableSecurityEventReporting = false
      CanIfSupportCanDrvAsr440 = false
      CanIfSetBaudrateApi = false
