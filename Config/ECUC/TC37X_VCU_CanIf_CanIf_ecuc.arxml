AUTOSAR XML (schema 00048)
package /ActiveEcuC
  module config CanIf: implementation-config-variant=VARIANT-PRE-COMPILE, module-description=CanIf_Impl
    CanIfCtrlDrvCfg_7d254554 (CanIfCtrlDrvCfg): CanIfCtrlDrvTxCancellation=false, CanIfCtrlDrvInitHohConfigRef=CanIfInitHohCfg, CanIfCtrlDrvNameRef=CanGeneral
      5 x CanIfCtrlCfg, all with CanIfCtrlWakeupSupport=false, CanIfCtrlJ1939DynAddrSupport=DISABLED:
        CT_TC37X_VCU_CAN00_22cb8fec: CanIfCtrlId=1, CanIfCtrlCanCtrlRef=CT_TC37X_VCU_CAN00_22cb8fec
        CT_TC37X_VCU_CAN01_55ccbf7a: CanIfCtrlId=2, CanIfCtrlCanCtrlRef=CT_TC37X_VCU_CAN01_55ccbf7a
        CT_KAMA_FP_EPT_0303_1b7da7f9: CanIfCtrlId=0, CanIfCtrlCanCtrlRef=CT_KAMA_FP_EPT_0303_1b7da7f9
        CT_TC37X_VCU_CAN12_d5dedf81: CanIfCtrlId=4, CanIfCtrlCanCtrlRef=CT_TC37X_VCU_CAN12_d5dedf81
        CT_TC37X_VCU_CAN03_bbc2de56: CanIfCtrlId=3, CanIfCtrlCanCtrlRef=CT_TC37X_VCU_CAN03_bbc2de56
    CanIfDispatchCfg:
      CanIfDispatchUserCtrlBusOffName = CanSM_ControllerBusOff
      CanIfDispatchUserCtrlBusOffUL = CAN_SM
      CanIfDispatchUserCtrlModeIndicationName = CanSM_ControllerModeIndication
      CanIfDispatchUserCtrlModeIndicationUL = CAN_SM
    CanIfInitCfg
      CanIfInitHohCfg: CanIfInitRefCfgSet=CanConfigSet
        CN_TC37X_VCU_CAN00_c052b9c5_Rx (CanIfHrhCfg): CanIfHrhSoftwareFilter=true, CanIfHrhCanCtrlIdRef=CT_TC37X_VCU_CAN00_22cb8fec, CanIfHrhIdSymRef=CN_TC37X_VCU_CAN00_c052b9c5_Rx
        CN_TC37X_VCU_CAN00_07b6c9c8_Tx (CanIfHthCfg): CanIfHthCanCtrlIdRef=CT_TC37X_VCU_CAN00_22cb8fec, CanIfHthIdSymRef=CN_TC37X_VCU_CAN00_07b6c9c8_Tx
        CanIfHrhCfg_VcuRxMsg1_oTC37X_VCU_CAN00_c149044d_Rx (CanIfHrhCfg):
          CanIfHrhSoftwareFilter = false
          CanIfHrhCanCtrlIdRef = CT_TC37X_VCU_CAN00_22cb8fec
          CanIfHrhIdSymRef = CanHardwareObject_VcuRxMsg1_oTC37X_VCU_CAN00_c149044d_Rx
        CanIfHrhCfg_VcuRxMsg2_oTC37X_VCU_CAN00_de1782b6_Rx (CanIfHrhCfg):
          CanIfHrhSoftwareFilter = false
          CanIfHrhCanCtrlIdRef = CT_TC37X_VCU_CAN00_22cb8fec
          CanIfHrhIdSymRef = CanHardwareObject_VcuRxMsg2_oTC37X_VCU_CAN00_de1782b6_Rx
        CanIfHthCfg_51Ch_NM (CanIfHthCfg): CanIfHthCanCtrlIdRef=CT_TC37X_VCU_CAN00_22cb8fec, CanIfHthIdSymRef=CanHardwareObject_TX0
        CN_TC37X_VCU_CAN01_2f90d2fb_Rx (CanIfHrhCfg): CanIfHrhSoftwareFilter=true, CanIfHrhCanCtrlIdRef=CT_TC37X_VCU_CAN01_55ccbf7a, CanIfHrhIdSymRef=CN_TC37X_VCU_CAN01_2f90d2fb_Rx
        CN_TC37X_VCU_CAN01_70b1f95e_Tx (CanIfHthCfg): CanIfHthCanCtrlIdRef=CT_TC37X_VCU_CAN01_55ccbf7a, CanIfHthIdSymRef=CN_TC37X_VCU_CAN01_70b1f95e_Tx
        CN_KAMA_FP_EPT_0303_275b3e6e_Tx (CanIfHthCfg): CanIfHthCanCtrlIdRef=CT_KAMA_FP_EPT_0303_1b7da7f9, CanIfHthIdSymRef=CN_KAMA_FP_EPT_0303_275b3e6e_Tx
        CN_KAMA_FP_EPT_0303_c7999d11_Rx (CanIfHrhCfg): CanIfHrhSoftwareFilter=true, CanIfHrhCanCtrlIdRef=CT_KAMA_FP_EPT_0303_1b7da7f9, CanIfHrhIdSymRef=CN_KAMA_FP_EPT_0303_c7999d11_Rx
        CN_TC37X_VCU_CAN12_f0a399a5_Tx (CanIfHthCfg): CanIfHthCanCtrlIdRef=CT_TC37X_VCU_CAN12_d5dedf81, CanIfHthIdSymRef=CN_TC37X_VCU_CAN12_f0a399a5_Tx
        CN_TC37X_VCU_CAN12_0529b638_Rx (CanIfHrhCfg): CanIfHrhSoftwareFilter=true, CanIfHrhCanCtrlIdRef=CT_TC37X_VCU_CAN12_d5dedf81, CanIfHrhIdSymRef=CN_TC37X_VCU_CAN12_0529b638_Rx
        CN_TC37X_VCU_CAN03_9ebf9872_Tx (CanIfHthCfg): CanIfHthCanCtrlIdRef=CT_TC37X_VCU_CAN03_bbc2de56, CanIfHthIdSymRef=CN_TC37X_VCU_CAN03_9ebf9872_Tx
        CN_TC37X_VCU_CAN03_2b6502c6_Rx (CanIfHrhCfg): CanIfHrhSoftwareFilter=true, CanIfHrhCanCtrlIdRef=CT_TC37X_VCU_CAN03_bbc2de56, CanIfHrhIdSymRef=CN_TC37X_VCU_CAN03_2b6502c6_Rx
      VcuTxMsg1_oTC37X_VCU_CAN00_78140f53_Tx (CanIfTxPduCfg):
        CanIfTxPduCanId = 256
        CanIfTxPduCanIdType = STANDARD_CAN
        CanIfTxPduDlc = 8
        CanIfTxPduUserTxConfirmationName = NULL_PTR
        CanIfTxPduUserTxConfirmationUL = NONE
        CanIfTxPduId = 13
        CanIfTxPduReadNotifyStatus = false
        CanIfTxPduType = STATIC
        CanIfTxPduTruncation = true
        CanIfTxPduBufferRef = CHNL_d841867f
        CanIfTxPduRef = VcuTxMsg1_oTC37X_VCU_CAN00_c82dd125_Tx
      VcuRxMsg1_oTC37X_VCU_CAN00_c149044d_Rx (CanIfRxPduCfg):
        CanIfRxPduCanId = 512
        CanIfRxPduCanIdType = STANDARD_CAN
        CanIfRxPduDlc = 8
        CanIfRxPduUserRxIndicationName = PduR_CanIfRxIndication
        CanIfRxPduUserRxIndicationUL = PDUR
        CanIfRxPduId = 6
        CanIfRxPduReadData = false
        CanIfRxPduReadNotifyStatus = false
        CanIfRxPduDlcCheck = true
        CanIfRxPduHrhIdRef = CanIfHrhCfg_VcuRxMsg1_oTC37X_VCU_CAN00_c149044d_Rx
        CanIfRxPduRef = VcuRxMsg1_oTC37X_VCU_CAN00_4589bbed_Rx
      VcuRxMsg2_oTC37X_VCU_CAN00_de1782b6_Rx (CanIfRxPduCfg):
        CanIfRxPduCanId = 513
        CanIfRxPduCanIdType = STANDARD_CAN
        CanIfRxPduDlc = 8
        CanIfRxPduUserRxIndicationName = PduR_CanIfRxIndication
        CanIfRxPduUserRxIndicationUL = PDUR
        CanIfRxPduId = 5
        CanIfRxPduReadData = false
        CanIfRxPduReadNotifyStatus = false
        CanIfRxPduDlcCheck = true
        CanIfRxPduHrhIdRef = CanIfHrhCfg_VcuRxMsg2_oTC37X_VCU_CAN00_de1782b6_Rx
        CanIfRxPduRef = VcuRxMsg2_oTC37X_VCU_CAN00_8cbda0e0_Rx
      CHNL_d841867f (CanIfBufferCfg):
        CanIfBufferSize = 0
        CanIfTxBufferHandlingType = NONE
        CanIfTxBufferMappedTxPdus = 12
        CanIfTxBufferMaxPduLength = 8
        CanIfBufferHthRef = CN_TC37X_VCU_CAN00_07b6c9c8_Tx
      VCU_Tx_51Ch_NM_oTC37X_VCU_CAN00_560cc988_Tx (CanIfTxPduCfg):
        CanIfTxPduCanId = 1308
        CanIfTxPduCanIdType = STANDARD_CAN
        CanIfTxPduDlc = 8
        CanIfTxPduUserTxConfirmationName = CanNm_TxConfirmation
        CanIfTxPduUserTxConfirmationUL = CAN_NM
        CanIfTxPduId = 14
        CanIfTxPduReadNotifyStatus = false
        CanIfTxPduType = STATIC
        CanIfTxPduTruncation = true
        CanIfTxPduBufferRef = CanIfBufferCfg_51Ch_NM
        CanIfTxPduRef = VCU_Tx_51Ch_NM_oTC37X_VCU_CAN00_0aa0ce62_Tx
      VcuTxMsg2_oTC37X_VCU_CAN00_674a89a8_Tx (CanIfTxPduCfg):
        CanIfTxPduCanId = 257
        CanIfTxPduCanIdType = STANDARD_CAN
        CanIfTxPduDlc = 8
        CanIfTxPduUserTxConfirmationName = NULL_PTR
        CanIfTxPduUserTxConfirmationUL = NONE
        CanIfTxPduId = 12
        CanIfTxPduReadNotifyStatus = false
        CanIfTxPduType = STATIC
        CanIfTxPduTruncation = true
        CanIfTxPduBufferRef = CHNL_d841867f
        CanIfTxPduRef = VcuTxMsg2_oTC37X_VCU_CAN00_0119ca28_Tx
      CanIfBufferCfg_51Ch_NM (CanIfBufferCfg): CanIfBufferSize=0, CanIfTxBufferHandlingType=NONE, CanIfTxBufferMappedTxPdus=1, CanIfTxBufferMaxPduLength=8, CanIfBufferHthRef=CanIfHthCfg_51Ch_NM
      VCU_Rx_500h_NM_oTC37X_VCU_CAN00_2f971b6a_Rx (CanIfRxPduCfg):
        CanIfRxPduCanId = 1280
        CanIfRxPduCanIdType = STANDARD_CAN
        CanIfRxPduDlc = 8
        CanIfRxPduUserRxIndicationName = CanNm_RxIndication
        CanIfRxPduUserRxIndicationUL = CAN_NM
        CanIfRxPduId = 4
        CanIfRxPduReadData = false
        CanIfRxPduReadNotifyStatus = false
        CanIfRxPduDlcCheck = true
        CanIfRxPduHrhIdRef = CN_TC37X_VCU_CAN00_c052b9c5_Rx
        CanIfRxPduRef = VCU_Rx_500h_NM_oTC37X_VCU_CAN00_c4b96e15_Rx
      XCP_Response_oTC37X_VCU_CAN00_933a9e7a_Tx (CanIfTxPduCfg):
        CanIfTxPduCanId = 1543
        CanIfTxPduCanIdType = STANDARD_CAN
        CanIfTxPduDlc = 8
        CanIfTxPduUserTxConfirmationName = Xcp_CanIfTxConfirmation
        CanIfTxPduUserTxConfirmationUL = XCP
        CanIfTxPduId = 3
        CanIfTxPduReadNotifyStatus = false
        CanIfTxPduType = STATIC
        CanIfTxPduTruncation = true
        CanIfTxPduBufferRef = CHNL_d841867f
        CanIfTxPduRef = XCP_Response_oTC37X_VCU_CAN00_34d2da2d_Tx
      XCP_Request_oTC37X_VCU_CAN00_e22de59e_Rx (CanIfRxPduCfg):
        CanIfRxPduCanId = 1542
        CanIfRxPduCanIdType = STANDARD_CAN
        CanIfRxPduDlc = 8
        CanIfRxPduUserRxIndicationName = Xcp_CanIfRxIndication
        CanIfRxPduUserRxIndicationUL = XCP
        CanIfRxPduId = 3
        CanIfRxPduReadData = false
        CanIfRxPduReadNotifyStatus = false
        CanIfRxPduDlcCheck = true
        CanIfRxPduHrhIdRef = CN_TC37X_VCU_CAN00_c052b9c5_Rx
        CanIfRxPduRef = XCP_Request_oTC37X_VCU_CAN00_3c25b45e_Rx
      Vcu_Uds_Func_Request_Tp_oTC37X_VCU_CAN00_b229a038_Rx (CanIfRxPduCfg):
        CanIfRxPduCanId = 1792
        CanIfRxPduCanIdType = STANDARD_CAN
        CanIfRxPduDlc = 8
        CanIfRxPduUserRxIndicationName = CanTp_RxIndication
        CanIfRxPduUserRxIndicationType = PDUID_PDUINFOPTR
        CanIfRxPduUserRxIndicationUL = CAN_TP
        CanIfRxPduId = 2
        CanIfRxPduReadData = false
        CanIfRxPduReadNotifyStatus = false
        CanIfRxPduDlcCheck = true
        CanIfRxPduHrhIdRef = CN_TC37X_VCU_CAN00_c052b9c5_Rx
        CanIfRxPduRef = Vcu_Uds_Func_Request_Tp_oTC37X_VCU_CAN00_3dbedef7_Rx
      Vcu_Uds_Response_Tp_oTC37X_VCU_CAN00_2ff8982b_Tx (CanIfTxPduCfg):
        CanIfTxPduCanId = 1921
        CanIfTxPduCanIdType = STANDARD_CAN
        CanIfTxPduDlc = 8
        CanIfTxPduUserTxConfirmationName = CanTp_TxConfirmation
        CanIfTxPduUserTxConfirmationUL = CAN_TP
        CanIfTxPduId = 2
        CanIfTxPduReadNotifyStatus = false
        CanIfTxPduType = STATIC
        CanIfTxPduTruncation = true
        CanIfTxPduBufferRef = CHNL_d841867f
        CanIfTxPduRef = Vcu_Uds_Response_Tp_oTC37X_VCU_CAN00_834178f3_Tx
      Vcu_Uds_Phy_Request_Tp_oTC37X_VCU_CAN00_fc9370a6_Rx (CanIfRxPduCfg):
        CanIfRxPduCanId = 1793
        CanIfRxPduCanIdType = STANDARD_CAN
        CanIfRxPduDlc = 8
        CanIfRxPduUserRxIndicationName = CanTp_RxIndication
        CanIfRxPduUserRxIndicationType = PDUID_PDUINFOPTR
        CanIfRxPduUserRxIndicationUL = CAN_TP
        CanIfRxPduId = 1
        CanIfRxPduReadData = false
        CanIfRxPduReadNotifyStatus = false
        CanIfRxPduDlcCheck = true
        CanIfRxPduHrhIdRef = CN_TC37X_VCU_CAN00_c052b9c5_Rx
        CanIfRxPduRef = Vcu_Uds_Phy_Request_Tp_oTC37X_VCU_CAN00_58c52463_Rx
      CHNL_131d55da (CanIfBufferCfg):
        CanIfBufferSize = 0
        CanIfTxBufferHandlingType = NONE
        CanIfTxBufferMappedTxPdus = 3
        CanIfTxBufferMaxPduLength = 8
        CanIfBufferHthRef = CN_TC37X_VCU_CAN01_70b1f95e_Tx
      VCU_Tx_51Ch_NM_oTC37X_VCU_CAN01_587183bc_Tx (CanIfTxPduCfg):
        CanIfTxPduCanId = 1308
        CanIfTxPduCanIdType = STANDARD_CAN
        CanIfTxPduDlc = 8
        CanIfTxPduUserTxConfirmationName = CanNm_TxConfirmation
        CanIfTxPduUserTxConfirmationUL = CAN_NM
        CanIfTxPduId = 15
        CanIfTxPduReadNotifyStatus = false
        CanIfTxPduType = STATIC
        CanIfTxPduTruncation = true
        CanIfTxPduBufferRef = CHNL_131d55da
        CanIfTxPduRef = VCU_Tx_51Ch_NM_oTC37X_VCU_CAN01_9aba5863_Tx
      VCU_Rx_500h_NM_oTC37X_VCU_CAN01_21ea515e_Rx (CanIfRxPduCfg):
        CanIfRxPduCanId = 1280
        CanIfRxPduCanIdType = STANDARD_CAN
        CanIfRxPduDlc = 8
        CanIfRxPduUserRxIndicationName = CanNm_RxIndication
        CanIfRxPduUserRxIndicationUL = CAN_NM
        CanIfRxPduId = 7
        CanIfRxPduReadData = false
        CanIfRxPduReadNotifyStatus = false
        CanIfRxPduDlcCheck = true
        CanIfRxPduHrhIdRef = CN_TC37X_VCU_CAN01_2f90d2fb_Rx
        CanIfRxPduRef = VCU_Rx_500h_NM_oTC37X_VCU_CAN01_54a3f814_Rx
      VcuRxMsg4_oTC37X_VCU_CAN01_1d60377a_Rx (CanIfRxPduCfg):
        CanIfRxPduCanId = 515
        CanIfRxPduCanIdType = STANDARD_CAN
        CanIfRxPduDlc = 8
        CanIfRxPduUserRxIndicationName = PduR_CanIfRxIndication
        CanIfRxPduUserRxIndicationUL = PDUR
        CanIfRxPduId = 8
        CanIfRxPduReadData = false
        CanIfRxPduReadNotifyStatus = false
        CanIfRxPduDlcCheck = true
        CanIfRxPduHrhIdRef = CN_TC37X_VCU_CAN01_2f90d2fb_Rx
        CanIfRxPduRef = VcuRxMsg4_oTC37X_VCU_CAN01_55be06ba_Rx
      VcuAdcTxMsg2_oTC37X_VCU_CAN01_fa8a8e09_Tx (CanIfTxPduCfg):
        CanIfTxPduCanId = 259
        CanIfTxPduCanIdType = STANDARD_CAN
        CanIfTxPduDlc = 8
        CanIfTxPduUserTxConfirmationName = NULL_PTR
        CanIfTxPduUserTxConfirmationUL = NONE
        CanIfTxPduId = 16
        CanIfTxPduReadNotifyStatus = false
        CanIfTxPduType = STATIC
        CanIfTxPduTruncation = true
        CanIfTxPduBufferRef = CHNL_131d55da
        CanIfTxPduRef = VcuAdcTxMsg2_oTC37X_VCU_CAN01_afb1dcb2_Tx
      VcuRxMsg3_oTC37X_VCU_CAN01_29174725_Rx (CanIfRxPduCfg):
        CanIfRxPduCanId = 514
        CanIfRxPduCanIdType = STANDARD_CAN
        CanIfRxPduDlc = 8
        CanIfRxPduUserRxIndicationName = PduR_CanIfRxIndication
        CanIfRxPduUserRxIndicationUL = PDUR
        CanIfRxPduId = 9
        CanIfRxPduReadData = false
        CanIfRxPduReadNotifyStatus = false
        CanIfRxPduDlcCheck = true
        CanIfRxPduHrhIdRef = CN_TC37X_VCU_CAN01_2f90d2fb_Rx
        CanIfRxPduRef = VcuRxMsg3_oTC37X_VCU_CAN01_5bb4c01a_Rx
      11 x CanIfTxPduCfg, all with CanIfTxPduCanIdType=STANDARD_CAN, CanIfTxPduDlc=8, CanIfTxPduUserTxConfirmationName=NULL_PTR, CanIfTxPduUserTxConfirmationUL=NONE, CanIfTxPduReadNotifyStatus=false, CanIfTxPduType=STATIC, CanIfTxPduTruncation=true:
        VcuAdcTxMsg1_oTC37X_VCU_CAN01_29adaf4d_Tx: CanIfTxPduCanId=258, CanIfTxPduId=17, CanIfTxPduBufferRef=CHNL_131d55da, CanIfTxPduRef=VcuAdcTxMsg1_oTC37X_VCU_CAN01_6685c7bf_Tx
        VcuTxIoMsg1_oTC37X_VCU_CAN00_644aaa1f_Tx: CanIfTxPduCanId=260, CanIfTxPduId=11, CanIfTxPduBufferRef=CHNL_d841867f, CanIfTxPduRef=VcuTxIoMsg1_oTC37X_VCU_CAN00_869e33bc_Tx
        VcuTxIoMsg2_oTC37X_VCU_CAN00_0c9644c1_Tx: CanIfTxPduCanId=261, CanIfTxPduId=10, CanIfTxPduBufferRef=CHNL_d841867f, CanIfTxPduRef=VcuTxIoMsg2_oTC37X_VCU_CAN00_4faa28b1_Tx
        VcuTxIoMsg3_oTC37X_VCU_CAN00_2b221e8b_Tx: CanIfTxPduCanId=262, CanIfTxPduId=9, CanIfTxPduBufferRef=CHNL_d841867f, CanIfTxPduRef=VcuTxIoMsg3_oTC37X_VCU_CAN00_08b9de4a_Tx
        VcuTxIoMsg6_oTC37X_VCU_CAN00_92472de9_Tx: CanIfTxPduCanId=265, CanIfTxPduId=6, CanIfTxPduBufferRef=CHNL_d841867f, CanIfTxPduRef=VcuTxIoMsg6_oTC37X_VCU_CAN00_8894f51c_Tx
        VcuTxIoMsg5_oTC37X_VCU_CAN00_fa9bc337_Tx: CanIfTxPduCanId=264, CanIfTxPduId=7, CanIfTxPduBufferRef=CHNL_d841867f, CanIfTxPduRef=VcuTxIoMsg5_oTC37X_VCU_CAN00_41a0ee11_Tx
        VcuTxIoMsg7_oTC37X_VCU_CAN00_b5f377a3_Tx: CanIfTxPduCanId=266, CanIfTxPduId=5, CanIfTxPduBufferRef=CHNL_d841867f, CanIfTxPduRef=VcuTxIoMsg7_oTC37X_VCU_CAN00_cf8703e7_Tx
        VcuTxIoMsg8_oTC37X_VCU_CAN00_a52d2444_Tx: CanIfTxPduCanId=267, CanIfTxPduId=4, CanIfTxPduBufferRef=CHNL_d841867f, CanIfTxPduRef=VcuTxIoMsg8_oTC37X_VCU_CAN00_9481785c_Tx
        VcuTxIoMsg4_oTC37X_VCU_CAN00_dd2f997d_Tx: CanIfTxPduCanId=263, CanIfTxPduId=8, CanIfTxPduBufferRef=CHNL_d841867f, CanIfTxPduRef=VcuTxIoMsg4_oTC37X_VCU_CAN00_06b318ea_Tx
        VCU_Minor_02_oKAMA_FP_EPT_0303_5fe2f6bf_Tx: CanIfTxPduCanId=126, CanIfTxPduId=0, CanIfTxPduBufferRef=CHNL_f95a0907, CanIfTxPduRef=VCU_Minor_02_oKAMA_FP_EPT_0303_7ae377f6_Tx
        VCU_Minor_01_oKAMA_FP_EPT_0303_1cd15024_Tx: CanIfTxPduCanId=121, CanIfTxPduId=1, CanIfTxPduBufferRef=CHNL_f95a0907, CanIfTxPduRef=VCU_Minor_01_oKAMA_FP_EPT_0303_45280963_Tx
      CHNL_f95a0907 (CanIfBufferCfg):
        CanIfBufferSize = 0
        CanIfTxBufferHandlingType = NONE
        CanIfTxBufferMappedTxPdus = 2
        CanIfTxBufferMaxPduLength = 8
        CanIfBufferHthRef = CN_KAMA_FP_EPT_0303_275b3e6e_Tx
      VCU_Minor_03_oKAMA_FP_EPT_0303_610c6b36_Rx (CanIfRxPduCfg):
        CanIfRxPduCanId = 127
        CanIfRxPduCanIdType = STANDARD_CAN
        CanIfRxPduDlc = 8
        CanIfRxPduUserRxIndicationName = PduR_CanIfRxIndication
        CanIfRxPduUserRxIndicationUL = PDUR
        CanIfRxPduId = 0
        CanIfRxPduReadData = false
        CanIfRxPduReadNotifyStatus = false
        CanIfRxPduDlcCheck = true
        CanIfRxPduHrhIdRef = CN_KAMA_FP_EPT_0303_c7999d11_Rx
        CanIfRxPduRef = VCU_Minor_03_oKAMA_FP_EPT_0303_d9755fba_Rx
      VCU_Tx_51Ch_NM_oTC37X_VCU_CAN12_6b4cd41f_Tx (CanIfTxPduCfg):
        CanIfTxPduCanId = 1308
        CanIfTxPduCanIdType = STANDARD_CAN
        CanIfTxPduDlc = 8
        CanIfTxPduUserTxConfirmationName = CanNm_TxConfirmation
        CanIfTxPduUserTxConfirmationUL = CAN_NM
        CanIfTxPduId = 21
        CanIfTxPduReadNotifyStatus = false
        CanIfTxPduType = STATIC
        CanIfTxPduTruncation = true
        CanIfTxPduBufferRef = CHNL_33fe2cc0
        CanIfTxPduRef = VCU_Tx_51Ch_NM_oTC37X_VCU_CAN12_8673ce21_Tx
      VcuCan12TxMsg1_oTC37X_VCU_CAN12_a82524bb_Tx (CanIfTxPduCfg):
        CanIfTxPduCanId = 53
        CanIfTxPduCanIdType = STANDARD_CAN
        CanIfTxPduDlc = 8
        CanIfTxPduUserTxConfirmationName = NULL_PTR
        CanIfTxPduUserTxConfirmationUL = NONE
        CanIfTxPduId = 22
        CanIfTxPduReadNotifyStatus = false
        CanIfTxPduType = STATIC
        CanIfTxPduTruncation = true
        CanIfTxPduBufferRef = CHNL_33fe2cc0
        CanIfTxPduRef = VcuCan12TxMsg1_oTC37X_VCU_CAN12_2c92f390_Tx
      VcuCan12RxMsg3_oTC37X_VCU_CAN12_b2a63007_Rx (CanIfRxPduCfg):
        CanIfRxPduCanId = 51
        CanIfRxPduCanIdType = STANDARD_CAN
        CanIfRxPduDlc = 8
        CanIfRxPduUserRxIndicationName = PduR_CanIfRxIndication
        CanIfRxPduUserRxIndicationUL = PDUR
        CanIfRxPduId = 14
        CanIfRxPduReadData = false
        CanIfRxPduReadNotifyStatus = false
        CanIfRxPduDlcCheck = true
        CanIfRxPduHrhIdRef = CN_TC37X_VCU_CAN12_0529b638_Rx
        CanIfRxPduRef = VcuCan12RxMsg3_oTC37X_VCU_CAN12_2f1174ae_Rx
      VcuCan12TxMsg2_oTC37X_VCU_CAN12_eb168220_Tx (CanIfTxPduCfg):
        CanIfTxPduCanId = 52
        CanIfTxPduCanIdType = STANDARD_CAN
        CanIfTxPduDlc = 8
        CanIfTxPduUserTxConfirmationName = NULL_PTR
        CanIfTxPduUserTxConfirmationUL = NONE
        CanIfTxPduId = 23
        CanIfTxPduReadNotifyStatus = false
        CanIfTxPduType = STATIC
        CanIfTxPduTruncation = true
        CanIfTxPduBufferRef = CHNL_33fe2cc0
        CanIfTxPduRef = VcuCan12TxMsg2_oTC37X_VCU_CAN12_e5a6e89d_Tx
      VCU_Rx_500h_NM_oTC37X_VCU_CAN12_12d706fd_Rx (CanIfRxPduCfg):
        CanIfRxPduCanId = 1280
        CanIfRxPduCanIdType = STANDARD_CAN
        CanIfRxPduDlc = 8
        CanIfRxPduUserRxIndicationName = CanNm_RxIndication
        CanIfRxPduUserRxIndicationUL = CAN_NM
        CanIfRxPduId = 13
        CanIfRxPduReadData = false
        CanIfRxPduReadNotifyStatus = false
        CanIfRxPduDlcCheck = true
        CanIfRxPduHrhIdRef = CN_TC37X_VCU_CAN12_0529b638_Rx
        CanIfRxPduRef = VCU_Rx_500h_NM_oTC37X_VCU_CAN12_486a6e56_Rx
      CHNL_33fe2cc0 (CanIfBufferCfg):
        CanIfBufferSize = 0
        CanIfTxBufferHandlingType = NONE
        CanIfTxBufferMappedTxPdus = 3
        CanIfTxBufferMaxPduLength = 8
        CanIfBufferHthRef = CN_TC37X_VCU_CAN12_f0a399a5_Tx
      VcuCan12RxMsg4_oTC37X_VCU_CAN12_0a2fe0b8_Rx (CanIfRxPduCfg):
        CanIfRxPduCanId = 50
        CanIfRxPduCanIdType = STANDARD_CAN
        CanIfRxPduDlc = 8
        CanIfRxPduUserRxIndicationName = PduR_CanIfRxIndication
        CanIfRxPduUserRxIndicationUL = PDUR
        CanIfRxPduId = 15
        CanIfRxPduReadData = false
        CanIfRxPduReadNotifyStatus = false
        CanIfRxPduDlcCheck = true
        CanIfRxPduHrhIdRef = CN_TC37X_VCU_CAN12_0529b638_Rx
        CanIfRxPduRef = VcuCan12RxMsg4_oTC37X_VCU_CAN12_211bb20e_Rx
      VCU_Tx_51Ch_NM_oTC37X_VCU_CAN03_448b17d4_Tx (CanIfTxPduCfg):
        CanIfTxPduCanId = 1308
        CanIfTxPduCanIdType = STANDARD_CAN
        CanIfTxPduDlc = 8
        CanIfTxPduUserTxConfirmationName = CanNm_TxConfirmation
        CanIfTxPduUserTxConfirmationUL = CAN_NM
        CanIfTxPduId = 18
        CanIfTxPduReadNotifyStatus = false
        CanIfTxPduType = STATIC
        CanIfTxPduTruncation = true
        CanIfTxPduBufferRef = CHNL_5ed5f4d1
        CanIfTxPduRef = VCU_Tx_51Ch_NM_oTC37X_VCU_CAN03_61fe7220_Tx
      VcuCan03TxMsg1_oTC37X_VCU_CAN03_b4f8e3c0_Tx (CanIfTxPduCfg):
        CanIfTxPduCanId = 274
        CanIfTxPduCanIdType = STANDARD_CAN
        CanIfTxPduDlc = 8
        CanIfTxPduUserTxConfirmationName = NULL_PTR
        CanIfTxPduUserTxConfirmationUL = NONE
        CanIfTxPduId = 20
        CanIfTxPduReadNotifyStatus = false
        CanIfTxPduType = STATIC
        CanIfTxPduTruncation = true
        CanIfTxPduBufferRef = CHNL_5ed5f4d1
        CanIfTxPduRef = VcuCan03TxMsg1_oTC37X_VCU_CAN03_c0767973_Tx
      VCU_Rx_500h_NM_oTC37X_VCU_CAN03_3d10c536_Rx (CanIfRxPduCfg):
        CanIfRxPduCanId = 1280
        CanIfRxPduCanIdType = STANDARD_CAN
        CanIfRxPduDlc = 8
        CanIfRxPduUserRxIndicationName = CanNm_RxIndication
        CanIfRxPduUserRxIndicationUL = CAN_NM
        CanIfRxPduId = 10
        CanIfRxPduReadData = false
        CanIfRxPduReadNotifyStatus = false
        CanIfRxPduDlcCheck = true
        CanIfRxPduHrhIdRef = CN_TC37X_VCU_CAN03_2b6502c6_Rx
        CanIfRxPduRef = VCU_Rx_500h_NM_oTC37X_VCU_CAN03_afe7d257_Rx
      VcuCan03TxMsg2_oTC37X_VCU_CAN03_f7cb455b_Tx (CanIfTxPduCfg):
        CanIfTxPduCanId = 275
        CanIfTxPduCanIdType = STANDARD_CAN
        CanIfTxPduDlc = 8
        CanIfTxPduUserTxConfirmationName = NULL_PTR
        CanIfTxPduUserTxConfirmationUL = NONE
        CanIfTxPduId = 19
        CanIfTxPduReadNotifyStatus = false
        CanIfTxPduType = STATIC
        CanIfTxPduTruncation = true
        CanIfTxPduBufferRef = CHNL_5ed5f4d1
        CanIfTxPduRef = VcuCan03TxMsg2_oTC37X_VCU_CAN03_0942627e_Tx
      CHNL_5ed5f4d1 (CanIfBufferCfg):
        CanIfBufferSize = 0
        CanIfTxBufferHandlingType = NONE
        CanIfTxBufferMappedTxPdus = 3
        CanIfTxBufferMaxPduLength = 8
        CanIfBufferHthRef = CN_TC37X_VCU_CAN03_9ebf9872_Tx
      VcuCan03RxMsg2_oTC37X_VCU_CAN03_90956af5_Rx (CanIfRxPduCfg):
        CanIfRxPduCanId = 531
        CanIfRxPduCanIdType = STANDARD_CAN
        CanIfRxPduDlc = 8
        CanIfRxPduUserRxIndicationName = PduR_CanIfRxIndication
        CanIfRxPduUserRxIndicationUL = PDUR
        CanIfRxPduId = 11
        CanIfRxPduReadData = false
        CanIfRxPduReadNotifyStatus = false
        CanIfRxPduDlcCheck = true
        CanIfRxPduHrhIdRef = CN_TC37X_VCU_CAN03_2b6502c6_Rx
        CanIfRxPduRef = VcuCan03RxMsg2_oTC37X_VCU_CAN03_84e608b6_Rx
      VcuCan03RxMsg1_oTC37X_VCU_CAN03_d3a6cc6e_Rx (CanIfRxPduCfg):
        CanIfRxPduCanId = 530
        CanIfRxPduCanIdType = STANDARD_CAN
        CanIfRxPduDlc = 8
        CanIfRxPduUserRxIndicationName = PduR_CanIfRxIndication
        CanIfRxPduUserRxIndicationUL = PDUR
        CanIfRxPduId = 12
        CanIfRxPduReadData = false
        CanIfRxPduReadNotifyStatus = false
        CanIfRxPduDlcCheck = true
        CanIfRxPduHrhIdRef = CN_TC37X_VCU_CAN03_2b6502c6_Rx
        CanIfRxPduRef = VcuCan03RxMsg1_oTC37X_VCU_CAN03_4dd213bb_Rx
    CanIfPrivateCfg:
      CanIfPrivateSoftwareFilterType = LINEAR
      CanIfPrivateDlcCheck = true
      CanIfSupportTTCAN = false
      CanIfTransceiverMapping = false
      CanIfTransceiverHandling = false
      CanIfSupportExtendedIds = false
      CanIfSupportNmOsek = false
      CanIfTxBufferType = NONE
      CanIfWakeupSupport = false
      CanIfStaticFdTxBufferSupport = false
      CanIfRxSearchConsiderMsgType = false
      CanIfTxBufferFifoSupport = false
      CanIfSetPduReceptionModeSupport = false
      CanIfCheckWakeupCanRetType = false
      CanIfDataChecksumRxSupport = false
      CanIfDataChecksumTxSupport = false
    CanIfPublicCfg:
      CanIfPublicPnSupport = false
      CanIfPublicCancelTransmitSupport = false
      CanIfPublicDevErrorDetect = true
      CanIfPublicHandleTypeEnum = UINT8
      CanIfPublicMultipleDrvSupport = false
      CanIfPublicNumberOfCanHwUnits = 1
      CanIfPublicReadRxPduDataApi = false
      CanIfPublicReadRxPduNotifyStatusApi = false
      CanIfPublicReadTxPduNotifyStatusApi = false
      CanIfPublicSetDynamicTxIdApi = false
      CanIfPublicTxBuffering = false
      CanIfPublicTxConfirmPollingSupport = false
      CanIfPublicVersionInfoApi = false
      CanIfPublicWakeupCheckValidSupport = false
      CanIfPnWakeupTxPduFilterSupport = false
      CanIfPnTrcvHandlingSupport = false
      CanIfJ1939DynAddrSupport = DISABLED
      CanIfSafeBswChecks = false
      CanIfBusMirroringSupport = false
      CanIfEnableSecurityEventReporting = false
      CanIfSupportCanDrvAsr440 = false
      CanIfSetBaudrateApi = false
