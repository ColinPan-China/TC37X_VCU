AUTOSAR XML (schema 00048)
package /ActiveEcuC
  module config CanIf: implementation-config-variant=VARIANT-PRE-COMPILE, module-description=CanIf_Impl
    CanIfCtrlDrvCfg_7d254554 (CanIfCtrlDrvCfg): CanIfCtrlDrvTxCancellation=false, CanIfCtrlDrvInitHohConfigRef=CanIfInitHohCfg, CanIfCtrlDrvNameRef=CanGeneral
      5 x CanIfCtrlCfg, all with CanIfCtrlWakeupSupport=false, CanIfCtrlJ1939DynAddrSupport=DISABLED:
        CT_TC37X_VCU_CAN00_22cb8fec: CanIfCtrlId=1, CanIfCtrlCanCtrlRef=CT_TC37X_VCU_CAN00_22cb8fec
        CT_TC37X_VCU_CAN01_55ccbf7a: CanIfCtrlId=2, CanIfCtrlCanCtrlRef=CT_TC37X_VCU_CAN01_55ccbf7a
        CT_TC37X_VCU_CAN12_d5dedf81: CanIfCtrlId=4, CanIfCtrlCanCtrlRef=CT_TC37X_VCU_CAN12_d5dedf81
        CT_TC37X_VCU_CAN03_bbc2de56: CanIfCtrlId=3, CanIfCtrlCanCtrlRef=CT_TC37X_VCU_CAN03_bbc2de56
        CT_ATOM_CANFD_Matrix_CH_V600_202502_37050292: CanIfCtrlId=0, CanIfCtrlCanCtrlRef=CT_ATOM_CANFD_Matrix_CH_V600_202502_37050292
    CanIfDispatchCfg:
      CanIfDispatchUserCtrlBusOffName = CanSM_ControllerBusOff
      CanIfDispatchUserCtrlBusOffUL = CAN_SM
      CanIfDispatchUserCtrlModeIndicationName = CanSM_ControllerModeIndication
      CanIfDispatchUserCtrlModeIndicationUL = CAN_SM
    CanIfInitCfg
      CanIfInitHohCfg: CanIfInitRefCfgSet=CanConfigSet
        CN_TC37X_VCU_CAN00_c052b9c5_Rx (CanIfHrhCfg): CanIfHrhSoftwareFilter=true, CanIfHrhCanCtrlIdRef=CT_TC37X_VCU_CAN00_22cb8fec, CanIfHrhIdSymRef=CN_TC37X_VCU_CAN00_c052b9c5_Rx
        CN_TC37X_VCU_CAN00_07b6c9c8_Tx (CanIfHthCfg): CanIfHthCanCtrlIdRef=CT_TC37X_VCU_CAN00_22cb8fec, CanIfHthIdSymRef=CN_TC37X_VCU_CAN00_07b6c9c8_Tx
        CanIfHrhCfg_VcuRxMsg1_oTC37X_VCU_CAN00_c149044d_Rx (CanIfHrhCfg):
          CanIfHrhSoftwareFilter = false
          CanIfHrhCanCtrlIdRef = CT_TC37X_VCU_CAN00_22cb8fec
          CanIfHrhIdSymRef = CanHardwareObject_VcuRxMsg1_oTC37X_VCU_CAN00_c149044d_Rx
        CanIfHrhCfg_VcuRxMsg2_oTC37X_VCU_CAN00_de1782b6_Rx (CanIfHrhCfg):
          CanIfHrhSoftwareFilter = false
          CanIfHrhCanCtrlIdRef = CT_TC37X_VCU_CAN00_22cb8fec
          CanIfHrhIdSymRef = CanHardwareObject_VcuRxMsg2_oTC37X_VCU_CAN00_de1782b6_Rx
        CanIfHthCfg_51Ch_NM (CanIfHthCfg): CanIfHthCanCtrlIdRef=CT_TC37X_VCU_CAN00_22cb8fec, CanIfHthIdSymRef=CanHardwareObject_TX0
        CN_TC37X_VCU_CAN01_2f90d2fb_Rx (CanIfHrhCfg): CanIfHrhSoftwareFilter=true, CanIfHrhCanCtrlIdRef=CT_TC37X_VCU_CAN01_55ccbf7a, CanIfHrhIdSymRef=CN_TC37X_VCU_CAN01_2f90d2fb_Rx
        CN_TC37X_VCU_CAN01_70b1f95e_Tx (CanIfHthCfg): CanIfHthCanCtrlIdRef=CT_TC37X_VCU_CAN01_55ccbf7a, CanIfHthIdSymRef=CN_TC37X_VCU_CAN01_70b1f95e_Tx
        CN_TC37X_VCU_CAN12_f0a399a5_Tx (CanIfHthCfg): CanIfHthCanCtrlIdRef=CT_TC37X_VCU_CAN12_d5dedf81, CanIfHthIdSymRef=CN_TC37X_VCU_CAN12_f0a399a5_Tx
        CN_TC37X_VCU_CAN12_0529b638_Rx (CanIfHrhCfg): CanIfHrhSoftwareFilter=true, CanIfHrhCanCtrlIdRef=CT_TC37X_VCU_CAN12_d5dedf81, CanIfHrhIdSymRef=CN_TC37X_VCU_CAN12_0529b638_Rx
        CN_TC37X_VCU_CAN03_9ebf9872_Tx (CanIfHthCfg): CanIfHthCanCtrlIdRef=CT_TC37X_VCU_CAN03_bbc2de56, CanIfHthIdSymRef=CN_TC37X_VCU_CAN03_9ebf9872_Tx
        CN_TC37X_VCU_CAN03_2b6502c6_Rx (CanIfHrhCfg): CanIfHrhSoftwareFilter=true, CanIfHrhCanCtrlIdRef=CT_TC37X_VCU_CAN03_bbc2de56, CanIfHrhIdSymRef=CN_TC37X_VCU_CAN03_2b6502c6_Rx
        CN_ATOM_CANFD_Matrix_CH_V600_202502_64375107_Rx (CanIfHrhCfg):
          CanIfHrhSoftwareFilter = true
          CanIfHrhCanCtrlIdRef = CT_ATOM_CANFD_Matrix_CH_V600_202502_37050292
          CanIfHrhIdSymRef = CN_ATOM_CANFD_Matrix_CH_V600_202502_64375107_Rx
        3 x CanIfHthCfg, all with CanIfHthCanCtrlIdRef=CT_ATOM_CANFD_Matrix_CH_V600_202502_37050292:
          CN_ATOM_CANFD_Matrix_CH_V600_202502_a4d436ac_Tx: CanIfHthIdSymRef=CN_ATOM_CANFD_Matrix_CH_V600_202502_a4d436ac_Tx
          CN_ATOM_CANFD_Matrix_CH_V600_202502_a4d436ac_Tx_94h: CanIfHthIdSymRef=CN_ATOM_CANFD_Matrix_CH_V600_202502_a4d436ac_Tx_94h
          CN_ATOM_CANFD_Matrix_CH_V600_202502_a4d436ac_Tx_95h: CanIfHthIdSymRef=CN_ATOM_CANFD_Matrix_CH_V600_202502_a4d436ac_Tx_95h
      VcuTxMsg1_oTC37X_VCU_CAN00_78140f53_Tx (CanIfTxPduCfg):
        CanIfTxPduCanId = 256
        CanIfTxPduCanIdType = STANDARD_CAN
        CanIfTxPduDlc = 8
        CanIfTxPduUserTxConfirmationName = NULL_PTR
        CanIfTxPduUserTxConfirmationUL = NONE
        CanIfTxPduId = 23
        CanIfTxPduReadNotifyStatus = false
        CanIfTxPduType = STATIC
        CanIfTxPduTruncation = true
        CanIfTxPduBufferRef = CHNL_d841867f
        CanIfTxPduRef = VcuTxMsg1_oTC37X_VCU_CAN00_c82dd125_Tx
      VcuRxMsg1_oTC37X_VCU_CAN00_c149044d_Rx (CanIfRxPduCfg):
        CanIfRxPduCanId = 512
        CanIfRxPduCanIdType = STANDARD_CAN
        CanIfRxPduDlc = 8
        CanIfRxPduUserRxIndicationName = PduR_CanIfRxIndication
        CanIfRxPduUserRxIndicationUL = PDUR
        CanIfRxPduId = 26
        CanIfRxPduReadData = false
        CanIfRxPduReadNotifyStatus = false
        CanIfRxPduDlcCheck = true
        CanIfRxPduHrhIdRef = CanIfHrhCfg_VcuRxMsg1_oTC37X_VCU_CAN00_c149044d_Rx
        CanIfRxPduRef = VcuRxMsg1_oTC37X_VCU_CAN00_4589bbed_Rx
      VcuRxMsg2_oTC37X_VCU_CAN00_de1782b6_Rx (CanIfRxPduCfg):
        CanIfRxPduCanId = 513
        CanIfRxPduCanIdType = STANDARD_CAN
        CanIfRxPduDlc = 8
        CanIfRxPduUserRxIndicationName = PduR_CanIfRxIndication
        CanIfRxPduUserRxIndicationUL = PDUR
        CanIfRxPduId = 25
        CanIfRxPduReadData = false
        CanIfRxPduReadNotifyStatus = false
        CanIfRxPduDlcCheck = true
        CanIfRxPduHrhIdRef = CanIfHrhCfg_VcuRxMsg2_oTC37X_VCU_CAN00_de1782b6_Rx
        CanIfRxPduRef = VcuRxMsg2_oTC37X_VCU_CAN00_8cbda0e0_Rx
      CHNL_d841867f (CanIfBufferCfg):
        CanIfBufferSize = 12
        CanIfTxBufferHandlingType = PRIO_BY_CANID
        CanIfTxBufferMappedTxPdus = 12
        CanIfTxBufferMaxPduLength = 8
        CanIfBufferHthRef = CN_TC37X_VCU_CAN00_07b6c9c8_Tx
      VCU_Tx_51Ch_NM_oTC37X_VCU_CAN00_560cc988_Tx (CanIfTxPduCfg):
        CanIfTxPduCanId = 1308
        CanIfTxPduCanIdType = STANDARD_CAN
        CanIfTxPduDlc = 8
        CanIfTxPduUserTxConfirmationName = CanNm_TxConfirmation
        CanIfTxPduUserTxConfirmationUL = CAN_NM
        CanIfTxPduId = 24
        CanIfTxPduReadNotifyStatus = false
        CanIfTxPduType = STATIC
        CanIfTxPduTruncation = true
        CanIfTxPduBufferRef = CanIfBufferCfg_51Ch_NM
        CanIfTxPduRef = VCU_Tx_51Ch_NM_oTC37X_VCU_CAN00_0aa0ce62_Tx
      VcuTxMsg2_oTC37X_VCU_CAN00_674a89a8_Tx (CanIfTxPduCfg):
        CanIfTxPduCanId = 257
        CanIfTxPduCanIdType = STANDARD_CAN
        CanIfTxPduDlc = 8
        CanIfTxPduUserTxConfirmationName = NULL_PTR
        CanIfTxPduUserTxConfirmationUL = NONE
        CanIfTxPduId = 22
        CanIfTxPduReadNotifyStatus = false
        CanIfTxPduType = STATIC
        CanIfTxPduTruncation = true
        CanIfTxPduBufferRef = CHNL_d841867f
        CanIfTxPduRef = VcuTxMsg2_oTC37X_VCU_CAN00_0119ca28_Tx
      CanIfBufferCfg_51Ch_NM (CanIfBufferCfg): CanIfBufferSize=0, CanIfTxBufferHandlingType=NONE, CanIfTxBufferMappedTxPdus=1, CanIfTxBufferMaxPduLength=8, CanIfBufferHthRef=CanIfHthCfg_51Ch_NM
      VCU_Rx_500h_NM_oTC37X_VCU_CAN00_2f971b6a_Rx (CanIfRxPduCfg):
        CanIfRxPduCanId = 1280
        CanIfRxPduCanIdType = STANDARD_CAN
        CanIfRxPduDlc = 8
        CanIfRxPduUserRxIndicationName = CanNm_RxIndication
        CanIfRxPduUserRxIndicationUL = CAN_NM
        CanIfRxPduId = 24
        CanIfRxPduReadData = false
        CanIfRxPduReadNotifyStatus = false
        CanIfRxPduDlcCheck = true
        CanIfRxPduHrhIdRef = CN_TC37X_VCU_CAN00_c052b9c5_Rx
        CanIfRxPduRef = VCU_Rx_500h_NM_oTC37X_VCU_CAN00_c4b96e15_Rx
      XCP_Response_oTC37X_VCU_CAN00_933a9e7a_Tx (CanIfTxPduCfg):
        CanIfTxPduCanId = 1543
        CanIfTxPduCanIdType = STANDARD_CAN
        CanIfTxPduDlc = 8
        CanIfTxPduUserTxConfirmationName = Xcp_CanIfTxConfirmation
        CanIfTxPduUserTxConfirmationUL = XCP
        CanIfTxPduId = 13
        CanIfTxPduReadNotifyStatus = false
        CanIfTxPduType = STATIC
        CanIfTxPduTruncation = true
        CanIfTxPduBufferRef = CHNL_d841867f
        CanIfTxPduRef = XCP_Response_oTC37X_VCU_CAN00_34d2da2d_Tx
      XCP_Request_oTC37X_VCU_CAN00_e22de59e_Rx (CanIfRxPduCfg):
        CanIfRxPduCanId = 1542
        CanIfRxPduCanIdType = STANDARD_CAN
        CanIfRxPduDlc = 8
        CanIfRxPduUserRxIndicationName = Xcp_CanIfRxIndication
        CanIfRxPduUserRxIndicationUL = XCP
        CanIfRxPduId = 23
        CanIfRxPduReadData = false
        CanIfRxPduReadNotifyStatus = false
        CanIfRxPduDlcCheck = true
        CanIfRxPduHrhIdRef = CN_TC37X_VCU_CAN00_c052b9c5_Rx
        CanIfRxPduRef = XCP_Request_oTC37X_VCU_CAN00_3c25b45e_Rx
      Vcu_Uds_Func_Request_Tp_oTC37X_VCU_CAN00_b229a038_Rx (CanIfRxPduCfg):
        CanIfRxPduCanId = 1792
        CanIfRxPduCanIdType = STANDARD_CAN
        CanIfRxPduDlc = 8
        CanIfRxPduUserRxIndicationName = CanTp_RxIndication
        CanIfRxPduUserRxIndicationType = PDUID_PDUINFOPTR
        CanIfRxPduUserRxIndicationUL = CAN_TP
        CanIfRxPduId = 22
        CanIfRxPduReadData = false
        CanIfRxPduReadNotifyStatus = false
        CanIfRxPduDlcCheck = true
        CanIfRxPduHrhIdRef = CN_TC37X_VCU_CAN00_c052b9c5_Rx
        CanIfRxPduRef = Vcu_Uds_Func_Request_Tp_oTC37X_VCU_CAN00_3dbedef7_Rx
      Vcu_Uds_Response_Tp_oTC37X_VCU_CAN00_2ff8982b_Tx (CanIfTxPduCfg):
        CanIfTxPduCanId = 1921
        CanIfTxPduCanIdType = STANDARD_CAN
        CanIfTxPduDlc = 8
        CanIfTxPduUserTxConfirmationName = CanTp_TxConfirmation
        CanIfTxPduUserTxConfirmationUL = CAN_TP
        CanIfTxPduId = 12
        CanIfTxPduReadNotifyStatus = false
        CanIfTxPduType = STATIC
        CanIfTxPduTruncation = true
        CanIfTxPduBufferRef = CHNL_d841867f
        CanIfTxPduRef = Vcu_Uds_Response_Tp_oTC37X_VCU_CAN00_834178f3_Tx
      Vcu_Uds_Phy_Request_Tp_oTC37X_VCU_CAN00_fc9370a6_Rx (CanIfRxPduCfg):
        CanIfRxPduCanId = 1793
        CanIfRxPduCanIdType = STANDARD_CAN
        CanIfRxPduDlc = 8
        CanIfRxPduUserRxIndicationName = CanTp_RxIndication
        CanIfRxPduUserRxIndicationType = PDUID_PDUINFOPTR
        CanIfRxPduUserRxIndicationUL = CAN_TP
        CanIfRxPduId = 21
        CanIfRxPduReadData = false
        CanIfRxPduReadNotifyStatus = false
        CanIfRxPduDlcCheck = true
        CanIfRxPduHrhIdRef = CN_TC37X_VCU_CAN00_c052b9c5_Rx
        CanIfRxPduRef = Vcu_Uds_Phy_Request_Tp_oTC37X_VCU_CAN00_58c52463_Rx
      CHNL_131d55da (CanIfBufferCfg):
        CanIfBufferSize = 14
        CanIfTxBufferHandlingType = PRIO_BY_CANID
        CanIfTxBufferMappedTxPdus = 14
        CanIfTxBufferMaxPduLength = 8
        CanIfBufferHthRef = CN_TC37X_VCU_CAN01_70b1f95e_Tx
      VCU_Tx_51Ch_NM_oTC37X_VCU_CAN01_587183bc_Tx (CanIfTxPduCfg):
        CanIfTxPduCanId = 1308
        CanIfTxPduCanIdType = STANDARD_CAN
        CanIfTxPduDlc = 8
        CanIfTxPduUserTxConfirmationName = CanNm_TxConfirmation
        CanIfTxPduUserTxConfirmationUL = CAN_NM
        CanIfTxPduId = 25
        CanIfTxPduReadNotifyStatus = false
        CanIfTxPduType = STATIC
        CanIfTxPduTruncation = true
        CanIfTxPduBufferRef = CHNL_131d55da
        CanIfTxPduRef = VCU_Tx_51Ch_NM_oTC37X_VCU_CAN01_9aba5863_Tx
      3 x CanIfRxPduCfg, all with CanIfRxPduCanIdType=STANDARD_CAN, CanIfRxPduDlc=8, CanIfRxPduReadData=false, CanIfRxPduReadNotifyStatus=false, CanIfRxPduDlcCheck=true, CanIfRxPduHrhIdRef=CN_TC37X_VCU_CAN01_2f90d2fb_Rx:
        VCU_Rx_500h_NM_oTC37X_VCU_CAN01_21ea515e_Rx: CanIfRxPduCanId=1280, CanIfRxPduUserRxIndicationName=CanNm_RxIndication, CanIfRxPduUserRxIndicationUL=CAN_NM, CanIfRxPduId=27, CanIfRxPduRef=VCU_Rx_500h_NM_oTC37X_VCU_CAN01_54a3f814_Rx
        VcuRxMsg4_oTC37X_VCU_CAN01_1d60377a_Rx: CanIfRxPduCanId=515, CanIfRxPduUserRxIndicationName=PduR_CanIfRxIndication, CanIfRxPduUserRxIndicationUL=PDUR, CanIfRxPduId=28, CanIfRxPduRef=VcuRxMsg4_oTC37X_VCU_CAN01_55be06ba_Rx
        VcuRxMsg3_oTC37X_VCU_CAN01_29174725_Rx: CanIfRxPduCanId=514, CanIfRxPduUserRxIndicationName=PduR_CanIfRxIndication, CanIfRxPduUserRxIndicationUL=PDUR, CanIfRxPduId=29, CanIfRxPduRef=VcuRxMsg3_oTC37X_VCU_CAN01_5bb4c01a_Rx
      10 x CanIfTxPduCfg, all with CanIfTxPduCanIdType=STANDARD_CAN, CanIfTxPduDlc=8, CanIfTxPduReadNotifyStatus=false, CanIfTxPduType=STATIC, CanIfTxPduTruncation=true:
        VcuTxIoMsg1_oTC37X_VCU_CAN00_644aaa1f_Tx: CanIfTxPduCanId=260, CanIfTxPduUserTxConfirmationName=NULL_PTR, CanIfTxPduUserTxConfirmationUL=NONE, CanIfTxPduId=21, CanIfTxPduBufferRef=CHNL_d841867f, CanIfTxPduRef=VcuTxIoMsg1_oTC37X_VCU_CAN00_869e33bc_Tx
        VcuTxIoMsg2_oTC37X_VCU_CAN00_0c9644c1_Tx: CanIfTxPduCanId=261, CanIfTxPduUserTxConfirmationName=NULL_PTR, CanIfTxPduUserTxConfirmationUL=NONE, CanIfTxPduId=20, CanIfTxPduBufferRef=CHNL_d841867f, CanIfTxPduRef=VcuTxIoMsg2_oTC37X_VCU_CAN00_4faa28b1_Tx
        VcuTxIoMsg3_oTC37X_VCU_CAN00_2b221e8b_Tx: CanIfTxPduCanId=262, CanIfTxPduUserTxConfirmationName=NULL_PTR, CanIfTxPduUserTxConfirmationUL=NONE, CanIfTxPduId=19, CanIfTxPduBufferRef=CHNL_d841867f, CanIfTxPduRef=VcuTxIoMsg3_oTC37X_VCU_CAN00_08b9de4a_Tx
        VcuTxIoMsg6_oTC37X_VCU_CAN00_92472de9_Tx: CanIfTxPduCanId=265, CanIfTxPduUserTxConfirmationName=NULL_PTR, CanIfTxPduUserTxConfirmationUL=NONE, CanIfTxPduId=16, CanIfTxPduBufferRef=CHNL_d841867f, CanIfTxPduRef=VcuTxIoMsg6_oTC37X_VCU_CAN00_8894f51c_Tx
        VcuTxIoMsg5_oTC37X_VCU_CAN00_fa9bc337_Tx: CanIfTxPduCanId=264, CanIfTxPduUserTxConfirmationName=NULL_PTR, CanIfTxPduUserTxConfirmationUL=NONE, CanIfTxPduId=17, CanIfTxPduBufferRef=CHNL_d841867f, CanIfTxPduRef=VcuTxIoMsg5_oTC37X_VCU_CAN00_41a0ee11_Tx
        VcuTxIoMsg7_oTC37X_VCU_CAN00_b5f377a3_Tx: CanIfTxPduCanId=266, CanIfTxPduUserTxConfirmationName=NULL_PTR, CanIfTxPduUserTxConfirmationUL=NONE, CanIfTxPduId=15, CanIfTxPduBufferRef=CHNL_d841867f, CanIfTxPduRef=VcuTxIoMsg7_oTC37X_VCU_CAN00_cf8703e7_Tx
        VcuTxIoMsg8_oTC37X_VCU_CAN00_a52d2444_Tx: CanIfTxPduCanId=267, CanIfTxPduUserTxConfirmationName=NULL_PTR, CanIfTxPduUserTxConfirmationUL=NONE, CanIfTxPduId=14, CanIfTxPduBufferRef=CHNL_d841867f, CanIfTxPduRef=VcuTxIoMsg8_oTC37X_VCU_CAN00_9481785c_Tx
        VcuTxIoMsg4_oTC37X_VCU_CAN00_dd2f997d_Tx: CanIfTxPduCanId=263, CanIfTxPduUserTxConfirmationName=NULL_PTR, CanIfTxPduUserTxConfirmationUL=NONE, CanIfTxPduId=18, CanIfTxPduBufferRef=CHNL_d841867f, CanIfTxPduRef=VcuTxIoMsg4_oTC37X_VCU_CAN00_06b318ea_Tx
        VCU_Tx_51Ch_NM_oTC37X_VCU_CAN12_6b4cd41f_Tx: CanIfTxPduCanId=1308, CanIfTxPduUserTxConfirmationName=CanNm_TxConfirmation, CanIfTxPduUserTxConfirmationUL=CAN_NM, CanIfTxPduId=42, CanIfTxPduBufferRef=CHNL_33fe2cc0, CanIfTxPduRef=VCU_Tx_51Ch_NM_oTC37X_VCU_CAN12_8673ce21_Tx
        VcuCan12TxMsg1_oTC37X_VCU_CAN12_a82524bb_Tx: CanIfTxPduCanId=53, CanIfTxPduUserTxConfirmationName=NULL_PTR, CanIfTxPduUserTxConfirmationUL=NONE, CanIfTxPduId=43, CanIfTxPduBufferRef=CHNL_33fe2cc0, CanIfTxPduRef=VcuCan12TxMsg1_oTC37X_VCU_CAN12_2c92f390_Tx
      VcuCan12RxMsg3_oTC37X_VCU_CAN12_b2a63007_Rx (CanIfRxPduCfg):
        CanIfRxPduCanId = 51
        CanIfRxPduCanIdType = STANDARD_CAN
        CanIfRxPduDlc = 8
        CanIfRxPduUserRxIndicationName = PduR_CanIfRxIndication
        CanIfRxPduUserRxIndicationUL = PDUR
        CanIfRxPduId = 37
        CanIfRxPduReadData = false
        CanIfRxPduReadNotifyStatus = false
        CanIfRxPduDlcCheck = true
        CanIfRxPduHrhIdRef = CN_TC37X_VCU_CAN12_0529b638_Rx
        CanIfRxPduRef = VcuCan12RxMsg3_oTC37X_VCU_CAN12_2f1174ae_Rx
      VcuCan12TxMsg2_oTC37X_VCU_CAN12_eb168220_Tx (CanIfTxPduCfg):
        CanIfTxPduCanId = 52
        CanIfTxPduCanIdType = STANDARD_CAN
        CanIfTxPduDlc = 8
        CanIfTxPduUserTxConfirmationName = NULL_PTR
        CanIfTxPduUserTxConfirmationUL = NONE
        CanIfTxPduId = 44
        CanIfTxPduReadNotifyStatus = false
        CanIfTxPduType = STATIC
        CanIfTxPduTruncation = true
        CanIfTxPduBufferRef = CHNL_33fe2cc0
        CanIfTxPduRef = VcuCan12TxMsg2_oTC37X_VCU_CAN12_e5a6e89d_Tx
      VCU_Rx_500h_NM_oTC37X_VCU_CAN12_12d706fd_Rx (CanIfRxPduCfg):
        CanIfRxPduCanId = 1280
        CanIfRxPduCanIdType = STANDARD_CAN
        CanIfRxPduDlc = 8
        CanIfRxPduUserRxIndicationName = CanNm_RxIndication
        CanIfRxPduUserRxIndicationUL = CAN_NM
        CanIfRxPduId = 36
        CanIfRxPduReadData = false
        CanIfRxPduReadNotifyStatus = false
        CanIfRxPduDlcCheck = true
        CanIfRxPduHrhIdRef = CN_TC37X_VCU_CAN12_0529b638_Rx
        CanIfRxPduRef = VCU_Rx_500h_NM_oTC37X_VCU_CAN12_486a6e56_Rx
      CHNL_33fe2cc0 (CanIfBufferCfg):
        CanIfBufferSize = 3
        CanIfTxBufferHandlingType = PRIO_BY_CANID
        CanIfTxBufferMappedTxPdus = 3
        CanIfTxBufferMaxPduLength = 8
        CanIfBufferHthRef = CN_TC37X_VCU_CAN12_f0a399a5_Tx
      VcuCan12RxMsg4_oTC37X_VCU_CAN12_0a2fe0b8_Rx (CanIfRxPduCfg):
        CanIfRxPduCanId = 50
        CanIfRxPduCanIdType = STANDARD_CAN
        CanIfRxPduDlc = 8
        CanIfRxPduUserRxIndicationName = PduR_CanIfRxIndication
        CanIfRxPduUserRxIndicationUL = PDUR
        CanIfRxPduId = 38
        CanIfRxPduReadData = false
        CanIfRxPduReadNotifyStatus = false
        CanIfRxPduDlcCheck = true
        CanIfRxPduHrhIdRef = CN_TC37X_VCU_CAN12_0529b638_Rx
        CanIfRxPduRef = VcuCan12RxMsg4_oTC37X_VCU_CAN12_211bb20e_Rx
      VCU_Tx_51Ch_NM_oTC37X_VCU_CAN03_448b17d4_Tx (CanIfTxPduCfg):
        CanIfTxPduCanId = 1308
        CanIfTxPduCanIdType = STANDARD_CAN
        CanIfTxPduDlc = 8
        CanIfTxPduUserTxConfirmationName = CanNm_TxConfirmation
        CanIfTxPduUserTxConfirmationUL = CAN_NM
        CanIfTxPduId = 39
        CanIfTxPduReadNotifyStatus = false
        CanIfTxPduType = STATIC
        CanIfTxPduTruncation = true
        CanIfTxPduBufferRef = CHNL_5ed5f4d1
        CanIfTxPduRef = VCU_Tx_51Ch_NM_oTC37X_VCU_CAN03_61fe7220_Tx
      VcuCan03TxMsg1_oTC37X_VCU_CAN03_b4f8e3c0_Tx (CanIfTxPduCfg):
        CanIfTxPduCanId = 274
        CanIfTxPduCanIdType = STANDARD_CAN
        CanIfTxPduDlc = 8
        CanIfTxPduUserTxConfirmationName = NULL_PTR
        CanIfTxPduUserTxConfirmationUL = NONE
        CanIfTxPduId = 41
        CanIfTxPduReadNotifyStatus = false
        CanIfTxPduType = STATIC
        CanIfTxPduTruncation = true
        CanIfTxPduBufferRef = CHNL_5ed5f4d1
        CanIfTxPduRef = VcuCan03TxMsg1_oTC37X_VCU_CAN03_c0767973_Tx
      VCU_Rx_500h_NM_oTC37X_VCU_CAN03_3d10c536_Rx (CanIfRxPduCfg):
        CanIfRxPduCanId = 1280
        CanIfRxPduCanIdType = STANDARD_CAN
        CanIfRxPduDlc = 8
        CanIfRxPduUserRxIndicationName = CanNm_RxIndication
        CanIfRxPduUserRxIndicationUL = CAN_NM
        CanIfRxPduId = 33
        CanIfRxPduReadData = false
        CanIfRxPduReadNotifyStatus = false
        CanIfRxPduDlcCheck = true
        CanIfRxPduHrhIdRef = CN_TC37X_VCU_CAN03_2b6502c6_Rx
        CanIfRxPduRef = VCU_Rx_500h_NM_oTC37X_VCU_CAN03_afe7d257_Rx
      VcuCan03TxMsg2_oTC37X_VCU_CAN03_f7cb455b_Tx (CanIfTxPduCfg):
        CanIfTxPduCanId = 275
        CanIfTxPduCanIdType = STANDARD_CAN
        CanIfTxPduDlc = 8
        CanIfTxPduUserTxConfirmationName = NULL_PTR
        CanIfTxPduUserTxConfirmationUL = NONE
        CanIfTxPduId = 40
        CanIfTxPduReadNotifyStatus = false
        CanIfTxPduType = STATIC
        CanIfTxPduTruncation = true
        CanIfTxPduBufferRef = CHNL_5ed5f4d1
        CanIfTxPduRef = VcuCan03TxMsg2_oTC37X_VCU_CAN03_0942627e_Tx
      CHNL_5ed5f4d1 (CanIfBufferCfg):
        CanIfBufferSize = 3
        CanIfTxBufferHandlingType = PRIO_BY_CANID
        CanIfTxBufferMappedTxPdus = 3
        CanIfTxBufferMaxPduLength = 8
        CanIfBufferHthRef = CN_TC37X_VCU_CAN03_9ebf9872_Tx
      3 x CanIfRxPduCfg, all with CanIfRxPduCanIdType=STANDARD_CAN, CanIfRxPduDlc=8, CanIfRxPduUserRxIndicationName=PduR_CanIfRxIndication, CanIfRxPduUserRxIndicationUL=PDUR, CanIfRxPduReadData=false, CanIfRxPduReadNotifyStatus=false, CanIfRxPduDlcCheck=true:
        VcuCan03RxMsg2_oTC37X_VCU_CAN03_90956af5_Rx: CanIfRxPduCanId=531, CanIfRxPduId=34, CanIfRxPduHrhIdRef=CN_TC37X_VCU_CAN03_2b6502c6_Rx, CanIfRxPduRef=VcuCan03RxMsg2_oTC37X_VCU_CAN03_84e608b6_Rx
        VcuCan03RxMsg1_oTC37X_VCU_CAN03_d3a6cc6e_Rx: CanIfRxPduCanId=530, CanIfRxPduId=35, CanIfRxPduHrhIdRef=CN_TC37X_VCU_CAN03_2b6502c6_Rx, CanIfRxPduRef=VcuCan03RxMsg1_oTC37X_VCU_CAN03_4dd213bb_Rx
        IBS_APS_oATOM_CANFD_Matrix_CH_V600_202502_85b7a139_Rx: CanIfRxPduCanId=183, CanIfRxPduId=13, CanIfRxPduHrhIdRef=CN_ATOM_CANFD_Matrix_CH_V600_202502_64375107_Rx, CanIfRxPduRef=IBS_APS_oATOM_CANFD_Matrix_CH_V600_202502_8feeb71a_Rx
      3 x CanIfTxPduCfg, all with CanIfTxPduDlc=8, CanIfTxPduReadNotifyStatus=false, CanIfTxPduType=STATIC, CanIfTxPduTruncation=true, CanIfTxPduBufferRef=CHNL_785eea40:
        VCU_03_oATOM_CANFD_Matrix_CH_V600_202502_dd165c0d_Tx: CanIfTxPduCanId=546, CanIfTxPduCanIdType=STANDARD_FD_CAN, CanIfTxPduUserTxConfirmationName=NULL_PTR, CanIfTxPduUserTxConfirmationUL=NONE, CanIfTxPduId=6, CanIfTxPduRef=VCU_03_oATOM_CANFD_Matrix_CH_V600_202502_785f8119_Tx
        NM_VCU_oATOM_CANFD_Matrix_CH_V600_202502_4d937c12_Tx: CanIfTxPduCanId=1324, CanIfTxPduCanIdType=STANDARD_CAN, CanIfTxPduUserTxConfirmationName=CanNm_TxConfirmation, CanIfTxPduUserTxConfirmationUL=CAN_NM, CanIfTxPduId=0, CanIfTxPduRef=NM_VCU_oATOM_CANFD_Matrix_CH_V600_202502_7321f2c3_Tx
        VCU_HMIsignals_02_oATOM_CANFD_Matrix_CH_V600_202502_52710e60_Tx: CanIfTxPduCanId=792, CanIfTxPduCanIdType=STANDARD_FD_CAN, CanIfTxPduUserTxConfirmationName=NULL_PTR, CanIfTxPduUserTxConfirmationUL=NONE, CanIfTxPduId=3, CanIfTxPduRef=VCU_HMIsignals_02_oATOM_CANFD_Matrix_CH_V600_202502_343b3975_Tx
      SGW_17_oATOM_CANFD_Matrix_CH_V600_202502_a3accfb6_Rx (CanIfRxPduCfg):
        CanIfRxPduCanId = 850
        CanIfRxPduCanIdType = STANDARD_CAN
        CanIfRxPduDlc = 8
        CanIfRxPduUserRxIndicationName = PduR_CanIfRxIndication
        CanIfRxPduUserRxIndicationUL = PDUR
        CanIfRxPduId = 1
        CanIfRxPduReadData = false
        CanIfRxPduReadNotifyStatus = false
        CanIfRxPduDlcCheck = true
        CanIfRxPduHrhIdRef = CN_ATOM_CANFD_Matrix_CH_V600_202502_64375107_Rx
        CanIfRxPduRef = SGW_17_oATOM_CANFD_Matrix_CH_V600_202502_3a9eb4a2_Rx
      VCU_Chassis_01_oATOM_CANFD_Matrix_CH_V600_202502_d9a729e3_Tx (CanIfTxPduCfg):
        CanIfTxPduCanId = 211
        CanIfTxPduCanIdType = STANDARD_FD_CAN
        CanIfTxPduDlc = 8
        CanIfTxPduUserTxConfirmationName = NULL_PTR
        CanIfTxPduUserTxConfirmationUL = NONE
        CanIfTxPduId = 7
        CanIfTxPduReadNotifyStatus = false
        CanIfTxPduType = STATIC
        CanIfTxPduTruncation = true
        CanIfTxPduBufferRef = CHNL_785eea40
        CanIfTxPduRef = VCU_Chassis_01_oATOM_CANFD_Matrix_CH_V600_202502_e79830d3_Tx
      IBS_WheelSpeed_02_oATOM_CANFD_Matrix_CH_V600_202502_9a94b166_Rx (CanIfRxPduCfg):
        CanIfRxPduCanId = 177
        CanIfRxPduCanIdType = STANDARD_CAN
        CanIfRxPduDlc = 8
        CanIfRxPduUserRxIndicationName = PduR_CanIfRxIndication
        CanIfRxPduUserRxIndicationUL = PDUR
        CanIfRxPduId = 17
        CanIfRxPduReadData = false
        CanIfRxPduReadNotifyStatus = false
        CanIfRxPduDlcCheck = true
        CanIfRxPduHrhIdRef = CN_ATOM_CANFD_Matrix_CH_V600_202502_64375107_Rx
        CanIfRxPduRef = IBS_WheelSpeed_02_oATOM_CANFD_Matrix_CH_V600_202502_54b7c66f_Rx
      VCU_HMIsignals_01_oATOM_CANFD_Matrix_CH_V600_202502_d2142187_Tx (CanIfTxPduCfg):
        CanIfTxPduCanId = 791
        CanIfTxPduCanIdType = STANDARD_FD_CAN
        CanIfTxPduDlc = 8
        CanIfTxPduUserTxConfirmationName = NULL_PTR
        CanIfTxPduUserTxConfirmationUL = NONE
        CanIfTxPduId = 4
        CanIfTxPduReadNotifyStatus = false
        CanIfTxPduType = STATIC
        CanIfTxPduTruncation = true
        CanIfTxPduBufferRef = CHNL_785eea40
        CanIfTxPduRef = VCU_HMIsignals_01_oATOM_CANFD_Matrix_CH_V600_202502_ad7bde1a_Tx
      VCU_42a243c5_Rx (CanIfRxPduCfg):
        CanIfRxPduCanIdType = STANDARD_CAN
        CanIfRxPduDlc = 8
        CanIfRxPduUserRxIndicationName = CanNm_RxIndication
        CanIfRxPduUserRxIndicationUL = CAN_NM
        CanIfRxPduId = 0
        CanIfRxPduReadData = false
        CanIfRxPduReadNotifyStatus = false
        CanIfRxPduDlcCheck = true
        CanIfRxPduHrhIdRef = CN_ATOM_CANFD_Matrix_CH_V600_202502_64375107_Rx
        CanIfRxPduRef = VCU_3966faea_Rx
        CHNL_9f084fc6 (CanIfRxPduCanIdRange): CanIfRxPduCanIdRangeLowerCanId=1280, CanIfRxPduCanIdRangeUpperCanId=1407
      ADCU_DA_oATOM_CANFD_Matrix_CH_V600_202502_006b7786_Rx (CanIfRxPduCfg):
        CanIfRxPduCanId = 230
        CanIfRxPduCanIdType = STANDARD_CAN
        CanIfRxPduDlc = 8
        CanIfRxPduUserRxIndicationName = PduR_CanIfRxIndication
        CanIfRxPduUserRxIndicationUL = PDUR
        CanIfRxPduId = 5
        CanIfRxPduReadData = false
        CanIfRxPduReadNotifyStatus = false
        CanIfRxPduDlcCheck = true
        CanIfRxPduHrhIdRef = CN_ATOM_CANFD_Matrix_CH_V600_202502_64375107_Rx
        CanIfRxPduRef = ADCU_DA_oATOM_CANFD_Matrix_CH_V600_202502_8a75132b_Rx
      VCU_02_oATOM_CANFD_Matrix_CH_V600_202502_ba0b4faa_Tx (CanIfTxPduCfg):
        CanIfTxPduCanId = 793
        CanIfTxPduCanIdType = STANDARD_FD_CAN
        CanIfTxPduDlc = 8
        CanIfTxPduUserTxConfirmationName = NULL_PTR
        CanIfTxPduUserTxConfirmationUL = NONE
        CanIfTxPduId = 2
        CanIfTxPduReadNotifyStatus = false
        CanIfTxPduType = STATIC
        CanIfTxPduTruncation = true
        CanIfTxPduBufferRef = CHNL_785eea40
        CanIfTxPduRef = VCU_02_oATOM_CANFD_Matrix_CH_V600_202502_b9b0de03_Tx
      IBS_Status_01_oATOM_CANFD_Matrix_CH_V600_202502_efd7d15c_Rx (CanIfRxPduCfg):
        CanIfRxPduCanId = 178
        CanIfRxPduCanIdType = STANDARD_CAN
        CanIfRxPduDlc = 8
        CanIfRxPduUserRxIndicationName = PduR_CanIfRxIndication
        CanIfRxPduUserRxIndicationUL = PDUR
        CanIfRxPduId = 16
        CanIfRxPduReadData = false
        CanIfRxPduReadNotifyStatus = false
        CanIfRxPduDlcCheck = true
        CanIfRxPduHrhIdRef = CN_ATOM_CANFD_Matrix_CH_V600_202502_64375107_Rx
        CanIfRxPduRef = IBS_Status_01_oATOM_CANFD_Matrix_CH_V600_202502_acfe14e2_Rx
      ACU_info_oATOM_CANFD_Matrix_CH_V600_202502_3a26f0a5_Rx (CanIfRxPduCfg):
        CanIfRxPduCanId = 151
        CanIfRxPduCanIdType = STANDARD_CAN
        CanIfRxPduDlc = 8
        CanIfRxPduUserRxIndicationName = PduR_CanIfRxIndication
        CanIfRxPduUserRxIndicationUL = PDUR
        CanIfRxPduId = 19
        CanIfRxPduReadData = false
        CanIfRxPduReadNotifyStatus = false
        CanIfRxPduDlcCheck = true
        CanIfRxPduHrhIdRef = CN_ATOM_CANFD_Matrix_CH_V600_202502_64375107_Rx
        CanIfRxPduRef = ACU_info_oATOM_CANFD_Matrix_CH_V600_202502_83006605_Rx
      VCU_04_oATOM_CANFD_Matrix_CH_V600_202502_33342039_Tx (CanIfTxPduCfg):
        CanIfTxPduCanId = 547
        CanIfTxPduCanIdType = STANDARD_FD_CAN
        CanIfTxPduDlc = 8
        CanIfTxPduUserTxConfirmationName = NULL_PTR
        CanIfTxPduUserTxConfirmationUL = NONE
        CanIfTxPduId = 5
        CanIfTxPduReadNotifyStatus = false
        CanIfTxPduType = STATIC
        CanIfTxPduTruncation = true
        CanIfTxPduBufferRef = CHNL_785eea40
        CanIfTxPduRef = VCU_04_oATOM_CANFD_Matrix_CH_V600_202502_5040169c_Tx
      ACU_02_oATOM_CANFD_Matrix_CH_V600_202502_013f48ab_Rx (CanIfRxPduCfg):
        CanIfRxPduCanId = 246
        CanIfRxPduCanIdType = STANDARD_CAN
        CanIfRxPduDlc = 8
        CanIfRxPduUserRxIndicationName = PduR_CanIfRxIndication
        CanIfRxPduUserRxIndicationUL = PDUR
        CanIfRxPduId = 3
        CanIfRxPduReadData = false
        CanIfRxPduReadNotifyStatus = false
        CanIfRxPduDlcCheck = true
        CanIfRxPduHrhIdRef = CN_ATOM_CANFD_Matrix_CH_V600_202502_64375107_Rx
        CanIfRxPduRef = ACU_02_oATOM_CANFD_Matrix_CH_V600_202502_8a035e80_Rx
      VCU_AccPedal_oATOM_CANFD_Matrix_CH_V600_202502_6e926372_Tx (CanIfTxPduCfg):
        CanIfTxPduCanId = 210
        CanIfTxPduCanIdType = STANDARD_FD_CAN
        CanIfTxPduDlc = 8
        CanIfTxPduUserTxConfirmationName = NULL_PTR
        CanIfTxPduUserTxConfirmationUL = NONE
        CanIfTxPduId = 8
        CanIfTxPduReadNotifyStatus = false
        CanIfTxPduType = STATIC
        CanIfTxPduTruncation = true
        CanIfTxPduBufferRef = CHNL_785eea40
        CanIfTxPduRef = VCU_AccPedal_oATOM_CANFD_Matrix_CH_V600_202502_3cf928f4_Tx
      VCU_IBS_01_oATOM_CANFD_Matrix_CH_V600_202502_7a39d019_Tx (CanIfTxPduCfg):
        CanIfTxPduCanId = 148
        CanIfTxPduCanIdType = STANDARD_FD_CAN
        CanIfTxPduDlc = 8
        CanIfTxPduUserTxConfirmationName = NULL_PTR
        CanIfTxPduUserTxConfirmationUL = NONE
        CanIfTxPduId = 11
        CanIfTxPduReadNotifyStatus = false
        CanIfTxPduType = STATIC
        CanIfTxPduTruncation = true
        CanIfTxPduBufferRef = CHNL_CH_94h
        CanIfTxPduRef = VCU_IBS_01_oATOM_CANFD_Matrix_CH_V600_202502_72f519e8_Tx
      3 x CanIfRxPduCfg, all with CanIfRxPduCanIdType=STANDARD_CAN, CanIfRxPduDlc=8, CanIfRxPduUserRxIndicationName=PduR_CanIfRxIndication, CanIfRxPduUserRxIndicationUL=PDUR, CanIfRxPduReadData=false, CanIfRxPduReadNotifyStatus=false, CanIfRxPduDlcCheck=true, CanIfRxPduHrhIdRef=CN_ATOM_CANFD_Matrix_CH_V600_202502_64375107_Rx:
        IBS_ACC_oATOM_CANFD_Matrix_CH_V600_202502_bc049b13_Rx: CanIfRxPduCanId=184, CanIfRxPduId=12, CanIfRxPduRef=IBS_ACC_oATOM_CANFD_Matrix_CH_V600_202502_205c1446_Rx
        IBS_VCU_MotorControl_oATOM_CANFD_Matrix_CH_V600_202502_0ce6310f_Rx: CanIfRxPduCanId=144, CanIfRxPduId=20, CanIfRxPduRef=IBS_VCU_MotorControl_oATOM_CANFD_Matrix_CH_V600_202502_df4c437b_Rx
        IBS_Status_06_oATOM_CANFD_Matrix_CH_V600_202502_d61b4b72_Rx: CanIfRxPduCanId=188, CanIfRxPduId=9, CanIfRxPduRef=IBS_Status_06_oATOM_CANFD_Matrix_CH_V600_202502_84e18367_Rx
      CHNL_785eea40 (CanIfBufferCfg):
        CanIfBufferSize = 10
        CanIfTxBufferHandlingType = PRIO_BY_CANID
        CanIfTxBufferMappedTxPdus = 10
        CanIfTxBufferMaxPduLength = 8
        CanIfBufferHthRef = CN_ATOM_CANFD_Matrix_CH_V600_202502_a4d436ac_Tx
      ADCU_APS_02_oATOM_CANFD_Matrix_CH_V600_202502_4e07b11c_Rx (CanIfRxPduCfg):
        CanIfRxPduCanId = 525
        CanIfRxPduCanIdType = STANDARD_CAN
        CanIfRxPduDlc = 8
        CanIfRxPduUserRxIndicationName = PduR_CanIfRxIndication
        CanIfRxPduUserRxIndicationUL = PDUR
        CanIfRxPduId = 2
        CanIfRxPduReadData = false
        CanIfRxPduReadNotifyStatus = false
        CanIfRxPduDlcCheck = true
        CanIfRxPduHrhIdRef = CN_ATOM_CANFD_Matrix_CH_V600_202502_64375107_Rx
        CanIfRxPduRef = ADCU_APS_02_oATOM_CANFD_Matrix_CH_V600_202502_599b516e_Rx
      VCU_BMS_oATOM_CANFD_Matrix_CH_V600_202502_f1d5756e_Tx (CanIfTxPduCfg):
        CanIfTxPduCanId = 209
        CanIfTxPduCanIdType = STANDARD_FD_CAN
        CanIfTxPduDlc = 8
        CanIfTxPduUserTxConfirmationName = NULL_PTR
        CanIfTxPduUserTxConfirmationUL = NONE
        CanIfTxPduId = 9
        CanIfTxPduReadNotifyStatus = false
        CanIfTxPduType = STATIC
        CanIfTxPduTruncation = true
        CanIfTxPduBufferRef = CHNL_785eea40
        CanIfTxPduRef = VCU_BMS_oATOM_CANFD_Matrix_CH_V600_202502_8dd4382b_Tx
      4 x CanIfRxPduCfg, all with CanIfRxPduCanIdType=STANDARD_CAN, CanIfRxPduDlc=8, CanIfRxPduUserRxIndicationName=PduR_CanIfRxIndication, CanIfRxPduUserRxIndicationUL=PDUR, CanIfRxPduReadData=false, CanIfRxPduReadNotifyStatus=false, CanIfRxPduDlcCheck=true, CanIfRxPduHrhIdRef=CN_ATOM_CANFD_Matrix_CH_V600_202502_64375107_Rx:
        IBS_WheelSpeed_01_oATOM_CANFD_Matrix_CH_V600_202502_1af19e81_Rx: CanIfRxPduCanId=176, CanIfRxPduId=18, CanIfRxPduRef=IBS_WheelSpeed_01_oATOM_CANFD_Matrix_CH_V600_202502_cdf72100_Rx
        IBS_Status_02_oATOM_CANFD_Matrix_CH_V600_202502_b20084e1_Rx: CanIfRxPduCanId=179, CanIfRxPduId=15, CanIfRxPduRef=IBS_Status_02_oATOM_CANFD_Matrix_CH_V600_202502_35bef38d_Rx
        IBS_Status_03_oATOM_CANFD_Matrix_CH_V600_202502_3062b5b5_Rx: CanIfRxPduCanId=180, CanIfRxPduId=14, CanIfRxPduRef=IBS_Status_03_oATOM_CANFD_Matrix_CH_V600_202502_f451ac97_Rx
        ADCU_ACC_02_oATOM_CANFD_Matrix_CH_V600_202502_c4c0c3b8_Rx: CanIfRxPduCanId=224, CanIfRxPduId=8, CanIfRxPduRef=ADCU_ACC_02_oATOM_CANFD_Matrix_CH_V600_202502_9c78bb9f_Rx
      VCU_MCU_03_oATOM_CANFD_Matrix_CH_V600_202502_033d9a67_Tx (CanIfTxPduCfg):
        CanIfTxPduCanId = 149
        CanIfTxPduCanIdType = STANDARD_FD_CAN
        CanIfTxPduDlc = 8
        CanIfTxPduUserTxConfirmationName = NULL_PTR
        CanIfTxPduUserTxConfirmationUL = NONE
        CanIfTxPduId = 10
        CanIfTxPduReadNotifyStatus = false
        CanIfTxPduType = STATIC
        CanIfTxPduTruncation = true
        CanIfTxPduBufferRef = CHNL_CH_95h
        CanIfTxPduRef = VCU_MCU_03_oATOM_CANFD_Matrix_CH_V600_202502_9c2fbb06_Tx
      IBS_Status_04_oATOM_CANFD_Matrix_CH_V600_202502_09ae2f9b_Rx (CanIfRxPduCfg):
        CanIfRxPduCanId = 186
        CanIfRxPduCanIdType = STANDARD_CAN
        CanIfRxPduDlc = 8
        CanIfRxPduUserRxIndicationName = PduR_CanIfRxIndication
        CanIfRxPduUserRxIndicationUL = PDUR
        CanIfRxPduId = 10
        CanIfRxPduReadData = false
        CanIfRxPduReadNotifyStatus = false
        CanIfRxPduDlcCheck = true
        CanIfRxPduHrhIdRef = CN_ATOM_CANFD_Matrix_CH_V600_202502_64375107_Rx
        CanIfRxPduRef = IBS_Status_04_oATOM_CANFD_Matrix_CH_V600_202502_dc4e3b12_Rx
      VCU_PlugInChrgInfo_oATOM_CANFD_Matrix_CH_V600_202502_bd173cc2_Tx (CanIfTxPduCfg):
        CanIfTxPduCanId = 913
        CanIfTxPduCanIdType = STANDARD_FD_CAN
        CanIfTxPduDlc = 8
        CanIfTxPduUserTxConfirmationName = NULL_PTR
        CanIfTxPduUserTxConfirmationUL = NONE
        CanIfTxPduId = 1
        CanIfTxPduReadNotifyStatus = false
        CanIfTxPduType = STATIC
        CanIfTxPduTruncation = true
        CanIfTxPduBufferRef = CHNL_785eea40
        CanIfTxPduRef = VCU_PlugInChrgInfo_oATOM_CANFD_Matrix_CH_V600_202502_f8a23add_Tx
      4 x CanIfRxPduCfg, all with CanIfRxPduCanIdType=STANDARD_CAN, CanIfRxPduDlc=8, CanIfRxPduUserRxIndicationName=PduR_CanIfRxIndication, CanIfRxPduUserRxIndicationUL=PDUR, CanIfRxPduReadData=false, CanIfRxPduReadNotifyStatus=false, CanIfRxPduDlcCheck=true, CanIfRxPduHrhIdRef=CN_ATOM_CANFD_Matrix_CH_V600_202502_64375107_Rx:
        ADCU_AEB_01_oATOM_CANFD_Matrix_CH_V600_202502_112d0569_Rx: CanIfRxPduCanId=226, CanIfRxPduId=7, CanIfRxPduRef=ADCU_AEB_01_oATOM_CANFD_Matrix_CH_V600_202502_aeea498e_Rx
        ACU_01_oATOM_CANFD_Matrix_CH_V600_202502_a8187c42_Rx: CanIfRxPduCanId=245, CanIfRxPduId=4, CanIfRxPduRef=ACU_01_oATOM_CANFD_Matrix_CH_V600_202502_1343b9ef_Rx
        IBS_Torque_oATOM_CANFD_Matrix_CH_V600_202502_859bc039_Rx: CanIfRxPduCanId=185, CanIfRxPduId=11, CanIfRxPduRef=IBS_Torque_oATOM_CANFD_Matrix_CH_V600_202502_94259583_Rx
        ADCU_APS_01_oATOM_CANFD_Matrix_CH_V600_202502_49d00f95_Rx: CanIfRxPduCanId=228, CanIfRxPduId=6, CanIfRxPduRef=ADCU_APS_01_oATOM_CANFD_Matrix_CH_V600_202502_c0dbb601_Rx
      CHNL_CH_94h (CanIfBufferCfg):
        CanIfBufferSize = 0
        CanIfTxBufferHandlingType = NONE
        CanIfTxBufferMappedTxPdus = 1
        CanIfTxBufferMaxPduLength = 8
        CanIfBufferHthRef = CN_ATOM_CANFD_Matrix_CH_V600_202502_a4d436ac_Tx_94h
      CHNL_CH_95h (CanIfBufferCfg):
        CanIfBufferSize = 0
        CanIfTxBufferHandlingType = NONE
        CanIfTxBufferMappedTxPdus = 1
        CanIfTxBufferMaxPduLength = 8
        CanIfBufferHthRef = CN_ATOM_CANFD_Matrix_CH_V600_202502_a4d436ac_Tx_95h
      12 x CanIfTxPduCfg, all with CanIfTxPduCanIdType=STANDARD_CAN, CanIfTxPduDlc=8, CanIfTxPduUserTxConfirmationName=NULL_PTR, CanIfTxPduUserTxConfirmationUL=NONE, CanIfTxPduReadNotifyStatus=false, CanIfTxPduType=STATIC, CanIfTxPduTruncation=true, CanIfTxPduBufferRef=CHNL_131d55da:
        VcuAdcTxG3Msg1_oTC37X_VCU_CAN01_6e9c9e8d_Tx: CanIfTxPduCanId=265, CanIfTxPduId=31, CanIfTxPduRef=VcuAdcTxG3Msg1_oTC37X_VCU_CAN01_f4df30a9_Tx
        VcuAdcTxG1Msg0_oTC37X_VCU_CAN01_987e20b2_Tx: CanIfTxPduCanId=260, CanIfTxPduId=36, CanIfTxPduRef=VcuAdcTxG1Msg0_oTC37X_VCU_CAN01_613ed098_Tx
        VcuAdcTxG0Msg0_oTC37X_VCU_CAN01_fc783169_Tx: CanIfTxPduCanId=258, CanIfTxPduId=38, CanIfTxPduRef=VcuAdcTxG0Msg0_oTC37X_VCU_CAN01_0847dbfd_Tx
        VcuAdcTxG1Msg1_oTC37X_VCU_CAN01_a690bd3b_Tx: CanIfTxPduCanId=261, CanIfTxPduId=35, CanIfTxPduRef=VcuAdcTxG1Msg1_oTC37X_VCU_CAN01_262d2663_Tx
        VcuAdcTxG8Msg3_oTC37X_VCU_CAN01_299915a8_Tx: CanIfTxPduCanId=269, CanIfTxPduId=27, CanIfTxPduRef=VcuAdcTxG8Msg3_oTC37X_VCU_CAN01_3c59975a_Tx
        VcuAdcTxG8Msg1_oTC37X_VCU_CAN01_54442eba_Tx: CanIfTxPduCanId=267, CanIfTxPduId=29, CanIfTxPduRef=VcuAdcTxG8Msg1_oTC37X_VCU_CAN01_b27e7aac_Tx
        VcuAdcTxG3Msg0_oTC37X_VCU_CAN01_50720304_Tx: CanIfTxPduCanId=264, CanIfTxPduId=32, CanIfTxPduRef=VcuAdcTxG3Msg0_oTC37X_VCU_CAN01_b3ccc652_Tx
        VcuAdcTxG8Msg0_oTC37X_VCU_CAN01_6aaab333_Tx: CanIfTxPduCanId=266, CanIfTxPduId=30, CanIfTxPduRef=VcuAdcTxG8Msg0_oTC37X_VCU_CAN01_f56d8c57_Tx
        VcuAdcTxG8Msg2_oTC37X_VCU_CAN01_17778821_Tx: CanIfTxPduCanId=268, CanIfTxPduId=28, CanIfTxPduRef=VcuAdcTxG8Msg2_oTC37X_VCU_CAN01_7b4a61a1_Tx
        VcuAdcTxG2Msg0_oTC37X_VCU_CAN01_347412df_Tx: CanIfTxPduCanId=262, CanIfTxPduId=34, CanIfTxPduRef=VcuAdcTxG2Msg0_oTC37X_VCU_CAN01_dab5cd37_Tx
        VcuAdcTxG2Msg1_oTC37X_VCU_CAN01_0a9a8f56_Tx: CanIfTxPduCanId=263, CanIfTxPduId=33, CanIfTxPduRef=VcuAdcTxG2Msg1_oTC37X_VCU_CAN01_9da63bcc_Tx
        VcuAdcTxG0Msg1_oTC37X_VCU_CAN01_c296ace0_Tx: CanIfTxPduCanId=259, CanIfTxPduId=37, CanIfTxPduRef=VcuAdcTxG0Msg1_oTC37X_VCU_CAN01_4f542d06_Tx
      3 x CanIfRxPduCfg, all with CanIfRxPduCanIdType=STANDARD_CAN, CanIfRxPduDlc=8, CanIfRxPduUserRxIndicationName=PduR_CanIfRxIndication, CanIfRxPduUserRxIndicationUL=PDUR, CanIfRxPduReadData=false, CanIfRxPduReadNotifyStatus=false, CanIfRxPduDlcCheck=true, CanIfRxPduHrhIdRef=CN_TC37X_VCU_CAN01_2f90d2fb_Rx:
        VcuRxCtrlMsg0_oTC37X_VCU_CAN01_6f777a62_Rx: CanIfRxPduCanId=270, CanIfRxPduId=32, CanIfRxPduRef=VcuRxCtrlMsg0_oTC37X_VCU_CAN01_3715838b_Rx
        VcuRxCtrlMsg1_oTC37X_VCU_CAN01_989a1812_Rx: CanIfRxPduCanId=271, CanIfRxPduId=31, CanIfRxPduRef=VcuRxCtrlMsg1_oTC37X_VCU_CAN01_70067570_Rx
        VcuRxCtrlMsg2_oTC37X_VCU_CAN01_5bdcb8c3_Rx: CanIfRxPduCanId=272, CanIfRxPduId=30, CanIfRxPduRef=VcuRxCtrlMsg2_oTC37X_VCU_CAN01_b9326e7d_Rx
      VcuMeasurementMsg0_oTC37X_VCU_CAN01_b3a7d237_Tx (CanIfTxPduCfg):
        CanIfTxPduCanId = 273
        CanIfTxPduCanIdType = STANDARD_CAN
        CanIfTxPduDlc = 8
        CanIfTxPduUserTxConfirmationName = NULL_PTR
        CanIfTxPduUserTxConfirmationUL = NONE
        CanIfTxPduId = 26
        CanIfTxPduReadNotifyStatus = false
        CanIfTxPduType = STATIC
        CanIfTxPduTruncation = true
        CanIfTxPduBufferRef = CHNL_131d55da
        CanIfTxPduRef = VcuMeasurementMsg0_oTC37X_VCU_CAN01_d96481d0_Tx
    CanIfPrivateCfg:
      CanIfPrivateSoftwareFilterType = LINEAR
      CanIfPrivateDlcCheck = true
      CanIfSupportTTCAN = false
      CanIfTransceiverMapping = false
      CanIfTransceiverHandling = false
      CanIfSupportExtendedIds = false
      CanIfSupportNmOsek = false
      CanIfTxBufferType = BYTE_QUEUE
      CanIfWakeupSupport = false
      CanIfStaticFdTxBufferSupport = false
      CanIfRxSearchConsiderMsgType = false
      CanIfTxBufferFifoSupport = false
      CanIfSetPduReceptionModeSupport = false
      CanIfCheckWakeupCanRetType = false
      CanIfDataChecksumRxSupport = false
      CanIfDataChecksumTxSupport = false
    CanIfPublicCfg:
      CanIfPublicPnSupport = false
      CanIfPublicCancelTransmitSupport = false
      CanIfPublicDevErrorDetect = true
      CanIfPublicHandleTypeEnum = UINT8
      CanIfPublicMultipleDrvSupport = false
      CanIfPublicNumberOfCanHwUnits = 1
      CanIfPublicReadRxPduDataApi = false
      CanIfPublicReadRxPduNotifyStatusApi = false
      CanIfPublicReadTxPduNotifyStatusApi = false
      CanIfPublicSetDynamicTxIdApi = false
      CanIfPublicTxBuffering = true
      CanIfPublicTxConfirmPollingSupport = false
      CanIfPublicVersionInfoApi = false
      CanIfPublicWakeupCheckValidSupport = false
      CanIfPnWakeupTxPduFilterSupport = false
      CanIfPnTrcvHandlingSupport = false
      CanIfJ1939DynAddrSupport = DISABLED
      CanIfSafeBswChecks = false
      CanIfBusMirroringSupport = false
      CanIfEnableSecurityEventReporting = false
      CanIfSupportCanDrvAsr440 = false
      CanIfSetBaudrateApi = false
