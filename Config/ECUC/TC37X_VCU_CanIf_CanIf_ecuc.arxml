AUTOSAR XML (schema 00048)
package /ActiveEcuC
  module config CanIf: implementation-config-variant=VARIANT-PRE-COMPILE, module-description=CanIf_Impl
    CanIfCtrlDrvCfg_7d254554 (CanIfCtrlDrvCfg): CanIfCtrlDrvTxCancellation=false, CanIfCtrlDrvInitHohConfigRef=CanIfInitHohCfg, CanIfCtrlDrvNameRef=CanGeneral
      5 x CanIfCtrlCfg, all with CanIfCtrlWakeupSupport=false, CanIfCtrlJ1939DynAddrSupport=DISABLED:
        CT_TC37X_VCU_CAN01_55ccbf7a: CanIfCtrlId=4, CanIfCtrlCanCtrlRef=CT_TC37X_VCU_CAN01_55ccbf7a
        CT_ATOM_CANFD_Matrix_CH_V600_202502_37050292: CanIfCtrlId=0, CanIfCtrlCanCtrlRef=CT_ATOM_CANFD_Matrix_CH_V600_202502_37050292, CanIfCtrlTrcvCfgRef=CanIfTrcvCfg_CH
        CT_ATOM_CAN_Matrix_PT_V600_20250211_08587b03: CanIfCtrlId=1, CanIfCtrlCanCtrlRef=CT_ATOM_CAN_Matrix_PT_V600_20250211_08587b03, CanIfCtrlTrcvCfgRef=CanIfTrcvCfg_PT
        CT_ATOM_CAN_XCP_40afa023: CanIfCtrlId=2, CanIfCtrlCanCtrlRef=CT_ATOM_CAN_XCP_40afa023
        CT_J1939_bms_92f0044b: CanIfCtrlId=3, CanIfCtrlCanCtrlRef=CT_J1939_bms_92f0044b
    CanIfDispatchCfg:
      CanIfDispatchUserCtrlBusOffName = CanSM_ControllerBusOff
      CanIfDispatchUserCtrlBusOffUL = CAN_SM
      CanIfDispatchUserCtrlModeIndicationName = CanSM_ControllerModeIndication
      CanIfDispatchUserCtrlModeIndicationUL = CAN_SM
      CanIfDispatchUserValidateWakeupEventName = EcuM_ValidateWakeupEvent
      CanIfDispatchUserValidateWakeupEventUL = ECUM
      CanIfDispatchUserTrcvModeIndicationName = CanSM_TransceiverModeIndication
      CanIfDispatchUserTrcvModeIndicationUL = CAN_SM
    CanIfInitCfg
      CanIfInitHohCfg: CanIfInitRefCfgSet=CanConfigSet
        CN_TC37X_VCU_CAN01_2f90d2fb_Rx (CanIfHrhCfg): CanIfHrhSoftwareFilter=true, CanIfHrhCanCtrlIdRef=CT_TC37X_VCU_CAN01_55ccbf7a, CanIfHrhIdSymRef=CN_TC37X_VCU_CAN01_2f90d2fb_Rx
        CN_TC37X_VCU_CAN01_70b1f95e_Tx (CanIfHthCfg): CanIfHthCanCtrlIdRef=CT_TC37X_VCU_CAN01_55ccbf7a, CanIfHthIdSymRef=CN_TC37X_VCU_CAN01_70b1f95e_Tx
        CN_ATOM_CANFD_Matrix_CH_V600_202502_64375107_Rx (CanIfHrhCfg):
          CanIfHrhSoftwareFilter = true
          CanIfHrhCanCtrlIdRef = CT_ATOM_CANFD_Matrix_CH_V600_202502_37050292
          CanIfHrhIdSymRef = CN_ATOM_CANFD_Matrix_CH_V600_202502_64375107_Rx
        3 x CanIfHthCfg, all with CanIfHthCanCtrlIdRef=CT_ATOM_CANFD_Matrix_CH_V600_202502_37050292:
          CN_ATOM_CANFD_Matrix_CH_V600_202502_a4d436ac_Tx: CanIfHthIdSymRef=CN_ATOM_CANFD_Matrix_CH_V600_202502_a4d436ac_Tx
          CN_ATOM_CANFD_Matrix_CH_Tx_94h: CanIfHthIdSymRef=CN_ATOM_CANFD_Matrix_CH_Tx_94h
          CN_ATOM_CANFD_Matrix_CH_Tx_95h: CanIfHthIdSymRef=CN_ATOM_CANFD_Matrix_CH_Tx_95h
        CN_ATOM_CAN_Matrix_PT_V600_20250211_bde8b0ce_Rx (CanIfHrhCfg):
          CanIfHrhSoftwareFilter = true
          CanIfHrhCanCtrlIdRef = CT_ATOM_CAN_Matrix_PT_V600_20250211_08587b03
          CanIfHrhIdSymRef = CN_ATOM_CAN_Matrix_PT_V600_20250211_bde8b0ce_Rx
        4 x CanIfHthCfg:
          CN_ATOM_CAN_Matrix_PT_V600_20250211_9b894f3d_Tx: CanIfHthCanCtrlIdRef=CT_ATOM_CAN_Matrix_PT_V600_20250211_08587b03, CanIfHthIdSymRef=CN_ATOM_CAN_Matrix_PT_V600_20250211_9b894f3d_Tx
          CN_ATOM_CAN_PT_Tx_95h: CanIfHthCanCtrlIdRef=CT_ATOM_CAN_Matrix_PT_V600_20250211_08587b03, CanIfHthIdSymRef=CN_ATOM_CAN_PT_Tx_95h
          CN_ATOM_CAN_PT_Tx_96h: CanIfHthCanCtrlIdRef=CT_ATOM_CAN_Matrix_PT_V600_20250211_08587b03, CanIfHthIdSymRef=CN_ATOM_CAN_PT_Tx_96h
          CN_ATOM_CAN_XCP_f42a46d4_Tx: CanIfHthCanCtrlIdRef=CT_ATOM_CAN_XCP_40afa023, CanIfHthIdSymRef=CN_ATOM_CAN_XCP_f42a46d4_Tx
        CN_ATOM_CAN_XCP_bbd3e829_Rx (CanIfHrhCfg): CanIfHrhSoftwareFilter=true, CanIfHrhCanCtrlIdRef=CT_ATOM_CAN_XCP_40afa023, CanIfHrhIdSymRef=CN_ATOM_CAN_XCP_bbd3e829_Rx
        CN_J1939_bms_96c04df9_Rx (CanIfHrhCfg): CanIfHrhSoftwareFilter=true, CanIfHrhCanCtrlIdRef=CT_J1939_bms_92f0044b, CanIfHrhIdSymRef=CN_J1939_bms_96c04df9_Rx
        9 x CanIfHthCfg:
          CN_J1939_bms_dea99804_Tx: CanIfHthCanCtrlIdRef=CT_J1939_bms_92f0044b, CanIfHthIdSymRef=CN_J1939_bms_dea99804_Tx
          CN_J1939_bms_101956F4h_Tx: CanIfHthCanCtrlIdRef=CT_J1939_bms_92f0044b, CanIfHthIdSymRef=CN_J1939_bms_101956F4h_Tx
          CN_ATOM_CANFD_Matrix_CH_Tx_D{1..3}h: CanIfHthCanCtrlIdRef=CT_ATOM_CANFD_Matrix_CH_V600_202502_37050292, CanIfHthIdSymRef=CN_ATOM_CANFD_Matrix_CH_Tx_D{1..3}h
          CN_ATOM_CAN_PT_Tx_D1h: CanIfHthCanCtrlIdRef=CT_ATOM_CAN_Matrix_PT_V600_20250211_08587b03, CanIfHthIdSymRef=CN_ATOM_CAN_PT_Tx_D1h
          CN_ATOM_CAN_PT_Tx_D2h: CanIfHthCanCtrlIdRef=CT_ATOM_CAN_Matrix_PT_V600_20250211_08587b03, CanIfHthIdSymRef=CN_ATOM_CAN_PT_Tx_D2h
          CN_ATOM_CAN_PT_Tx_D6h: CanIfHthCanCtrlIdRef=CT_ATOM_CAN_Matrix_PT_V600_20250211_08587b03, CanIfHthIdSymRef=CN_ATOM_CAN_PT_Tx_D6h
          CN_ATOM_CAN_PT_Tx_121h: CanIfHthCanCtrlIdRef=CT_ATOM_CAN_Matrix_PT_V600_20250211_08587b03, CanIfHthIdSymRef=CN_ATOM_CAN_PT_Tx_121h
        6 x CanIfHrhCfg, all with CanIfHrhSoftwareFilter=false, CanIfHrhCanCtrlIdRef=CT_ATOM_CAN_Matrix_PT_V600_20250211_08587b03:
          CanIfHrhCfg_MCU_01_oATOM_CAN_Matrix_PT_V600_20250211_a575570e_Rx: CanIfHrhIdSymRef=CanHardwareObject_MCU_01_oATOM_CAN_Matrix_PT_V600_20250211_a575570e_Rx
          CanIfHrhCfg_MCU_02_oATOM_CAN_Matrix_PT_V600_20250211_0c5263e7_Rx: CanIfHrhIdSymRef=CanHardwareObject_MCU_02_oATOM_CAN_Matrix_PT_V600_20250211_0c5263e7_Rx
          CanIfHrhCfg_BMS_status_01_oATOM_CAN_Matrix_PT_V600_20250211_e1a63e78_Rx: CanIfHrhIdSymRef=CanHardwareObject_BMS_status_01_oATOM_CAN_Matrix_PT_V600_20250211_e1a63e78_Rx
          CanIfHrhCfg_BMS_status_02_oATOM_CAN_Matrix_PT_V600_20250211_bc716bc5_Rx: CanIfHrhIdSymRef=CanHardwareObject_BMS_status_02_oATOM_CAN_Matrix_PT_V600_20250211_bc716bc5_Rx
          CanIfHrhCfg_IBS_Status_05_oATOM_CAN_Matrix_PT_V600_20250211_3b732231_Rx: CanIfHrhIdSymRef=CanHardwareObject_IBS_Status_05_oATOM_CAN_Matrix_PT_V600_20250211_3b732231_Rx
          CanIfHrhCfg_IVI_03_oATOM_CAN_Matrix_PT_V600_20250211_d0d400f2_Rx: CanIfHrhIdSymRef=CanHardwareObject_IVI_03_oATOM_CAN_Matrix_PT_V600_20250211_d0d400f2_Rx
        4 x CanIfHthCfg, all with CanIfHthCanCtrlIdRef=CT_ATOM_CAN_Matrix_PT_V600_20250211_08587b03:
          CN_ATOM_CAN_PT_Tx_220h: CanIfHthIdSymRef=CN_ATOM_CAN_PT_Tx_220h
          CN_ATOM_CAN_PT_Tx_221h: CanIfHthIdSymRef=CN_ATOM_CAN_PT_Tx_221h
          CN_ATOM_CAN_PT_Tx_224h: CanIfHthIdSymRef=CN_ATOM_CAN_PT_Tx_224h
          CN_ATOM_CAN_PT_Tx_225h: CanIfHthIdSymRef=CN_ATOM_CAN_PT_Tx_225h
      CHNL_131d55da (CanIfBufferCfg):
        CanIfBufferSize = 14
        CanIfTxBufferHandlingType = FIFO
        CanIfTxBufferMappedTxPdus = 14
        CanIfTxBufferMaxPduLength = 8
        CanIfBufferHthRef = CN_TC37X_VCU_CAN01_70b1f95e_Tx
      VCU_Tx_51Ch_NM_oTC37X_VCU_CAN01_587183bc_Tx (CanIfTxPduCfg):
        CanIfTxPduCanId = 1308
        CanIfTxPduCanIdType = STANDARD_CAN
        CanIfTxPduDlc = 8
        CanIfTxPduUserTxConfirmationName = CanNm_TxConfirmation
        CanIfTxPduUserTxConfirmationUL = CAN_NM
        CanIfTxPduId = 42
        CanIfTxPduReadNotifyStatus = false
        CanIfTxPduType = STATIC
        CanIfTxPduTruncation = true
        CanIfTxPduBufferRef = CHNL_131d55da
        CanIfTxPduRef = VCU_Tx_51Ch_NM_oTC37X_VCU_CAN01_9aba5863_Tx
      4 x CanIfRxPduCfg, all with CanIfRxPduCanIdType=STANDARD_CAN, CanIfRxPduDlc=8, CanIfRxPduReadData=false, CanIfRxPduReadNotifyStatus=false, CanIfRxPduDlcCheck=true:
        VCU_Rx_500h_NM_oTC37X_VCU_CAN01_21ea515e_Rx: CanIfRxPduCanId=1280, CanIfRxPduUserRxIndicationName=CanNm_RxIndication, CanIfRxPduUserRxIndicationUL=CAN_NM, CanIfRxPduId=103, CanIfRxPduHrhIdRef=CN_TC37X_VCU_CAN01_2f90d2fb_Rx, CanIfRxPduRef=VCU_Rx_500h_NM_oTC37X_VCU_CAN01_54a3f814_Rx
        VcuRxMsg4_oTC37X_VCU_CAN01_1d60377a_Rx: CanIfRxPduCanId=515, CanIfRxPduUserRxIndicationName=PduR_CanIfRxIndication, CanIfRxPduUserRxIndicationUL=PDUR, CanIfRxPduId=104, CanIfRxPduHrhIdRef=CN_TC37X_VCU_CAN01_2f90d2fb_Rx, CanIfRxPduRef=VcuRxMsg4_oTC37X_VCU_CAN01_55be06ba_Rx
        VcuRxMsg3_oTC37X_VCU_CAN01_29174725_Rx: CanIfRxPduCanId=514, CanIfRxPduUserRxIndicationName=PduR_CanIfRxIndication, CanIfRxPduUserRxIndicationUL=PDUR, CanIfRxPduId=105, CanIfRxPduHrhIdRef=CN_TC37X_VCU_CAN01_2f90d2fb_Rx, CanIfRxPduRef=VcuRxMsg3_oTC37X_VCU_CAN01_5bb4c01a_Rx
        IBS_APS_oATOM_CANFD_Matrix_CH_V600_202502_85b7a139_Rx: CanIfRxPduCanId=183, CanIfRxPduUserRxIndicationName=PduR_CanIfRxIndication, CanIfRxPduUserRxIndicationUL=PDUR, CanIfRxPduId=14, CanIfRxPduHrhIdRef=CN_ATOM_CANFD_Matrix_CH_V600_202502_64375107_Rx, CanIfRxPduRef=IBS_APS_oATOM_CANFD_Matrix_CH_V600_202502_8feeb71a_Rx
      3 x CanIfTxPduCfg, all with CanIfTxPduDlc=8, CanIfTxPduReadNotifyStatus=false, CanIfTxPduType=STATIC, CanIfTxPduTruncation=true, CanIfTxPduBufferRef=CHNL_785eea40:
        VCU_03_oATOM_CANFD_Matrix_CH_V600_202502_dd165c0d_Tx: CanIfTxPduCanId=546, CanIfTxPduCanIdType=STANDARD_FD_CAN, CanIfTxPduUserTxConfirmationName=NULL_PTR, CanIfTxPduUserTxConfirmationUL=NONE, CanIfTxPduId=6, CanIfTxPduRef=VCU_03_oATOM_CANFD_Matrix_CH_V600_202502_785f8119_Tx
        NM_VCU_oATOM_CANFD_Matrix_CH_V600_202502_4d937c12_Tx: CanIfTxPduCanId=1324, CanIfTxPduCanIdType=STANDARD_CAN, CanIfTxPduUserTxConfirmationName=CanNm_TxConfirmation, CanIfTxPduUserTxConfirmationUL=CAN_NM, CanIfTxPduId=0, CanIfTxPduRef=NM_VCU_oATOM_CANFD_Matrix_CH_V600_202502_7321f2c3_Tx
        VCU_HMIsignals_02_oATOM_CANFD_Matrix_CH_V600_202502_52710e60_Tx: CanIfTxPduCanId=792, CanIfTxPduCanIdType=STANDARD_FD_CAN, CanIfTxPduUserTxConfirmationName=NULL_PTR, CanIfTxPduUserTxConfirmationUL=NONE, CanIfTxPduId=3, CanIfTxPduRef=VCU_HMIsignals_02_oATOM_CANFD_Matrix_CH_V600_202502_343b3975_Tx
      SGW_17_oATOM_CANFD_Matrix_CH_V600_202502_a3accfb6_Rx (CanIfRxPduCfg):
        CanIfRxPduCanId = 850
        CanIfRxPduCanIdType = STANDARD_CAN
        CanIfRxPduDlc = 8
        CanIfRxPduUserRxIndicationName = PduR_CanIfRxIndication
        CanIfRxPduUserRxIndicationUL = PDUR
        CanIfRxPduId = 1
        CanIfRxPduReadData = false
        CanIfRxPduReadNotifyStatus = false
        CanIfRxPduDlcCheck = true
        CanIfRxPduHrhIdRef = CN_ATOM_CANFD_Matrix_CH_V600_202502_64375107_Rx
        CanIfRxPduRef = SGW_17_oATOM_CANFD_Matrix_CH_V600_202502_3a9eb4a2_Rx
      VCU_Chassis_01_oATOM_CANFD_Matrix_CH_V600_202502_d9a729e3_Tx (CanIfTxPduCfg):
        CanIfTxPduCanId = 211
        CanIfTxPduCanIdType = STANDARD_FD_CAN
        CanIfTxPduDlc = 8
        CanIfTxPduUserTxConfirmationName = NULL_PTR
        CanIfTxPduUserTxConfirmationUL = NONE
        CanIfTxPduId = 7
        CanIfTxPduReadNotifyStatus = false
        CanIfTxPduType = STATIC
        CanIfTxPduTruncation = true
        CanIfTxPduBufferRef = CHNL_CH_D3h
        CanIfTxPduRef = VCU_Chassis_01_oATOM_CANFD_Matrix_CH_V600_202502_e79830d3_Tx
      IBS_WheelSpeed_02_oATOM_CANFD_Matrix_CH_V600_202502_9a94b166_Rx (CanIfRxPduCfg):
        CanIfRxPduCanId = 177
        CanIfRxPduCanIdType = STANDARD_CAN
        CanIfRxPduDlc = 8
        CanIfRxPduUserRxIndicationName = PduR_CanIfRxIndication
        CanIfRxPduUserRxIndicationUL = PDUR
        CanIfRxPduId = 18
        CanIfRxPduReadData = false
        CanIfRxPduReadNotifyStatus = false
        CanIfRxPduDlcCheck = true
        CanIfRxPduHrhIdRef = CN_ATOM_CANFD_Matrix_CH_V600_202502_64375107_Rx
        CanIfRxPduRef = IBS_WheelSpeed_02_oATOM_CANFD_Matrix_CH_V600_202502_54b7c66f_Rx
      VCU_HMIsignals_01_oATOM_CANFD_Matrix_CH_V600_202502_d2142187_Tx (CanIfTxPduCfg):
        CanIfTxPduCanId = 791
        CanIfTxPduCanIdType = STANDARD_FD_CAN
        CanIfTxPduDlc = 8
        CanIfTxPduUserTxConfirmationName = NULL_PTR
        CanIfTxPduUserTxConfirmationUL = NONE
        CanIfTxPduId = 4
        CanIfTxPduReadNotifyStatus = false
        CanIfTxPduType = STATIC
        CanIfTxPduTruncation = true
        CanIfTxPduBufferRef = CHNL_785eea40
        CanIfTxPduRef = VCU_HMIsignals_01_oATOM_CANFD_Matrix_CH_V600_202502_ad7bde1a_Tx
      VCU_42a243c5_Rx (CanIfRxPduCfg):
        CanIfRxPduCanIdType = STANDARD_CAN
        CanIfRxPduDlc = 8
        CanIfRxPduUserRxIndicationName = CanNm_RxIndication
        CanIfRxPduUserRxIndicationUL = CAN_NM
        CanIfRxPduId = 0
        CanIfRxPduReadData = false
        CanIfRxPduReadNotifyStatus = false
        CanIfRxPduDlcCheck = true
        CanIfRxPduHrhIdRef = CN_ATOM_CANFD_Matrix_CH_V600_202502_64375107_Rx
        CanIfRxPduRef = VCU_3966faea_Rx
        CHNL_9f084fc6 (CanIfRxPduCanIdRange): CanIfRxPduCanIdRangeLowerCanId=1280, CanIfRxPduCanIdRangeUpperCanId=1407
      ADCU_DA_oATOM_CANFD_Matrix_CH_V600_202502_006b7786_Rx (CanIfRxPduCfg):
        CanIfRxPduCanId = 230
        CanIfRxPduCanIdType = STANDARD_CAN
        CanIfRxPduDlc = 8
        CanIfRxPduUserRxIndicationName = PduR_CanIfRxIndication
        CanIfRxPduUserRxIndicationUL = PDUR
        CanIfRxPduId = 6
        CanIfRxPduReadData = false
        CanIfRxPduReadNotifyStatus = false
        CanIfRxPduDlcCheck = true
        CanIfRxPduHrhIdRef = CN_ATOM_CANFD_Matrix_CH_V600_202502_64375107_Rx
        CanIfRxPduRef = ADCU_DA_oATOM_CANFD_Matrix_CH_V600_202502_8a75132b_Rx
      VCU_02_oATOM_CANFD_Matrix_CH_V600_202502_ba0b4faa_Tx (CanIfTxPduCfg):
        CanIfTxPduCanId = 793
        CanIfTxPduCanIdType = STANDARD_FD_CAN
        CanIfTxPduDlc = 8
        CanIfTxPduUserTxConfirmationName = NULL_PTR
        CanIfTxPduUserTxConfirmationUL = NONE
        CanIfTxPduId = 2
        CanIfTxPduReadNotifyStatus = false
        CanIfTxPduType = STATIC
        CanIfTxPduTruncation = true
        CanIfTxPduBufferRef = CHNL_785eea40
        CanIfTxPduRef = VCU_02_oATOM_CANFD_Matrix_CH_V600_202502_b9b0de03_Tx
      IBS_Status_01_oATOM_CANFD_Matrix_CH_V600_202502_efd7d15c_Rx (CanIfRxPduCfg):
        CanIfRxPduCanId = 178
        CanIfRxPduCanIdType = STANDARD_CAN
        CanIfRxPduDlc = 8
        CanIfRxPduUserRxIndicationName = PduR_CanIfRxIndication
        CanIfRxPduUserRxIndicationUL = PDUR
        CanIfRxPduId = 17
        CanIfRxPduReadData = false
        CanIfRxPduReadNotifyStatus = false
        CanIfRxPduDlcCheck = true
        CanIfRxPduHrhIdRef = CN_ATOM_CANFD_Matrix_CH_V600_202502_64375107_Rx
        CanIfRxPduRef = IBS_Status_01_oATOM_CANFD_Matrix_CH_V600_202502_acfe14e2_Rx
      ACU_info_oATOM_CANFD_Matrix_CH_V600_202502_3a26f0a5_Rx (CanIfRxPduCfg):
        CanIfRxPduCanId = 151
        CanIfRxPduCanIdType = STANDARD_CAN
        CanIfRxPduDlc = 8
        CanIfRxPduUserRxIndicationName = PduR_CanIfRxIndication
        CanIfRxPduUserRxIndicationUL = PDUR
        CanIfRxPduId = 20
        CanIfRxPduReadData = false
        CanIfRxPduReadNotifyStatus = false
        CanIfRxPduDlcCheck = true
        CanIfRxPduHrhIdRef = CN_ATOM_CANFD_Matrix_CH_V600_202502_64375107_Rx
        CanIfRxPduRef = ACU_info_oATOM_CANFD_Matrix_CH_V600_202502_83006605_Rx
      VCU_04_oATOM_CANFD_Matrix_CH_V600_202502_33342039_Tx (CanIfTxPduCfg):
        CanIfTxPduCanId = 547
        CanIfTxPduCanIdType = STANDARD_FD_CAN
        CanIfTxPduDlc = 8
        CanIfTxPduUserTxConfirmationName = NULL_PTR
        CanIfTxPduUserTxConfirmationUL = NONE
        CanIfTxPduId = 5
        CanIfTxPduReadNotifyStatus = false
        CanIfTxPduType = STATIC
        CanIfTxPduTruncation = true
        CanIfTxPduBufferRef = CHNL_785eea40
        CanIfTxPduRef = VCU_04_oATOM_CANFD_Matrix_CH_V600_202502_5040169c_Tx
      ACU_02_oATOM_CANFD_Matrix_CH_V600_202502_013f48ab_Rx (CanIfRxPduCfg):
        CanIfRxPduCanId = 246
        CanIfRxPduCanIdType = STANDARD_CAN
        CanIfRxPduDlc = 8
        CanIfRxPduUserRxIndicationName = PduR_CanIfRxIndication
        CanIfRxPduUserRxIndicationUL = PDUR
        CanIfRxPduId = 3
        CanIfRxPduReadData = false
        CanIfRxPduReadNotifyStatus = false
        CanIfRxPduDlcCheck = true
        CanIfRxPduHrhIdRef = CN_ATOM_CANFD_Matrix_CH_V600_202502_64375107_Rx
        CanIfRxPduRef = ACU_02_oATOM_CANFD_Matrix_CH_V600_202502_8a035e80_Rx
      VCU_AccPedal_oATOM_CANFD_Matrix_CH_V600_202502_6e926372_Tx (CanIfTxPduCfg):
        CanIfTxPduCanId = 210
        CanIfTxPduCanIdType = STANDARD_FD_CAN
        CanIfTxPduDlc = 8
        CanIfTxPduUserTxConfirmationName = NULL_PTR
        CanIfTxPduUserTxConfirmationUL = NONE
        CanIfTxPduId = 8
        CanIfTxPduReadNotifyStatus = false
        CanIfTxPduType = STATIC
        CanIfTxPduTruncation = true
        CanIfTxPduBufferRef = CHNL_CH_D2h
        CanIfTxPduRef = VCU_AccPedal_oATOM_CANFD_Matrix_CH_V600_202502_3cf928f4_Tx
      VCU_IBS_01_oATOM_CANFD_Matrix_CH_V600_202502_7a39d019_Tx (CanIfTxPduCfg):
        CanIfTxPduCanId = 148
        CanIfTxPduCanIdType = STANDARD_FD_CAN
        CanIfTxPduDlc = 8
        CanIfTxPduUserTxConfirmationName = NULL_PTR
        CanIfTxPduUserTxConfirmationUL = NONE
        CanIfTxPduId = 11
        CanIfTxPduReadNotifyStatus = false
        CanIfTxPduType = STATIC
        CanIfTxPduTruncation = true
        CanIfTxPduBufferRef = CHNL_CH_94h
        CanIfTxPduRef = VCU_IBS_01_oATOM_CANFD_Matrix_CH_V600_202502_72f519e8_Tx
      3 x CanIfRxPduCfg, all with CanIfRxPduCanIdType=STANDARD_CAN, CanIfRxPduDlc=8, CanIfRxPduUserRxIndicationName=PduR_CanIfRxIndication, CanIfRxPduUserRxIndicationUL=PDUR, CanIfRxPduReadData=false, CanIfRxPduReadNotifyStatus=false, CanIfRxPduDlcCheck=true, CanIfRxPduHrhIdRef=CN_ATOM_CANFD_Matrix_CH_V600_202502_64375107_Rx:
        IBS_ACC_oATOM_CANFD_Matrix_CH_V600_202502_bc049b13_Rx: CanIfRxPduCanId=184, CanIfRxPduId=13, CanIfRxPduRef=IBS_ACC_oATOM_CANFD_Matrix_CH_V600_202502_205c1446_Rx
        IBS_VCU_MotorControl_oATOM_CANFD_Matrix_CH_V600_202502_0ce6310f_Rx: CanIfRxPduCanId=144, CanIfRxPduId=21, CanIfRxPduRef=IBS_VCU_MotorControl_oATOM_CANFD_Matrix_CH_V600_202502_df4c437b_Rx
        IBS_Status_06_oATOM_CANFD_Matrix_CH_V600_202502_d61b4b72_Rx: CanIfRxPduCanId=188, CanIfRxPduId=10, CanIfRxPduRef=IBS_Status_06_oATOM_CANFD_Matrix_CH_V600_202502_84e18367_Rx
      CHNL_785eea40 (CanIfBufferCfg):
        CanIfBufferSize = 10
        CanIfTxBufferHandlingType = FIFO
        CanIfTxBufferMappedTxPdus = 7
        CanIfTxBufferMaxPduLength = 8
        CanIfBufferHthRef = CN_ATOM_CANFD_Matrix_CH_V600_202502_a4d436ac_Tx
      ADCU_APS_02_oATOM_CANFD_Matrix_CH_V600_202502_4e07b11c_Rx (CanIfRxPduCfg):
        CanIfRxPduCanId = 525
        CanIfRxPduCanIdType = STANDARD_CAN
        CanIfRxPduDlc = 8
        CanIfRxPduUserRxIndicationName = PduR_CanIfRxIndication
        CanIfRxPduUserRxIndicationUL = PDUR
        CanIfRxPduId = 2
        CanIfRxPduReadData = false
        CanIfRxPduReadNotifyStatus = false
        CanIfRxPduDlcCheck = true
        CanIfRxPduHrhIdRef = CN_ATOM_CANFD_Matrix_CH_V600_202502_64375107_Rx
        CanIfRxPduRef = ADCU_APS_02_oATOM_CANFD_Matrix_CH_V600_202502_599b516e_Rx
      VCU_BMS_oATOM_CANFD_Matrix_CH_V600_202502_f1d5756e_Tx (CanIfTxPduCfg):
        CanIfTxPduCanId = 209
        CanIfTxPduCanIdType = STANDARD_FD_CAN
        CanIfTxPduDlc = 8
        CanIfTxPduUserTxConfirmationName = NULL_PTR
        CanIfTxPduUserTxConfirmationUL = NONE
        CanIfTxPduId = 9
        CanIfTxPduReadNotifyStatus = false
        CanIfTxPduType = STATIC
        CanIfTxPduTruncation = true
        CanIfTxPduBufferRef = CHNL_CH_D1h
        CanIfTxPduRef = VCU_BMS_oATOM_CANFD_Matrix_CH_V600_202502_8dd4382b_Tx
      4 x CanIfRxPduCfg, all with CanIfRxPduCanIdType=STANDARD_CAN, CanIfRxPduDlc=8, CanIfRxPduUserRxIndicationName=PduR_CanIfRxIndication, CanIfRxPduUserRxIndicationUL=PDUR, CanIfRxPduReadData=false, CanIfRxPduReadNotifyStatus=false, CanIfRxPduDlcCheck=true, CanIfRxPduHrhIdRef=CN_ATOM_CANFD_Matrix_CH_V600_202502_64375107_Rx:
        IBS_WheelSpeed_01_oATOM_CANFD_Matrix_CH_V600_202502_1af19e81_Rx: CanIfRxPduCanId=176, CanIfRxPduId=19, CanIfRxPduRef=IBS_WheelSpeed_01_oATOM_CANFD_Matrix_CH_V600_202502_cdf72100_Rx
        IBS_Status_02_oATOM_CANFD_Matrix_CH_V600_202502_b20084e1_Rx: CanIfRxPduCanId=179, CanIfRxPduId=16, CanIfRxPduRef=IBS_Status_02_oATOM_CANFD_Matrix_CH_V600_202502_35bef38d_Rx
        IBS_Status_03_oATOM_CANFD_Matrix_CH_V600_202502_3062b5b5_Rx: CanIfRxPduCanId=180, CanIfRxPduId=15, CanIfRxPduRef=IBS_Status_03_oATOM_CANFD_Matrix_CH_V600_202502_f451ac97_Rx
        ADCU_ACC_02_oATOM_CANFD_Matrix_CH_V600_202502_c4c0c3b8_Rx: CanIfRxPduCanId=224, CanIfRxPduId=9, CanIfRxPduRef=ADCU_ACC_02_oATOM_CANFD_Matrix_CH_V600_202502_9c78bb9f_Rx
      VCU_MCU_03_oATOM_CANFD_Matrix_CH_V600_202502_033d9a67_Tx (CanIfTxPduCfg):
        CanIfTxPduCanId = 149
        CanIfTxPduCanIdType = STANDARD_FD_CAN
        CanIfTxPduDlc = 8
        CanIfTxPduUserTxConfirmationName = NULL_PTR
        CanIfTxPduUserTxConfirmationUL = NONE
        CanIfTxPduId = 10
        CanIfTxPduReadNotifyStatus = false
        CanIfTxPduType = STATIC
        CanIfTxPduTruncation = true
        CanIfTxPduBufferRef = CHNL_CH_95h
        CanIfTxPduRef = VCU_MCU_03_oATOM_CANFD_Matrix_CH_V600_202502_9c2fbb06_Tx
      IBS_Status_04_oATOM_CANFD_Matrix_CH_V600_202502_09ae2f9b_Rx (CanIfRxPduCfg):
        CanIfRxPduCanId = 186
        CanIfRxPduCanIdType = STANDARD_CAN
        CanIfRxPduDlc = 8
        CanIfRxPduUserRxIndicationName = PduR_CanIfRxIndication
        CanIfRxPduUserRxIndicationUL = PDUR
        CanIfRxPduId = 11
        CanIfRxPduReadData = false
        CanIfRxPduReadNotifyStatus = false
        CanIfRxPduDlcCheck = true
        CanIfRxPduHrhIdRef = CN_ATOM_CANFD_Matrix_CH_V600_202502_64375107_Rx
        CanIfRxPduRef = IBS_Status_04_oATOM_CANFD_Matrix_CH_V600_202502_dc4e3b12_Rx
      VCU_PlugInChrgInfo_oATOM_CANFD_Matrix_CH_V600_202502_bd173cc2_Tx (CanIfTxPduCfg):
        CanIfTxPduCanId = 913
        CanIfTxPduCanIdType = STANDARD_FD_CAN
        CanIfTxPduDlc = 8
        CanIfTxPduUserTxConfirmationName = NULL_PTR
        CanIfTxPduUserTxConfirmationUL = NONE
        CanIfTxPduId = 1
        CanIfTxPduReadNotifyStatus = false
        CanIfTxPduType = STATIC
        CanIfTxPduTruncation = true
        CanIfTxPduBufferRef = CHNL_785eea40
        CanIfTxPduRef = VCU_PlugInChrgInfo_oATOM_CANFD_Matrix_CH_V600_202502_f8a23add_Tx
      4 x CanIfRxPduCfg, all with CanIfRxPduCanIdType=STANDARD_CAN, CanIfRxPduDlc=8, CanIfRxPduUserRxIndicationName=PduR_CanIfRxIndication, CanIfRxPduUserRxIndicationUL=PDUR, CanIfRxPduReadData=false, CanIfRxPduReadNotifyStatus=false, CanIfRxPduDlcCheck=true, CanIfRxPduHrhIdRef=CN_ATOM_CANFD_Matrix_CH_V600_202502_64375107_Rx:
        ADCU_AEB_01_oATOM_CANFD_Matrix_CH_V600_202502_112d0569_Rx: CanIfRxPduCanId=226, CanIfRxPduId=8, CanIfRxPduRef=ADCU_AEB_01_oATOM_CANFD_Matrix_CH_V600_202502_aeea498e_Rx
        ACU_01_oATOM_CANFD_Matrix_CH_V600_202502_a8187c42_Rx: CanIfRxPduCanId=245, CanIfRxPduId=4, CanIfRxPduRef=ACU_01_oATOM_CANFD_Matrix_CH_V600_202502_1343b9ef_Rx
        IBS_Torque_oATOM_CANFD_Matrix_CH_V600_202502_859bc039_Rx: CanIfRxPduCanId=185, CanIfRxPduId=12, CanIfRxPduRef=IBS_Torque_oATOM_CANFD_Matrix_CH_V600_202502_94259583_Rx
        ADCU_APS_01_oATOM_CANFD_Matrix_CH_V600_202502_49d00f95_Rx: CanIfRxPduCanId=228, CanIfRxPduId=7, CanIfRxPduRef=ADCU_APS_01_oATOM_CANFD_Matrix_CH_V600_202502_c0dbb601_Rx
      CHNL_CH_94h (CanIfBufferCfg):
        CanIfBufferSize = 0
        CanIfTxBufferHandlingType = NONE
        CanIfTxBufferMappedTxPdus = 1
        CanIfTxBufferMaxPduLength = 8
        CanIfBufferHthRef = CN_ATOM_CANFD_Matrix_CH_Tx_94h
      CHNL_CH_95h (CanIfBufferCfg):
        CanIfBufferSize = 0
        CanIfTxBufferHandlingType = NONE
        CanIfTxBufferMappedTxPdus = 1
        CanIfTxBufferMaxPduLength = 8
        CanIfBufferHthRef = CN_ATOM_CANFD_Matrix_CH_Tx_95h
      12 x CanIfTxPduCfg, all with CanIfTxPduCanIdType=STANDARD_CAN, CanIfTxPduDlc=8, CanIfTxPduUserTxConfirmationName=NULL_PTR, CanIfTxPduUserTxConfirmationUL=NONE, CanIfTxPduReadNotifyStatus=false, CanIfTxPduType=STATIC, CanIfTxPduTruncation=true, CanIfTxPduBufferRef=CHNL_131d55da:
        VcuAdcTxG3Msg1_oTC37X_VCU_CAN01_6e9c9e8d_Tx: CanIfTxPduCanId=265, CanIfTxPduId=48, CanIfTxPduRef=VcuAdcTxG3Msg1_oTC37X_VCU_CAN01_f4df30a9_Tx
        VcuAdcTxG1Msg0_oTC37X_VCU_CAN01_987e20b2_Tx: CanIfTxPduCanId=260, CanIfTxPduId=53, CanIfTxPduRef=VcuAdcTxG1Msg0_oTC37X_VCU_CAN01_613ed098_Tx
        VcuAdcTxG0Msg0_oTC37X_VCU_CAN01_fc783169_Tx: CanIfTxPduCanId=258, CanIfTxPduId=55, CanIfTxPduRef=VcuAdcTxG0Msg0_oTC37X_VCU_CAN01_0847dbfd_Tx
        VcuAdcTxG1Msg1_oTC37X_VCU_CAN01_a690bd3b_Tx: CanIfTxPduCanId=261, CanIfTxPduId=52, CanIfTxPduRef=VcuAdcTxG1Msg1_oTC37X_VCU_CAN01_262d2663_Tx
        VcuAdcTxG8Msg3_oTC37X_VCU_CAN01_299915a8_Tx: CanIfTxPduCanId=269, CanIfTxPduId=44, CanIfTxPduRef=VcuAdcTxG8Msg3_oTC37X_VCU_CAN01_3c59975a_Tx
        VcuAdcTxG8Msg1_oTC37X_VCU_CAN01_54442eba_Tx: CanIfTxPduCanId=267, CanIfTxPduId=46, CanIfTxPduRef=VcuAdcTxG8Msg1_oTC37X_VCU_CAN01_b27e7aac_Tx
        VcuAdcTxG3Msg0_oTC37X_VCU_CAN01_50720304_Tx: CanIfTxPduCanId=264, CanIfTxPduId=49, CanIfTxPduRef=VcuAdcTxG3Msg0_oTC37X_VCU_CAN01_b3ccc652_Tx
        VcuAdcTxG8Msg0_oTC37X_VCU_CAN01_6aaab333_Tx: CanIfTxPduCanId=266, CanIfTxPduId=47, CanIfTxPduRef=VcuAdcTxG8Msg0_oTC37X_VCU_CAN01_f56d8c57_Tx
        VcuAdcTxG8Msg2_oTC37X_VCU_CAN01_17778821_Tx: CanIfTxPduCanId=268, CanIfTxPduId=45, CanIfTxPduRef=VcuAdcTxG8Msg2_oTC37X_VCU_CAN01_7b4a61a1_Tx
        VcuAdcTxG2Msg0_oTC37X_VCU_CAN01_347412df_Tx: CanIfTxPduCanId=262, CanIfTxPduId=51, CanIfTxPduRef=VcuAdcTxG2Msg0_oTC37X_VCU_CAN01_dab5cd37_Tx
        VcuAdcTxG2Msg1_oTC37X_VCU_CAN01_0a9a8f56_Tx: CanIfTxPduCanId=263, CanIfTxPduId=50, CanIfTxPduRef=VcuAdcTxG2Msg1_oTC37X_VCU_CAN01_9da63bcc_Tx
        VcuAdcTxG0Msg1_oTC37X_VCU_CAN01_c296ace0_Tx: CanIfTxPduCanId=259, CanIfTxPduId=54, CanIfTxPduRef=VcuAdcTxG0Msg1_oTC37X_VCU_CAN01_4f542d06_Tx
      3 x CanIfRxPduCfg, all with CanIfRxPduCanIdType=STANDARD_CAN, CanIfRxPduDlc=8, CanIfRxPduUserRxIndicationName=PduR_CanIfRxIndication, CanIfRxPduUserRxIndicationUL=PDUR, CanIfRxPduReadData=false, CanIfRxPduReadNotifyStatus=false, CanIfRxPduDlcCheck=true, CanIfRxPduHrhIdRef=CN_TC37X_VCU_CAN01_2f90d2fb_Rx:
        VcuRxCtrlMsg0_oTC37X_VCU_CAN01_6f777a62_Rx: CanIfRxPduCanId=270, CanIfRxPduId=108, CanIfRxPduRef=VcuRxCtrlMsg0_oTC37X_VCU_CAN01_3715838b_Rx
        VcuRxCtrlMsg1_oTC37X_VCU_CAN01_989a1812_Rx: CanIfRxPduCanId=271, CanIfRxPduId=107, CanIfRxPduRef=VcuRxCtrlMsg1_oTC37X_VCU_CAN01_70067570_Rx
        VcuRxCtrlMsg2_oTC37X_VCU_CAN01_5bdcb8c3_Rx: CanIfRxPduCanId=272, CanIfRxPduId=106, CanIfRxPduRef=VcuRxCtrlMsg2_oTC37X_VCU_CAN01_b9326e7d_Rx
      VcuMeasurementMsg0_oTC37X_VCU_CAN01_b3a7d237_Tx (CanIfTxPduCfg):
        CanIfTxPduCanId = 273
        CanIfTxPduCanIdType = STANDARD_CAN
        CanIfTxPduDlc = 8
        CanIfTxPduUserTxConfirmationName = NULL_PTR
        CanIfTxPduUserTxConfirmationUL = NONE
        CanIfTxPduId = 43
        CanIfTxPduReadNotifyStatus = false
        CanIfTxPduType = STATIC
        CanIfTxPduTruncation = true
        CanIfTxPduBufferRef = CHNL_131d55da
        CanIfTxPduRef = VcuMeasurementMsg0_oTC37X_VCU_CAN01_d96481d0_Tx
      CGW_VIN1_oATOM_CAN_Matrix_PT_V600_20250211_43fd203c_Rx (CanIfRxPduCfg):
        CanIfRxPduCanId = 896
        CanIfRxPduCanIdType = STANDARD_CAN
        CanIfRxPduDlc = 8
        CanIfRxPduUserRxIndicationName = PduR_CanIfRxIndication
        CanIfRxPduUserRxIndicationUL = PDUR
        CanIfRxPduId = 42
        CanIfRxPduReadData = false
        CanIfRxPduReadNotifyStatus = false
        CanIfRxPduDlcCheck = true
        CanIfRxPduHrhIdRef = CN_ATOM_CAN_Matrix_PT_V600_20250211_bde8b0ce_Rx
        CanIfRxPduRef = CGW_VIN1_oATOM_CAN_Matrix_PT_V600_20250211_a569c65a_Rx
      EVCOM_State_01_oATOM_CAN_Matrix_PT_V600_20250211_fae06f9a_Rx (CanIfRxPduCfg):
        CanIfRxPduCanId = 614
        CanIfRxPduCanIdType = STANDARD_CAN
        CanIfRxPduDlc = 8
        CanIfRxPduUserRxIndicationName = PduR_CanIfRxIndication
        CanIfRxPduUserRxIndicationUL = PDUR
        CanIfRxPduId = 61
        CanIfRxPduReadData = false
        CanIfRxPduReadNotifyStatus = false
        CanIfRxPduDlcCheck = true
        CanIfRxPduHrhIdRef = CN_ATOM_CAN_Matrix_PT_V600_20250211_bde8b0ce_Rx
        CanIfRxPduRef = EVCOM_State_01_oATOM_CAN_Matrix_PT_V600_20250211_14a0a5cc_Rx
      DiagResp_VCU_OBD_Tp_oATOM_CAN_Matrix_PT_V600_20250211_56f96c78_Tx (CanIfTxPduCfg):
        CanIfTxPduCanId = 2024
        CanIfTxPduCanIdType = STANDARD_CAN
        CanIfTxPduDlc = 8
        CanIfTxPduUserTxConfirmationName = CanTp_TxConfirmation
        CanIfTxPduUserTxConfirmationUL = CAN_TP
        CanIfTxPduId = 12
        CanIfTxPduReadNotifyStatus = false
        CanIfTxPduType = STATIC
        CanIfTxPduTruncation = true
        CanIfTxPduBufferRef = CHNL_beb59c29
        CanIfTxPduRef = DiagResp_VCU_OBD_Tp_oATOM_CAN_Matrix_PT_V600_20250211_09b7b9b1_Tx
      5 x CanIfRxPduCfg, all with CanIfRxPduCanIdType=STANDARD_CAN, CanIfRxPduDlc=8, CanIfRxPduUserRxIndicationName=PduR_CanIfRxIndication, CanIfRxPduUserRxIndicationUL=PDUR, CanIfRxPduReadData=false, CanIfRxPduReadNotifyStatus=false, CanIfRxPduDlcCheck=true, CanIfRxPduHrhIdRef=CN_ATOM_CAN_Matrix_PT_V600_20250211_bde8b0ce_Rx:
        BMS_BatInfor_03_oATOM_CAN_Matrix_PT_V600_20250211_3dc51a58_Rx: CanIfRxPduCanId=938, CanIfRxPduId=32, CanIfRxPduRef=BMS_BatInfor_03_oATOM_CAN_Matrix_PT_V600_20250211_cd43c7b3_Rx
        BMS_status_04_oATOM_CAN_Matrix_PT_V600_20250211_07dfc0bf_Rx: CanIfRxPduCanId=533, CanIfRxPduId=81, CanIfRxPduRef=BMS_status_04_oATOM_CAN_Matrix_PT_V600_20250211_861a70a5_Rx
        CGW_VIN2_oATOM_CAN_Matrix_PT_V600_20250211_76badae8_Rx: CanIfRxPduCanId=897, CanIfRxPduId=41, CanIfRxPduRef=CGW_VIN2_oATOM_CAN_Matrix_PT_V600_20250211_3c292135_Rx
        POD_DCDC_02_oATOM_CAN_Matrix_PT_V600_20250211_04706390_Rx: CanIfRxPduCanId=770, CanIfRxPduId=49, CanIfRxPduRef=POD_DCDC_02_oATOM_CAN_Matrix_PT_V600_20250211_07124be6_Rx
        BMS_Charge_01_oATOM_CAN_Matrix_PT_V600_20250211_070f7ad1_Rx: CanIfRxPduCanId=530, CanIfRxPduId=84, CanIfRxPduRef=BMS_Charge_01_oATOM_CAN_Matrix_PT_V600_20250211_7145a374_Rx
      VCU_02_oATOM_CAN_Matrix_PT_V600_20250211_d64c1292_Tx (CanIfTxPduCfg):
        CanIfTxPduCanId = 793
        CanIfTxPduCanIdType = STANDARD_CAN
        CanIfTxPduDlc = 8
        CanIfTxPduUserTxConfirmationName = NULL_PTR
        CanIfTxPduUserTxConfirmationUL = NONE
        CanIfTxPduId = 18
        CanIfTxPduReadNotifyStatus = false
        CanIfTxPduType = STATIC
        CanIfTxPduTruncation = true
        CanIfTxPduBufferRef = CHNL_beb59c29
        CanIfTxPduRef = VCU_02_oATOM_CAN_Matrix_PT_V600_20250211_dc79618a_Tx
      MCU_DeratingStatus_oATOM_CAN_Matrix_PT_V600_20250211_013e3848_Rx (CanIfRxPduCfg):
        CanIfRxPduCanId = 594
        CanIfRxPduCanIdType = STANDARD_CAN
        CanIfRxPduDlc = 8
        CanIfRxPduUserRxIndicationName = PduR_CanIfRxIndication
        CanIfRxPduUserRxIndicationUL = PDUR
        CanIfRxPduId = 66
        CanIfRxPduReadData = false
        CanIfRxPduReadNotifyStatus = false
        CanIfRxPduDlcCheck = true
        CanIfRxPduHrhIdRef = CN_ATOM_CAN_Matrix_PT_V600_20250211_bde8b0ce_Rx
        CanIfRxPduRef = MCU_DeratingStatus_oATOM_CAN_Matrix_PT_V600_20250211_de507b38_Rx
      POD_DCDC_01_oATOM_CAN_Matrix_PT_V600_20250211_03a7dd19_Rx (CanIfRxPduCfg):
        CanIfRxPduCanId = 578
        CanIfRxPduCanIdType = STANDARD_CAN
        CanIfRxPduDlc = 8
        CanIfRxPduUserRxIndicationName = PduR_CanIfRxIndication
        CanIfRxPduUserRxIndicationUL = PDUR
        CanIfRxPduId = 71
        CanIfRxPduReadData = false
        CanIfRxPduReadNotifyStatus = false
        CanIfRxPduDlcCheck = true
        CanIfRxPduHrhIdRef = CN_ATOM_CAN_Matrix_PT_V600_20250211_bde8b0ce_Rx
        CanIfRxPduRef = POD_DCDC_01_oATOM_CAN_Matrix_PT_V600_20250211_9e52ac89_Rx
      NM_VCU_oATOM_CAN_Matrix_PT_V600_20250211_21d4212a_Tx (CanIfTxPduCfg):
        CanIfTxPduCanId = 1324
        CanIfTxPduCanIdType = STANDARD_CAN
        CanIfTxPduDlc = 8
        CanIfTxPduUserTxConfirmationName = CanNm_TxConfirmation
        CanIfTxPduUserTxConfirmationUL = CAN_NM
        CanIfTxPduId = 15
        CanIfTxPduReadNotifyStatus = false
        CanIfTxPduType = STATIC
        CanIfTxPduTruncation = true
        CanIfTxPduBufferRef = CHNL_beb59c29
        CanIfTxPduRef = NM_VCU_oATOM_CAN_Matrix_PT_V600_20250211_16e84d4a_Tx
      POD_OBC_CHRGSTATION_oATOM_CAN_Matrix_PT_V600_20250211_386be088_Rx (CanIfRxPduCfg):
        CanIfRxPduCanId = 581
        CanIfRxPduCanIdType = STANDARD_CAN
        CanIfRxPduDlc = 8
        CanIfRxPduUserRxIndicationName = PduR_CanIfRxIndication
        CanIfRxPduUserRxIndicationUL = PDUR
        CanIfRxPduId = 69
        CanIfRxPduReadData = false
        CanIfRxPduReadNotifyStatus = false
        CanIfRxPduDlcCheck = true
        CanIfRxPduHrhIdRef = CN_ATOM_CAN_Matrix_PT_V600_20250211_bde8b0ce_Rx
        CanIfRxPduRef = POD_OBC_CHRGSTATION_oATOM_CAN_Matrix_PT_V600_20250211_df8ecd71_Rx
      VCU_SynReq_01_oATOM_CAN_Matrix_PT_V600_20250211_59ebe7dd_Tx (CanIfTxPduCfg):
        CanIfTxPduCanId = 319
        CanIfTxPduCanIdType = STANDARD_CAN
        CanIfTxPduDlc = 8
        CanIfTxPduUserTxConfirmationName = NULL_PTR
        CanIfTxPduUserTxConfirmationUL = NONE
        CanIfTxPduId = 20
        CanIfTxPduReadNotifyStatus = false
        CanIfTxPduType = STATIC
        CanIfTxPduTruncation = true
        CanIfTxPduBufferRef = CHNL_beb59c29
        CanIfTxPduRef = VCU_SynReq_01_oATOM_CAN_Matrix_PT_V600_20250211_fde06b01_Tx
      IVI_03_oATOM_CAN_Matrix_PT_V600_20250211_d0d400f2_Rx (CanIfRxPduCfg):
        CanIfRxPduCanId = 249
        CanIfRxPduCanIdType = STANDARD_CAN
        CanIfRxPduDlc = 8
        CanIfRxPduUserRxIndicationName = PduR_CanIfRxIndication
        CanIfRxPduUserRxIndicationUL = PDUR
        CanIfRxPduId = 86
        CanIfRxPduReadData = false
        CanIfRxPduReadNotifyStatus = false
        CanIfRxPduDlcCheck = true
        CanIfRxPduHrhIdRef = CanIfHrhCfg_IVI_03_oATOM_CAN_Matrix_PT_V600_20250211_d0d400f2_Rx
        CanIfRxPduRef = IVI_03_oATOM_CAN_Matrix_PT_V600_20250211_302b6c18_Rx
      SGW_PT_01_oATOM_CAN_Matrix_PT_V600_20250211_ad5190bf_Rx (CanIfRxPduCfg):
        CanIfRxPduCanId = 693
        CanIfRxPduCanIdType = STANDARD_CAN
        CanIfRxPduDlc = 8
        CanIfRxPduUserRxIndicationName = PduR_CanIfRxIndication
        CanIfRxPduUserRxIndicationUL = PDUR
        CanIfRxPduId = 51
        CanIfRxPduReadData = false
        CanIfRxPduReadNotifyStatus = false
        CanIfRxPduDlcCheck = true
        CanIfRxPduHrhIdRef = CN_ATOM_CAN_Matrix_PT_V600_20250211_bde8b0ce_Rx
        CanIfRxPduRef = SGW_PT_01_oATOM_CAN_Matrix_PT_V600_20250211_3c4b1ea4_Rx
      DiagResp_VCU_Tp_oATOM_CAN_Matrix_PT_V600_20250211_81d5a184_Tx (CanIfTxPduCfg):
        CanIfTxPduCanId = 1836
        CanIfTxPduCanIdType = STANDARD_CAN
        CanIfTxPduDlc = 8
        CanIfTxPduUserTxConfirmationName = CanTp_TxConfirmation
        CanIfTxPduUserTxConfirmationUL = CAN_TP
        CanIfTxPduId = 14
        CanIfTxPduReadNotifyStatus = false
        CanIfTxPduType = STATIC
        CanIfTxPduTruncation = true
        CanIfTxPduBufferRef = CHNL_beb59c29
        CanIfTxPduRef = DiagResp_VCU_Tp_oATOM_CAN_Matrix_PT_V600_20250211_17d2a785_Tx
      BMS_VersionInfor_oATOM_CAN_Matrix_PT_V600_20250211_8ca088c6_Rx (CanIfRxPduCfg):
        CanIfRxPduCanId = 932
        CanIfRxPduCanIdType = STANDARD_CAN
        CanIfRxPduDlc = 8
        CanIfRxPduUserRxIndicationName = PduR_CanIfRxIndication
        CanIfRxPduUserRxIndicationUL = PDUR
        CanIfRxPduId = 37
        CanIfRxPduReadData = false
        CanIfRxPduReadNotifyStatus = false
        CanIfRxPduDlcCheck = true
        CanIfRxPduHrhIdRef = CN_ATOM_CAN_Matrix_PT_V600_20250211_bde8b0ce_Rx
        CanIfRxPduRef = BMS_VersionInfor_oATOM_CAN_Matrix_PT_V600_20250211_a6395240_Rx
      TCU_02_oATOM_CAN_Matrix_PT_V600_20250211_70eff9bb_Rx (CanIfRxPduCfg):
        CanIfRxPduCanId = 609
        CanIfRxPduCanIdType = STANDARD_CAN
        CanIfRxPduDlc = 8
        CanIfRxPduUserRxIndicationName = PduR_CanIfRxIndication
        CanIfRxPduUserRxIndicationUL = PDUR
        CanIfRxPduId = 63
        CanIfRxPduReadData = false
        CanIfRxPduReadNotifyStatus = false
        CanIfRxPduDlcCheck = true
        CanIfRxPduHrhIdRef = CN_ATOM_CAN_Matrix_PT_V600_20250211_bde8b0ce_Rx
        CanIfRxPduRef = TCU_02_oATOM_CAN_Matrix_PT_V600_20250211_95cba541_Rx
      VCU_05_oATOM_CAN_Matrix_PT_V600_20250211_386e6ea6_Tx (CanIfTxPduCfg):
        CanIfTxPduCanId = 548
        CanIfTxPduCanIdType = STANDARD_CAN
        CanIfTxPduDlc = 8
        CanIfTxPduUserTxConfirmationName = NULL_PTR
        CanIfTxPduUserTxConfirmationUL = NONE
        CanIfTxPduId = 22
        CanIfTxPduReadNotifyStatus = false
        CanIfTxPduType = STATIC
        CanIfTxPduTruncation = true
        CanIfTxPduBufferRef = CHNL_PT_224h
        CanIfTxPduRef = VCU_05_oATOM_CAN_Matrix_PT_V600_20250211_f466f60f_Tx
      TCU_01_oATOM_CAN_Matrix_PT_V600_20250211_d9c8cd52_Rx (CanIfRxPduCfg):
        CanIfRxPduCanId = 608
        CanIfRxPduCanIdType = STANDARD_CAN
        CanIfRxPduDlc = 8
        CanIfRxPduUserRxIndicationName = PduR_CanIfRxIndication
        CanIfRxPduUserRxIndicationUL = PDUR
        CanIfRxPduId = 64
        CanIfRxPduReadData = false
        CanIfRxPduReadNotifyStatus = false
        CanIfRxPduDlcCheck = true
        CanIfRxPduHrhIdRef = CN_ATOM_CAN_Matrix_PT_V600_20250211_bde8b0ce_Rx
        CanIfRxPduRef = TCU_01_oATOM_CAN_Matrix_PT_V600_20250211_0c8b422e_Rx
      MCU_02_oATOM_CAN_Matrix_PT_V600_20250211_0c5263e7_Rx (CanIfRxPduCfg):
        CanIfRxPduCanId = 243
        CanIfRxPduCanIdType = STANDARD_CAN
        CanIfRxPduDlc = 8
        CanIfRxPduUserRxIndicationName = PduR_CanIfRxIndication
        CanIfRxPduUserRxIndicationUL = PDUR
        CanIfRxPduId = 87
        CanIfRxPduReadData = false
        CanIfRxPduReadNotifyStatus = false
        CanIfRxPduDlcCheck = true
        CanIfRxPduHrhIdRef = CanIfHrhCfg_MCU_02_oATOM_CAN_Matrix_PT_V600_20250211_0c5263e7_Rx
        CanIfRxPduRef = MCU_02_oATOM_CAN_Matrix_PT_V600_20250211_81157df2_Rx
      VCU_MCU_05_oATOM_CAN_Matrix_PT_V600_20250211_ef1d8001_Tx (CanIfTxPduCfg):
        CanIfTxPduCanId = 214
        CanIfTxPduCanIdType = STANDARD_CAN
        CanIfTxPduDlc = 8
        CanIfTxPduUserTxConfirmationName = NULL_PTR
        CanIfTxPduUserTxConfirmationUL = NONE
        CanIfTxPduId = 26
        CanIfTxPduReadNotifyStatus = false
        CanIfTxPduType = STATIC
        CanIfTxPduTruncation = true
        CanIfTxPduBufferRef = CHNL_PT_D6h
        CanIfTxPduRef = VCU_MCU_05_oATOM_CAN_Matrix_PT_V600_20250211_1016cc10_Tx
      VCU_HMIsignals_03_oATOM_CAN_Matrix_PT_V600_20250211_ce5997a6_Tx (CanIfTxPduCfg):
        CanIfTxPduCanId = 795
        CanIfTxPduCanIdType = STANDARD_CAN
        CanIfTxPduDlc = 8
        CanIfTxPduUserTxConfirmationName = NULL_PTR
        CanIfTxPduUserTxConfirmationUL = NONE
        CanIfTxPduId = 17
        CanIfTxPduReadNotifyStatus = false
        CanIfTxPduType = STATIC
        CanIfTxPduTruncation = true
        CanIfTxPduBufferRef = CHNL_beb59c29
        CanIfTxPduRef = VCU_HMIsignals_03_oATOM_CAN_Matrix_PT_V600_20250211_901dd9e6_Tx
      6 x CanIfRxPduCfg, all with CanIfRxPduCanIdType=STANDARD_CAN, CanIfRxPduDlc=8, CanIfRxPduReadData=false, CanIfRxPduReadNotifyStatus=false, CanIfRxPduDlcCheck=true, CanIfRxPduHrhIdRef=CN_ATOM_CAN_Matrix_PT_V600_20250211_bde8b0ce_Rx:
        POD_Status_02_oATOM_CAN_Matrix_PT_V600_20250211_67276c9b_Rx: CanIfRxPduCanId=577, CanIfRxPduUserRxIndicationName=PduR_CanIfRxIndication, CanIfRxPduUserRxIndicationUL=PDUR, CanIfRxPduId=72, CanIfRxPduRef=POD_Status_02_oATOM_CAN_Matrix_PT_V600_20250211_7e4dfbbc_Rx
        PRND_oATOM_CAN_Matrix_PT_V600_20250211_f3f01afb_Rx: CanIfRxPduCanId=584, CanIfRxPduUserRxIndicationName=PduR_CanIfRxIndication, CanIfRxPduUserRxIndicationUL=PDUR, CanIfRxPduId=68, CanIfRxPduRef=PRND_oATOM_CAN_Matrix_PT_V600_20250211_7ae8f154_Rx
        VCU_8f9a5a9f_Rx: CanIfRxPduUserRxIndicationName=CanNm_RxIndication, CanIfRxPduUserRxIndicationUL=CAN_NM, CanIfRxPduId=22, CanIfRxPduRef=VCU_f2fc806b_Rx
          CHNL_3345e5b7 (CanIfRxPduCanIdRange): CanIfRxPduCanIdRangeLowerCanId=1280, CanIfRxPduCanIdRangeUpperCanId=1407
        BMS_PRO_oATOM_CAN_Matrix_PT_V600_20250211_5511d976_Rx: CanIfRxPduCanId=933, CanIfRxPduUserRxIndicationName=PduR_CanIfRxIndication, CanIfRxPduUserRxIndicationUL=PDUR, CanIfRxPduId=36, CanIfRxPduRef=BMS_PRO_oATOM_CAN_Matrix_PT_V600_20250211_925408cc_Rx
        SGW_FVSynchronization_01_oATOM_CAN_Matrix_PT_V600_20250211_1b833339_Rx: CanIfRxPduCanId=960, CanIfRxPduUserRxIndicationName=PduR_CanIfRxIndication, CanIfRxPduUserRxIndicationUL=PDUR, CanIfRxPduId=30, CanIfRxPduRef=SGW_FVSynchronization_01_oATOM_CAN_Matrix_PT_V600_20250211_d9a61796_Rx
        CGW_02_oATOM_CAN_Matrix_PT_V600_20250211_926ea823_Rx: CanIfRxPduCanId=858, CanIfRxPduUserRxIndicationName=PduR_CanIfRxIndication, CanIfRxPduUserRxIndicationUL=PDUR, CanIfRxPduId=43, CanIfRxPduRef=CGW_02_oATOM_CAN_Matrix_PT_V600_20250211_f2411e65_Rx
      3 x CanIfTxPduCfg, all with CanIfTxPduCanIdType=STANDARD_CAN, CanIfTxPduDlc=8, CanIfTxPduUserTxConfirmationName=NULL_PTR, CanIfTxPduUserTxConfirmationUL=NONE, CanIfTxPduReadNotifyStatus=false, CanIfTxPduType=STATIC, CanIfTxPduTruncation=true:
        VCU_DiagInfor_oATOM_CAN_Matrix_PT_V600_20250211_a221e0ee_Tx: CanIfTxPduCanId=1068, CanIfTxPduId=16, CanIfTxPduBufferRef=CHNL_beb59c29, CanIfTxPduRef=VCU_DiagInfor_oATOM_CAN_Matrix_PT_V600_20250211_99a29031_Tx
        VCU_AccPedal_oATOM_CAN_Matrix_PT_V600_20250211_0136bf08_Tx: CanIfTxPduCanId=210, CanIfTxPduId=27, CanIfTxPduBufferRef=CHNL_PT_D2h, CanIfTxPduRef=VCU_AccPedal_oATOM_CAN_Matrix_PT_V600_20250211_5930977d_Tx
        VCU_POD_oATOM_CAN_Matrix_PT_V600_20250211_d17423c6_Tx: CanIfTxPduCanId=289, CanIfTxPduId=25, CanIfTxPduBufferRef=CHNL_PT_121h, CanIfTxPduRef=VCU_POD_oATOM_CAN_Matrix_PT_V600_20250211_bb987d73_Tx
      3 x CanIfRxPduCfg, all with CanIfRxPduCanIdType=STANDARD_CAN, CanIfRxPduDlc=8, CanIfRxPduUserRxIndicationName=PduR_CanIfRxIndication, CanIfRxPduUserRxIndicationUL=PDUR, CanIfRxPduReadData=false, CanIfRxPduReadNotifyStatus=false, CanIfRxPduDlcCheck=true, CanIfRxPduHrhIdRef=CN_ATOM_CAN_Matrix_PT_V600_20250211_bde8b0ce_Rx:
        CGW_VIN3VER_oATOM_CAN_Matrix_PT_V600_20250211_088f7594_Rx: CanIfRxPduCanId=898, CanIfRxPduId=40, CanIfRxPduRef=CGW_VIN3VER_oATOM_CAN_Matrix_PT_V600_20250211_255d67dc_Rx
        IVI_OdometerInfor_oATOM_CAN_Matrix_PT_V600_20250211_24f49b57_Rx: CanIfRxPduCanId=944, CanIfRxPduId=31, CanIfRxPduRef=IVI_OdometerInfor_oATOM_CAN_Matrix_PT_V600_20250211_41b50bfd_Rx
        POD_OBC_STATUS_04_oATOM_CAN_Matrix_PT_V600_20250211_cf7150d5_Rx: CanIfRxPduCanId=585, CanIfRxPduId=67, CanIfRxPduRef=POD_OBC_STATUS_04_oATOM_CAN_Matrix_PT_V600_20250211_c02c654c_Rx
      VCU_MCU_03_oATOM_CAN_Matrix_PT_V600_20250211_a9fa037b_Tx (CanIfTxPduCfg):
        CanIfTxPduCanId = 149
        CanIfTxPduCanIdType = STANDARD_CAN
        CanIfTxPduDlc = 8
        CanIfTxPduUserTxConfirmationName = NULL_PTR
        CanIfTxPduUserTxConfirmationUL = NONE
        CanIfTxPduId = 30
        CanIfTxPduReadNotifyStatus = false
        CanIfTxPduType = STATIC
        CanIfTxPduTruncation = true
        CanIfTxPduBufferRef = CHNL_PT_95h
        CanIfTxPduRef = VCU_MCU_03_oATOM_CAN_Matrix_PT_V600_20250211_f9e6048f_Tx
      3 x CanIfRxPduCfg, all with CanIfRxPduCanIdType=STANDARD_CAN, CanIfRxPduDlc=8, CanIfRxPduUserRxIndicationName=PduR_CanIfRxIndication, CanIfRxPduUserRxIndicationUL=PDUR, CanIfRxPduReadData=false, CanIfRxPduReadNotifyStatus=false, CanIfRxPduDlcCheck=true, CanIfRxPduHrhIdRef=CN_ATOM_CAN_Matrix_PT_V600_20250211_bde8b0ce_Rx:
        BCM_Authentication_oATOM_CAN_Matrix_PT_V600_20250211_dab81413_Rx: CanIfRxPduCanId=820, CanIfRxPduId=45, CanIfRxPduRef=BCM_Authentication_oATOM_CAN_Matrix_PT_V600_20250211_8720645c_Rx
        BMS_CellTemp_oATOM_CAN_Matrix_PT_V600_20250211_dc7716a9_Rx: CanIfRxPduCanId=536, CanIfRxPduId=79, CanIfRxPduRef=BMS_CellTemp_oATOM_CAN_Matrix_PT_V600_20250211_253e5592_Rx
        BCM_11_oATOM_CAN_Matrix_PT_V600_20250211_540aeca8_Rx: CanIfRxPduCanId=626, CanIfRxPduId=59, CanIfRxPduRef=BCM_11_oATOM_CAN_Matrix_PT_V600_20250211_f3ce7274_Rx
      VCU_DCDC_oATOM_CAN_Matrix_PT_V600_20250211_c9a902ae_Tx (CanIfTxPduCfg):
        CanIfTxPduCanId = 544
        CanIfTxPduCanIdType = STANDARD_CAN
        CanIfTxPduDlc = 8
        CanIfTxPduUserTxConfirmationName = NULL_PTR
        CanIfTxPduUserTxConfirmationUL = NONE
        CanIfTxPduId = 24
        CanIfTxPduReadNotifyStatus = false
        CanIfTxPduType = STATIC
        CanIfTxPduTruncation = true
        CanIfTxPduBufferRef = CHNL_PT_220h
        CanIfTxPduRef = VCU_DCDC_oATOM_CAN_Matrix_PT_V600_20250211_2cf6caff_Tx
      5 x CanIfRxPduCfg, all with CanIfRxPduCanIdType=STANDARD_CAN, CanIfRxPduDlc=8, CanIfRxPduUserRxIndicationName=PduR_CanIfRxIndication, CanIfRxPduUserRxIndicationUL=PDUR, CanIfRxPduReadData=false, CanIfRxPduReadNotifyStatus=false, CanIfRxPduDlcCheck=true, CanIfRxPduHrhIdRef=CN_ATOM_CAN_Matrix_PT_V600_20250211_bde8b0ce_Rx:
        BMS_TCU_oATOM_CAN_Matrix_PT_V600_20250211_73bae360_Rx: CanIfRxPduCanId=771, CanIfRxPduId=48, CanIfRxPduRef=BMS_TCU_oATOM_CAN_Matrix_PT_V600_20250211_0825057e_Rx
        BMS_BatInfor_02_oATOM_CAN_Matrix_PT_V600_20250211_c4095af1_Rx: CanIfRxPduCanId=935, CanIfRxPduId=34, CanIfRxPduRef=BMS_BatInfor_02_oATOM_CAN_Matrix_PT_V600_20250211_0cac98a9_Rx
        APTC_TCU_oATOM_CAN_Matrix_PT_V600_20250211_28c64e42_Rx: CanIfRxPduCanId=613, CanIfRxPduId=62, CanIfRxPduRef=APTC_TCU_oATOM_CAN_Matrix_PT_V600_20250211_e759f28b_Rx
        MCU_FailureCode_oATOM_CAN_Matrix_PT_V600_20250211_6e18eae9_Rx: CanIfRxPduCanId=595, CanIfRxPduId=65, CanIfRxPduRef=MCU_FailureCode_oATOM_CAN_Matrix_PT_V600_20250211_51b3e171_Rx
        SGW_01_oATOM_CAN_Matrix_PT_V600_20250211_0e01d645_Rx: CanIfRxPduCanId=572, CanIfRxPduId=74, CanIfRxPduRef=SGW_01_oATOM_CAN_Matrix_PT_V600_20250211_4b04d591_Rx
      VCU_TCU_oATOM_CAN_Matrix_PT_V600_20250211_c350eb20_Tx (CanIfTxPduCfg):
        CanIfTxPduCanId = 545
        CanIfTxPduCanIdType = STANDARD_CAN
        CanIfTxPduDlc = 8
        CanIfTxPduUserTxConfirmationName = NULL_PTR
        CanIfTxPduUserTxConfirmationUL = NONE
        CanIfTxPduId = 23
        CanIfTxPduReadNotifyStatus = false
        CanIfTxPduType = STATIC
        CanIfTxPduTruncation = true
        CanIfTxPduBufferRef = CHNL_PT_221h
        CanIfTxPduRef = VCU_TCU_oATOM_CAN_Matrix_PT_V600_20250211_e6bfcc3d_Tx
      POD_OBC_STATUS_02_oATOM_CAN_Matrix_PT_V600_20250211_14ca095a_Rx (CanIfRxPduCfg):
        CanIfRxPduCanId = 580
        CanIfRxPduCanIdType = STANDARD_CAN
        CanIfRxPduDlc = 8
        CanIfRxPduUserRxIndicationName = PduR_CanIfRxIndication
        CanIfRxPduUserRxIndicationUL = PDUR
        CanIfRxPduId = 70
        CanIfRxPduReadData = false
        CanIfRxPduReadNotifyStatus = false
        CanIfRxPduDlcCheck = true
        CanIfRxPduHrhIdRef = CN_ATOM_CAN_Matrix_PT_V600_20250211_bde8b0ce_Rx
        CanIfRxPduRef = POD_OBC_STATUS_02_oATOM_CAN_Matrix_PT_V600_20250211_29dcadd3_Rx
      CHNL_beb59c29 (CanIfBufferCfg):
        CanIfBufferSize = 19
        CanIfTxBufferHandlingType = FIFO
        CanIfTxBufferMappedTxPdus = 9
        CanIfTxBufferMaxPduLength = 8
        CanIfBufferHthRef = CN_ATOM_CAN_Matrix_PT_V600_20250211_9b894f3d_Tx
      3 x CanIfRxPduCfg, all with CanIfRxPduCanIdType=STANDARD_CAN, CanIfRxPduDlc=8, CanIfRxPduReadData=false, CanIfRxPduReadNotifyStatus=false, CanIfRxPduDlcCheck=true, CanIfRxPduHrhIdRef=CN_ATOM_CAN_Matrix_PT_V600_20250211_bde8b0ce_Rx:
        DiagReq_OBD_Tp_oATOM_CAN_Matrix_PT_V600_20250211_6244654e_Rx: CanIfRxPduCanId=1843, CanIfRxPduUserRxIndicationName=CanTp_RxIndication, CanIfRxPduUserRxIndicationType=PDUID_PDUINFOPTR, CanIfRxPduUserRxIndicationUL=CAN_TP, CanIfRxPduId=28, CanIfRxPduRef=DiagReq_OBD_Tp_oATOM_CAN_Matrix_PT_V600_20250211_42fea685_Rx
        DiagReq_PT_Tp_oATOM_CAN_Matrix_PT_V600_20250211_52e67120_Rx: CanIfRxPduCanId=2026, CanIfRxPduUserRxIndicationName=CanTp_RxIndication, CanIfRxPduUserRxIndicationType=PDUID_PDUINFOPTR, CanIfRxPduUserRxIndicationUL=CAN_TP, CanIfRxPduId=24, CanIfRxPduRef=DiagReq_PT_Tp_oATOM_CAN_Matrix_PT_V600_20250211_5469a8b1_Rx
        BMS_Charge_02_oATOM_CAN_Matrix_PT_V600_20250211_5ad82f6c_Rx: CanIfRxPduCanId=531, CanIfRxPduUserRxIndicationName=PduR_CanIfRxIndication, CanIfRxPduUserRxIndicationUL=PDUR, CanIfRxPduId=83, CanIfRxPduRef=BMS_Charge_02_oATOM_CAN_Matrix_PT_V600_20250211_e805441b_Rx
      VCU_BMS_oATOM_CAN_Matrix_PT_V600_20250211_d9bb8aad_Tx (CanIfTxPduCfg):
        CanIfTxPduCanId = 209
        CanIfTxPduCanIdType = STANDARD_CAN
        CanIfTxPduDlc = 8
        CanIfTxPduUserTxConfirmationName = NULL_PTR
        CanIfTxPduUserTxConfirmationUL = NONE
        CanIfTxPduId = 28
        CanIfTxPduReadNotifyStatus = false
        CanIfTxPduType = STATIC
        CanIfTxPduTruncation = true
        CanIfTxPduBufferRef = CHNL_PT_D1h
        CanIfTxPduRef = VCU_BMS_oATOM_CAN_Matrix_PT_V600_20250211_e81d87a2_Tx
      3 x CanIfRxPduCfg, all with CanIfRxPduCanIdType=STANDARD_CAN, CanIfRxPduDlc=8, CanIfRxPduReadData=false, CanIfRxPduReadNotifyStatus=false, CanIfRxPduDlcCheck=true, CanIfRxPduHrhIdRef=CN_ATOM_CAN_Matrix_PT_V600_20250211_bde8b0ce_Rx:
        CGW_01_oATOM_CAN_Matrix_PT_V600_20250211_3b499cca_Rx: CanIfRxPduCanId=632, CanIfRxPduUserRxIndicationName=PduR_CanIfRxIndication, CanIfRxPduUserRxIndicationUL=PDUR, CanIfRxPduId=58, CanIfRxPduRef=CGW_01_oATOM_CAN_Matrix_PT_V600_20250211_6b01f90a_Rx
        DiagReq_VCU_Tp_oATOM_CAN_Matrix_PT_V600_20250211_79dda889_Rx: CanIfRxPduCanId=1964, CanIfRxPduUserRxIndicationName=CanTp_RxIndication, CanIfRxPduUserRxIndicationType=PDUID_PDUINFOPTR, CanIfRxPduUserRxIndicationUL=CAN_TP, CanIfRxPduId=27, CanIfRxPduRef=DiagReq_VCU_Tp_oATOM_CAN_Matrix_PT_V600_20250211_3ecea241_Rx
        SGW_VCU_01_oATOM_CAN_Matrix_PT_V600_20250211_e767388d_Rx: CanIfRxPduCanId=560, CanIfRxPduUserRxIndicationName=PduR_CanIfRxIndication, CanIfRxPduUserRxIndicationUL=PDUR, CanIfRxPduId=78, CanIfRxPduRef=SGW_VCU_01_oATOM_CAN_Matrix_PT_V600_20250211_fbd26219_Rx
      VCU_MCU_02_oATOM_CAN_Matrix_PT_V600_20250211_01fbbe2f_Tx (CanIfTxPduCfg):
        CanIfTxPduCanId = 150
        CanIfTxPduCanIdType = STANDARD_CAN
        CanIfTxPduDlc = 8
        CanIfTxPduUserTxConfirmationName = NULL_PTR
        CanIfTxPduUserTxConfirmationUL = NONE
        CanIfTxPduId = 29
        CanIfTxPduReadNotifyStatus = false
        CanIfTxPduType = STATIC
        CanIfTxPduTruncation = true
        CanIfTxPduBufferRef = CHNL_PT_96h
        CanIfTxPduRef = VCU_MCU_02_oATOM_CAN_Matrix_PT_V600_20250211_38095b95_Tx
      DCM_FR_02_oATOM_CAN_Matrix_PT_V600_20250211_9166f992_Rx (CanIfRxPduCfg):
        CanIfRxPduCanId = 651
        CanIfRxPduCanIdType = STANDARD_CAN
        CanIfRxPduDlc = 8
        CanIfRxPduUserRxIndicationName = PduR_CanIfRxIndication
        CanIfRxPduUserRxIndicationUL = PDUR
        CanIfRxPduId = 53
        CanIfRxPduReadData = false
        CanIfRxPduReadNotifyStatus = false
        CanIfRxPduDlcCheck = true
        CanIfRxPduHrhIdRef = CN_ATOM_CAN_Matrix_PT_V600_20250211_bde8b0ce_Rx
        CanIfRxPduRef = DCM_FR_02_oATOM_CAN_Matrix_PT_V600_20250211_519d17ad_Rx
      BMS_ErrorInfo_oATOM_CAN_Matrix_PT_V600_20250211_a264f431_Rx (CanIfRxPduCfg):
        CanIfRxPduCanId = 772
        CanIfRxPduCanIdType = STANDARD_CAN
        CanIfRxPduDlc = 8
        CanIfRxPduUserRxIndicationName = PduR_CanIfRxIndication
        CanIfRxPduUserRxIndicationUL = PDUR
        CanIfRxPduId = 47
        CanIfRxPduReadData = false
        CanIfRxPduReadNotifyStatus = false
        CanIfRxPduDlcCheck = true
        CanIfRxPduHrhIdRef = CN_ATOM_CAN_Matrix_PT_V600_20250211_bde8b0ce_Rx
        CanIfRxPduRef = BMS_ErrorInfo_oATOM_CAN_Matrix_PT_V600_20250211_744f74f5_Rx
      Uds_EPT_Boot_Response_oATOM_CAN_Matrix_PT_V600_20250211_17c5802f_Tx (CanIfTxPduCfg):
        CanIfTxPduCanId = 1937
        CanIfTxPduCanIdType = STANDARD_CAN
        CanIfTxPduDlc = 8
        CanIfTxPduUserTxConfirmationName = NULL_PTR
        CanIfTxPduUserTxConfirmationUL = NONE
        CanIfTxPduId = 13
        CanIfTxPduReadNotifyStatus = false
        CanIfTxPduType = STATIC
        CanIfTxPduTruncation = true
        CanIfTxPduBufferRef = CHNL_beb59c29
        CanIfTxPduRef = Uds_EPT_Boot_Response_oATOM_CAN_Matrix_PT_V600_20250211_c47c83fb_Tx
      4 x CanIfRxPduCfg, all with CanIfRxPduCanIdType=STANDARD_CAN, CanIfRxPduDlc=8, CanIfRxPduUserRxIndicationName=PduR_CanIfRxIndication, CanIfRxPduUserRxIndicationUL=PDUR, CanIfRxPduReadData=false, CanIfRxPduReadNotifyStatus=false, CanIfRxPduDlcCheck=true:
        BCM_06_oATOM_CAN_Matrix_PT_V600_20250211_f2fdbbc4_Rx: CanIfRxPduCanId=625, CanIfRxPduId=60, CanIfRxPduHrhIdRef=CN_ATOM_CAN_Matrix_PT_V600_20250211_bde8b0ce_Rx, CanIfRxPduRef=BCM_06_oATOM_CAN_Matrix_PT_V600_20250211_2672f3d4_Rx
        BMS_status_02_oATOM_CAN_Matrix_PT_V600_20250211_bc716bc5_Rx: CanIfRxPduCanId=194, CanIfRxPduId=88, CanIfRxPduHrhIdRef=CanIfHrhCfg_BMS_status_02_oATOM_CAN_Matrix_PT_V600_20250211_bc716bc5_Rx, CanIfRxPduRef=BMS_status_02_oATOM_CAN_Matrix_PT_V600_20250211_6feab83a_Rx
        BMS_status_01_oATOM_CAN_Matrix_PT_V600_20250211_e1a63e78_Rx: CanIfRxPduCanId=193, CanIfRxPduId=89, CanIfRxPduHrhIdRef=CanIfHrhCfg_BMS_status_01_oATOM_CAN_Matrix_PT_V600_20250211_e1a63e78_Rx, CanIfRxPduRef=BMS_status_01_oATOM_CAN_Matrix_PT_V600_20250211_f6aa5f55_Rx
        SGW_16_oATOM_CAN_Matrix_PT_V600_20250211_a8f68129_Rx: CanIfRxPduCanId=692, CanIfRxPduId=52, CanIfRxPduHrhIdRef=CN_ATOM_CAN_Matrix_PT_V600_20250211_bde8b0ce_Rx, CanIfRxPduRef=SGW_16_oATOM_CAN_Matrix_PT_V600_20250211_9eb85431_Rx
      VCU_HMIsignals_02_oATOM_CAN_Matrix_PT_V600_20250211_b18572fb_Tx (CanIfTxPduCfg):
        CanIfTxPduCanId = 792
        CanIfTxPduCanIdType = STANDARD_CAN
        CanIfTxPduDlc = 8
        CanIfTxPduUserTxConfirmationName = NULL_PTR
        CanIfTxPduUserTxConfirmationUL = NONE
        CanIfTxPduId = 19
        CanIfTxPduReadNotifyStatus = false
        CanIfTxPduType = STATIC
        CanIfTxPduTruncation = true
        CanIfTxPduBufferRef = CHNL_beb59c29
        CanIfTxPduRef = VCU_HMIsignals_02_oATOM_CAN_Matrix_PT_V600_20250211_51f286fc_Tx
      BMS_status_03_oATOM_CAN_Matrix_PT_V600_20250211_3e135a91_Rx (CanIfRxPduCfg):
        CanIfRxPduCanId = 532
        CanIfRxPduCanIdType = STANDARD_CAN
        CanIfRxPduDlc = 8
        CanIfRxPduUserRxIndicationName = PduR_CanIfRxIndication
        CanIfRxPduUserRxIndicationUL = PDUR
        CanIfRxPduId = 82
        CanIfRxPduReadData = false
        CanIfRxPduReadNotifyStatus = false
        CanIfRxPduDlcCheck = true
        CanIfRxPduHrhIdRef = CN_ATOM_CAN_Matrix_PT_V600_20250211_bde8b0ce_Rx
        CanIfRxPduRef = BMS_status_03_oATOM_CAN_Matrix_PT_V600_20250211_ae05e720_Rx
      BMS_DIRelayState_oATOM_CAN_Matrix_PT_V600_20250211_de479d1f_Rx (CanIfRxPduCfg):
        CanIfRxPduCanId = 528
        CanIfRxPduCanIdType = STANDARD_CAN
        CanIfRxPduDlc = 8
        CanIfRxPduUserRxIndicationName = PduR_CanIfRxIndication
        CanIfRxPduUserRxIndicationUL = PDUR
        CanIfRxPduId = 85
        CanIfRxPduReadData = false
        CanIfRxPduReadNotifyStatus = false
        CanIfRxPduDlcCheck = true
        CanIfRxPduHrhIdRef = CN_ATOM_CAN_Matrix_PT_V600_20250211_bde8b0ce_Rx
        CanIfRxPduRef = BMS_DIRelayState_oATOM_CAN_Matrix_PT_V600_20250211_64866c1e_Rx
      VCU_06_oATOM_CAN_Matrix_PT_V600_20250211_91495a4f_Tx (CanIfTxPduCfg):
        CanIfTxPduCanId = 549
        CanIfTxPduCanIdType = STANDARD_CAN
        CanIfTxPduDlc = 8
        CanIfTxPduUserTxConfirmationName = NULL_PTR
        CanIfTxPduUserTxConfirmationUL = NONE
        CanIfTxPduId = 21
        CanIfTxPduReadNotifyStatus = false
        CanIfTxPduType = STATIC
        CanIfTxPduTruncation = true
        CanIfTxPduBufferRef = CHNL_PT_225h
        CanIfTxPduRef = VCU_06_oATOM_CAN_Matrix_PT_V600_20250211_6d261160_Tx
      22 x CanIfRxPduCfg, all with CanIfRxPduCanIdType=STANDARD_CAN, CanIfRxPduDlc=8, CanIfRxPduReadData=false, CanIfRxPduReadNotifyStatus=false, CanIfRxPduDlcCheck=true:
        BCM_05_oATOM_CAN_Matrix_PT_V600_20250211_5bda8f2d_Rx: CanIfRxPduCanId=826, CanIfRxPduUserRxIndicationName=PduR_CanIfRxIndication, CanIfRxPduUserRxIndicationUL=PDUR, CanIfRxPduId=44, CanIfRxPduHrhIdRef=CN_ATOM_CAN_Matrix_PT_V600_20250211_bde8b0ce_Rx, CanIfRxPduRef=BCM_05_oATOM_CAN_Matrix_PT_V600_20250211_bf3214bb_Rx
        DiagReq_VCU_OBD_Tp_oATOM_CAN_Matrix_PT_V600_20250211_1fcdbf51_Rx: CanIfRxPduCanId=2016, CanIfRxPduUserRxIndicationName=CanTp_RxIndication, CanIfRxPduUserRxIndicationType=PDUID_PDUINFOPTR, CanIfRxPduUserRxIndicationUL=CAN_TP, CanIfRxPduId=25, CanIfRxPduHrhIdRef=CN_ATOM_CAN_Matrix_PT_V600_20250211_bde8b0ce_Rx, CanIfRxPduRef=DiagReq_VCU_OBD_Tp_oATOM_CAN_Matrix_PT_V600_20250211_5296c73a_Rx
        SGW_IBS_01_oATOM_CAN_Matrix_PT_V600_20250211_18dbd081_Rx: CanIfRxPduCanId=561, CanIfRxPduUserRxIndicationName=PduR_CanIfRxIndication, CanIfRxPduUserRxIndicationUL=PDUR, CanIfRxPduId=77, CanIfRxPduHrhIdRef=CN_ATOM_CAN_Matrix_PT_V600_20250211_bde8b0ce_Rx, CanIfRxPduRef=SGW_IBS_01_oATOM_CAN_Matrix_PT_V600_20250211_10cb64fa_Rx
        POD_Status_01_oATOM_CAN_Matrix_PT_V600_20250211_3af03926_Rx: CanIfRxPduCanId=576, CanIfRxPduUserRxIndicationName=PduR_CanIfRxIndication, CanIfRxPduUserRxIndicationUL=PDUR, CanIfRxPduId=73, CanIfRxPduHrhIdRef=CN_ATOM_CAN_Matrix_PT_V600_20250211_bde8b0ce_Rx, CanIfRxPduRef=POD_Status_01_oATOM_CAN_Matrix_PT_V600_20250211_e70d1cd3_Rx
        SGW_Time_oATOM_CAN_Matrix_PT_V600_20250211_f8e1fd1f_Rx: CanIfRxPduCanId=564, CanIfRxPduUserRxIndicationName=PduR_CanIfRxIndication, CanIfRxPduUserRxIndicationUL=PDUR, CanIfRxPduId=76, CanIfRxPduHrhIdRef=CN_ATOM_CAN_Matrix_PT_V600_20250211_bde8b0ce_Rx, CanIfRxPduRef=SGW_Time_oATOM_CAN_Matrix_PT_V600_20250211_90c528d8_Rx
        DiagReq_FUN_Tp_oATOM_CAN_Matrix_PT_V600_20250211_e7003379_Rx: CanIfRxPduCanId=2015, CanIfRxPduUserRxIndicationName=CanTp_RxIndication, CanIfRxPduUserRxIndicationType=PDUID_PDUINFOPTR, CanIfRxPduUserRxIndicationUL=CAN_TP, CanIfRxPduId=26, CanIfRxPduHrhIdRef=CN_ATOM_CAN_Matrix_PT_V600_20250211_bde8b0ce_Rx, CanIfRxPduRef=DiagReq_FUN_Tp_oATOM_CAN_Matrix_PT_V600_20250211_1fcbc442_Rx
        MCU_Temperature_02_oATOM_CAN_Matrix_PT_V600_20250211_991cd74d_Rx: CanIfRxPduCanId=915, CanIfRxPduUserRxIndicationName=PduR_CanIfRxIndication, CanIfRxPduUserRxIndicationUL=PDUR, CanIfRxPduId=38, CanIfRxPduHrhIdRef=CN_ATOM_CAN_Matrix_PT_V600_20250211_bde8b0ce_Rx, CanIfRxPduRef=MCU_Temperature_02_oATOM_CAN_Matrix_PT_V600_20250211_73569f60_Rx
        BMS_BatInfor_01_oATOM_CAN_Matrix_PT_V600_20250211_152c9d4b_Rx: CanIfRxPduCanId=934, CanIfRxPduUserRxIndicationName=PduR_CanIfRxIndication, CanIfRxPduUserRxIndicationUL=PDUR, CanIfRxPduId=35, CanIfRxPduHrhIdRef=CN_ATOM_CAN_Matrix_PT_V600_20250211_bde8b0ce_Rx, CanIfRxPduRef=BMS_BatInfor_01_oATOM_CAN_Matrix_PT_V600_20250211_95ec7fc6_Rx
        DCM_FR_oATOM_CAN_Matrix_PT_V600_20250211_6a17879c_Rx: CanIfRxPduCanId=643, CanIfRxPduUserRxIndicationName=PduR_CanIfRxIndication, CanIfRxPduUserRxIndicationUL=PDUR, CanIfRxPduId=57, CanIfRxPduHrhIdRef=CN_ATOM_CAN_Matrix_PT_V600_20250211_bde8b0ce_Rx, CanIfRxPduRef=DCM_FR_oATOM_CAN_Matrix_PT_V600_20250211_00cda30a_Rx
        IVI_01_oATOM_CAN_Matrix_PT_V600_20250211_1eee27bc_Rx: CanIfRxPduCanId=694, CanIfRxPduUserRxIndicationName=PduR_CanIfRxIndication, CanIfRxPduUserRxIndicationUL=PDUR, CanIfRxPduId=50, CanIfRxPduHrhIdRef=CN_ATOM_CAN_Matrix_PT_V600_20250211_bde8b0ce_Rx, CanIfRxPduRef=IVI_01_oATOM_CAN_Matrix_PT_V600_20250211_6884d46d_Rx
        DCM_FL_02_oATOM_CAN_Matrix_PT_V600_20250211_7e6e4c82_Rx: CanIfRxPduCanId=650, CanIfRxPduUserRxIndicationName=PduR_CanIfRxIndication, CanIfRxPduUserRxIndicationUL=PDUR, CanIfRxPduId=54, CanIfRxPduHrhIdRef=CN_ATOM_CAN_Matrix_PT_V600_20250211_bde8b0ce_Rx, CanIfRxPduRef=DCM_FL_02_oATOM_CAN_Matrix_PT_V600_20250211_e178006a_Rx
        DCM_RR_oATOM_CAN_Matrix_PT_V600_20250211_c4468cbb_Rx: CanIfRxPduCanId=645, CanIfRxPduUserRxIndicationName=PduR_CanIfRxIndication, CanIfRxPduUserRxIndicationUL=PDUR, CanIfRxPduId=55, CanIfRxPduHrhIdRef=CN_ATOM_CAN_Matrix_PT_V600_20250211_bde8b0ce_Rx, CanIfRxPduRef=DCM_RR_oATOM_CAN_Matrix_PT_V600_20250211_9a6ba105_Rx
        Uds_EPT_Boot_Request_oATOM_CAN_Matrix_PT_V600_20250211_e449ee36_Rx: CanIfRxPduCanId=1809, CanIfRxPduUserRxIndicationName=PduR_CanIfRxIndication, CanIfRxPduUserRxIndicationUL=PDUR, CanIfRxPduId=29, CanIfRxPduHrhIdRef=CN_ATOM_CAN_Matrix_PT_V600_20250211_bde8b0ce_Rx, CanIfRxPduRef=Uds_EPT_Boot_Request_oATOM_CAN_Matrix_PT_V600_20250211_5ef4d74d_Rx
        POD_OBC_STATUS_03_oATOM_CAN_Matrix_PT_V600_20250211_6b16ec07_Rx: CanIfRxPduCanId=787, CanIfRxPduUserRxIndicationName=PduR_CanIfRxIndication, CanIfRxPduUserRxIndicationUL=PDUR, CanIfRxPduId=46, CanIfRxPduHrhIdRef=CN_ATOM_CAN_Matrix_PT_V600_20250211_bde8b0ce_Rx, CanIfRxPduRef=POD_OBC_STATUS_03_oATOM_CAN_Matrix_PT_V600_20250211_e833f2c9_Rx
        BMS_CellVoltage_oATOM_CAN_Matrix_PT_V600_20250211_f8b61923_Rx: CanIfRxPduCanId=535, CanIfRxPduUserRxIndicationName=PduR_CanIfRxIndication, CanIfRxPduUserRxIndicationUL=PDUR, CanIfRxPduId=80, CanIfRxPduHrhIdRef=CN_ATOM_CAN_Matrix_PT_V600_20250211_bde8b0ce_Rx, CanIfRxPduRef=BMS_CellVoltage_oATOM_CAN_Matrix_PT_V600_20250211_49a2ff30_Rx
        SGW_04_oATOM_CAN_Matrix_PT_V600_20250211_2e198d3f_Rx: CanIfRxPduCanId=565, CanIfRxPduUserRxIndicationName=PduR_CanIfRxIndication, CanIfRxPduUserRxIndicationUL=PDUR, CanIfRxPduId=75, CanIfRxPduHrhIdRef=CN_ATOM_CAN_Matrix_PT_V600_20250211_bde8b0ce_Rx, CanIfRxPduRef=SGW_04_oATOM_CAN_Matrix_PT_V600_20250211_3bb4fa61_Rx
        BMS_Charge_03_oATOM_CAN_Matrix_PT_V600_20250211_d8ba1e38_Rx: CanIfRxPduCanId=936, CanIfRxPduUserRxIndicationName=PduR_CanIfRxIndication, CanIfRxPduUserRxIndicationUL=PDUR, CanIfRxPduId=33, CanIfRxPduHrhIdRef=CN_ATOM_CAN_Matrix_PT_V600_20250211_bde8b0ce_Rx, CanIfRxPduRef=BMS_Charge_03_oATOM_CAN_Matrix_PT_V600_20250211_29ea1b01_Rx
        MCU_01_oATOM_CAN_Matrix_PT_V600_20250211_a575570e_Rx: CanIfRxPduCanId=152, CanIfRxPduUserRxIndicationName=PduR_CanIfRxIndication, CanIfRxPduUserRxIndicationUL=PDUR, CanIfRxPduId=91, CanIfRxPduHrhIdRef=CanIfHrhCfg_MCU_01_oATOM_CAN_Matrix_PT_V600_20250211_a575570e_Rx, CanIfRxPduRef=MCU_01_oATOM_CAN_Matrix_PT_V600_20250211_18559a9d_Rx
        MCU_Temperature_01_oATOM_CAN_Matrix_PT_V600_20250211_15d6c7c0_Rx: CanIfRxPduCanId=914, CanIfRxPduUserRxIndicationName=PduR_CanIfRxIndication, CanIfRxPduUserRxIndicationUL=PDUR, CanIfRxPduId=39, CanIfRxPduHrhIdRef=CN_ATOM_CAN_Matrix_PT_V600_20250211_bde8b0ce_Rx, CanIfRxPduRef=MCU_Temperature_01_oATOM_CAN_Matrix_PT_V600_20250211_ea16780f_Rx
        DCM_RL_oATOM_CAN_Matrix_PT_V600_20250211_041757a7_Rx: CanIfRxPduCanId=644, CanIfRxPduUserRxIndicationName=PduR_CanIfRxIndication, CanIfRxPduUserRxIndicationUL=PDUR, CanIfRxPduId=56, CanIfRxPduHrhIdRef=CN_ATOM_CAN_Matrix_PT_V600_20250211_bde8b0ce_Rx, CanIfRxPduRef=DCM_RL_oATOM_CAN_Matrix_PT_V600_20250211_62ba4764_Rx
        IBS_Status_05_oATOM_CAN_Matrix_PT_V600_20250211_3b732231_Rx: CanIfRxPduCanId=187, CanIfRxPduUserRxIndicationName=PduR_CanIfRxIndication, CanIfRxPduUserRxIndicationUL=PDUR, CanIfRxPduId=90, CanIfRxPduHrhIdRef=CanIfHrhCfg_IBS_Status_05_oATOM_CAN_Matrix_PT_V600_20250211_3b732231_Rx, CanIfRxPduRef=IBS_Status_05_oATOM_CAN_Matrix_PT_V600_20250211_7868db81_Rx
        DiagReq_ALL_Tp_oATOM_CAN_Matrix_PT_V600_20250211_683a156f_Rx: CanIfRxPduCanId=2047, CanIfRxPduUserRxIndicationName=CanTp_RxIndication, CanIfRxPduUserRxIndicationType=PDUID_PDUINFOPTR, CanIfRxPduUserRxIndicationUL=CAN_TP, CanIfRxPduId=23, CanIfRxPduHrhIdRef=CN_ATOM_CAN_Matrix_PT_V600_20250211_bde8b0ce_Rx, CanIfRxPduRef=DiagReq_ALL_Tp_oATOM_CAN_Matrix_PT_V600_20250211_ebb6a46c_Rx
      3 x CanIfBufferCfg, all with CanIfTxBufferMaxPduLength=8:
        CHNL_PT_95h: CanIfBufferSize=0, CanIfTxBufferHandlingType=NONE, CanIfTxBufferMappedTxPdus=1, CanIfBufferHthRef=CN_ATOM_CAN_PT_Tx_95h
        CHNL_PT_96h: CanIfBufferSize=0, CanIfTxBufferHandlingType=NONE, CanIfTxBufferMappedTxPdus=1, CanIfBufferHthRef=CN_ATOM_CAN_PT_Tx_96h
        CHNL_31a12637: CanIfBufferSize=2, CanIfTxBufferHandlingType=FIFO, CanIfTxBufferMappedTxPdus=2, CanIfBufferHthRef=CN_ATOM_CAN_XCP_f42a46d4_Tx
      XCP_Response_oATOM_CAN_XCP_d6d6f7ba_Tx (CanIfTxPduCfg):
        CanIfTxPduCanId = 2033
        CanIfTxPduCanIdType = STANDARD_CAN
        CanIfTxPduDlc = 8
        CanIfTxPduUserTxConfirmationName = Xcp_CanIfTxConfirmation
        CanIfTxPduUserTxConfirmationUL = XCP
        CanIfTxPduId = 31
        CanIfTxPduReadNotifyStatus = false
        CanIfTxPduType = STATIC
        CanIfTxPduTruncation = true
        CanIfTxPduBufferRef = CHNL_31a12637
        CanIfTxPduRef = XCP_Response_oATOM_CAN_XCP_0289d1df_Tx
      XCP_Request_oATOM_CAN_XCP_c6725b76_Rx (CanIfRxPduCfg):
        CanIfRxPduCanId = 2032
        CanIfRxPduCanIdType = STANDARD_CAN
        CanIfRxPduDlc = 8
        CanIfRxPduUserRxIndicationName = Xcp_CanIfRxIndication
        CanIfRxPduUserRxIndicationUL = XCP
        CanIfRxPduId = 92
        CanIfRxPduReadData = false
        CanIfRxPduReadNotifyStatus = false
        CanIfRxPduDlcCheck = true
        CanIfRxPduHrhIdRef = CN_ATOM_CAN_XCP_bbd3e829_Rx
        CanIfRxPduRef = XCP_Request_oATOM_CAN_XCP_69ebf888_Rx
      4 x CanIfTxPduCfg, all with CanIfTxPduUserTxConfirmationName=NULL_PTR, CanIfTxPduUserTxConfirmationUL=NONE, CanIfTxPduReadNotifyStatus=false, CanIfTxPduType=STATIC, CanIfTxPduTruncation=true:
        VcuCan12TxMsg1_oATOM_CAN_XCP_d981eee3_Tx: CanIfTxPduCanId=53, CanIfTxPduCanIdType=STANDARD_CAN, CanIfTxPduDlc=8, CanIfTxPduId=32, CanIfTxPduBufferRef=CHNL_31a12637, CanIfTxPduRef=VcuCan12TxMsg1_oATOM_CAN_XCP_4049029a_Tx
        BCL_oJ1939_bms_23e5ef2c_Tx: CanIfTxPduCanId=403724020, CanIfTxPduCanIdMask=4294967295, CanIfTxPduCanIdType=EXTENDED_CAN, CanIfTxPduDlc=5, CanIfTxPduId=38, CanIfTxPduBufferRef=CHNL_47d531e5, CanIfTxPduRef=BCL_oJ1939_bms_0b0f8249_Tx
        BSD_oJ1939_bms_fde044b7_Tx: CanIfTxPduCanId=404510452, CanIfTxPduCanIdMask=4294967295, CanIfTxPduCanIdType=EXTENDED_CAN, CanIfTxPduDlc=7, CanIfTxPduId=36, CanIfTxPduBufferRef=CHNL_47d531e5, CanIfTxPduRef=BSD_oJ1939_bms_6169aa28_Tx
        BEM_oJ1939_bms_b95b1f8b_Tx: CanIfTxPduCanId=136206068, CanIfTxPduCanIdMask=4294967295, CanIfTxPduCanIdType=EXTENDED_CAN, CanIfTxPduDlc=4, CanIfTxPduId=40, CanIfTxPduBufferRef=CHNL_47d531e5, CanIfTxPduRef=BEM_oJ1939_bms_4ca77da7_Tx
      5 x CanIfRxPduCfg, all with CanIfRxPduCanIdMask=67108863, CanIfRxPduCanIdType=EXTENDED_CAN, CanIfRxPduUserRxIndicationName=PduR_CanIfRxIndication, CanIfRxPduUserRxIndicationUL=PDUR, CanIfRxPduReadData=false, CanIfRxPduReadNotifyStatus=false, CanIfRxPduDlcCheck=true, CanIfRxPduHrhIdRef=CN_J1939_bms_96c04df9_Rx:
        CST_oJ1939_bms_e81a6c9e_Rx: CanIfRxPduCanId=270201942, CanIfRxPduDlc=4, CanIfRxPduId=94, CanIfRxPduRef=CST_oJ1939_bms_b9e5b7cb_Rx
        CRO_oJ1939_bms_676d7071_Rx: CanIfRxPduCanId=269153366, CanIfRxPduDlc=1, CanIfRxPduId=95, CanIfRxPduRef=CRO_oJ1939_bms_c256408a_Rx
        CRM_oJ1939_bms_0744fcab_Rx: CanIfRxPduCanId=402781270, CanIfRxPduDlc=8, CanIfRxPduId=96, CanIfRxPduRef=CRM_oJ1939_bms_df999128_Rx
        CSD_oJ1939_bms_5fb406cc_Rx: CanIfRxPduCanId=404616278, CanIfRxPduDlc=8, CanIfRxPduId=97, CanIfRxPduRef=CSD_oJ1939_bms_579b3adb_Rx
        CHM_oJ1939_bms_a6193f06_Rx: CanIfRxPduCanId=405206102, CanIfRxPduDlc=3, CanIfRxPduId=98, CanIfRxPduRef=CHM_oJ1939_bms_1911c680_Rx
      3 x CanIfTxPduCfg, all with CanIfTxPduCanIdMask=4294967295, CanIfTxPduCanIdType=EXTENDED_CAN, CanIfTxPduUserTxConfirmationName=NULL_PTR, CanIfTxPduUserTxConfirmationUL=NONE, CanIfTxPduReadNotifyStatus=false, CanIfTxPduType=STATIC, CanIfTxPduTruncation=true:
        BHM_oJ1939_bms_044d7d7d_Tx: CanIfTxPduCanId=405231348, CanIfTxPduDlc=2, CanIfTxPduId=35, CanIfTxPduBufferRef=CHNL_47d531e5, CanIfTxPduRef=BHM_oJ1939_bms_2fe35673_Tx
        BSM_oJ1939_bms_9623b7f3_Tx: CanIfTxPduCanId=403920628, CanIfTxPduDlc=7, CanIfTxPduId=37, CanIfTxPduBufferRef=CHNL_47d531e5, CanIfTxPduRef=BSM_oJ1939_bms_18b10471_Tx
        BST_oJ1939_bms_4a4e2ee5_Tx: CanIfTxPduCanId=270096116, CanIfTxPduDlc=4, CanIfTxPduId=41, CanIfTxPduBufferRef=CHNL_J1939_bms_101956F4h, CanIfTxPduRef=BST_oJ1939_bms_8f172738_Tx
      3 x CanIfRxPduCfg, all with CanIfRxPduCanIdType=EXTENDED_CAN, CanIfRxPduReadData=false, CanIfRxPduReadNotifyStatus=false, CanIfRxPduDlcCheck=true, CanIfRxPduHrhIdRef=CN_J1939_bms_96c04df9_Rx:
        TPCM_Tp_oJ1939_bms_a48fdf8c_Rx: CanIfRxPduCanId=485293822, CanIfRxPduCanIdMask=67043328, CanIfRxPduDlc=8, CanIfRxPduUserRxIndicationName=J1939Tp_RxIndication, CanIfRxPduUserRxIndicationUL=J1939TP, CanIfRxPduId=93, CanIfRxPduRef=TPCM_Tp_oJ1939_bms_7c7c1783_Rx
        CTS_oJ1939_bms_e1ed0074_Rx: CanIfRxPduCanId=403174486, CanIfRxPduCanIdMask=67108863, CanIfRxPduDlc=7, CanIfRxPduUserRxIndicationName=PduR_CanIfRxIndication, CanIfRxPduUserRxIndicationUL=PDUR, CanIfRxPduId=99, CanIfRxPduRef=CTS_oJ1939_bms_29c73f69_Rx
        CCS_oJ1939_bms_fda6a12f_Rx: CanIfRxPduCanId=403895382, CanIfRxPduCanIdMask=67108863, CanIfRxPduDlc=7, CanIfRxPduUserRxIndicationName=PduR_CanIfRxIndication, CanIfRxPduUserRxIndicationUL=PDUR, CanIfRxPduId=100, CanIfRxPduRef=CCS_oJ1939_bms_8c0b4315_Rx
      TPDT_Tp_oJ1939_bms_8ac69245_Tx (CanIfTxPduCfg):
        CanIfTxPduCanId = 485228286
        CanIfTxPduCanIdMask = 3825139712
        CanIfTxPduCanIdType = EXTENDED_CAN
        CanIfTxPduDlc = 8
        CanIfTxPduUserTxConfirmationName = J1939Tp_TxConfirmation
        CanIfTxPduUserTxConfirmationUL = J1939TP
        CanIfTxPduId = 34
        CanIfTxPduReadNotifyStatus = false
        CanIfTxPduType = STATIC
        CanIfTxPduTruncation = true
        CanIfTxPduBufferRef = CHNL_47d531e5
        CanIfTxPduRef = TPDT_Tp_oJ1939_bms_8162bd5c_Tx
      CML_oJ1939_bms_69f2d4c4_Rx (CanIfRxPduCfg):
        CanIfRxPduCanId = 403240022
        CanIfRxPduCanIdMask = 67108863
        CanIfRxPduCanIdType = EXTENDED_CAN
        CanIfRxPduDlc = 8
        CanIfRxPduUserRxIndicationName = PduR_CanIfRxIndication
        CanIfRxPduUserRxIndicationUL = PDUR
        CanIfRxPduId = 101
        CanIfRxPduReadData = false
        CanIfRxPduReadNotifyStatus = false
        CanIfRxPduDlcCheck = true
        CanIfRxPduHrhIdRef = CN_J1939_bms_96c04df9_Rx
        CanIfRxPduRef = CML_oJ1939_bms_97a631d1_Rx
      CEM_oJ1939_bms_1b0f5df0_Rx (CanIfRxPduCfg):
        CanIfRxPduCanId = 136311894
        CanIfRxPduCanIdMask = 67108863
        CanIfRxPduCanIdType = EXTENDED_CAN
        CanIfRxPduDlc = 4
        CanIfRxPduUserRxIndicationName = PduR_CanIfRxIndication
        CanIfRxPduUserRxIndicationUL = PDUR
        CanIfRxPduId = 102
        CanIfRxPduReadData = false
        CanIfRxPduReadNotifyStatus = false
        CanIfRxPduDlcCheck = true
        CanIfRxPduHrhIdRef = CN_J1939_bms_96c04df9_Rx
        CanIfRxPduRef = CEM_oJ1939_bms_7a55ed54_Rx
      CHNL_47d531e5 (CanIfBufferCfg):
        CanIfBufferSize = 8
        CanIfTxBufferHandlingType = FIFO
        CanIfTxBufferMappedTxPdus = 8
        CanIfTxBufferMaxPduLength = 8
        CanIfBufferHthRef = CN_J1939_bms_dea99804_Tx
      TPCM_Tp_oJ1939_bms_a48fdf8c_Tx (CanIfTxPduCfg):
        CanIfTxPduCanId = 485293822
        CanIfTxPduCanIdMask = 3825139712
        CanIfTxPduCanIdType = EXTENDED_CAN
        CanIfTxPduDlc = 8
        CanIfTxPduUserTxConfirmationName = J1939Tp_TxConfirmation
        CanIfTxPduUserTxConfirmationUL = J1939TP
        CanIfTxPduId = 33
        CanIfTxPduReadNotifyStatus = false
        CanIfTxPduType = STATIC
        CanIfTxPduTruncation = true
        CanIfTxPduBufferRef = CHNL_47d531e5
        CanIfTxPduRef = TPCM_Tp_oJ1939_bms_7c7c1783_Tx
      BRO_oJ1939_bms_c539320a_Tx (CanIfTxPduCfg):
        CanIfTxPduCanId = 269047540
        CanIfTxPduCanIdMask = 4294967295
        CanIfTxPduCanIdType = EXTENDED_CAN
        CanIfTxPduDlc = 1
        CanIfTxPduUserTxConfirmationName = NULL_PTR
        CanIfTxPduUserTxConfirmationUL = NONE
        CanIfTxPduId = 39
        CanIfTxPduReadNotifyStatus = false
        CanIfTxPduType = STATIC
        CanIfTxPduTruncation = true
        CanIfTxPduBufferRef = CHNL_47d531e5
        CanIfTxPduRef = BRO_oJ1939_bms_f4a4d079_Tx
      8 x CanIfBufferCfg, all with CanIfBufferSize=0, CanIfTxBufferHandlingType=NONE, CanIfTxBufferMappedTxPdus=1, CanIfTxBufferMaxPduLength=8:
        CHNL_J1939_bms_101956F4h: CanIfBufferHthRef=CN_J1939_bms_101956F4h_Tx
        CHNL_CH_D{1..3}h: CanIfBufferHthRef=CN_ATOM_CANFD_Matrix_CH_Tx_D{1..3}h
        CHNL_PT_D1h: CanIfBufferHthRef=CN_ATOM_CAN_PT_Tx_D1h
        CHNL_PT_D2h: CanIfBufferHthRef=CN_ATOM_CAN_PT_Tx_D2h
        CHNL_PT_D6h: CanIfBufferHthRef=CN_ATOM_CAN_PT_Tx_D6h
        CHNL_PT_121h: CanIfBufferHthRef=CN_ATOM_CAN_PT_Tx_121h
      EPS_CONV_oATOM_CANFD_Matrix_CH_V600_202502_0f3c50a5_Rx (CanIfRxPduCfg):
        CanIfRxPduCanId = 240
        CanIfRxPduCanIdType = STANDARD_CAN
        CanIfRxPduDlc = 8
        CanIfRxPduUserRxIndicationName = PduR_CanIfRxIndication
        CanIfRxPduUserRxIndicationUL = PDUR
        CanIfRxPduId = 5
        CanIfRxPduReadData = false
        CanIfRxPduReadNotifyStatus = false
        CanIfRxPduDlcCheck = true
        CanIfRxPduHrhIdRef = CN_ATOM_CANFD_Matrix_CH_V600_202502_64375107_Rx
        CanIfRxPduRef = EPS_CONV_oATOM_CANFD_Matrix_CH_V600_202502_5a733336_Rx
      4 x CanIfBufferCfg, all with CanIfBufferSize=0, CanIfTxBufferHandlingType=NONE, CanIfTxBufferMappedTxPdus=1, CanIfTxBufferMaxPduLength=8:
        CHNL_PT_221h: CanIfBufferHthRef=CN_ATOM_CAN_PT_Tx_221h
        CHNL_PT_220h: CanIfBufferHthRef=CN_ATOM_CAN_PT_Tx_220h
        CHNL_PT_224h: CanIfBufferHthRef=CN_ATOM_CAN_PT_Tx_224h
        CHNL_PT_225h: CanIfBufferHthRef=CN_ATOM_CAN_PT_Tx_225h
    CanIfPrivateCfg:
      CanIfPrivateSoftwareFilterType = LINEAR
      CanIfPrivateDlcCheck = true
      CanIfSupportTTCAN = false
      CanIfTransceiverMapping = false
      CanIfTransceiverHandling = true
      CanIfSupportExtendedIds = true
      CanIfSupportNmOsek = false
      CanIfTxBufferType = NONE
      CanIfWakeupSupport = true
      CanIfStaticFdTxBufferSupport = false
      CanIfRxSearchConsiderMsgType = false
      CanIfTxBufferFifoSupport = true
      CanIfSetPduReceptionModeSupport = false
      CanIfCheckWakeupCanRetType = false
      CanIfDataChecksumRxSupport = false
      CanIfDataChecksumTxSupport = false
    CanIfPublicCfg:
      CanIfPublicPnSupport = false
      CanIfPublicCancelTransmitSupport = false
      CanIfPublicDevErrorDetect = true
      CanIfPublicHandleTypeEnum = UINT8
      CanIfPublicMultipleDrvSupport = false
      CanIfPublicNumberOfCanHwUnits = 1
      CanIfPublicReadRxPduDataApi = false
      CanIfPublicReadRxPduNotifyStatusApi = false
      CanIfPublicReadTxPduNotifyStatusApi = false
      CanIfPublicSetDynamicTxIdApi = false
      CanIfPublicTxBuffering = true
      CanIfPublicTxConfirmPollingSupport = false
      CanIfPublicVersionInfoApi = false
      CanIfPublicWakeupCheckValidSupport = true
      CanIfPnWakeupTxPduFilterSupport = false
      CanIfPnTrcvHandlingSupport = false
      CanIfJ1939DynAddrSupport = DISABLED
      CanIfSafeBswChecks = false
      CanIfBusMirroringSupport = false
      CanIfEnableSecurityEventReporting = false
      CanIfSupportCanDrvAsr440 = false
      CanIfSetBaudrateApi = false
      CanIfPublicWakeupCheckValidByNM = true
    CanIfTrcvDrvCfg
      CanIfTrcvCfg_PT (CanIfTrcvCfg): CanIfTrcvId=0, CanIfTrcvWakeupSupport=true, CanIfTrcvCanTrcvRef=CanTrcvChannel_PT
      CanIfTrcvCfg_CH (CanIfTrcvCfg): CanIfTrcvId=1, CanIfTrcvWakeupSupport=true, CanIfTrcvCanTrcvRef=CanTrcvChannel_CH
