AUTOSAR XML (schema 00048)
package /Fls
  module config Fls: implementation-config-variant=VARIANT-POST-BUILD, module-description=Fls_Impl
    CommonPublishedInformation:
      ArMajorVersion = 4
      ArMinorVersion = 2
      ArPatchVersion = 2
      ModuleId = 92
      Release = _TRICORE_TC377
      SwMajorVersion = 10
      SwMinorVersion = 40
      SwPatchVersion = 1
      VendorApiInfix = Dmu
      VendorId = 17
    FlsConfigSet:
      FlsAcErase = 0
      FlsAcWrite = 0
      FlsCallCycle = 0.01
      FlsDefaultMode = MEMIF_MODE_SLOW
      FlsJobEndNotification = Fee_JobEndNotification
      FlsJobErrorNotification = Fee_JobErrorNotification
      FlsMaxReadFastMode = 64
      FlsMaxReadNormalMode = 32
      FlsMaxWriteFastMode = 32
      FlsMaxWriteNormalMode = 32
      FlsProtection = 0
      FlsWaitStateErrorCorrection = FLS_17_DMU_WAIT_STATE_ERRORCORRECTION1
      FlsWaitStateRead = FLS_17_DMU_WAIT_STATE_READACCESS9
      FlsSectorList_0 (FlsSectorList)
        FlsSector_0 (FlsSector): FlsNumberOfSectors=2, FlsPageSize=8, FlsSectorSize=131072, FlsSectorStartaddress=0
    FlsGeneral:
      FlsAcLoadOnJobStart = false
      FlsBaseAddress = 2936012800
      FlsBlankCheckApi = true
      FlsCancelApi = true
      FlsCompareApi = true
      FlsDevErrorDetect = false
      FlsDriverIndex = 0
      FlsGetJobResultApi = true
      FlsGetStatusApi = true
      FlsIfxFeeUse = true
      FlsInitApiMode = FLS_17_DMU_MCAL_SUPERVISOR
      FlsInitCheckApi = true
      FlsRunTimeErrorDetect = false
      FlsRuntimeApiMode = FLS_17_DMU_MCAL_SUPERVISOR
      FlsSafetyEnable = false
      FlsSetModeApi = true
      FlsTotalSize = 262144
      FlsUseInterrupts = false
      FlsVersionInfoApi = false
    FlsIfxSpecificConfig: FlsEraseSuspendTimeout=12000, FlsIllegalStateNotification=NULL_PTR, FlsStateVarStruct=FlsStateVar, FlsUseEraseSuspend=false
    FlsPublishedInformation:
      FlsAcLocationErase = 0
      FlsAcLocationWrite = 0
      FlsAcSizeErase = 0
      FlsAcSizeWrite = 0
      FlsEraseTime = 1725000
      FlsErasedValue = 0
      FlsExpectedHwId = 0
      FlsSpecifiedEraseCycles = 125000
      FlsWriteTime = 5140
