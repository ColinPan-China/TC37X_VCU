AUTOSAR XML (schema 00048)
package /Dma
  module config Dma: implementation-config-variant=VARIANT-POST-BUILD, module-description=Dma_Impl
    CommonPublishedInformation:
      ArMajorVersion = 4
      ArMinorVersion = 2
      ArPatchVersion = 2
      ModuleId = 255
      Release = _TRICORE_TC377
      SwMajorVersion = 10
      SwMinorVersion = 40
      SwPatchVersion = 1
      VendorId = 17
    4 x DmaChannelConfig, all with DmaChannelAssignedPartition=0, DmaChannelNotification=NULL_PTR, DmaChannelNumTransactionSet=1, DmaTcsInterruptTransactionLoss=false:
      DmaChannelConfig_QSPI2_RX: DmaChannelId=12
        DmaChannelTransactionSet_0 (DmaChannelTransactionSet):
          DmaNextTcsIndex = 1
          DmaTcsAppendTimeStamp = false
          DmaTcsAutoStartEnable = false
          DmaTcsCircularBufferDestinationEnable = false
          DmaTcsCircularBufferDestinationLength = DMA_CIRCULAR_BUFFER_LENGTH_1BYTE
          DmaTcsCircularBufferSourceEnable = false
          DmaTcsCircularBufferSourceLength = DMA_CIRCULAR_BUFFER_LENGTH_1BYTE
          DmaTcsDaisyChaining = false
          DmaTcsDataTransferInterrupt = false
          DmaTcsDestinationAddress = NULL_PTR
          DmaTcsDestinationAddressModificationFactor = DMA_FACTOR_1
          DmaTcsDestinationAddressMovement = DMA_INCREASING
          DmaTcsDoubleBuffer = NULL_PTR
          DmaTcsHardwareTrigger = DMA_NO_HARDWARE_TRIGGER
          DmaTcsIndex = 0
          DmaTcsInterruptDataTransfer = DMA_INTERRUPT_PER_TRANSACTION
          DmaTcsInterruptDataTransferThreshold = 0
          DmaTcsInterruptDestinationAddressWrap = false
          DmaTcsInterruptSourceAddressWrap = false
          DmaTcsMoveLength = DMA_WIDTH_8BITS
          DmaTcsReferenceAddressCrc = 0
          DmaTcsReferenceDataCrc = 0
          DmaTcsShadowRegisterConfiguration = DMA_SHADOWING_DISABLED
          DmaTcsSourceAddress = NULL_PTR
          DmaTcsSourceAddressModificationFactor = DMA_FACTOR_1
          DmaTcsSourceAddressMovement = DMA_INCREASING
          DmaTcsSwapDataCRCByteOrder = false
          DmaTcsTransactionLength = 0
          DmaTcsTransferLength = DMA_MOVES_1
          DmaTcsTriggerFrequency = DMA_TRANSFER_PER_TRIGGER
          DmaUserHeaderFileWithExternDeclarations = NULL
      DmaChannelConfig_QSPI2_TX: DmaChannelId=13
        DmaChannelTransactionSet_0 (DmaChannelTransactionSet):
          DmaNextTcsIndex = 1
          DmaTcsAppendTimeStamp = false
          DmaTcsAutoStartEnable = false
          DmaTcsCircularBufferDestinationEnable = false
          DmaTcsCircularBufferDestinationLength = DMA_CIRCULAR_BUFFER_LENGTH_1BYTE
          DmaTcsCircularBufferSourceEnable = false
          DmaTcsCircularBufferSourceLength = DMA_CIRCULAR_BUFFER_LENGTH_1BYTE
          DmaTcsDaisyChaining = false
          DmaTcsDataTransferInterrupt = false
          DmaTcsDestinationAddress = NULL_PTR
          DmaTcsDestinationAddressModificationFactor = DMA_FACTOR_1
          DmaTcsDestinationAddressMovement = DMA_INCREASING
          DmaTcsDoubleBuffer = NULL_PTR
          DmaTcsHardwareTrigger = DMA_NO_HARDWARE_TRIGGER
          DmaTcsIndex = 0
          DmaTcsInterruptDataTransfer = DMA_INTERRUPT_PER_TRANSACTION
          DmaTcsInterruptDataTransferThreshold = 0
          DmaTcsInterruptDestinationAddressWrap = false
          DmaTcsInterruptSourceAddressWrap = false
          DmaTcsMoveLength = DMA_WIDTH_8BITS
          DmaTcsReferenceAddressCrc = 0
          DmaTcsReferenceDataCrc = 0
          DmaTcsShadowRegisterConfiguration = DMA_SHADOWING_DISABLED
          DmaTcsSourceAddress = NULL_PTR
          DmaTcsSourceAddressModificationFactor = DMA_FACTOR_1
          DmaTcsSourceAddressMovement = DMA_INCREASING
          DmaTcsSwapDataCRCByteOrder = false
          DmaTcsTransactionLength = 0
          DmaTcsTransferLength = DMA_MOVES_1
          DmaTcsTriggerFrequency = DMA_TRANSFER_PER_TRIGGER
          DmaUserHeaderFileWithExternDeclarations = NULL
      DmaChannelConfig_QSPI3_RX: DmaChannelId=10
        DmaChannelTransactionSet_0 (DmaChannelTransactionSet):
          DmaNextTcsIndex = 1
          DmaTcsAppendTimeStamp = false
          DmaTcsAutoStartEnable = false
          DmaTcsCircularBufferDestinationEnable = false
          DmaTcsCircularBufferDestinationLength = DMA_CIRCULAR_BUFFER_LENGTH_1BYTE
          DmaTcsCircularBufferSourceEnable = false
          DmaTcsCircularBufferSourceLength = DMA_CIRCULAR_BUFFER_LENGTH_1BYTE
          DmaTcsDaisyChaining = false
          DmaTcsDataTransferInterrupt = false
          DmaTcsDestinationAddress = NULL_PTR
          DmaTcsDestinationAddressModificationFactor = DMA_FACTOR_1
          DmaTcsDestinationAddressMovement = DMA_INCREASING
          DmaTcsDoubleBuffer = NULL_PTR
          DmaTcsHardwareTrigger = DMA_NO_HARDWARE_TRIGGER
          DmaTcsIndex = 0
          DmaTcsInterruptDataTransfer = DMA_INTERRUPT_PER_TRANSACTION
          DmaTcsInterruptDataTransferThreshold = 0
          DmaTcsInterruptDestinationAddressWrap = false
          DmaTcsInterruptSourceAddressWrap = false
          DmaTcsMoveLength = DMA_WIDTH_8BITS
          DmaTcsReferenceAddressCrc = 0
          DmaTcsReferenceDataCrc = 0
          DmaTcsShadowRegisterConfiguration = DMA_SHADOWING_DISABLED
          DmaTcsSourceAddress = NULL_PTR
          DmaTcsSourceAddressModificationFactor = DMA_FACTOR_1
          DmaTcsSourceAddressMovement = DMA_INCREASING
          DmaTcsSwapDataCRCByteOrder = false
          DmaTcsTransactionLength = 0
          DmaTcsTransferLength = DMA_MOVES_1
          DmaTcsTriggerFrequency = DMA_TRANSFER_PER_TRIGGER
          DmaUserHeaderFileWithExternDeclarations = NULL
      DmaChannelConfig_QSPI3_TX: DmaChannelId=11
        DmaChannelTransactionSet_0 (DmaChannelTransactionSet):
          DmaNextTcsIndex = 1
          DmaTcsAppendTimeStamp = false
          DmaTcsAutoStartEnable = false
          DmaTcsCircularBufferDestinationEnable = false
          DmaTcsCircularBufferDestinationLength = DMA_CIRCULAR_BUFFER_LENGTH_1BYTE
          DmaTcsCircularBufferSourceEnable = false
          DmaTcsCircularBufferSourceLength = DMA_CIRCULAR_BUFFER_LENGTH_1BYTE
          DmaTcsDaisyChaining = false
          DmaTcsDataTransferInterrupt = false
          DmaTcsDestinationAddress = NULL_PTR
          DmaTcsDestinationAddressModificationFactor = DMA_FACTOR_1
          DmaTcsDestinationAddressMovement = DMA_INCREASING
          DmaTcsDoubleBuffer = NULL_PTR
          DmaTcsHardwareTrigger = DMA_NO_HARDWARE_TRIGGER
          DmaTcsIndex = 0
          DmaTcsInterruptDataTransfer = DMA_INTERRUPT_PER_TRANSACTION
          DmaTcsInterruptDataTransferThreshold = 0
          DmaTcsInterruptDestinationAddressWrap = false
          DmaTcsInterruptSourceAddressWrap = false
          DmaTcsMoveLength = DMA_WIDTH_8BITS
          DmaTcsReferenceAddressCrc = 0
          DmaTcsReferenceDataCrc = 0
          DmaTcsShadowRegisterConfiguration = DMA_SHADOWING_DISABLED
          DmaTcsSourceAddress = NULL_PTR
          DmaTcsSourceAddressModificationFactor = DMA_FACTOR_1
          DmaTcsSourceAddressMovement = DMA_INCREASING
          DmaTcsSwapDataCRCByteOrder = false
          DmaTcsTransactionLength = 0
          DmaTcsTransferLength = DMA_MOVES_1
          DmaTcsTriggerFrequency = DMA_TRANSFER_PER_TRIGGER
          DmaUserHeaderFileWithExternDeclarations = NULL
    DmaGeneral:
      DmaBufferSwitchApiConfiguration = true
      DmaDataPendingApiConfiguration = true
      DmaDeinitApiConfiguration = true
      DmaDevErrorDetect = false
      DmaInitApiMode = DMA_MCAL_SUPERVISORMODE
      DmaInitCheckApi = true
      DmaMaxTransactionSetPerChannel = 1
      DmaMultiCoreErrorDetect = false
      DmaRuntimeApiMode = DMA_MCAL_SUPERVISORMODE
      DmaSafetyEnable = false
      DmaSuspendApiConfiguration = true
      DmaTriggerApiConfiguration = true
      DmaVersionInfoApi = false
    DmaMoveEngineConfig: DmaMEDestinationErrorInterrupt=false, DmaMELinkedListErrorInterrupt=false, DmaMESourceErrorInterrupt=false
    4 x DmaResourcePartition, all with DmaMoveEngineErrorNotifRoutine=NULL_PTR, DmaPermittedBusMaster=4294967295, DmaResourcePartitionBusMode=DMA_RP_SUPERVISOR_MODE:
      DmaResourcePartition_{0..3}
