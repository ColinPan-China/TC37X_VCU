AUTOSAR XML (schema 00048)
package /ActiveEcuC
  module config Dcm: implementation-config-variant=VARIANT-PRE-COMPILE, module-description=Dcm_Impl
    DcmConfigSet
      DcmDsl
        DcmDslProtocol
          DcmDslProtocolRow_29812fbf (DcmDslProtocolRow):
            DcmDslProtocolEndiannessConvEnabled = false
            DcmDslProtocolID = DCM_UDS_ON_CAN
            DcmDslProtocolPreemptTimeout = 0
            DcmDslProtocolPriority = 0
            DcmSendRespPendOnTransToBoot = true
            DcmTimStrP2ServerAdjust = 0
            DcmTimStrP2StarServerAdjust = 0
            DcmDslProtocolMaximumResponseSize = 4095
            DcmDslProtocolRxBufferID = DcmDslBuffer
            DcmDslProtocolSIDTable = DcmDsdServiceTable
            DcmDslProtocolTxBufferID = DcmDslBuffer
            DcmDemClientRef = DemClient
            DC_0x0002_oVCU_oATOM_CAN_Matrix_PT_V600_20250211_07b46d87 (DcmDslConnection)
              DC_0x0002_oVCU_oATOM_CAN_Matrix_PT_V600_20250211_07b46d87 (DcmDslMainConnection): DcmDslProtocolRxTesterSourceAddr=11, DcmDslProtocolRxConnectionId=1
                DiagReq_VCU_OBD_oATOM_CAN_Matrix_PT_V600_20250211_39988d3e_Rx_28448685 (DcmDslProtocolRx):
                  DcmDslProtocolRxAddrType = DCM_PHYSICAL_TYPE
                  DcmDslProtocolRxPduId = 5
                  DcmDslProtocolRxChannelId = 0
                  DcmDslProtocolRxComMChannelRef = CN_ATOM_CAN_Matrix_PT_V600_20250211_9b894f3d
                  DcmDslProtocolRxPduRef = DiagReq_VCU_OBD_oATOM_CAN_Matrix_PT_V600_20250211_39988d3e_Rx
                DiagResp_VCU_OBD_oATOM_CAN_Matrix_PT_V600_20250211_599d1fc3_Tx_9f6fe4de (DcmDslProtocolTx): DcmDslTxConfirmationPduId=1, DcmDslProtocolTxPduRef=DiagResp_VCU_OBD_oATOM_CAN_Matrix_PT_V600_20250211_599d1fc3_Tx
                DiagReq_OBD_oATOM_CAN_Matrix_PT_V600_20250211_97cbed37_Rx_85440dd6 (DcmDslProtocolRx):
                  DcmDslProtocolRxAddrType = DCM_FUNCTIONAL_TYPE
                  DcmDslProtocolRxPduId = 4
                  DcmDslProtocolRxChannelId = 0
                  DcmDslProtocolRxComMChannelRef = CN_ATOM_CAN_Matrix_PT_V600_20250211_9b894f3d
                  DcmDslProtocolRxPduRef = DiagReq_OBD_oATOM_CAN_Matrix_PT_V600_20250211_97cbed37_Rx
            DC_0x0001_oVCU_oATOM_CAN_Matrix_PT_V600_20250211_2d08dd0f (DcmDslConnection)
              DC_0x0001_oVCU_oATOM_CAN_Matrix_PT_V600_20250211_2d08dd0f (DcmDslMainConnection): DcmDslProtocolRxTesterSourceAddr=10, DcmDslProtocolRxConnectionId=0
                DiagReq_FUN_oATOM_CAN_Matrix_PT_V600_20250211_f8649eb7_Rx_c25173e7 (DcmDslProtocolRx):
                  DcmDslProtocolRxAddrType = DCM_FUNCTIONAL_TYPE
                  DcmDslProtocolRxPduId = 1
                  DcmDslProtocolRxChannelId = 0
                  DcmDslProtocolRxComMChannelRef = CN_ATOM_CAN_Matrix_PT_V600_20250211_9b894f3d
                  DcmDslProtocolRxPduRef = DiagReq_FUN_oATOM_CAN_Matrix_PT_V600_20250211_f8649eb7_Rx
                DiagReq_PT_oATOM_CAN_Matrix_PT_V600_20250211_35bae364_Rx_1636832d (DcmDslProtocolRx):
                  DcmDslProtocolRxAddrType = DCM_FUNCTIONAL_TYPE
                  DcmDslProtocolRxPduId = 2
                  DcmDslProtocolRxChannelId = 0
                  DcmDslProtocolRxComMChannelRef = CN_ATOM_CAN_Matrix_PT_V600_20250211_9b894f3d
                  DcmDslProtocolRxPduRef = DiagReq_PT_oATOM_CAN_Matrix_PT_V600_20250211_35bae364_Rx
                DiagResp_VCU_oATOM_CAN_Matrix_PT_V600_20250211_6bab0738_Tx_f4157bca (DcmDslProtocolTx): DcmDslTxConfirmationPduId=0, DcmDslProtocolTxPduRef=DiagResp_VCU_oATOM_CAN_Matrix_PT_V600_20250211_6bab0738_Tx
                DiagReq_ALL_oATOM_CAN_Matrix_PT_V600_20250211_8c8ad95e_Rx_003bd04d (DcmDslProtocolRx):
                  DcmDslProtocolRxAddrType = DCM_FUNCTIONAL_TYPE
                  DcmDslProtocolRxPduId = 0
                  DcmDslProtocolRxChannelId = 0
                  DcmDslProtocolRxComMChannelRef = CN_ATOM_CAN_Matrix_PT_V600_20250211_9b894f3d
                  DcmDslProtocolRxPduRef = DiagReq_ALL_oATOM_CAN_Matrix_PT_V600_20250211_8c8ad95e_Rx
                DiagReq_VCU_oATOM_CAN_Matrix_PT_V600_20250211_bcb58cfd_Rx_931d17fc (DcmDslProtocolRx):
                  DcmDslProtocolRxAddrType = DCM_PHYSICAL_TYPE
                  DcmDslProtocolRxPduId = 3
                  DcmDslProtocolRxChannelId = 0
                  DcmDslProtocolRxComMChannelRef = CN_ATOM_CAN_Matrix_PT_V600_20250211_9b894f3d
                  DcmDslProtocolRxPduRef = DiagReq_VCU_oATOM_CAN_Matrix_PT_V600_20250211_bcb58cfd_Rx
        DcmDslDiagResp: DcmDslDiagRespMaxNumRespPend=0, DcmDslDiagRespOnSecondDeclinedRequest=false, DcmDslDiagRespMaxNumOfDeclinedRequests=3
        DcmDslBuffer: DcmDslBufferSize=50
        DcmDslServiceRequestSupplierNotification: DcmDslServiceRequestSupplierNotificationUsePort=true
      DcmGeneral:
        DcmResetToFblAfterSessionFinalResponseEnabled = false
        DcmDevErrorDetect = true
        DcmRequestManufacturerNotificationEnabled = false
        DcmRequestSupplierNotificationEnabled = false
        DcmRespondAllRequest = true
        DcmTaskTime = 0.01
        DcmVersionInfoApi = false
        DcmDspDataDefaultEndianness = LITTLE_ENDIAN
        DcmSafeBswChecks = false
        DcmSupportedIDCalculationSuppressionEnabled = false
        DcmDtrDataProvisionViaDemEnabled = true
        DcmForeignDiagnosticRequestDetectionEnabled = false
        DcmSuppressResponseOnCanTpFuncMixedAddrRequests = false
        DcmSenderReceiverPRPortsEnabled = false
      DcmDsd
        DcmDsdServiceTable
          17 x DcmDsdService:
            ClearDiagInfo: DcmDsdSidTabServiceId=20, DcmDsdSidTabSubfuncAvail=false, DcmDsdSidTabSessionLevelRef=DcmDspSession/Default, DcmDsdSidTabSessionLevelRef=DcmDspSession/Extended, DcmDsdSidTabSessionLevelRef=Coding_Session
            EcuReset: DcmDsdSidTabServiceId=17, DcmDsdSidTabSubfuncAvail=true, DcmDsdSidTabSessionLevelRef=DcmDspSession/Programming, DcmDsdSidTabSessionLevelRef=DcmDspSession/Extended, DcmDsdSidTabSessionLevelRef=Coding_Session
              Hard (DcmDsdSubService):
                DcmDsdSubServiceId = 1
                DcmDsdSubServiceFnc = DcmService_HardReset
                DcmDsdSubServiceSessionLevelRef = DcmDspSession/Programming
                DcmDsdSubServiceSessionLevelRef = DcmDspSession/Extended
                DcmDsdSubServiceSessionLevelRef = Coding_Session
              Soft (DcmDsdSubService):
                DcmDsdSubServiceId = 3
                DcmDsdSubServiceSessionLevelRef = DcmDspSession/Programming
                DcmDsdSubServiceSessionLevelRef = DcmDspSession/Extended
                DcmDsdSubServiceSessionLevelRef = Coding_Session
            ControlDtcSetting: DcmDsdSidTabServiceId=133, DcmDsdSidTabSubfuncAvail=true, DcmDsdSidTabSessionLevelRef=DcmDspSession/Extended, DcmDsdSidTabSessionLevelRef=Coding_Session
              Disable (DcmDsdSubService): DcmDsdSubServiceId=2, DcmDsdSubServiceSessionLevelRef=DcmDspSession/Extended, DcmDsdSubServiceSessionLevelRef=Coding_Session
              Enable (DcmDsdSubService): DcmDsdSubServiceId=1, DcmDsdSubServiceSessionLevelRef=DcmDspSession/Extended, DcmDsdSubServiceSessionLevelRef=Coding_Session
            WriteDataById: DcmDsdSidTabServiceId=46, DcmDsdSidTabSubfuncAvail=false, DcmDsdSidTabSessionLevelRef=DcmDspSession/Extended, DcmDsdSidTabSessionLevelRef=Coding_Session, DcmDsdSidTabSecurityLevelRef=UnlockedL1, DcmDsdSidTabSecurityLevelRef=Unlocked_Level_2, DcmDsdSidTabSecurityLevelRef=Unlocked_Level_3, DcmDsdSidTabSecurityLevelRef=Unlocked_Level_4
            ReadDataById: DcmDsdSidTabServiceId=34, DcmDsdSidTabSubfuncAvail=false
            SecurityAccess: DcmDsdSidTabServiceId=39, DcmDsdSidTabSubfuncAvail=true, DcmDsdSidTabSessionLevelRef=DcmDspSession/Programming, DcmDsdSidTabSessionLevelRef=DcmDspSession/Extended, DcmDsdSidTabSessionLevelRef=Coding_Session
              8 x DcmDsdSubService, all with DcmDsdSubServiceSessionLevelRef=DcmDspSession/Extended:
                SendKey_Level2_Send: DcmDsdSubServiceId=4
                SendKey_Level1_Send: DcmDsdSubServiceId=2
                SendKey_Level4_Send: DcmDsdSubServiceId=8, DcmDsdSubServiceSessionLevelRef=DcmDspSession/Programming
                RequestSeed_Level3_Request: DcmDsdSubServiceId=5, DcmDsdSubServiceSessionLevelRef=Coding_Session
                RequestSeed_Level2_Request: DcmDsdSubServiceId=3
                SendKey_Level3_Send: DcmDsdSubServiceId=6, DcmDsdSubServiceSessionLevelRef=Coding_Session
                RequestSeed_Level1_Request: DcmDsdSubServiceId=1
                RequestSeed_Level4_Request: DcmDsdSubServiceId=7, DcmDsdSubServiceSessionLevelRef=DcmDspSession/Programming
            ReadDtcInfo: DcmDsdSidTabServiceId=25, DcmDsdSidTabSubfuncAvail=true, DcmDsdSidTabSessionLevelRef=DcmDspSession/Default, DcmDsdSidTabSessionLevelRef=DcmDspSession/Extended, DcmDsdSidTabSessionLevelRef=Coding_Session
              6 x DcmDsdSubService, all with DcmDsdSubServiceSessionLevelRef=DcmDspSession/Default, DcmDsdSubServiceSessionLevelRef=DcmDspSession/Extended, DcmDsdSubServiceSessionLevelRef=Coding_Session:
                RDTCEDRBDN: DcmDsdSubServiceId=6
                RDTCSSI: DcmDsdSubServiceId=3
                RSUPDTC: DcmDsdSubServiceId=10
                RDTCBSM: DcmDsdSubServiceId=2
                RNODTCBSM: DcmDsdSubServiceId=1
                RDTCSSBDTC: DcmDsdSubServiceId=4
            TesterPresent: DcmDsdSidTabServiceId=62, DcmDsdSidTabSubfuncAvail=true
              TesterPresent (DcmDsdSubService): DcmDsdSubServiceId=0
            CommunicationControl: DcmDsdSidTabServiceId=40, DcmDsdSidTabSubfuncAvail=true, DcmDsdSidTabSessionLevelRef=DcmDspSession/Extended, DcmDsdSidTabSessionLevelRef=Coding_Session
              DisableRxAndTx (DcmDsdSubService): DcmDsdSubServiceId=3, DcmDsdSubServiceSessionLevelRef=DcmDspSession/Extended, DcmDsdSubServiceSessionLevelRef=Coding_Session
              EnableRxAndTx (DcmDsdSubService): DcmDsdSubServiceId=0, DcmDsdSubServiceSessionLevelRef=DcmDspSession/Extended, DcmDsdSubServiceSessionLevelRef=Coding_Session
            RoutineControl: DcmDsdSidTabServiceId=49, DcmDsdSidTabSubfuncAvail=true, DcmDsdSidTabSessionLevelRef=DcmDspSession/Programming, DcmDsdSidTabSessionLevelRef=DcmDspSession/Extended, DcmDsdSidTabSessionLevelRef=Coding_Session
            DiagSessionControl: DcmDsdSidTabServiceId=16, DcmDsdSidTabSubfuncAvail=true
              4 x DcmDsdSubService:
                Programming: DcmDsdSubServiceId=2, DcmDsdSubServiceSessionLevelRef=DcmDspSession/Programming, DcmDsdSubServiceSessionLevelRef=DcmDspSession/Extended
                Default: DcmDsdSubServiceId=1
                Extended: DcmDsdSubServiceId=3, DcmDsdSubServiceSessionLevelRef=DcmDspSession/Default, DcmDsdSubServiceSessionLevelRef=DcmDspSession/Extended, DcmDsdSubServiceSessionLevelRef=Coding_Session
                Coding_Session_Start: DcmDsdSubServiceId=65, DcmDsdSubServiceSessionLevelRef=DcmDspSession/Extended, DcmDsdSubServiceSessionLevelRef=Coding_Session
            RequestDownload: DcmDsdSidTabServiceId=52, DcmDsdSidTabSubfuncAvail=false, DcmDsdSidTabSessionLevelRef=DcmDspSession/Programming, DcmDsdSidTabSecurityLevelRef=Unlocked_Level_4
            ProcessOBDService01: DcmDsdSidTabServiceId=1, DcmDsdSidTabSubfuncAvail=false, DcmDsdSidTabFnc=Dcm_DiagnosticService_0x01, DcmDsdSidTabSessionLevelRef=DcmDspSession/Default, DcmDsdSidTabSessionLevelRef=DcmDspSession/Extended, DcmDsdSidTabSessionLevelRef=Coding_Session
            TransferData: DcmDsdSidTabServiceId=54, DcmDsdSidTabSubfuncAvail=false, DcmDsdSidTabSessionLevelRef=DcmDspSession/Programming, DcmDsdSidTabSecurityLevelRef=Unlocked_Level_4
            Upload_Download_RequestFileTransfer: DcmDsdSidTabServiceId=56, DcmDsdSidTabSubfuncAvail=false, DcmDsdSidTabFnc=Dcm_DiagnosticService_0x38, DcmDsdSidTabSessionLevelRef=DcmDspSession/Programming, DcmDsdSidTabSecurityLevelRef=Unlocked_Level_4
            RequestTransferExit: DcmDsdSidTabServiceId=55, DcmDsdSidTabSubfuncAvail=false, DcmDsdSidTabSessionLevelRef=DcmDspSession/Programming, DcmDsdSidTabSecurityLevelRef=Unlocked_Level_4
            ProcessOBDService09: DcmDsdSidTabServiceId=9, DcmDsdSidTabSubfuncAvail=false, DcmDsdSidTabFnc=Dcm_DiagnosticService_0x09, DcmDsdSidTabSessionLevelRef=DcmDspSession/Default, DcmDsdSidTabSessionLevelRef=DcmDspSession/Extended, DcmDsdSidTabSessionLevelRef=Coding_Session
      DcmDsp: DcmDspMaxDidToRead=5, DcmDspReadDIDReportsNODIByte=false
        DevelopmentData (DcmDspDid): DcmDspDidIdentifier=61834, DcmDspDidUsed=true, DcmDspDidUsePort=USE_DATA_ELEMENT_SPECIFIC_INTERFACES, DcmDspDidInfoRef=DidInfo_DevelopmentData
          3 x DcmDspDidSignal:
            Country_code: DcmDspDidDataPos=0, DcmDspDidDataRef=DevelopmentData_Country_code
            Supplier_code: DcmDspDidDataPos=40, DcmDspDidDataRef=DevelopmentData_Supplier_code
            Supplier_family_code: DcmDspDidDataPos=16, DcmDspDidDataRef=DevelopmentData_Supplier_family_code
        DcmDspSecurity
          4 x DcmDspSecurityRow, all with DcmDspSecurityDelayTime=10, DcmDspSecurityDelayTimeOnBoot=0, DcmDspSecurityKeySize=16, DcmDspSecurityNumAttDelay=3, DcmDspSecuritySeedSize=16, DcmDspSecurityAttemptCounterEnabled=false, DcmDspSecurityUsePort=USE_ASYNCH_CLIENT_SERVER:
            UnlockedL1: DcmDspSecurityLevel=1
            Unlocked_Level_{2..4}: DcmDspSecurityLevel={2..4}
        EcuIdentification (DcmDspDid): DcmDspDidIdentifier=61698, DcmDspDidUsed=true, DcmDspDidUsePort=USE_DATA_ELEMENT_SPECIFIC_INTERFACES, DcmDspDidInfoRef=DidInfo_EcuIdentification
          5 x DcmDspDidSignal:
            Specific_Vehicle_Code_WMI: DcmDspDidDataPos=0, DcmDspDidDataRef=EcuIdentification_Specific_Vehicle_Code_WMI
            Detail_Code: DcmDspDidDataPos=80, DcmDspDidDataRef=EcuIdentification_Detail_Code
            Execution_Package: DcmDspDidDataPos=104, DcmDspDidDataRef=EcuIdentification_Execution_Package
            Subgroup: DcmDspDidDataPos=64, DcmDspDidDataRef=EcuIdentification_Subgroup
            Group: DcmDspDidDataPos=48, DcmDspDidDataRef=EcuIdentification_Group
        SerialNumber (DcmDspDid): DcmDspDidIdentifier=61836, DcmDspDidUsed=true, DcmDspDidUsePort=USE_DATA_ELEMENT_SPECIFIC_INTERFACES, DcmDspDidInfoRef=DidInfo_SerialNumber
          4 x DcmDspDidSignal:
            ECU_Name: DcmDspDidDataPos=0, DcmDspDidDataRef=SerialNumber_ECU_Name
            ECU_index_number: DcmDspDidDataPos=112, DcmDspDidDataRef=SerialNumber_ECU_index_number
            ECU_production_date_in_DD_MM_YY_format: DcmDspDidDataPos=64, DcmDspDidDataRef=SerialNumber_ECU_production_date_in_DD_MM_YY_format
            Supplier_name: DcmDspDidDataPos=24, DcmDspDidDataRef=SerialNumber_Supplier_name
        DidInfo_SerialNumber (DcmDspDidInfo)
          DcmDspDidAccess
            DcmDspDidRead: DcmDspDidReadSessionRef=DcmDspSession/Default, DcmDspDidReadSessionRef=DcmDspSession/Extended, DcmDspDidReadSessionRef=Coding_Session
        DidInfo_DevelopmentData (DcmDspDidInfo)
          DcmDspDidAccess
            DcmDspDidRead: DcmDspDidReadSessionRef=DcmDspSession/Default, DcmDspDidReadSessionRef=DcmDspSession/Extended, DcmDspDidReadSessionRef=Coding_Session
        ComControl (DcmDspComControl)
          DspComContolAllChannel (DcmDspComControlAllChannel): DcmDspAllComMChannelRef=CN_ATOM_CAN_Matrix_PT_V600_20250211_9b894f3d
        DidInfo_EcuIdentification (DcmDspDidInfo)
          DcmDspDidAccess
            DcmDspDidWrite: DcmDspDidWriteSessionRef=DcmDspSession/Extended, DcmDspDidWriteSecurityLevelRef=UnlockedL1, DcmDspDidWriteSecurityLevelRef=Unlocked_Level_2
            DcmDspDidRead: DcmDspDidReadSessionRef=DcmDspSession/Default, DcmDspDidReadSessionRef=DcmDspSession/Extended, DcmDspDidReadSessionRef=Coding_Session
        DcmDspSession
          4 x DcmDspSessionRow, all with DcmDspSessionP2ServerMax=0.05, DcmDspSessionP2StarServerMax=5, DcmDspSessionForBoot=DCM_NO_BOOT:
            Default: DcmDspSessionLevel=1
            Programming: DcmDspSessionLevel=2
            Extended: DcmDspSessionLevel=3
            Coding_Session: DcmDspSessionLevel=65
        DcmDspMemory: DcmDspUseMemoryId=false
          DcmDspMemoryIdInfo
            DcmDspReadMemoryRangeInfo: DcmDspReadMemoryRangeHigh=4294967294, DcmDspReadMemoryRangeLow=0
            DcmDspWriteMemoryRangeInfo: DcmDspWriteMemoryRangeHigh=4294967294, DcmDspWriteMemoryRangeLow=0
        Date_And_Time_Date_And_Time_Second (DcmDspData):
          DcmDspDataSize = 8
          DcmDspDataType = UINT8
          DcmDspDataUsePort = USE_DATA_ASYNCH_CLIENT_SERVER
          DcmDspDataInfoRef = DataInfo_Date_And_Time_Date_And_Time_Second
        AC_charging_parameter (DcmDspDid):
          DcmDspDidIdentifier = 7429
          DcmDspDidUsed = true
          DcmDspDidUsePort = USE_DATA_ELEMENT_SPECIFIC_INTERFACES
          DcmDspDidInfoRef = DidInfo_AC_charging_parameter
          4 x DcmDspDidSignal:
            VCU_OBC_ChargeCurrentCommand: DcmDspDidDataPos=16, DcmDspDidDataRef=AC_charging_parameter_VCU_OBC_ChargeCurrentCommand
            POD_OBC_InputACVoltage: DcmDspDidDataPos=0, DcmDspDidDataRef=AC_charging_parameter_POD_OBC_InputACVoltage
            POD_OBC_OutputDCChargeVoltage: DcmDspDidDataPos=48, DcmDspDidDataRef=AC_charging_parameter_POD_OBC_OutputDCChargeVoltage
            POD_OBC_OutputDCChargeCurrent: DcmDspDidDataPos=32, DcmDspDidDataRef=AC_charging_parameter_POD_OBC_OutputDCChargeCurrent
        DataInfo_Read_Level2_OEM_Key_written_status_Read_Level2_OEM_Key_rewrite_counter (DcmDspDataInfo): DcmDspDataFixedLength=true
        DataInfo_EcuIdentification_Group (DcmDspDataInfo): DcmDspDataFixedLength=true
        Last_service_date_Year (DcmDspData): DcmDspDataSize=8, DcmDspDataType=UINT8, DcmDspDataUsePort=USE_DATA_ASYNCH_CLIENT_SERVER, DcmDspDataInfoRef=DataInfo_Last_service_date_Year
        Read_Vehicle_Security_related_events_Brute_Force_UDS_0x27_servic_Brute_Force_UDS_0x27_service_Event_occurrence_counter (DcmDspData):
          DcmDspDataSize = 16
          DcmDspDataType = UINT16
          DcmDspDataUsePort = USE_DATA_ASYNCH_CLIENT_SERVER
          DcmDspDataInfoRef = DataInfo_Read_Vehicle_Security_related_events_Brute_Force_UDS_0x27_servic_Brute_Force_UDS_0x27_service_Event_occurrence_counter
        DataInfo_Read_Vehicle_Security_related_events_Software_configuration_inte_Software_configuration_integrity_check_failurec315628 (DcmDspDataInfo): DcmDspDataFixedLength=true
        DataInfo_Write_Level3_OEM_Key_OEM_Key_Value (DcmDspDataInfo): DcmDspDataFixedLength=true
        3 x DcmDspData, all with DcmDspDataSize=8, DcmDspDataType=UINT8, DcmDspDataUsePort=USE_DATA_ASYNCH_CLIENT_SERVER:
          Read_Vehicle_Security_related_events_Software_configuration_inte_Event_occurance_time_Year_{3..5}: DcmDspDataInfoRef=DataInfo_Read_Vehicle_Security_related_events_Software_configuration_inte_Event_occurance_time_Year_{3..5}
        DataInfo_VCU_PowerMaxAllowed_parameter2_BMSChgPowerLimit (DcmDspDataInfo): DcmDspDataFixedLength=true
        Read_active_diagnostic_session_Active_diagnostic_session (DcmDspData):
          DcmDspDataSize = 8
          DcmDspDataType = UINT8
          DcmDspDataUsePort = USE_DATA_ASYNCH_CLIENT_SERVER
          DcmDspDataInfoRef = DataInfo_Read_active_diagnostic_session_Active_diagnostic_session
        DataInfo_Read_Write_coding_data_string_CDS_CDS_CRC (DcmDspDataInfo): DcmDspDataFixedLength=true
        Electronic_lock_state_Electronic_lock_state (DcmDspData):
          DcmDspDataSize = 8
          DcmDspDataType = UINT8
          DcmDspDataUsePort = USE_DATA_ASYNCH_CLIENT_SERVER
          DcmDspDataInfoRef = DataInfo_Electronic_lock_state_Electronic_lock_state
        DataInfo_Read_Write_coding_data_string_CDS_Version_Byte_1 (DcmDspDataInfo): DcmDspDataFixedLength=true
        EcuIdentification_Execution_Package (DcmDspData):
          DcmDspDataSize = 16
          DcmDspDataType = UINT8_N
          DcmDspDataUsePort = USE_DATA_ASYNCH_CLIENT_SERVER
          DcmDspDataInfoRef = DataInfo_EcuIdentification_Execution_Package
        3 x DcmDspDataInfo, all with DcmDspDataFixedLength=true:
          DataInfo_Date_And_Time_Date_And_Time_Hour
          DataInfo_Read_Write_coding_data_string_CDS_Version_Byte_0
          DataInfo_Driver_Mode_Driver_Mode
        DidInfo_VCU_PowerMaxAllowed_parameter1 (DcmDspDidInfo)
          DcmDspDidAccess
            DcmDspDidRead: DcmDspDidReadSessionRef=DcmDspSession/Default, DcmDspDidReadSessionRef=DcmDspSession/Extended, DcmDspDidReadSessionRef=Coding_Session
        Read_Vehicle_Security_related_events_Brute_Force_UDS_0x27_servic_Event_occurance_time_Year_3 (DcmDspData):
          DcmDspDataSize = 8
          DcmDspDataType = UINT8
          DcmDspDataUsePort = USE_DATA_ASYNCH_CLIENT_SERVER
          DcmDspDataInfoRef = DataInfo_Read_Vehicle_Security_related_events_Brute_Force_UDS_0x27_servic_Event_occurance_time_Year_3
        Read_Vehicle_Security_related_events_Brute_Force_UDS_0x27_servic_Event_occurance_time_Year_2 (DcmDspData):
          DcmDspDataSize = 8
          DcmDspDataType = UINT8
          DcmDspDataUsePort = USE_DATA_ASYNCH_CLIENT_SERVER
          DcmDspDataInfoRef = DataInfo_Read_Vehicle_Security_related_events_Brute_Force_UDS_0x27_servic_Event_occurance_time_Year_2
        DidInfo_VCU_PowerMaxAllowed_parameter2 (DcmDspDidInfo)
          DcmDspDidAccess
            DcmDspDidRead: DcmDspDidReadSessionRef=DcmDspSession/Default, DcmDspDidReadSessionRef=DcmDspSession/Extended, DcmDspDidReadSessionRef=Coding_Session
        Read_Vehicle_Security_related_events_Brute_Force_UDS_0x27_servic_Event_occurance_time_Year_1 (DcmDspData):
          DcmDspDataSize = 8
          DcmDspDataType = UINT8
          DcmDspDataUsePort = USE_DATA_ASYNCH_CLIENT_SERVER
          DcmDspDataInfoRef = DataInfo_Read_Vehicle_Security_related_events_Brute_Force_UDS_0x27_servic_Event_occurance_time_Year_1
        DidInfo_VCU_PowerMaxAllowed_parameter3 (DcmDspDidInfo)
          DcmDspDidAccess
            DcmDspDidRead: DcmDspDidReadSessionRef=DcmDspSession/Default, DcmDspDidReadSessionRef=DcmDspSession/Extended, DcmDspDidReadSessionRef=Coding_Session
        Read_Vehicle_Security_related_events_Brute_Force_UDS_0x27_servic_Event_occurance_time_Year_5 (DcmDspData):
          DcmDspDataSize = 8
          DcmDspDataType = UINT8
          DcmDspDataUsePort = USE_DATA_ASYNCH_CLIENT_SERVER
          DcmDspDataInfoRef = DataInfo_Read_Vehicle_Security_related_events_Brute_Force_UDS_0x27_servic_Event_occurance_time_Year_5
        Read_Vehicle_Security_related_events_Brute_Force_UDS_0x27_servic_Event_occurance_time_Year_4 (DcmDspData):
          DcmDspDataSize = 8
          DcmDspDataType = UINT8
          DcmDspDataUsePort = USE_DATA_ASYNCH_CLIENT_SERVER
          DcmDspDataInfoRef = DataInfo_Read_Vehicle_Security_related_events_Brute_Force_UDS_0x27_servic_Event_occurance_time_Year_4
        DataInfo_BS_base_information4_SOF_V1 (DcmDspDataInfo): DcmDspDataFixedLength=true
        DataInfo_VCU_PowerMaxAllowed_parameter3_V2LPower (DcmDspDataInfo): DcmDspDataFixedLength=true
        VCU_PowerMaxAllowed_parameter2_BMSChgPowerLimit (DcmDspData):
          DcmDspDataSize = 16
          DcmDspDataType = UINT16
          DcmDspDataUsePort = USE_DATA_ASYNCH_CLIENT_SERVER
          DcmDspDataInfoRef = DataInfo_VCU_PowerMaxAllowed_parameter2_BMSChgPowerLimit
        SOC_SOC (DcmDspData): DcmDspDataSize=16, DcmDspDataType=UINT16, DcmDspDataUsePort=USE_DATA_ASYNCH_CLIENT_SERVER, DcmDspDataInfoRef=DataInfo_SOC_SOC
        DidInfo_Last_service_date (DcmDspDidInfo)
          DcmDspDidAccess
            DcmDspDidWrite: DcmDspDidWriteSessionRef=DcmDspSession/Extended, DcmDspDidWriteSecurityLevelRef=UnlockedL1
            DcmDspDidRead: DcmDspDidReadSessionRef=DcmDspSession/Default, DcmDspDidReadSessionRef=DcmDspSession/Extended, DcmDspDidReadSessionRef=Coding_Session
        DataInfo_Read_active_diagnostic_session_Active_diagnostic_session (DcmDspDataInfo): DcmDspDataFixedLength=true
        Write_Level3_OEM_Key (DcmDspDid):
          DcmDspDidIdentifier = 61460
          DcmDspDidUsed = true
          DcmDspDidUsePort = USE_DATA_ELEMENT_SPECIFIC_INTERFACES
          DcmDspDidInfoRef = DidInfo_Write_Level3_OEM_Key
          OEM_Key_Value (DcmDspDidSignal): DcmDspDidDataPos=0, DcmDspDidDataRef=Write_Level3_OEM_Key_OEM_Key_Value
          CRC (DcmDspDidSignal): DcmDspDidDataPos=128, DcmDspDidDataRef=Write_Level3_OEM_Key_CRC
        6 x DcmDspDataInfo, all with DcmDspDataFixedLength=true:
          DataInfo_AC_charging_parameter_POD_OBC_InputACVoltage
          DataInfo_Read_Write_coding_data_string_CDS_Reserved3
          DataInfo_BS_base_information4_SOF_V2
          DataInfo_VCU_PowerMaxAllowed_parameter3_DCDCPower
          DataInfo_Read_Write_coding_data_string_CDS_Reserved2
          DataInfo_Coding_for_CDS_fingerprint_codingDate_byte_1_YY
        EcuIdentification_Subgroup (DcmDspData): DcmDspDataSize=16, DcmDspDataType=UINT8_N, DcmDspDataUsePort=USE_DATA_ASYNCH_CLIENT_SERVER, DcmDspDataInfoRef=DataInfo_EcuIdentification_Subgroup
        DataInfo_BS_base_information4_T_BATT (DcmDspDataInfo): DcmDspDataFixedLength=true
        Read_Vehicle_Security_related_events_Software_configuration_inte (DcmDspDid):
          DcmDspDidIdentifier = 61472
          DcmDspDidUsed = true
          DcmDspDidUsePort = USE_DATA_ELEMENT_SPECIFIC_INTERFACES
          DcmDspDidInfoRef = DidInfo_Read_Vehicle_Security_related_events_Software_configuration_inte
          21 x DcmDspDidSignal:
            Event_occurance_time_Year_1: DcmDspDidDataPos=8, DcmDspDidDataRef=Read_Vehicle_Security_related_events_Software_configuration_inte_Event_occurance_time_Year_1
            Event_occurance_time_Day_1: DcmDspDidDataPos=24, DcmDspDidDataRef=Read_Vehicle_Security_related_events_Software_configuration_inte_Event_occurance_time_Day_1
            Software_configuration_integrity_check_failure_Event_occurrence_: DcmDspDidDataPos=160, DcmDspDidDataRef=Read_Vehicle_Security_related_events_Software_configuration_inte_Software_configuration_integrity_check_failure_Event_oc4f77644e
            Event_occurance_time_Day_2: DcmDspDidDataPos=56, DcmDspDidDataRef=Read_Vehicle_Security_related_events_Software_configuration_inte_Event_occurance_time_Day_2
            Event_occurance_time_Day_3: DcmDspDidDataPos=88, DcmDspDidDataRef=Read_Vehicle_Security_related_events_Software_configuration_inte_Event_occurance_time_Day_3
            Event_occurance_time_Day_4: DcmDspDidDataPos=120, DcmDspDidDataRef=Read_Vehicle_Security_related_events_Software_configuration_inte_Event_occurance_time_Day_4
            Event_occurance_time_Day_5: DcmDspDidDataPos=152, DcmDspDidDataRef=Read_Vehicle_Security_related_events_Software_configuration_inte_Event_occurance_time_Day_5
            Software_configuration_integrity_check_5: DcmDspDidDataPos=128, DcmDspDidDataRef=Read_Vehicle_Security_related_events_Software_configuration_inte_Software_configuration_integrity_check_5
            Event_occurance_time_Month_2: DcmDspDidDataPos=48, DcmDspDidDataRef=Read_Vehicle_Security_related_events_Software_configuration_inte_Event_occurance_time_Month_2
            Event_occurance_time_Month_1: DcmDspDidDataPos=16, DcmDspDidDataRef=Read_Vehicle_Security_related_events_Software_configuration_inte_Event_occurance_time_Month_1
            Event_occurance_time_Month_4: DcmDspDidDataPos=112, DcmDspDidDataRef=Read_Vehicle_Security_related_events_Software_configuration_inte_Event_occurance_time_Month_4
            Software_configuration_integrity_check_3: DcmDspDidDataPos=64, DcmDspDidDataRef=Read_Vehicle_Security_related_events_Software_configuration_inte_Software_configuration_integrity_check_3
            Software_configuration_integrity_check_4: DcmDspDidDataPos=96, DcmDspDidDataRef=Read_Vehicle_Security_related_events_Software_configuration_inte_Software_configuration_integrity_check_4
            Event_occurance_time_Month_3: DcmDspDidDataPos=80, DcmDspDidDataRef=Read_Vehicle_Security_related_events_Software_configuration_inte_Event_occurance_time_Month_3
            Software_configuration_integrity_check_1: DcmDspDidDataPos=0, DcmDspDidDataRef=Read_Vehicle_Security_related_events_Software_configuration_inte_Software_configuration_integrity_check_1
            Event_occurance_time_Month_5: DcmDspDidDataPos=144, DcmDspDidDataRef=Read_Vehicle_Security_related_events_Software_configuration_inte_Event_occurance_time_Month_5
            Software_configuration_integrity_check_2: DcmDspDidDataPos=32, DcmDspDidDataRef=Read_Vehicle_Security_related_events_Software_configuration_inte_Software_configuration_integrity_check_2
            Event_occurance_time_Year_4: DcmDspDidDataPos=104, DcmDspDidDataRef=Read_Vehicle_Security_related_events_Software_configuration_inte_Event_occurance_time_Year_4
            Event_occurance_time_Year_5: DcmDspDidDataPos=136, DcmDspDidDataRef=Read_Vehicle_Security_related_events_Software_configuration_inte_Event_occurance_time_Year_5
            Event_occurance_time_Year_2: DcmDspDidDataPos=40, DcmDspDidDataRef=Read_Vehicle_Security_related_events_Software_configuration_inte_Event_occurance_time_Year_2
            Event_occurance_time_Year_3: DcmDspDidDataPos=72, DcmDspDidDataRef=Read_Vehicle_Security_related_events_Software_configuration_inte_Event_occurance_time_Year_3
        BSW_version_number_Major_release (DcmDspData):
          DcmDspDataSize = 8
          DcmDspDataType = UINT8
          DcmDspDataUsePort = USE_DATA_ASYNCH_CLIENT_SERVER
          DcmDspDataInfoRef = DataInfo_BSW_version_number_Major_release
        VCU_AccPealparameter_Accelerator_pedal_sensor_1_voltage (DcmDspData):
          DcmDspDataSize = 16
          DcmDspDataType = UINT16
          DcmDspDataUsePort = USE_DATA_ASYNCH_CLIENT_SERVER
          DcmDspDataInfoRef = DataInfo_VCU_AccPealparameter_Accelerator_pedal_sensor_1_voltage
        DataInfo_VCU_PowerMaxAllowed_parameter1_VCU_TCUPowerAllowed (DcmDspDataInfo): DcmDspDataFixedLength=true
        Battery_Voltage_Battery_Voltage (DcmDspData):
          DcmDspDataSize = 16
          DcmDspDataType = UINT16
          DcmDspDataUsePort = USE_DATA_ASYNCH_CLIENT_SERVER
          DcmDspDataInfoRef = DataInfo_Battery_Voltage_Battery_Voltage
        VCU_Torque_parameter_Torque_MinAllowed (DcmDspData):
          DcmDspDataSize = 16
          DcmDspDataType = UINT16
          DcmDspDataUsePort = USE_DATA_ASYNCH_CLIENT_SERVER
          DcmDspDataInfoRef = DataInfo_VCU_Torque_parameter_Torque_MinAllowed
        DidInfo_Electronic_lock_state (DcmDspDidInfo)
          DcmDspDidAccess
            DcmDspDidRead: DcmDspDidReadSessionRef=DcmDspSession/Default, DcmDspDidReadSessionRef=DcmDspSession/Extended, DcmDspDidReadSessionRef=Coding_Session
        DataInfo_SerialNumber_ECU_index_number (DcmDspDataInfo): DcmDspDataFixedLength=true
        BS_base_information4 (DcmDspDid): DcmDspDidIdentifier=7457, DcmDspDidUsed=true, DcmDspDidUsePort=USE_DATA_ELEMENT_SPECIFIC_INTERFACES, DcmDspDidInfoRef=DidInfo_BS_base_information4
          6 x DcmDspDidSignal:
            SOF_V2: DcmDspDidDataPos=40, DcmDspDidDataRef=BS_base_information4_SOF_V2
            VCU_BS_Hcurrent: DcmDspDidDataPos=8, DcmDspDidDataRef=BS_base_information4_VCU_BS_Hcurrent
            SOF_V1: DcmDspDidDataPos=32, DcmDspDidDataRef=BS_base_information4_SOF_V1
            SOH: DcmDspDidDataPos=48, DcmDspDidDataRef=BS_base_information4_SOH
            BS_SOC: DcmDspDidDataPos=0, DcmDspDidDataRef=BS_base_information4_BS_SOC
            T_BATT: DcmDspDidDataPos=24, DcmDspDidDataRef=BS_base_information4_T_BATT
        DidInfo_Read_Level3_OEM_Key_written_status (DcmDspDidInfo)
          DcmDspDidAccess
            DcmDspDidRead: DcmDspDidReadSessionRef=DcmDspSession/Default, DcmDspDidReadSessionRef=DcmDspSession/Extended, DcmDspDidReadSessionRef=Coding_Session
        DataInfo_Total_Odometer_VCU_Total_Odometer_VCU (DcmDspDataInfo): DcmDspDataFixedLength=true
        VCU_PowerMaxAllowed_parameter3_MCUPower (DcmDspData):
          DcmDspDataSize = 8
          DcmDspDataType = UINT8
          DcmDspDataUsePort = USE_DATA_ASYNCH_CLIENT_SERVER
          DcmDspDataInfoRef = DataInfo_VCU_PowerMaxAllowed_parameter3_MCUPower
        Read_Level4_OEM_Key_written_status (DcmDspDid):
          DcmDspDidIdentifier = 61463
          DcmDspDidUsed = true
          DcmDspDidUsePort = USE_DATA_ELEMENT_SPECIFIC_INTERFACES
          DcmDspDidInfoRef = DidInfo_Read_Level4_OEM_Key_written_status
          Read_Level4_OEM_Key_rewrite_counter (DcmDspDidSignal): DcmDspDidDataPos=0, DcmDspDidDataRef=Read_Level4_OEM_Key_written_status_Read_Level4_OEM_Key_rewrite_counter
        DataInfo_Vehicle_speed_Vehicle_speed (DcmDspDataInfo): DcmDspDataFixedLength=true
        DataInfo_Read_Write_coding_data_string_CDS_Reserved1 (DcmDspDataInfo): DcmDspDataFixedLength=true
        Read_Write_coding_data_string_CDS_Version_Byte_0 (DcmDspData):
          DcmDspDataSize = 8
          DcmDspDataType = UINT8
          DcmDspDataUsePort = USE_DATA_ASYNCH_CLIENT_SERVER
          DcmDspDataInfoRef = DataInfo_Read_Write_coding_data_string_CDS_Version_Byte_0
        DidInfo_VCU_HV_InterLock_PWM_pfrequency (DcmDspDidInfo)
          DcmDspDidAccess
            DcmDspDidRead: DcmDspDidReadSessionRef=DcmDspSession/Default, DcmDspDidReadSessionRef=DcmDspSession/Extended, DcmDspDidReadSessionRef=Coding_Session
        DataInfo_VCU_control_S2_status_New_Bit_Field (DcmDspDataInfo): DcmDspDataFixedLength=true
        Last_service_date_Month (DcmDspData): DcmDspDataSize=8, DcmDspDataType=UINT8, DcmDspDataUsePort=USE_DATA_ASYNCH_CLIENT_SERVER, DcmDspDataInfoRef=DataInfo_Last_service_date_Month
        DidInfo_VCU_Torque_parameter (DcmDspDidInfo)
          DcmDspDidAccess
            DcmDspDidRead: DcmDspDidReadSessionRef=DcmDspSession/Default, DcmDspDidReadSessionRef=DcmDspSession/Extended, DcmDspDidReadSessionRef=Coding_Session
        DataInfo_Last_service_date_Day (DcmDspDataInfo): DcmDspDataFixedLength=true
        Read_Write_coding_data_string_CDS_Version_Byte_1 (DcmDspData):
          DcmDspDataSize = 8
          DcmDspDataType = UINT8
          DcmDspDataUsePort = USE_DATA_ASYNCH_CLIENT_SERVER
          DcmDspDataInfoRef = DataInfo_Read_Write_coding_data_string_CDS_Version_Byte_1
        5 x DcmDspDataInfo, all with DcmDspDataFixedLength=true:
          DataInfo_VCU_HVStatus_VCU_HVStatus
          DataInfo_Read_Vehicle_Security_related_events_Brute_Force_UDS_0x27_servic_Event_occurance_time_Year_3
          DataInfo_Read_Vehicle_Security_related_events_Brute_Force_UDS_0x27_servic_Event_occurance_time_Year_4
          DataInfo_Read_Vehicle_Security_related_events_Brute_Force_UDS_0x27_servic_Event_occurance_time_Year_1
          DataInfo_Read_Vehicle_Security_related_events_Software_configuration_inte_Event_occurance_time_Year_5
        DidInfo_Total_Odometer_VCU (DcmDspDidInfo)
          DcmDspDidAccess
            DcmDspDidWrite: DcmDspDidWriteSessionRef=DcmDspSession/Extended, DcmDspDidWriteSecurityLevelRef=Unlocked_Level_2
            DcmDspDidRead: DcmDspDidReadSessionRef=DcmDspSession/Default, DcmDspDidReadSessionRef=DcmDspSession/Extended, DcmDspDidReadSessionRef=Coding_Session
        4 x DcmDspDataInfo, all with DcmDspDataFixedLength=true:
          DataInfo_Read_Vehicle_Security_related_events_Brute_Force_UDS_0x27_servic_Event_occurance_time_Year_2
          DataInfo_Read_Vehicle_Security_related_events_Software_configuration_inte_Event_occurance_time_Year_4
          DataInfo_Read_Vehicle_Security_related_events_Software_configuration_inte_Event_occurance_time_Year_3
          DataInfo_Read_Vehicle_Security_related_events_Software_configuration_inte_Event_occurance_time_Year_2
        Vehicle_State_Ignition_Switch_Signal (DcmDspData):
          DcmDspDataSize = 8
          DcmDspDataType = UINT8
          DcmDspDataUsePort = USE_DATA_ASYNCH_CLIENT_SERVER
          DcmDspDataInfoRef = DataInfo_Vehicle_State_Ignition_Switch_Signal
        DataInfo_Read_Vehicle_Security_related_events_Software_configuration_inte_Event_occurance_time_Year_1 (DcmDspDataInfo): DcmDspDataFixedLength=true
        3 x DcmDspData, all with DcmDspDataUsePort=USE_DATA_ASYNCH_CLIENT_SERVER:
          Date_And_Time_Date_And_Time_Day: DcmDspDataSize=8, DcmDspDataType=UINT8, DcmDspDataInfoRef=DataInfo_Date_And_Time_Date_And_Time_Day
          VCU_PowerMaxAllowed_parameter2_BMSDisChgPowerLimit: DcmDspDataSize=16, DcmDspDataType=UINT16, DcmDspDataInfoRef=DataInfo_VCU_PowerMaxAllowed_parameter2_BMSDisChgPowerLimit
          VCU_Torque_parameter_Torque_MaxAllowed: DcmDspDataSize=16, DcmDspDataType=UINT16, DcmDspDataInfoRef=DataInfo_VCU_Torque_parameter_Torque_MaxAllowed
        DataInfo_VCU_Torque_parameter_Torque_MinAllowed (DcmDspDataInfo): DcmDspDataFixedLength=true
        RoutineInfo_CheckProgrammingPreCondition (DcmDspRoutineInfo)
          DcmDspRoutineAuthorization: DcmDspRoutineSessionRef=DcmDspSession/Extended
          DcmDspStartRoutineOut
            Out_programmingPreConditionList (DcmDspStartRoutineOutSignal): DcmDspRoutineSignalLength=40, DcmDspRoutineSignalType=UINT8_N, DcmDspRoutineSignalEndianness=opaque, DcmDspRoutineSignalPos=0
        DataInfo_Read_ECU_Part_Number_Specific_Vehicle_Code_WMI (DcmDspDataInfo): DcmDspDataFixedLength=true
        Read_ECU_Part_Number_Detail_Code (DcmDspData):
          DcmDspDataSize = 24
          DcmDspDataType = UINT8_N
          DcmDspDataUsePort = USE_DATA_ASYNCH_CLIENT_SERVER
          DcmDspDataInfoRef = DataInfo_Read_ECU_Part_Number_Detail_Code
        DataInfo_DevelopmentData_Country_code (DcmDspDataInfo): DcmDspDataFixedLength=true
        7 x DcmDspData, all with DcmDspDataSize=8, DcmDspDataType=UINT8_N, DcmDspDataUsePort=USE_DATA_ASYNCH_CLIENT_SERVER:
          Read_Write_coding_data_string_CDS_CDS_Short_VIN_High_Byte_{0..5}: DcmDspDataInfoRef=DataInfo_Read_Write_coding_data_string_CDS_CDS_Short_VIN_High_Byte_{0..5}
          Read_Write_coding_data_string_CDS_CDS_Short_VIN_High_Byte_7: DcmDspDataInfoRef=DataInfo_Read_Write_coding_data_string_CDS_CDS_Short_VIN_High_Byte_7
        DidInfo_Write_Level3_OEM_Key (DcmDspDidInfo)
          DcmDspDidAccess
            DcmDspDidWrite: DcmDspDidWriteSessionRef=DcmDspSession/Extended, DcmDspDidWriteSecurityLevelRef=Unlocked_Level_3
        DataInfo_Read_Vehicle_Security_related_events_Brute_Force_UDS_0x27_servic_Event_occurance_time_Year_5 (DcmDspDataInfo): DcmDspDataFixedLength=true
        Coding_for_CDS_fingerprint_codingDate_byte_2_MM (DcmDspData):
          DcmDspDataSize = 8
          DcmDspDataType = UINT8
          DcmDspDataUsePort = USE_DATA_ASYNCH_CLIENT_SERVER
          DcmDspDataInfoRef = DataInfo_Coding_for_CDS_fingerprint_codingDate_byte_2_MM
        VCU_PowerMaxAllowed_parameter2_MCUFeedbackPowerLimit (DcmDspData):
          DcmDspDataSize = 16
          DcmDspDataType = UINT16
          DcmDspDataUsePort = USE_DATA_ASYNCH_CLIENT_SERVER
          DcmDspDataInfoRef = DataInfo_VCU_PowerMaxAllowed_parameter2_MCUFeedbackPowerLimit
        DataInfo_Bootloader_version_number_Minor_release (DcmDspDataInfo): DcmDspDataFixedLength=true
        DidInfo_Read_Vehicle_Security_related_events_Brute_Force_UDS_0x27_servic (DcmDspDidInfo)
          DcmDspDidAccess
            DcmDspDidRead: DcmDspDidReadSessionRef=DcmDspSession/Default, DcmDspDidReadSessionRef=DcmDspSession/Extended, DcmDspDidReadSessionRef=Coding_Session
        DataInfo_Read_ECU_manufacturing_date_ECU_Manufacturing_Date_Year (DcmDspDataInfo): DcmDspDataFixedLength=true
        DidInfo_BS_base_information4 (DcmDspDidInfo)
          DcmDspDidAccess
            DcmDspDidRead: DcmDspDidReadSessionRef=DcmDspSession/Default, DcmDspDidReadSessionRef=DcmDspSession/Extended, DcmDspDidReadSessionRef=Coding_Session
        CheckProgrammingPreCondition (DcmDspRoutine):
          DcmDspRequestResultsRoutineSupported = false
          DcmDspStopRoutineSupported = false
          DcmDspRoutineIdentifier = 515
          DcmDspRoutineFixedLength = false
          DcmDspRoutineUsePort = true
          DcmDspRoutineUsed = true
          DcmDspRoutineInfoRef = RoutineInfo_CheckProgrammingPreCondition
        RoutineInfo_Check_Memory (DcmDspRoutineInfo)
          DcmDspStartRoutineIn
            In_checksum (DcmDspStartRoutineInSignal): DcmDspRoutineSignalLength=32, DcmDspRoutineSignalType=UINT32, DcmDspRoutineSignalEndianness=BIG_ENDIAN, DcmDspRoutineSignalPos=0
          DcmDspRoutineAuthorization: DcmDspRoutineSessionRef=DcmDspSession/Programming, DcmDspRoutineSecurityLevelRef=Unlocked_Level_4
          DcmDspStartRoutineOut
            Out_routineResult (DcmDspStartRoutineOutSignal): DcmDspRoutineSignalLength=8, DcmDspRoutineSignalType=UINT8, DcmDspRoutineSignalPos=0
        3 x DcmDspDataInfo, all with DcmDspDataFixedLength=true:
          DataInfo_Read_ECU_Part_Number_Group
          DataInfo_EcuIdentification_Specific_Vehicle_Code_WMI
          DataInfo_Write_Level4_OEM_Key_OEM_Key_Value
        RoutineInfo_Erase_Memory (DcmDspRoutineInfo)
          DcmDspStartRoutineIn
            3 x DcmDspStartRoutineInSignal:
              In_memoryAddress: DcmDspRoutineSignalLength=32, DcmDspRoutineSignalType=UINT32, DcmDspRoutineSignalEndianness=BIG_ENDIAN, DcmDspRoutineSignalPos=8
              In_memorySize: DcmDspRoutineSignalLength=32, DcmDspRoutineSignalType=UINT32, DcmDspRoutineSignalEndianness=BIG_ENDIAN, DcmDspRoutineSignalPos=40
              In_addressAndLengthFormatIdentifier: DcmDspRoutineSignalLength=8, DcmDspRoutineSignalType=UINT8, DcmDspRoutineSignalPos=0
          DcmDspRoutineAuthorization: DcmDspRoutineSessionRef=DcmDspSession/Programming, DcmDspRoutineSecurityLevelRef=Unlocked_Level_4
          DcmDspStartRoutineOut
            Out_routineResult (DcmDspStartRoutineOutSignal): DcmDspRoutineSignalLength=8, DcmDspRoutineSignalType=UINT8, DcmDspRoutineSignalPos=0
        Read_active_diagnostic_session (DcmDspDid):
          DcmDspDidIdentifier = 61830
          DcmDspDidUsed = true
          DcmDspDidUsePort = USE_DATA_ELEMENT_SPECIFIC_INTERFACES
          DcmDspDidInfoRef = DidInfo_Read_active_diagnostic_session
          Active_diagnostic_session (DcmDspDidSignal): DcmDspDidDataPos=0, DcmDspDidDataRef=Read_active_diagnostic_session_Active_diagnostic_session
        Total_Odometer_VCU (DcmDspDid): DcmDspDidIdentifier=7456, DcmDspDidUsed=true, DcmDspDidUsePort=USE_DATA_ELEMENT_SPECIFIC_INTERFACES, DcmDspDidInfoRef=DidInfo_Total_Odometer_VCU
          Total_Odometer_VCU (DcmDspDidSignal): DcmDspDidDataPos=0, DcmDspDidDataRef=Total_Odometer_VCU_Total_Odometer_VCU
        DidInfo_Date_And_Time (DcmDspDidInfo)
          DcmDspDidAccess
            DcmDspDidRead: DcmDspDidReadSessionRef=DcmDspSession/Default, DcmDspDidReadSessionRef=DcmDspSession/Extended, DcmDspDidReadSessionRef=Coding_Session
        DataInfo_DC_Charging_port_Temperature_POD_DCInletTempA (DcmDspDataInfo): DcmDspDataFixedLength=true
        DidInfo_Read_Write_complete_VIN (DcmDspDidInfo)
          DcmDspDidAccess
            DcmDspDidWrite: DcmDspDidWriteSessionRef=DcmDspSession/Extended, DcmDspDidWriteSecurityLevelRef=UnlockedL1, DcmDspDidWriteSecurityLevelRef=Unlocked_Level_2
            DcmDspDidRead: DcmDspDidReadSessionRef=DcmDspSession/Default, DcmDspDidReadSessionRef=DcmDspSession/Extended, DcmDspDidReadSessionRef=Coding_Session
        3 x DcmDspDataInfo, all with DcmDspDataFixedLength=true:
          DataInfo_Supplier_ECU_hardware_part_number_Changes_in_electronic_components_level
          DataInfo_Bootloader_version_number_Major_release
          DataInfo_DC_Charging_port_Temperature_POD_DCInletTempB
        Read_Write_coding_data_string_CDS_CDS_Format_Byte_High_Byte_0 (DcmDspData):
          DcmDspDataSize = 8
          DcmDspDataType = UINT8
          DcmDspDataUsePort = USE_DATA_ASYNCH_CLIENT_SERVER
          DcmDspDataInfoRef = DataInfo_Read_Write_coding_data_string_CDS_CDS_Format_Byte_High_Byte_0
        DidInfo_Battery_Voltage (DcmDspDidInfo)
          DcmDspDidAccess
            DcmDspDidRead: DcmDspDidReadSessionRef=DcmDspSession/Default, DcmDspDidReadSessionRef=DcmDspSession/Extended, DcmDspDidReadSessionRef=Coding_Session
        BSW_version_number_Minor_release (DcmDspData):
          DcmDspDataSize = 8
          DcmDspDataType = UINT8
          DcmDspDataUsePort = USE_DATA_ASYNCH_CLIENT_SERVER
          DcmDspDataInfoRef = DataInfo_BSW_version_number_Minor_release
        VCU_HVStatus (DcmDspDid): DcmDspDidIdentifier=61861, DcmDspDidUsed=true, DcmDspDidUsePort=USE_DATA_ELEMENT_SPECIFIC_INTERFACES, DcmDspDidInfoRef=DidInfo_VCU_HVStatus
          VCU_HVStatus (DcmDspDidSignal): DcmDspDidDataPos=0, DcmDspDidDataRef=VCU_HVStatus_VCU_HVStatus
        Read_Write_coding_data_string_CDS_CDS_Format_Byte_High_Byte_1 (DcmDspData):
          DcmDspDataSize = 8
          DcmDspDataType = UINT8
          DcmDspDataUsePort = USE_DATA_ASYNCH_CLIENT_SERVER
          DcmDspDataInfoRef = DataInfo_Read_Write_coding_data_string_CDS_CDS_Format_Byte_High_Byte_1
        DataInfo_Read_ECU_Part_Number_Detail_Code (DcmDspDataInfo): DcmDspDataFixedLength=true
        DidInfo_Write_Level2_OEM_Key (DcmDspDidInfo)
          DcmDspDidAccess
            DcmDspDidWrite: DcmDspDidWriteSessionRef=DcmDspSession/Extended, DcmDspDidWriteSecurityLevelRef=Unlocked_Level_2
        DidInfo_Read_ECU_Part_Number (DcmDspDidInfo)
          DcmDspDidAccess
            DcmDspDidRead: DcmDspDidReadSessionRef=DcmDspSession/Default, DcmDspDidReadSessionRef=DcmDspSession/Extended, DcmDspDidReadSessionRef=Coding_Session
        SerialNumber_ECU_Name (DcmDspData): DcmDspDataSize=24, DcmDspDataType=UINT8_N, DcmDspDataUsePort=USE_DATA_ASYNCH_CLIENT_SERVER, DcmDspDataInfoRef=DataInfo_SerialNumber_ECU_Name
        Vehicle_speed (DcmDspDid): DcmDspDidIdentifier=61859, DcmDspDidUsed=true, DcmDspDidUsePort=USE_DATA_ELEMENT_SPECIFIC_INTERFACES, DcmDspDidInfoRef=DidInfo_Vehicle_speed
          Vehicle_speed (DcmDspDidSignal): DcmDspDidDataPos=0, DcmDspDidDataRef=Vehicle_speed_Vehicle_speed
        Read_Vehicle_Security_related_events_Software_configuration_inte_Software_configuration_integrity_check_failure_Event_oc4f77644e (DcmDspData):
          DcmDspDataSize = 16
          DcmDspDataType = UINT16
          DcmDspDataUsePort = USE_DATA_ASYNCH_CLIENT_SERVER
          DcmDspDataInfoRef = DataInfo_Read_Vehicle_Security_related_events_Software_configuration_inte_Software_configuration_integrity_check_failurec315628
        DidInfo_Bootloader_version_number (DcmDspDidInfo)
          DcmDspDidAccess
            DcmDspDidRead: DcmDspDidReadSessionRef=DcmDspSession/Default, DcmDspDidReadSessionRef=DcmDspSession/Extended, DcmDspDidReadSessionRef=Coding_Session
        DidInfo_VCU_control_main_relay (DcmDspDidInfo)
          DcmDspDidAccess
            DcmDspDidRead: DcmDspDidReadSessionRef=DcmDspSession/Default, DcmDspDidReadSessionRef=DcmDspSession/Extended, DcmDspDidReadSessionRef=Coding_Session
        4 x DcmDspDataInfo, all with DcmDspDataFixedLength=true:
          DataInfo_Vehicle_State_Ignition_Switch_Signal
          DataInfo_Coding_for_CDS_fingerprint_codingDate_byte_2_MM
          DataInfo_SOC_SOC
          DataInfo_Gear_Gear
        DevelopmentData_Supplier_family_code (DcmDspData):
          DcmDspDataSize = 24
          DcmDspDataType = UINT8_N
          DcmDspDataUsePort = USE_DATA_ASYNCH_CLIENT_SERVER
          DcmDspDataInfoRef = DataInfo_DevelopmentData_Supplier_family_code
        Read_ECU_manufacturing_date (DcmDspDid):
          DcmDspDidIdentifier = 61835
          DcmDspDidUsed = true
          DcmDspDidUsePort = USE_DATA_ELEMENT_SPECIFIC_INTERFACES
          DcmDspDidInfoRef = DidInfo_Read_ECU_manufacturing_date
          3 x DcmDspDidSignal:
            ECU_Manufacturing_Date_Day: DcmDspDidDataPos=16, DcmDspDidDataRef=Read_ECU_manufacturing_date_ECU_Manufacturing_Date_Day
            ECU_Manufacturing_Date_Month: DcmDspDidDataPos=8, DcmDspDidDataRef=Read_ECU_manufacturing_date_ECU_Manufacturing_Date_Month
            ECU_Manufacturing_Date_Year: DcmDspDidDataPos=0, DcmDspDidDataRef=Read_ECU_manufacturing_date_ECU_Manufacturing_Date_Year
        10 x DcmDspData, all with DcmDspDataUsePort=USE_DATA_ASYNCH_CLIENT_SERVER:
          Write_Level3_OEM_Key_CRC: DcmDspDataSize=8, DcmDspDataType=UINT8, DcmDspDataInfoRef=DataInfo_Write_Level3_OEM_Key_CRC
          Read_Vehicle_Security_related_events_Software_configuration_inte_Event_occurance_time_Day_2: DcmDspDataSize=8, DcmDspDataType=UINT8, DcmDspDataInfoRef=DataInfo_Read_Vehicle_Security_related_events_Software_configuration_inte_Event_occurance_time_Day_2
          SerialNumber_ECU_index_number: DcmDspDataSize=48, DcmDspDataType=UINT8_N, DcmDspDataInfoRef=DataInfo_SerialNumber_ECU_index_number
          Read_Vehicle_Security_related_events_Software_configuration_inte_Event_occurance_time_Day_{3..5}: DcmDspDataSize=8, DcmDspDataType=UINT8, DcmDspDataInfoRef=DataInfo_Read_Vehicle_Security_related_events_Software_configuration_inte_Event_occurance_time_Day_{3..5}
          Write_Level3_OEM_Key_OEM_Key_Value: DcmDspDataSize=128, DcmDspDataType=UINT8_N, DcmDspDataInfoRef=DataInfo_Write_Level3_OEM_Key_OEM_Key_Value
          Gear_Gear: DcmDspDataSize=8, DcmDspDataType=UINT8, DcmDspDataInfoRef=DataInfo_Gear_Gear
          DC_Charging_port_Temperature_POD_DCInletTempB: DcmDspDataSize=8, DcmDspDataType=UINT8, DcmDspDataInfoRef=DataInfo_DC_Charging_port_Temperature_POD_DCInletTempB
          DC_Charging_port_Temperature_POD_DCInletTempA: DcmDspDataSize=8, DcmDspDataType=UINT8, DcmDspDataInfoRef=DataInfo_DC_Charging_port_Temperature_POD_DCInletTempA
        DidInfo_PWT_vehicle_fault (DcmDspDidInfo)
          DcmDspDidAccess
            DcmDspDidRead: DcmDspDidReadSessionRef=DcmDspSession/Default, DcmDspDidReadSessionRef=DcmDspSession/Extended, DcmDspDidReadSessionRef=Coding_Session
        Write_Level2_OEM_Key_CRC (DcmDspData): DcmDspDataSize=8, DcmDspDataType=UINT8, DcmDspDataUsePort=USE_DATA_ASYNCH_CLIENT_SERVER, DcmDspDataInfoRef=DataInfo_Write_Level2_OEM_Key_CRC
        DataInfo_VCU_HV_InterLock_PWM_pfrequency_VCU_HVIL (DcmDspDataInfo): DcmDspDataFixedLength=true
        VCU_control_S2_status_New_Bit_Field (DcmDspData):
          DcmDspDataSize = 8
          DcmDspDataType = UINT8
          DcmDspDataUsePort = USE_DATA_ASYNCH_CLIENT_SERVER
          DcmDspDataInfoRef = DataInfo_VCU_control_S2_status_New_Bit_Field
        BS_base_information4_BS_SOC (DcmDspData): DcmDspDataSize=8, DcmDspDataType=UINT8, DcmDspDataUsePort=USE_DATA_ASYNCH_CLIENT_SERVER, DcmDspDataInfoRef=DataInfo_BS_base_information4_BS_SOC
        RoutineInfo_CheckCodingState (DcmDspRoutineInfo)
          DcmDspRoutineAuthorization: DcmDspRoutineSessionRef=Coding_Session, DcmDspRoutineSecurityLevelRef=Unlocked_Level_3
          DcmDspStartRoutineOut
            Out_routineResult (DcmDspStartRoutineOutSignal): DcmDspRoutineSignalLength=8, DcmDspRoutineSignalType=UINT8, DcmDspRoutineSignalPos=0
        DidInfo_Read_Write_coding_data_string_CDS (DcmDspDidInfo)
          DcmDspDidAccess
            DcmDspDidWrite: DcmDspDidWriteSessionRef=Coding_Session, DcmDspDidWriteSecurityLevelRef=Unlocked_Level_3
            DcmDspDidRead: DcmDspDidReadSessionRef=DcmDspSession/Default, DcmDspDidReadSessionRef=DcmDspSession/Extended, DcmDspDidReadSessionRef=Coding_Session
        DataInfo_VCU_AccPealparameter_Accelerator_pedal_sensor_1_voltage (DcmDspDataInfo): DcmDspDataFixedLength=true
        DidInfo_Read_Level2_OEM_Key_written_status (DcmDspDidInfo)
          DcmDspDidAccess
            DcmDspDidRead: DcmDspDidReadSessionRef=DcmDspSession/Default, DcmDspDidReadSessionRef=DcmDspSession/Extended, DcmDspDidReadSessionRef=Coding_Session
        BS_base_information4_SOH (DcmDspData): DcmDspDataSize=8, DcmDspDataType=UINT8, DcmDspDataUsePort=USE_DATA_ASYNCH_CLIENT_SERVER, DcmDspDataInfoRef=DataInfo_BS_base_information4_SOH
        Read_Vehicle_Security_related_events_Software_configuration_inte_Event_occurance_time_Day_1 (DcmDspData):
          DcmDspDataSize = 8
          DcmDspDataType = UINT8
          DcmDspDataUsePort = USE_DATA_ASYNCH_CLIENT_SERVER
          DcmDspDataInfoRef = DataInfo_Read_Vehicle_Security_related_events_Software_configuration_inte_Event_occurance_time_Day_1
        DidInfo_Coding_for_CDS_fingerprint (DcmDspDidInfo)
          DcmDspDidAccess
            DcmDspDidWrite: DcmDspDidWriteSessionRef=Coding_Session, DcmDspDidWriteSecurityLevelRef=Unlocked_Level_3
            DcmDspDidRead: DcmDspDidReadSessionRef=DcmDspSession/Default, DcmDspDidReadSessionRef=DcmDspSession/Extended, DcmDspDidReadSessionRef=Coding_Session
        DataInfo_PWT_vehicle_fault_PWT_ErrorLevel1 (DcmDspDataInfo): DcmDspDataFixedLength=true
        HV_Status_and_Charging_Status (DcmDspDid):
          DcmDspDidIdentifier = 364
          DcmDspDidUsed = true
          DcmDspDidUsePort = USE_DATA_ELEMENT_SPECIFIC_INTERFACES
          DcmDspDidInfoRef = DidInfo_HV_Status_and_Charging_Status
          HV_status_and_charging_status (DcmDspDidSignal): DcmDspDidDataPos=0, DcmDspDidDataRef=HV_Status_and_Charging_Status_HV_status_and_charging_status
        4 x DcmDspDataInfo, all with DcmDspDataFixedLength=true:
          DataInfo_PWT_vehicle_fault_PWT_ErrorLevel3
          DataInfo_PWT_vehicle_fault_PWT_ErrorLevel2
          DataInfo_EcuIdentification_Detail_Code
          DataInfo_Read_ECU_Part_Number_Execution_Package
        Read_Vehicle_Security_related_events_Brute_Force_UDS_0x27_servic_Brute_Force_UDS_0x27_service_1 (DcmDspData):
          DcmDspDataSize = 8
          DcmDspDataType = UINT8
          DcmDspDataUsePort = USE_DATA_ASYNCH_CLIENT_SERVER
          DcmDspDataInfoRef = DataInfo_Read_Vehicle_Security_related_events_Brute_Force_UDS_0x27_servic_Brute_Force_UDS_0x27_service_1
        DataInfo_Read_ECU_manufacturing_date_ECU_Manufacturing_Date_Day (DcmDspDataInfo): DcmDspDataFixedLength=true
        Read_Vehicle_Security_related_events_Brute_Force_UDS_0x27_servic_Brute_Force_UDS_0x27_service_2 (DcmDspData):
          DcmDspDataSize = 8
          DcmDspDataType = UINT8
          DcmDspDataUsePort = USE_DATA_ASYNCH_CLIENT_SERVER
          DcmDspDataInfoRef = DataInfo_Read_Vehicle_Security_related_events_Brute_Force_UDS_0x27_servic_Brute_Force_UDS_0x27_service_2
        SOC (DcmDspDid): DcmDspDidIdentifier=61862, DcmDspDidUsed=true, DcmDspDidUsePort=USE_DATA_ELEMENT_SPECIFIC_INTERFACES, DcmDspDidInfoRef=DidInfo_SOC
          SOC (DcmDspDidSignal): DcmDspDidDataPos=0, DcmDspDidDataRef=SOC_SOC
        4 x DcmDspData, all with DcmDspDataUsePort=USE_DATA_ASYNCH_CLIENT_SERVER:
          Read_Vehicle_Security_related_events_Brute_Force_UDS_0x27_servic_Brute_Force_UDS_0x27_service_3: DcmDspDataSize=8, DcmDspDataType=UINT8, DcmDspDataInfoRef=DataInfo_Read_Vehicle_Security_related_events_Brute_Force_UDS_0x27_servic_Brute_Force_UDS_0x27_service_3
          EcuIdentification_Specific_Vehicle_Code_WMI: DcmDspDataSize=48, DcmDspDataType=UINT8_N, DcmDspDataInfoRef=DataInfo_EcuIdentification_Specific_Vehicle_Code_WMI
          Read_Vehicle_Security_related_events_Brute_Force_UDS_0x27_servic_Brute_Force_UDS_0x27_service_4: DcmDspDataSize=8, DcmDspDataType=UINT8, DcmDspDataInfoRef=DataInfo_Read_Vehicle_Security_related_events_Brute_Force_UDS_0x27_servic_Brute_Force_UDS_0x27_service_4
          Coding_for_CDS_fingerprint_codingDate_byte_1_YY: DcmDspDataSize=8, DcmDspDataType=UINT8, DcmDspDataInfoRef=DataInfo_Coding_for_CDS_fingerprint_codingDate_byte_1_YY
        DataInfo_Read_Vehicle_Security_related_events_Software_configuration_inte_Event_occurance_time_Day_5 (DcmDspDataInfo): DcmDspDataFixedLength=true
        Supplier_ECU_hardware_part_number (DcmDspDid):
          DcmDspDidIdentifier = 61842
          DcmDspDidUsed = true
          DcmDspDidUsePort = USE_DATA_ELEMENT_SPECIFIC_INTERFACES
          DcmDspDidInfoRef = DidInfo_Supplier_ECU_hardware_part_number
          Major_release (DcmDspDidSignal): DcmDspDidDataPos=0, DcmDspDidDataRef=Supplier_ECU_hardware_part_number_Major_release
          Changes_in_electronic_components_level (DcmDspDidSignal): DcmDspDidDataPos=8, DcmDspDidDataRef=Supplier_ECU_hardware_part_number_Changes_in_electronic_components_level
        Write_Level4_OEM_Key (DcmDspDid):
          DcmDspDidIdentifier = 61462
          DcmDspDidUsed = true
          DcmDspDidUsePort = USE_DATA_ELEMENT_SPECIFIC_INTERFACES
          DcmDspDidInfoRef = DidInfo_Write_Level4_OEM_Key
          OEM_Key_Value (DcmDspDidSignal): DcmDspDidDataPos=0, DcmDspDidDataRef=Write_Level4_OEM_Key_OEM_Key_Value
          CRC (DcmDspDidSignal): DcmDspDidDataPos=128, DcmDspDidDataRef=Write_Level4_OEM_Key_CRC
        5 x DcmDspDataInfo, all with DcmDspDataFixedLength=true:
          DataInfo_Read_Vehicle_Security_related_events_Software_configuration_inte_Event_occurance_time_Day_{1..4}
          DataInfo_Read_Vehicle_Security_related_events_Brute_Force_UDS_0x27_servic_Brute_Force_UDS_0x27_service_Event_occurrence_counter
        Read_Vehicle_Security_related_events_Brute_Force_UDS_0x27_servic_Brute_Force_UDS_0x27_service_5 (DcmDspData):
          DcmDspDataSize = 8
          DcmDspDataType = UINT8
          DcmDspDataUsePort = USE_DATA_ASYNCH_CLIENT_SERVER
          DcmDspDataInfoRef = DataInfo_Read_Vehicle_Security_related_events_Brute_Force_UDS_0x27_servic_Brute_Force_UDS_0x27_service_5
        VCU_AccPealparameter (DcmDspDid): DcmDspDidIdentifier=7425, DcmDspDidUsed=true, DcmDspDidUsePort=USE_DATA_ELEMENT_SPECIFIC_INTERFACES, DcmDspDidInfoRef=DidInfo_VCU_AccPealparameter
          4 x DcmDspDidSignal:
            VCU_AccelerationPedal: DcmDspDidDataPos=48, DcmDspDidDataRef=VCU_AccPealparameter_VCU_AccelerationPedal
            Accelerator_pedal_sensor_2_voltage: DcmDspDidDataPos=32, DcmDspDidDataRef=VCU_AccPealparameter_Accelerator_pedal_sensor_2_voltage
            Accelerator_pedal_sensor_1_voltage: DcmDspDidDataPos=16, DcmDspDidDataRef=VCU_AccPealparameter_Accelerator_pedal_sensor_1_voltage
            VCU_VehicleSpeed: DcmDspDidDataPos=0, DcmDspDidDataRef=VCU_AccPealparameter_VCU_VehicleSpeed
        RoutineInfo_Erase_Mileage_Provisional_Parameter (DcmDspRoutineInfo)
          DcmDspRoutineAuthorization: DcmDspRoutineSessionRef=DcmDspSession/Extended, DcmDspRoutineSecurityLevelRef=UnlockedL1, DcmDspRoutineSecurityLevelRef=Unlocked_Level_2
          DcmDspStartRoutineOut
            Out_routineResult (DcmDspStartRoutineOutSignal): DcmDspRoutineSignalLength=8, DcmDspRoutineSignalType=UINT8, DcmDspRoutineSignalPos=0
        DataInfo_EcuIdentification_Subgroup (DcmDspDataInfo): DcmDspDataFixedLength=true
        Date_And_Time_Date_And_Time_Hour (DcmDspData):
          DcmDspDataSize = 8
          DcmDspDataType = UINT8
          DcmDspDataUsePort = USE_DATA_ASYNCH_CLIENT_SERVER
          DcmDspDataInfoRef = DataInfo_Date_And_Time_Date_And_Time_Hour
        HV_part_work_mode (DcmDspDid): DcmDspDidIdentifier=7444, DcmDspDidUsed=true, DcmDspDidUsePort=USE_DATA_ELEMENT_SPECIFIC_INTERFACES, DcmDspDidInfoRef=DidInfo_HV_part_work_mode
          HV_part_work_mode1 (DcmDspDidSignal): DcmDspDidDataPos=0, DcmDspDidDataRef=HV_part_work_mode_HV_part_work_mode1
          HV_part_work_mode2 (DcmDspDidSignal): DcmDspDidDataPos=8, DcmDspDidDataRef=HV_part_work_mode_HV_part_work_mode2
        DidInfo_VCU_HVStatus (DcmDspDidInfo)
          DcmDspDidAccess
            DcmDspDidRead: DcmDspDidReadSessionRef=DcmDspSession/Default, DcmDspDidReadSessionRef=DcmDspSession/Extended, DcmDspDidReadSessionRef=Coding_Session
        DataInfo_DevelopmentData_Supplier_code (DcmDspDataInfo): DcmDspDataFixedLength=true
        DataInfo_VCU_PowerMaxAllowed_parameter1_VCU_DisChgPowerLimit (DcmDspDataInfo): DcmDspDataFixedLength=true
        4 x DcmDspData, all with DcmDspDataUsePort=USE_DATA_ASYNCH_CLIENT_SERVER:
          Read_Level2_OEM_Key_written_status_Read_Level2_OEM_Key_rewrite_counter: DcmDspDataSize=8, DcmDspDataType=UINT8, DcmDspDataInfoRef=DataInfo_Read_Level2_OEM_Key_written_status_Read_Level2_OEM_Key_rewrite_counter
          Date_And_Time_Date_And_Time_Month: DcmDspDataSize=8, DcmDspDataType=UINT8, DcmDspDataInfoRef=DataInfo_Date_And_Time_Date_And_Time_Month
          Read_ECU_Part_Number_Subgroup: DcmDspDataSize=16, DcmDspDataType=UINT8_N, DcmDspDataInfoRef=DataInfo_Read_ECU_Part_Number_Subgroup
          Bootloader_version_number_No_functional_content_change: DcmDspDataSize=8, DcmDspDataType=UINT8, DcmDspDataInfoRef=DataInfo_Bootloader_version_number_No_functional_content_change
        DidInfo_DC_Charging_port_Temperature (DcmDspDidInfo)
          DcmDspDidAccess
            DcmDspDidRead: DcmDspDidReadSessionRef=DcmDspSession/Default, DcmDspDidReadSessionRef=DcmDspSession/Extended, DcmDspDidReadSessionRef=Coding_Session
        DataInfo_VCU_PowerMaxAllowed_parameter1_MCUPowerLimit (DcmDspDataInfo): DcmDspDataFixedLength=true
        DevelopmentData_Supplier_code (DcmDspData):
          DcmDspDataSize = 8
          DcmDspDataType = UINT8_N
          DcmDspDataUsePort = USE_DATA_ASYNCH_CLIENT_SERVER
          DcmDspDataInfoRef = DataInfo_DevelopmentData_Supplier_code
        Write_Level4_OEM_Key_OEM_Key_Value (DcmDspData):
          DcmDspDataSize = 128
          DcmDspDataType = UINT8_N
          DcmDspDataUsePort = USE_DATA_ASYNCH_CLIENT_SERVER
          DcmDspDataInfoRef = DataInfo_Write_Level4_OEM_Key_OEM_Key_Value
        Bootloader_version_number (DcmDspDid):
          DcmDspDidIdentifier = 61697
          DcmDspDidUsed = true
          DcmDspDidUsePort = USE_DATA_ELEMENT_SPECIFIC_INTERFACES
          DcmDspDidInfoRef = DidInfo_Bootloader_version_number
          3 x DcmDspDidSignal:
            Major_release: DcmDspDidDataPos=0, DcmDspDidDataRef=Bootloader_version_number_Major_release
            Minor_release: DcmDspDidDataPos=8, DcmDspDidDataRef=Bootloader_version_number_Minor_release
            No_functional_content_change: DcmDspDidDataPos=16, DcmDspDidDataRef=Bootloader_version_number_No_functional_content_change
        DataInfo_Read_ECU_Part_Number_Subgroup (DcmDspDataInfo): DcmDspDataFixedLength=true
        VCU_PowerMaxAllowed_parameter1_VCU_DCDCPowerLimit (DcmDspData):
          DcmDspDataSize = 8
          DcmDspDataType = UINT8_N
          DcmDspDataUsePort = USE_DATA_ASYNCH_CLIENT_SERVER
          DcmDspDataInfoRef = DataInfo_VCU_PowerMaxAllowed_parameter1_VCU_DCDCPowerLimit
        DidInfo_VCU_control_S2_status (DcmDspDidInfo)
          DcmDspDidAccess
            DcmDspDidRead: DcmDspDidReadSessionRef=DcmDspSession/Default, DcmDspDidReadSessionRef=DcmDspSession/Extended, DcmDspDidReadSessionRef=Coding_Session
        DataInfo_Write_Level1_OEM_Key_CRC (DcmDspDataInfo): DcmDspDataFixedLength=true
        Date_And_Time_Date_And_Time_Minute (DcmDspData):
          DcmDspDataSize = 8
          DcmDspDataType = UINT8
          DcmDspDataUsePort = USE_DATA_ASYNCH_CLIENT_SERVER
          DcmDspDataInfoRef = DataInfo_Date_And_Time_Date_And_Time_Minute
        Total_Odometer_VCU_Total_Odometer_VCU (DcmDspData):
          DcmDspDataSize = 24
          DcmDspDataType = UINT8_N
          DcmDspDataUsePort = USE_DATA_ASYNCH_CLIENT_SERVER
          DcmDspDataInfoRef = DataInfo_Total_Odometer_VCU_Total_Odometer_VCU
        DataInfo_Supplier_ECU_hardware_part_number_Major_release (DcmDspDataInfo): DcmDspDataFixedLength=true
        DataInfo_VCU_PowerMaxAllowed_parameter3_MCUPower (DcmDspDataInfo): DcmDspDataFixedLength=true
        4 x DcmDspData, all with DcmDspDataUsePort=USE_DATA_ASYNCH_CLIENT_SERVER:
          VCU_HV_InterLock_PWM_pfrequency_VCU_HVIL: DcmDspDataSize=8, DcmDspDataType=UINT8, DcmDspDataInfoRef=DataInfo_VCU_HV_InterLock_PWM_pfrequency_VCU_HVIL
          HV_part_work_mode_HV_part_work_mode1: DcmDspDataSize=8, DcmDspDataType=UINT8, DcmDspDataInfoRef=DataInfo_HV_part_work_mode_HV_part_work_mode1
          VCU_AccPealparameter_VCU_VehicleSpeed: DcmDspDataSize=16, DcmDspDataType=UINT16, DcmDspDataInfoRef=DataInfo_VCU_AccPealparameter_VCU_VehicleSpeed
          HV_part_work_mode_HV_part_work_mode2: DcmDspDataSize=8, DcmDspDataType=UINT8, DcmDspDataInfoRef=DataInfo_HV_part_work_mode_HV_part_work_mode2
        DataInfo_VCU_control_main_relay_Mainrealy1 (DcmDspDataInfo): DcmDspDataFixedLength=true
        Read_Level1_OEM_Key_written_status (DcmDspDid):
          DcmDspDidIdentifier = 61457
          DcmDspDidUsed = true
          DcmDspDidUsePort = USE_DATA_ELEMENT_SPECIFIC_INTERFACES
          DcmDspDidInfoRef = DidInfo_Read_Level1_OEM_Key_written_status
          Read_Level1_OEM_Key_rewrite_counter (DcmDspDidSignal): DcmDspDidDataPos=0, DcmDspDidDataRef=Read_Level1_OEM_Key_written_status_Read_Level1_OEM_Key_rewrite_counter
        3 x DcmDspDataInfo, all with DcmDspDataFixedLength=true:
          DataInfo_Read_Vehicle_Security_related_events_Software_configuration_inte_Software_configuration_integrity_check_5
          DataInfo_Read_Vehicle_Security_related_events_Software_configuration_inte_Software_configuration_integrity_check_4
          DataInfo_Read_Vehicle_Security_related_events_Software_configuration_inte_Software_configuration_integrity_check_3
        Coding_for_CDS_fingerprint (DcmDspDid):
          DcmDspDidIdentifier = 61706
          DcmDspDidUsed = true
          DcmDspDidUsePort = USE_DATA_ELEMENT_SPECIFIC_INTERFACES
          DcmDspDidInfoRef = DidInfo_Coding_for_CDS_fingerprint
          4 x DcmDspDidSignal:
            codingDate_byte_3_DD: DcmDspDidDataPos=16, DcmDspDidDataRef=Coding_for_CDS_fingerprint_codingDate_byte_3_DD
            codingDate_byte_2_MM: DcmDspDidDataPos=8, DcmDspDidDataRef=Coding_for_CDS_fingerprint_codingDate_byte_2_MM
            codingDate_byte_1_YY: DcmDspDidDataPos=0, DcmDspDidDataRef=Coding_for_CDS_fingerprint_codingDate_byte_1_YY
            repairShopCodeorTesterSerialNumber_byte_1_27_MSB: DcmDspDidDataPos=24, DcmDspDidDataRef=Coding_for_CDS_fingerprint_repairShopCodeorTesterSerialNumber_byte_1_27_MSB
        DataInfo_Read_Vehicle_Security_related_events_Software_configuration_inte_Software_configuration_integrity_check_2 (DcmDspDataInfo): DcmDspDataFixedLength=true
        DataInfo_Read_Vehicle_Security_related_events_Software_configuration_inte_Software_configuration_integrity_check_1 (DcmDspDataInfo): DcmDspDataFixedLength=true
        DidInfo_Supplier_ECU_hardware_part_number (DcmDspDidInfo)
          DcmDspDidAccess
            DcmDspDidRead: DcmDspDidReadSessionRef=DcmDspSession/Default, DcmDspDidReadSessionRef=DcmDspSession/Extended, DcmDspDidReadSessionRef=Coding_Session
        VCU_control_main_relay (DcmDspDid):
          DcmDspDidIdentifier = 7441
          DcmDspDidUsed = true
          DcmDspDidUsePort = USE_DATA_ELEMENT_SPECIFIC_INTERFACES
          DcmDspDidInfoRef = DidInfo_VCU_control_main_relay
          Mainrealy1 (DcmDspDidSignal): DcmDspDidDataPos=0, DcmDspDidDataRef=VCU_control_main_relay_Mainrealy1
          Mainrelay2 (DcmDspDidSignal): DcmDspDidDataPos=8, DcmDspDidDataRef=VCU_control_main_relay_Mainrelay2
        DataInfo_VCU_PowerMaxAllowed_parameter2_BMSDisChgPowerLimit (DcmDspDataInfo): DcmDspDataFixedLength=true
        DidInfo_Driver_Mode (DcmDspDidInfo)
          DcmDspDidAccess
            DcmDspDidRead: DcmDspDidReadSessionRef=DcmDspSession/Default, DcmDspDidReadSessionRef=DcmDspSession/Extended, DcmDspDidReadSessionRef=Coding_Session
        DataInfo_VCU_AccPealparameter_VCU_AccelerationPedal (DcmDspDataInfo): DcmDspDataFixedLength=true
        VCU_control_S2_status (DcmDspDid):
          DcmDspDidIdentifier = 7433
          DcmDspDidUsed = true
          DcmDspDidUsePort = USE_DATA_ELEMENT_SPECIFIC_INTERFACES
          DcmDspDidInfoRef = DidInfo_VCU_control_S2_status
          New_Bit_Field (DcmDspDidSignal): DcmDspDidDataPos=0, DcmDspDidDataRef=VCU_control_S2_status_New_Bit_Field
        Erase_Mileage_Provisional_Parameter (DcmDspRoutine):
          DcmDspRequestResultsRoutineSupported = false
          DcmDspStopRoutineSupported = false
          DcmDspRoutineIdentifier = 40192
          DcmDspRoutineFixedLength = false
          DcmDspRoutineUsePort = true
          DcmDspRoutineUsed = true
          DcmDspRoutineInfoRef = RoutineInfo_Erase_Mileage_Provisional_Parameter
        DataInfo_Read_Write_complete_VIN_Vehicle_Identification_Section (DcmDspDataInfo): DcmDspDataFixedLength=true
        Driver_Mode_Driver_Mode (DcmDspData): DcmDspDataSize=8, DcmDspDataType=UINT8, DcmDspDataUsePort=USE_DATA_ASYNCH_CLIENT_SERVER, DcmDspDataInfoRef=DataInfo_Driver_Mode_Driver_Mode
        Chargestatus_Chargestatus (DcmDspData): DcmDspDataSize=8, DcmDspDataType=UINT8, DcmDspDataUsePort=USE_DATA_ASYNCH_CLIENT_SERVER, DcmDspDataInfoRef=DataInfo_Chargestatus_Chargestatus
        Electronic_lock_state (DcmDspDid):
          DcmDspDidIdentifier = 7431
          DcmDspDidUsed = true
          DcmDspDidUsePort = USE_DATA_ELEMENT_SPECIFIC_INTERFACES
          DcmDspDidInfoRef = DidInfo_Electronic_lock_state
          Electronic_lock_state (DcmDspDidSignal): DcmDspDidDataPos=0, DcmDspDidDataRef=Electronic_lock_state_Electronic_lock_state
        DataInfo_Date_And_Time_Date_And_Time_Year (DcmDspDataInfo): DcmDspDataFixedLength=true
        RoutineInfo_Turn_Off_HV_Turn_Off_Charging (DcmDspRoutineInfo)
          DcmDspRoutineAuthorization:
            DcmDspRoutineSessionRef = DcmDspSession/Extended
            DcmDspRoutineSecurityLevelRef = UnlockedL1
            DcmDspRoutineSecurityLevelRef = Unlocked_Level_2
            DcmDspRoutineSecurityLevelRef = Unlocked_Level_4
          DcmDspRoutineStopOut
            Out_routineResult (DcmDspRoutineStopOutSignal): DcmDspRoutineSignalLength=8, DcmDspRoutineSignalType=UINT8, DcmDspRoutineSignalPos=0
          DcmDspStartRoutineOut
            Out_routineResult (DcmDspStartRoutineOutSignal): DcmDspRoutineSignalLength=8, DcmDspRoutineSignalType=UINT8, DcmDspRoutineSignalPos=0
        DC_Charging_port_Temperature (DcmDspDid):
          DcmDspDidIdentifier = 7443
          DcmDspDidUsed = true
          DcmDspDidUsePort = USE_DATA_ELEMENT_SPECIFIC_INTERFACES
          DcmDspDidInfoRef = DidInfo_DC_Charging_port_Temperature
          POD_DCInletTempA (DcmDspDidSignal): DcmDspDidDataPos=0, DcmDspDidDataRef=DC_Charging_port_Temperature_POD_DCInletTempA
          POD_DCInletTempB (DcmDspDidSignal): DcmDspDidDataPos=8, DcmDspDidDataRef=DC_Charging_port_Temperature_POD_DCInletTempB
        3 x DcmDspData, all with DcmDspDataUsePort=USE_DATA_ASYNCH_CLIENT_SERVER:
          VCU_PowerMaxAllowed_parameter1_VCU_TCUPowerAllowed: DcmDspDataSize=16, DcmDspDataType=UINT16, DcmDspDataInfoRef=DataInfo_VCU_PowerMaxAllowed_parameter1_VCU_TCUPowerAllowed
          Read_Level1_OEM_Key_written_status_Read_Level1_OEM_Key_rewrite_counter: DcmDspDataSize=8, DcmDspDataType=UINT8, DcmDspDataInfoRef=DataInfo_Read_Level1_OEM_Key_written_status_Read_Level1_OEM_Key_rewrite_counter
          Write_Level2_OEM_Key_OEM_Key_Value: DcmDspDataSize=128, DcmDspDataType=UINT8_N, DcmDspDataInfoRef=DataInfo_Write_Level2_OEM_Key_OEM_Key_Value
        Total_Odometer (DcmDspDid): DcmDspDidIdentifier=61858, DcmDspDidUsed=true, DcmDspDidUsePort=USE_DATA_ELEMENT_SPECIFIC_INTERFACES, DcmDspDidInfoRef=DidInfo_Total_Odometer
          Total_Odometer (DcmDspDidSignal): DcmDspDidDataPos=0, DcmDspDidDataRef=Total_Odometer_Total_Odometer
        DataInfo_Last_service_date_Month (DcmDspDataInfo): DcmDspDataFixedLength=true
        DataInfo_Date_And_Time_Date_And_Time_Month (DcmDspDataInfo): DcmDspDataFixedLength=true
        BS_base_information4_VCU_BS_Hcurrent (DcmDspData):
          DcmDspDataSize = 16
          DcmDspDataType = UINT16
          DcmDspDataUsePort = USE_DATA_ASYNCH_CLIENT_SERVER
          DcmDspDataInfoRef = DataInfo_BS_base_information4_VCU_BS_Hcurrent
        DataInfo_BSW_version_number_Minor_release (DcmDspDataInfo): DcmDspDataFixedLength=true
        3 x DcmDspData, all with DcmDspDataUsePort=USE_DATA_ASYNCH_CLIENT_SERVER:
          VCU_PowerMaxAllowed_parameter1_VCU_DisChgPowerLimit: DcmDspDataSize=8, DcmDspDataType=UINT8, DcmDspDataInfoRef=DataInfo_VCU_PowerMaxAllowed_parameter1_VCU_DisChgPowerLimit
          SerialNumber_ECU_production_date_in_DD_MM_YY_format: DcmDspDataSize=48, DcmDspDataType=UINT8_N, DcmDspDataInfoRef=DataInfo_SerialNumber_ECU_production_date_in_DD_MM_YY_format
          Supplier_ECU_hardware_part_number_Major_release: DcmDspDataSize=8, DcmDspDataType=UINT8, DcmDspDataInfoRef=DataInfo_Supplier_ECU_hardware_part_number_Major_release
        DataInfo_Read_ECU_manufacturing_date_ECU_Manufacturing_Date_Month (DcmDspDataInfo): DcmDspDataFixedLength=true
        DevelopmentData_Country_code (DcmDspData):
          DcmDspDataSize = 16
          DcmDspDataType = UINT8_N
          DcmDspDataUsePort = USE_DATA_ASYNCH_CLIENT_SERVER
          DcmDspDataInfoRef = DataInfo_DevelopmentData_Country_code
        DidInfo_Read_Level1_OEM_Key_written_status (DcmDspDidInfo)
          DcmDspDidAccess
            DcmDspDidRead: DcmDspDidReadSessionRef=DcmDspSession/Default, DcmDspDidReadSessionRef=DcmDspSession/Extended, DcmDspDidReadSessionRef=Coding_Session
        VCU_HV_InterLock_PWM_pfrequency (DcmDspDid):
          DcmDspDidIdentifier = 7432
          DcmDspDidUsed = true
          DcmDspDidUsePort = USE_DATA_ELEMENT_SPECIFIC_INTERFACES
          DcmDspDidInfoRef = DidInfo_VCU_HV_InterLock_PWM_pfrequency
          VCU_HVIL (DcmDspDidSignal): DcmDspDidDataPos=0, DcmDspDidDataRef=VCU_HV_InterLock_PWM_pfrequency_VCU_HVIL
        VCU_Torque_parameter_VCU_MCUDesiredTorque (DcmDspData):
          DcmDspDataSize = 16
          DcmDspDataType = UINT16
          DcmDspDataUsePort = USE_DATA_ASYNCH_CLIENT_SERVER
          DcmDspDataInfoRef = DataInfo_VCU_Torque_parameter_VCU_MCUDesiredTorque
        EcuIdentification_Group (DcmDspData): DcmDspDataSize=16, DcmDspDataType=UINT8_N, DcmDspDataUsePort=USE_DATA_ASYNCH_CLIENT_SERVER, DcmDspDataInfoRef=DataInfo_EcuIdentification_Group
        DidInfo_AC_charging_parameter (DcmDspDidInfo)
          DcmDspDidAccess
            DcmDspDidRead: DcmDspDidReadSessionRef=DcmDspSession/Default, DcmDspDidReadSessionRef=DcmDspSession/Extended, DcmDspDidReadSessionRef=Coding_Session
        DataInfo_VCU_AccPealparameter_VCU_VehicleSpeed (DcmDspDataInfo): DcmDspDataFixedLength=true
        DataInfo_Read_Level1_OEM_Key_written_status_Read_Level1_OEM_Key_rewrite_counter (DcmDspDataInfo): DcmDspDataFixedLength=true
        EcuIdentification_Detail_Code (DcmDspData):
          DcmDspDataSize = 24
          DcmDspDataType = UINT8_N
          DcmDspDataUsePort = USE_DATA_ASYNCH_CLIENT_SERVER
          DcmDspDataInfoRef = DataInfo_EcuIdentification_Detail_Code
        VCU_PowerMaxAllowed_parameter3_V2LPower (DcmDspData):
          DcmDspDataSize = 8
          DcmDspDataType = UINT8
          DcmDspDataUsePort = USE_DATA_ASYNCH_CLIENT_SERVER
          DcmDspDataInfoRef = DataInfo_VCU_PowerMaxAllowed_parameter3_V2LPower
        DidInfo_Vehicle_State (DcmDspDidInfo)
          DcmDspDidAccess
            DcmDspDidRead: DcmDspDidReadSessionRef=DcmDspSession/Default, DcmDspDidReadSessionRef=DcmDspSession/Extended, DcmDspDidReadSessionRef=Coding_Session
        DataInfo_Date_And_Time_Date_And_Time_Day (DcmDspDataInfo): DcmDspDataFixedLength=true
        DataInfo_Date_And_Time_Date_And_Time_Minute (DcmDspDataInfo): DcmDspDataFixedLength=true
        3 x DcmDspData, all with DcmDspDataSize=8, DcmDspDataType=UINT8, DcmDspDataUsePort=USE_DATA_ASYNCH_CLIENT_SERVER:
          Read_Write_coding_data_string_CDS_Reserved3: DcmDspDataInfoRef=DataInfo_Read_Write_coding_data_string_CDS_Reserved3
          Read_Write_coding_data_string_CDS_Reserved2: DcmDspDataInfoRef=DataInfo_Read_Write_coding_data_string_CDS_Reserved2
          Read_Write_coding_data_string_CDS_Reserved1: DcmDspDataInfoRef=DataInfo_Read_Write_coding_data_string_CDS_Reserved1
        DataInfo_Write_Level1_OEM_Key_OEM_Key_Value (DcmDspDataInfo): DcmDspDataFixedLength=true
        VCU_control_main_relay_Mainrealy1 (DcmDspData):
          DcmDspDataSize = 8
          DcmDspDataType = UINT8
          DcmDspDataUsePort = USE_DATA_ASYNCH_CLIENT_SERVER
          DcmDspDataInfoRef = DataInfo_VCU_control_main_relay_Mainrealy1
        DidInfo_Write_Level1_OEM_Key (DcmDspDidInfo)
          DcmDspDidAccess
            DcmDspDidWrite: DcmDspDidWriteSessionRef=DcmDspSession/Extended, DcmDspDidWriteSecurityLevelRef=UnlockedL1
        DataInfo_Read_Level3_OEM_Key_written_status_Read_Level3_OEM_Key_rewrite_counter (DcmDspDataInfo): DcmDspDataFixedLength=true
        ECU_application_software_ASW_version_number_Minor_release (DcmDspData):
          DcmDspDataSize = 8
          DcmDspDataType = UINT8
          DcmDspDataUsePort = USE_DATA_ASYNCH_CLIENT_SERVER
          DcmDspDataInfoRef = DataInfo_ECU_application_software_ASW_version_number_Minor_release
        4 x DcmDspDataInfo, all with DcmDspDataFixedLength=true:
          DataInfo_EcuIdentification_Execution_Package
          DataInfo_BSW_version_number_No_functional_content_change
          DataInfo_Last_service_date_Year
          DataInfo_Coding_for_CDS_fingerprint_repairShopCodeorTesterSerialNumber_byte_1_27_MSB
        DidInfo_VCU_AccPealparameter (DcmDspDidInfo)
          DcmDspDidAccess
            DcmDspDidRead: DcmDspDidReadSessionRef=DcmDspSession/Default, DcmDspDidReadSessionRef=DcmDspSession/Extended, DcmDspDidReadSessionRef=Coding_Session
        4 x DcmDspData, all with DcmDspDataSize=8, DcmDspDataType=UINT8, DcmDspDataUsePort=USE_DATA_ASYNCH_CLIENT_SERVER:
          BS_base_information4_SOF_V1: DcmDspDataInfoRef=DataInfo_BS_base_information4_SOF_V1
          ECU_application_software_ASW_version_number_Major_release: DcmDspDataInfoRef=DataInfo_ECU_application_software_ASW_version_number_Major_release
          BS_base_information4_SOF_V2: DcmDspDataInfoRef=DataInfo_BS_base_information4_SOF_V2
          VCU_PowerMaxAllowed_parameter3_DCDCPower: DcmDspDataInfoRef=DataInfo_VCU_PowerMaxAllowed_parameter3_DCDCPower
        DataInfo_Coding_for_CDS_fingerprint_codingDate_byte_3_DD (DcmDspDataInfo): DcmDspDataFixedLength=true
        4 x DcmDspData, all with DcmDspDataSize=8, DcmDspDataType=UINT8, DcmDspDataUsePort=USE_DATA_ASYNCH_CLIENT_SERVER:
          Read_Level3_OEM_Key_written_status_Read_Level3_OEM_Key_rewrite_counter: DcmDspDataInfoRef=DataInfo_Read_Level3_OEM_Key_written_status_Read_Level3_OEM_Key_rewrite_counter
          Read_ECU_manufacturing_date_ECU_Manufacturing_Date_Year: DcmDspDataInfoRef=DataInfo_Read_ECU_manufacturing_date_ECU_Manufacturing_Date_Year
          Read_ECU_manufacturing_date_ECU_Manufacturing_Date_Month: DcmDspDataInfoRef=DataInfo_Read_ECU_manufacturing_date_ECU_Manufacturing_Date_Month
          Bootloader_version_number_Major_release: DcmDspDataInfoRef=DataInfo_Bootloader_version_number_Major_release
        PWT_vehicle_fault (DcmDspDid): DcmDspDidIdentifier=7442, DcmDspDidUsed=true, DcmDspDidUsePort=USE_DATA_ELEMENT_SPECIFIC_INTERFACES, DcmDspDidInfoRef=DidInfo_PWT_vehicle_fault
          3 x DcmDspDidSignal:
            PWT_ErrorLevel1: DcmDspDidDataPos=0, DcmDspDidDataRef=PWT_vehicle_fault_PWT_ErrorLevel1
            PWT_ErrorLevel2: DcmDspDidDataPos=8, DcmDspDidDataRef=PWT_vehicle_fault_PWT_ErrorLevel2
            PWT_ErrorLevel3: DcmDspDidDataPos=16, DcmDspDidDataRef=PWT_vehicle_fault_PWT_ErrorLevel3
        DataInfo_Read_Vehicle_Security_related_events_Brute_Force_UDS_0x27_servic_Brute_Force_UDS_0x27_service_4 (DcmDspDataInfo): DcmDspDataFixedLength=true
        DataInfo_Read_Vehicle_Security_related_events_Brute_Force_UDS_0x27_servic_Brute_Force_UDS_0x27_service_5 (DcmDspDataInfo): DcmDspDataFixedLength=true
        HV_Status_and_Charging_Status_HV_status_and_charging_status (DcmDspData):
          DcmDspDataSize = 8
          DcmDspDataType = UINT8
          DcmDspDataUsePort = USE_DATA_ASYNCH_CLIENT_SERVER
          DcmDspDataInfoRef = DataInfo_HV_Status_and_Charging_Status_HV_status_and_charging_status
        4 x DcmDspDataInfo, all with DcmDspDataFixedLength=true:
          DataInfo_ECU_application_software_ASW_version_number_Minor_release
          DataInfo_Read_Vehicle_Security_related_events_Brute_Force_UDS_0x27_servic_Brute_Force_UDS_0x27_service_2
          DataInfo_Read_Vehicle_Security_related_events_Brute_Force_UDS_0x27_servic_Brute_Force_UDS_0x27_service_3
          DataInfo_AC_charging_parameter_VCU_OBC_ChargeCurrentCommand
        Read_Write_coding_data_string_CDS_Configuration (DcmDspData):
          DcmDspDataSize = 8
          DcmDspDataType = UINT8
          DcmDspDataUsePort = USE_DATA_ASYNCH_CLIENT_SERVER
          DcmDspDataInfoRef = DataInfo_Read_Write_coding_data_string_CDS_Configuration
        Read_ECU_Part_Number_Execution_Package (DcmDspData):
          DcmDspDataSize = 16
          DcmDspDataType = UINT8_N
          DcmDspDataUsePort = USE_DATA_ASYNCH_CLIENT_SERVER
          DcmDspDataInfoRef = DataInfo_Read_ECU_Part_Number_Execution_Package
        DataInfo_Read_Vehicle_Security_related_events_Brute_Force_UDS_0x27_servic_Brute_Force_UDS_0x27_service_1 (DcmDspDataInfo): DcmDspDataFixedLength=true
        Read_Vehicle_Security_related_events_Software_configuration_inte_Event_occurance_time_Month_1 (DcmDspData):
          DcmDspDataSize = 8
          DcmDspDataType = UINT8
          DcmDspDataUsePort = USE_DATA_ASYNCH_CLIENT_SERVER
          DcmDspDataInfoRef = DataInfo_Read_Vehicle_Security_related_events_Software_configuration_inte_Event_occurance_time_Month_1
        DataInfo_VCU_AccPealparameter_Accelerator_pedal_sensor_2_voltage (DcmDspDataInfo): DcmDspDataFixedLength=true
        4 x DcmDspData, all with DcmDspDataSize=8, DcmDspDataType=UINT8, DcmDspDataUsePort=USE_DATA_ASYNCH_CLIENT_SERVER:
          Read_Vehicle_Security_related_events_Software_configuration_inte_Event_occurance_time_Month_4: DcmDspDataInfoRef=DataInfo_Read_Vehicle_Security_related_events_Software_configuration_inte_Event_occurance_time_Month_4
          Read_Vehicle_Security_related_events_Software_configuration_inte_Event_occurance_time_Month_5: DcmDspDataInfoRef=DataInfo_Read_Vehicle_Security_related_events_Software_configuration_inte_Event_occurance_time_Month_5
          Read_Vehicle_Security_related_events_Software_configuration_inte_Event_occurance_time_Month_2: DcmDspDataInfoRef=DataInfo_Read_Vehicle_Security_related_events_Software_configuration_inte_Event_occurance_time_Month_2
          Read_Vehicle_Security_related_events_Software_configuration_inte_Event_occurance_time_Month_3: DcmDspDataInfoRef=DataInfo_Read_Vehicle_Security_related_events_Software_configuration_inte_Event_occurance_time_Month_3
        VCU_PowerMaxAllowed_parameter1 (DcmDspDid):
          DcmDspDidIdentifier = 7428
          DcmDspDidUsed = true
          DcmDspDidUsePort = USE_DATA_ELEMENT_SPECIFIC_INTERFACES
          DcmDspDidInfoRef = DidInfo_VCU_PowerMaxAllowed_parameter1
          4 x DcmDspDidSignal:
            VCU_DisChgPowerLimit: DcmDspDidDataPos=40, DcmDspDidDataRef=VCU_PowerMaxAllowed_parameter1_VCU_DisChgPowerLimit
            VCU_TCUPowerAllowed: DcmDspDidDataPos=0, DcmDspDidDataRef=VCU_PowerMaxAllowed_parameter1_VCU_TCUPowerAllowed
            VCU_DCDCPowerLimit: DcmDspDidDataPos=16, DcmDspDidDataRef=VCU_PowerMaxAllowed_parameter1_VCU_DCDCPowerLimit
            MCUPowerLimit: DcmDspDidDataPos=24, DcmDspDidDataRef=VCU_PowerMaxAllowed_parameter1_MCUPowerLimit
        4 x DcmDspDataInfo, all with DcmDspDataFixedLength=true:
          DataInfo_VCU_PowerMaxAllowed_parameter1_VCU_DCDCPowerLimit
          DataInfo_BSW_version_number_Major_release
          DataInfo_AC_charging_parameter_POD_OBC_OutputDCChargeVoltage
          DataInfo_BS_base_information4_VCU_BS_Hcurrent
        CheckCodingState (DcmDspRoutine):
          DcmDspRequestResultsRoutineSupported = false
          DcmDspStopRoutineSupported = false
          DcmDspRoutineIdentifier = 258
          DcmDspRoutineFixedLength = false
          DcmDspRoutineUsePort = true
          DcmDspRoutineUsed = true
          DcmDspRoutineInfoRef = RoutineInfo_CheckCodingState
        VCU_PowerMaxAllowed_parameter2 (DcmDspDid):
          DcmDspDidIdentifier = 7440
          DcmDspDidUsed = true
          DcmDspDidUsePort = USE_DATA_ELEMENT_SPECIFIC_INTERFACES
          DcmDspDidInfoRef = DidInfo_VCU_PowerMaxAllowed_parameter2
          3 x DcmDspDidSignal:
            BMSChgPowerLimit: DcmDspDidDataPos=32, DcmDspDidDataRef=VCU_PowerMaxAllowed_parameter2_BMSChgPowerLimit
            MCUFeedbackPowerLimit: DcmDspDidDataPos=16, DcmDspDidDataRef=VCU_PowerMaxAllowed_parameter2_MCUFeedbackPowerLimit
            BMSDisChgPowerLimit: DcmDspDidDataPos=0, DcmDspDidDataRef=VCU_PowerMaxAllowed_parameter2_BMSDisChgPowerLimit
        DataInfo_VCU_control_main_relay_Mainrelay2 (DcmDspDataInfo): DcmDspDataFixedLength=true
        VCU_PowerMaxAllowed_parameter3 (DcmDspDid):
          DcmDspDidIdentifier = 7445
          DcmDspDidUsed = true
          DcmDspDidUsePort = USE_DATA_ELEMENT_SPECIFIC_INTERFACES
          DcmDspDidInfoRef = DidInfo_VCU_PowerMaxAllowed_parameter3
          5 x DcmDspDidSignal:
            ACSystemPower: DcmDspDidDataPos=8, DcmDspDidDataRef=VCU_PowerMaxAllowed_parameter3_ACSystemPower
            V2LPower: DcmDspDidDataPos=32, DcmDspDidDataRef=VCU_PowerMaxAllowed_parameter3_V2LPower
            PackPTCPower: DcmDspDidDataPos=16, DcmDspDidDataRef=VCU_PowerMaxAllowed_parameter3_PackPTCPower
            MCUPower: DcmDspDidDataPos=24, DcmDspDidDataRef=VCU_PowerMaxAllowed_parameter3_MCUPower
            DCDCPower: DcmDspDidDataPos=0, DcmDspDidDataRef=VCU_PowerMaxAllowed_parameter3_DCDCPower
        3 x DcmDspDataInfo, all with DcmDspDataFixedLength=true:
          DataInfo_Battery_Voltage_Battery_Voltage
          DataInfo_Read_Write_coding_data_string_CDS_CDS_Format_Byte_High_Byte_1
          DataInfo_Read_Write_coding_data_string_CDS_CDS_Format_Byte_High_Byte_0
        Gear (DcmDspDid): DcmDspDidIdentifier=61863, DcmDspDidUsed=true, DcmDspDidUsePort=USE_DATA_ELEMENT_SPECIFIC_INTERFACES, DcmDspDidInfoRef=DidInfo_Gear
          Gear (DcmDspDidSignal): DcmDspDidDataPos=0, DcmDspDidDataRef=Gear_Gear
        4 x DcmDspDataInfo, all with DcmDspDataFixedLength=true:
          DataInfo_HV_Status_and_Charging_Status_HV_status_and_charging_status
          DataInfo_Read_Vehicle_Security_related_events_Brute_Force_UDS_0x27_servic_Event_occurance_time_Day_2
          DataInfo_Read_Vehicle_Security_related_events_Brute_Force_UDS_0x27_servic_Event_occurance_time_Day_3
          DataInfo_DevelopmentData_Supplier_family_code
        ECU_application_software_ASW_version_number_No_functional_content_change (DcmDspData):
          DcmDspDataSize = 8
          DcmDspDataType = UINT8
          DcmDspDataUsePort = USE_DATA_ASYNCH_CLIENT_SERVER
          DcmDspDataInfoRef = DataInfo_ECU_application_software_ASW_version_number_No_functional_content_change
        6 x DcmDspDataInfo, all with DcmDspDataFixedLength=true:
          DataInfo_Read_Vehicle_Security_related_events_Brute_Force_UDS_0x27_servic_Event_occurance_time_Day_1
          DataInfo_Write_Level4_OEM_Key_CRC
          DataInfo_Write_Level2_OEM_Key_CRC
          DataInfo_Date_And_Time_Date_And_Time_Second
          DataInfo_Read_Vehicle_Security_related_events_Brute_Force_UDS_0x27_servic_Event_occurance_time_Day_4
          DataInfo_Read_Vehicle_Security_related_events_Brute_Force_UDS_0x27_servic_Event_occurance_time_Day_5
        Chargestatus (DcmDspDid): DcmDspDidIdentifier=7430, DcmDspDidUsed=true, DcmDspDidUsePort=USE_DATA_ELEMENT_SPECIFIC_INTERFACES, DcmDspDidInfoRef=DidInfo_Chargestatus
          Chargestatus (DcmDspDidSignal): DcmDspDidDataPos=0, DcmDspDidDataRef=Chargestatus_Chargestatus
        Erase_Memory (DcmDspRoutine):
          DcmDspRequestResultsRoutineSupported = false
          DcmDspStopRoutineSupported = false
          DcmDspRoutineIdentifier = 65280
          DcmDspRoutineFixedLength = false
          DcmDspRoutineUsePort = true
          DcmDspRoutineUsed = true
          DcmDspRoutineInfoRef = RoutineInfo_Erase_Memory
        Read_Level2_OEM_Key_written_status (DcmDspDid):
          DcmDspDidIdentifier = 61459
          DcmDspDidUsed = true
          DcmDspDidUsePort = USE_DATA_ELEMENT_SPECIFIC_INTERFACES
          DcmDspDidInfoRef = DidInfo_Read_Level2_OEM_Key_written_status
          Read_Level2_OEM_Key_rewrite_counter (DcmDspDidSignal): DcmDspDidDataPos=0, DcmDspDidDataRef=Read_Level2_OEM_Key_written_status_Read_Level2_OEM_Key_rewrite_counter
        DataInfo_Electronic_lock_state_Electronic_lock_state (DcmDspDataInfo): DcmDspDataFixedLength=true
        DidInfo_HV_part_work_mode (DcmDspDidInfo)
          DcmDspDidAccess
            DcmDspDidRead: DcmDspDidReadSessionRef=DcmDspSession/Default, DcmDspDidReadSessionRef=DcmDspSession/Extended, DcmDspDidReadSessionRef=Coding_Session
        DataInfo_Bootloader_version_number_No_functional_content_change (DcmDspDataInfo): DcmDspDataFixedLength=true
        4 x DcmDspData, all with DcmDspDataUsePort=USE_DATA_ASYNCH_CLIENT_SERVER:
          PWT_vehicle_fault_PWT_ErrorLevel3: DcmDspDataSize=8, DcmDspDataType=UINT8, DcmDspDataInfoRef=DataInfo_PWT_vehicle_fault_PWT_ErrorLevel3
          PWT_vehicle_fault_PWT_ErrorLevel2: DcmDspDataSize=8, DcmDspDataType=UINT8, DcmDspDataInfoRef=DataInfo_PWT_vehicle_fault_PWT_ErrorLevel2
          VCU_PowerMaxAllowed_parameter1_MCUPowerLimit: DcmDspDataSize=16, DcmDspDataType=UINT16, DcmDspDataInfoRef=DataInfo_VCU_PowerMaxAllowed_parameter1_MCUPowerLimit
          PWT_vehicle_fault_PWT_ErrorLevel1: DcmDspDataSize=8, DcmDspDataType=UINT8, DcmDspDataInfoRef=DataInfo_PWT_vehicle_fault_PWT_ErrorLevel1
        DataInfo_VCU_PowerMaxAllowed_parameter3_ACSystemPower (DcmDspDataInfo): DcmDspDataFixedLength=true
        DidInfo_HV_Status_and_Charging_Status (DcmDspDidInfo)
          DcmDspDidAccess
            DcmDspDidRead: DcmDspDidReadSessionRef=DcmDspSession/Default, DcmDspDidReadSessionRef=DcmDspSession/Extended, DcmDspDidReadSessionRef=Coding_Session
        BSW_version_number_No_functional_content_change (DcmDspData):
          DcmDspDataSize = 8
          DcmDspDataType = UINT8
          DcmDspDataUsePort = USE_DATA_ASYNCH_CLIENT_SERVER
          DcmDspDataInfoRef = DataInfo_BSW_version_number_No_functional_content_change
        DidInfo_Read_active_diagnostic_session (DcmDspDidInfo)
          DcmDspDidAccess
            DcmDspDidRead
        Vehicle_State (DcmDspDid): DcmDspDidIdentifier=61856, DcmDspDidUsed=true, DcmDspDidUsePort=USE_DATA_ELEMENT_SPECIFIC_INTERFACES, DcmDspDidInfoRef=DidInfo_Vehicle_State
          Ignition_Switch_Signal (DcmDspDidSignal): DcmDspDidDataPos=0, DcmDspDidDataRef=Vehicle_State_Ignition_Switch_Signal
        3 x DcmDspDataInfo, all with DcmDspDataFixedLength=true:
          DataInfo_Read_Vehicle_Security_related_events_Brute_Force_UDS_0x27_servic_Event_occurance_time_Month_1
          DataInfo_Read_Vehicle_Security_related_events_Brute_Force_UDS_0x27_servic_Event_occurance_time_Month_3
          DataInfo_Read_Vehicle_Security_related_events_Brute_Force_UDS_0x27_servic_Event_occurance_time_Month_2
        CheckProgrammingDependencies (DcmDspRoutine):
          DcmDspRequestResultsRoutineSupported = false
          DcmDspStopRoutineSupported = false
          DcmDspRoutineIdentifier = 65281
          DcmDspRoutineFixedLength = false
          DcmDspRoutineUsePort = true
          DcmDspRoutineUsed = true
          DcmDspRoutineInfoRef = RoutineInfo_CheckProgrammingDependencies
        3 x DcmDspDataInfo, all with DcmDspDataFixedLength=true:
          DataInfo_Read_Vehicle_Security_related_events_Brute_Force_UDS_0x27_servic_Event_occurance_time_Month_5
          DataInfo_Read_Vehicle_Security_related_events_Brute_Force_UDS_0x27_servic_Event_occurance_time_Month_4
          DataInfo_ECU_application_software_ASW_version_number_No_functional_content_change
        Read_Write_complete_VIN_World_Manufacturers_Identification (DcmDspData):
          DcmDspDataSize = 24
          DcmDspDataType = UINT8_N
          DcmDspDataUsePort = USE_DATA_ASYNCH_CLIENT_SERVER
          DcmDspDataInfoRef = DataInfo_Read_Write_complete_VIN_World_Manufacturers_Identification
        DataInfo_Chargestatus_Chargestatus (DcmDspDataInfo): DcmDspDataFixedLength=true
        4 x DcmDspData, all with DcmDspDataSize=8, DcmDspDataType=UINT8, DcmDspDataUsePort=USE_DATA_ASYNCH_CLIENT_SERVER:
          Read_Vehicle_Security_related_events_Software_configuration_inte_Software_configuration_integrity_check_4: DcmDspDataInfoRef=DataInfo_Read_Vehicle_Security_related_events_Software_configuration_inte_Software_configuration_integrity_check_4
          Read_Vehicle_Security_related_events_Software_configuration_inte_Software_configuration_integrity_check_5: DcmDspDataInfoRef=DataInfo_Read_Vehicle_Security_related_events_Software_configuration_inte_Software_configuration_integrity_check_5
          Read_Vehicle_Security_related_events_Software_configuration_inte_Software_configuration_integrity_check_2: DcmDspDataInfoRef=DataInfo_Read_Vehicle_Security_related_events_Software_configuration_inte_Software_configuration_integrity_check_2
          Read_Vehicle_Security_related_events_Software_configuration_inte_Software_configuration_integrity_check_3: DcmDspDataInfoRef=DataInfo_Read_Vehicle_Security_related_events_Software_configuration_inte_Software_configuration_integrity_check_3
        DidInfo_Total_Odometer (DcmDspDidInfo)
          DcmDspDidAccess
            DcmDspDidRead: DcmDspDidReadSessionRef=DcmDspSession/Default, DcmDspDidReadSessionRef=DcmDspSession/Extended, DcmDspDidReadSessionRef=Coding_Session
        Read_Vehicle_Security_related_events_Software_configuration_inte_Software_configuration_integrity_check_1 (DcmDspData):
          DcmDspDataSize = 8
          DcmDspDataType = UINT8
          DcmDspDataUsePort = USE_DATA_ASYNCH_CLIENT_SERVER
          DcmDspDataInfoRef = DataInfo_Read_Vehicle_Security_related_events_Software_configuration_inte_Software_configuration_integrity_check_1
        3 x DcmDspDid, all with DcmDspDidUsed=true, DcmDspDidUsePort=USE_DATA_ELEMENT_SPECIFIC_INTERFACES:
          Read_ECU_Part_Number: DcmDspDidIdentifier=61831, DcmDspDidInfoRef=DidInfo_Read_ECU_Part_Number
            5 x DcmDspDidSignal:
              Specific_Vehicle_Code_WMI: DcmDspDidDataPos=0, DcmDspDidDataRef=Read_ECU_Part_Number_Specific_Vehicle_Code_WMI
              Detail_Code: DcmDspDidDataPos=80, DcmDspDidDataRef=Read_ECU_Part_Number_Detail_Code
              Execution_Package: DcmDspDidDataPos=104, DcmDspDidDataRef=Read_ECU_Part_Number_Execution_Package
              Subgroup: DcmDspDidDataPos=64, DcmDspDidDataRef=Read_ECU_Part_Number_Subgroup
              Group: DcmDspDidDataPos=48, DcmDspDidDataRef=Read_ECU_Part_Number_Group
          Write_Level2_OEM_Key: DcmDspDidIdentifier=61458, DcmDspDidInfoRef=DidInfo_Write_Level2_OEM_Key
            OEM_Key_Value (DcmDspDidSignal): DcmDspDidDataPos=0, DcmDspDidDataRef=Write_Level2_OEM_Key_OEM_Key_Value
            CRC (DcmDspDidSignal): DcmDspDidDataPos=128, DcmDspDidDataRef=Write_Level2_OEM_Key_CRC
          BSW_version_number: DcmDspDidIdentifier=7449, DcmDspDidInfoRef=DidInfo_BSW_version_number
            3 x DcmDspDidSignal:
              Major_release: DcmDspDidDataPos=0, DcmDspDidDataRef=BSW_version_number_Major_release
              Minor_release: DcmDspDidDataPos=8, DcmDspDidDataRef=BSW_version_number_Minor_release
              No_functional_content_change: DcmDspDidDataPos=16, DcmDspDidDataRef=BSW_version_number_No_functional_content_change
        5 x DcmDspData, all with DcmDspDataUsePort=USE_DATA_ASYNCH_CLIENT_SERVER:
          AC_charging_parameter_POD_OBC_OutputDCChargeVoltage: DcmDspDataSize=16, DcmDspDataType=UINT16, DcmDspDataInfoRef=DataInfo_AC_charging_parameter_POD_OBC_OutputDCChargeVoltage
          Read_Vehicle_Security_related_events_Brute_Force_UDS_0x27_servic_Event_occurance_time_Month_5: DcmDspDataSize=8, DcmDspDataType=UINT8, DcmDspDataInfoRef=DataInfo_Read_Vehicle_Security_related_events_Brute_Force_UDS_0x27_servic_Event_occurance_time_Month_5
          SerialNumber_Supplier_name: DcmDspDataSize=40, DcmDspDataType=UINT8_N, DcmDspDataInfoRef=DataInfo_SerialNumber_Supplier_name
          Read_Vehicle_Security_related_events_Brute_Force_UDS_0x27_servic_Event_occurance_time_Month_1: DcmDspDataSize=8, DcmDspDataType=UINT8, DcmDspDataInfoRef=DataInfo_Read_Vehicle_Security_related_events_Brute_Force_UDS_0x27_servic_Event_occurance_time_Month_1
          Read_Vehicle_Security_related_events_Brute_Force_UDS_0x27_servic_Event_occurance_time_Month_2: DcmDspDataSize=8, DcmDspDataType=UINT8, DcmDspDataInfoRef=DataInfo_Read_Vehicle_Security_related_events_Brute_Force_UDS_0x27_servic_Event_occurance_time_Month_2
        Read_Vehicle_Security_related_events_Brute_Force_UDS_0x27_servic (DcmDspDid):
          DcmDspDidIdentifier = 61473
          DcmDspDidUsed = true
          DcmDspDidUsePort = USE_DATA_ELEMENT_SPECIFIC_INTERFACES
          DcmDspDidInfoRef = DidInfo_Read_Vehicle_Security_related_events_Brute_Force_UDS_0x27_servic
          21 x DcmDspDidSignal:
            Event_occurance_time_Year_1: DcmDspDidDataPos=8, DcmDspDidDataRef=Read_Vehicle_Security_related_events_Brute_Force_UDS_0x27_servic_Event_occurance_time_Year_1
            Brute_Force_UDS_0x27_service_Event_occurrence_counter: DcmDspDidDataPos=160, DcmDspDidDataRef=Read_Vehicle_Security_related_events_Brute_Force_UDS_0x27_servic_Brute_Force_UDS_0x27_service_Event_occurrence_counter
            Event_occurance_time_Day_1: DcmDspDidDataPos=24, DcmDspDidDataRef=Read_Vehicle_Security_related_events_Brute_Force_UDS_0x27_servic_Event_occurance_time_Day_1
            Event_occurance_time_Day_2: DcmDspDidDataPos=56, DcmDspDidDataRef=Read_Vehicle_Security_related_events_Brute_Force_UDS_0x27_servic_Event_occurance_time_Day_2
            Brute_Force_UDS_0x27_service_4: DcmDspDidDataPos=96, DcmDspDidDataRef=Read_Vehicle_Security_related_events_Brute_Force_UDS_0x27_servic_Brute_Force_UDS_0x27_service_4
            Event_occurance_time_Day_3: DcmDspDidDataPos=88, DcmDspDidDataRef=Read_Vehicle_Security_related_events_Brute_Force_UDS_0x27_servic_Event_occurance_time_Day_3
            Event_occurance_time_Day_4: DcmDspDidDataPos=120, DcmDspDidDataRef=Read_Vehicle_Security_related_events_Brute_Force_UDS_0x27_servic_Event_occurance_time_Day_4
            Brute_Force_UDS_0x27_service_3: DcmDspDidDataPos=64, DcmDspDidDataRef=Read_Vehicle_Security_related_events_Brute_Force_UDS_0x27_servic_Brute_Force_UDS_0x27_service_3
            Event_occurance_time_Day_5: DcmDspDidDataPos=152, DcmDspDidDataRef=Read_Vehicle_Security_related_events_Brute_Force_UDS_0x27_servic_Event_occurance_time_Day_5
            Event_occurance_time_Month_2: DcmDspDidDataPos=48, DcmDspDidDataRef=Read_Vehicle_Security_related_events_Brute_Force_UDS_0x27_servic_Event_occurance_time_Month_2
            Brute_Force_UDS_0x27_service_5: DcmDspDidDataPos=128, DcmDspDidDataRef=Read_Vehicle_Security_related_events_Brute_Force_UDS_0x27_servic_Brute_Force_UDS_0x27_service_5
            Event_occurance_time_Month_1: DcmDspDidDataPos=16, DcmDspDidDataRef=Read_Vehicle_Security_related_events_Brute_Force_UDS_0x27_servic_Event_occurance_time_Month_1
            Event_occurance_time_Month_4: DcmDspDidDataPos=112, DcmDspDidDataRef=Read_Vehicle_Security_related_events_Brute_Force_UDS_0x27_servic_Event_occurance_time_Month_4
            Event_occurance_time_Month_3: DcmDspDidDataPos=80, DcmDspDidDataRef=Read_Vehicle_Security_related_events_Brute_Force_UDS_0x27_servic_Event_occurance_time_Month_3
            Event_occurance_time_Month_5: DcmDspDidDataPos=144, DcmDspDidDataRef=Read_Vehicle_Security_related_events_Brute_Force_UDS_0x27_servic_Event_occurance_time_Month_5
            Event_occurance_time_Year_4: DcmDspDidDataPos=104, DcmDspDidDataRef=Read_Vehicle_Security_related_events_Brute_Force_UDS_0x27_servic_Event_occurance_time_Year_4
            Event_occurance_time_Year_5: DcmDspDidDataPos=136, DcmDspDidDataRef=Read_Vehicle_Security_related_events_Brute_Force_UDS_0x27_servic_Event_occurance_time_Year_5
            Event_occurance_time_Year_2: DcmDspDidDataPos=40, DcmDspDidDataRef=Read_Vehicle_Security_related_events_Brute_Force_UDS_0x27_servic_Event_occurance_time_Year_2
            Event_occurance_time_Year_3: DcmDspDidDataPos=72, DcmDspDidDataRef=Read_Vehicle_Security_related_events_Brute_Force_UDS_0x27_servic_Event_occurance_time_Year_3
            Brute_Force_UDS_0x27_service_2: DcmDspDidDataPos=32, DcmDspDidDataRef=Read_Vehicle_Security_related_events_Brute_Force_UDS_0x27_servic_Brute_Force_UDS_0x27_service_2
            Brute_Force_UDS_0x27_service_1: DcmDspDidDataPos=0, DcmDspDidDataRef=Read_Vehicle_Security_related_events_Brute_Force_UDS_0x27_servic_Brute_Force_UDS_0x27_service_1
        Read_Vehicle_Security_related_events_Brute_Force_UDS_0x27_servic_Event_occurance_time_Month_3 (DcmDspData):
          DcmDspDataSize = 8
          DcmDspDataType = UINT8
          DcmDspDataUsePort = USE_DATA_ASYNCH_CLIENT_SERVER
          DcmDspDataInfoRef = DataInfo_Read_Vehicle_Security_related_events_Brute_Force_UDS_0x27_servic_Event_occurance_time_Month_3
        Read_Vehicle_Security_related_events_Brute_Force_UDS_0x27_servic_Event_occurance_time_Month_4 (DcmDspData):
          DcmDspDataSize = 8
          DcmDspDataType = UINT8
          DcmDspDataUsePort = USE_DATA_ASYNCH_CLIENT_SERVER
          DcmDspDataInfoRef = DataInfo_Read_Vehicle_Security_related_events_Brute_Force_UDS_0x27_servic_Event_occurance_time_Month_4
        Driver_Mode (DcmDspDid): DcmDspDidIdentifier=7427, DcmDspDidUsed=true, DcmDspDidUsePort=USE_DATA_ELEMENT_SPECIFIC_INTERFACES, DcmDspDidInfoRef=DidInfo_Driver_Mode
          Driver_Mode (DcmDspDidSignal): DcmDspDidDataPos=0, DcmDspDidDataRef=Driver_Mode_Driver_Mode
        DataInfo_SerialNumber_ECU_production_date_in_DD_MM_YY_format (DcmDspDataInfo): DcmDspDataFixedLength=true
        3 x DcmDspData, all with DcmDspDataUsePort=USE_DATA_ASYNCH_CLIENT_SERVER:
          AC_charging_parameter_POD_OBC_InputACVoltage: DcmDspDataSize=16, DcmDspDataType=UINT16, DcmDspDataInfoRef=DataInfo_AC_charging_parameter_POD_OBC_InputACVoltage
          VCU_AccPealparameter_Accelerator_pedal_sensor_2_voltage: DcmDspDataSize=16, DcmDspDataType=UINT16, DcmDspDataInfoRef=DataInfo_VCU_AccPealparameter_Accelerator_pedal_sensor_2_voltage
          Write_Level1_OEM_Key_OEM_Key_Value: DcmDspDataSize=128, DcmDspDataType=UINT8_N, DcmDspDataInfoRef=DataInfo_Write_Level1_OEM_Key_OEM_Key_Value
        DataInfo_AC_charging_parameter_POD_OBC_OutputDCChargeCurrent (DcmDspDataInfo): DcmDspDataFixedLength=true
        VCU_Torque_parameter_VCU_RegenTorqueCap (DcmDspData):
          DcmDspDataSize = 16
          DcmDspDataType = UINT16
          DcmDspDataUsePort = USE_DATA_ASYNCH_CLIENT_SERVER
          DcmDspDataInfoRef = DataInfo_VCU_Torque_parameter_VCU_RegenTorqueCap
        DidInfo_Gear (DcmDspDidInfo)
          DcmDspDidAccess
            DcmDspDidRead: DcmDspDidReadSessionRef=DcmDspSession/Default, DcmDspDidReadSessionRef=DcmDspSession/Extended, DcmDspDidReadSessionRef=Coding_Session
        VCU_control_main_relay_Mainrelay2 (DcmDspData):
          DcmDspDataSize = 8
          DcmDspDataType = UINT8
          DcmDspDataUsePort = USE_DATA_ASYNCH_CLIENT_SERVER
          DcmDspDataInfoRef = DataInfo_VCU_control_main_relay_Mainrelay2
        Read_ECU_manufacturing_date_ECU_Manufacturing_Date_Day (DcmDspData):
          DcmDspDataSize = 8
          DcmDspDataType = UINT8
          DcmDspDataUsePort = USE_DATA_ASYNCH_CLIENT_SERVER
          DcmDspDataInfoRef = DataInfo_Read_ECU_manufacturing_date_ECU_Manufacturing_Date_Day
        Battery_Voltage (DcmDspDid): DcmDspDidIdentifier=61857, DcmDspDidUsed=true, DcmDspDidUsePort=USE_DATA_ELEMENT_SPECIFIC_INTERFACES, DcmDspDidInfoRef=DidInfo_Battery_Voltage
          Battery_Voltage (DcmDspDidSignal): DcmDspDidDataPos=0, DcmDspDidDataRef=Battery_Voltage_Battery_Voltage
        DataInfo_Read_Write_coding_data_string_CDS_Configuration (DcmDspDataInfo): DcmDspDataFixedLength=true
        VCU_HVStatus_VCU_HVStatus (DcmDspData): DcmDspDataSize=8, DcmDspDataType=UINT8, DcmDspDataUsePort=USE_DATA_ASYNCH_CLIENT_SERVER, DcmDspDataInfoRef=DataInfo_VCU_HVStatus_VCU_HVStatus
        AC_charging_parameter_VCU_OBC_ChargeCurrentCommand (DcmDspData):
          DcmDspDataSize = 16
          DcmDspDataType = UINT16
          DcmDspDataUsePort = USE_DATA_ASYNCH_CLIENT_SERVER
          DcmDspDataInfoRef = DataInfo_AC_charging_parameter_VCU_OBC_ChargeCurrentCommand
        DidInfo_Read_Vehicle_Security_related_events_Software_configuration_inte (DcmDspDidInfo)
          DcmDspDidAccess
            DcmDspDidRead: DcmDspDidReadSessionRef=DcmDspSession/Default, DcmDspDidReadSessionRef=DcmDspSession/Extended, DcmDspDidReadSessionRef=Coding_Session
        Write_Level1_OEM_Key_CRC (DcmDspData): DcmDspDataSize=8, DcmDspDataType=UINT8, DcmDspDataUsePort=USE_DATA_ASYNCH_CLIENT_SERVER, DcmDspDataInfoRef=DataInfo_Write_Level1_OEM_Key_CRC
        Write_Level4_OEM_Key_CRC (DcmDspData): DcmDspDataSize=8, DcmDspDataType=UINT8, DcmDspDataUsePort=USE_DATA_ASYNCH_CLIENT_SERVER, DcmDspDataInfoRef=DataInfo_Write_Level4_OEM_Key_CRC
        DataInfo_VCU_Torque_parameter_VCU_MCUDesiredTorque (DcmDspDataInfo): DcmDspDataFixedLength=true
        DidInfo_BSW_version_number (DcmDspDidInfo)
          DcmDspDidAccess
            DcmDspDidRead: DcmDspDidReadSessionRef=DcmDspSession/Default, DcmDspDidReadSessionRef=DcmDspSession/Extended, DcmDspDidReadSessionRef=Coding_Session
        DataInfo_VCU_Torque_parameter_VCU_RegenTorqueCap (DcmDspDataInfo): DcmDspDataFixedLength=true
        Read_Write_coding_data_string_CDS_CDS_CRC (DcmDspData):
          DcmDspDataSize = 8
          DcmDspDataType = UINT8
          DcmDspDataUsePort = USE_DATA_ASYNCH_CLIENT_SERVER
          DcmDspDataInfoRef = DataInfo_Read_Write_coding_data_string_CDS_CDS_CRC
        Read_Level4_OEM_Key_written_status_Read_Level4_OEM_Key_rewrite_counter (DcmDspData):
          DcmDspDataSize = 8
          DcmDspDataType = UINT8
          DcmDspDataUsePort = USE_DATA_ASYNCH_CLIENT_SERVER
          DcmDspDataInfoRef = DataInfo_Read_Level4_OEM_Key_written_status_Read_Level4_OEM_Key_rewrite_counter
        DidInfo_Read_ECU_manufacturing_date (DcmDspDidInfo)
          DcmDspDidAccess
            DcmDspDidRead: DcmDspDidReadSessionRef=DcmDspSession/Default, DcmDspDidReadSessionRef=DcmDspSession/Extended, DcmDspDidReadSessionRef=Coding_Session
        DataInfo_VCU_PowerMaxAllowed_parameter2_MCUFeedbackPowerLimit (DcmDspDataInfo): DcmDspDataFixedLength=true
        Supplier_ECU_hardware_part_number_Changes_in_electronic_components_level (DcmDspData):
          DcmDspDataSize = 8
          DcmDspDataType = UINT8
          DcmDspDataUsePort = USE_DATA_ASYNCH_CLIENT_SERVER
          DcmDspDataInfoRef = DataInfo_Supplier_ECU_hardware_part_number_Changes_in_electronic_components_level
        DidInfo_SOC (DcmDspDidInfo)
          DcmDspDidAccess
            DcmDspDidRead: DcmDspDidReadSessionRef=DcmDspSession/Default, DcmDspDidReadSessionRef=DcmDspSession/Extended, DcmDspDidReadSessionRef=Coding_Session
        BS_base_information4_T_BATT (DcmDspData): DcmDspDataSize=8, DcmDspDataType=UINT8, DcmDspDataUsePort=USE_DATA_ASYNCH_CLIENT_SERVER, DcmDspDataInfoRef=DataInfo_BS_base_information4_T_BATT
        Read_Write_coding_data_string_CDS (DcmDspDid):
          DcmDspDidIdentifier = 61704
          DcmDspDidUsed = true
          DcmDspDidUsePort = USE_DATA_ELEMENT_SPECIFIC_INTERFACES
          DcmDspDidInfoRef = DidInfo_Read_Write_coding_data_string_CDS
          16 x DcmDspDidSignal:
            CDS_Short_VIN_High_Byte_7: DcmDspDidDataPos=64, DcmDspDidDataRef=Read_Write_coding_data_string_CDS_CDS_Short_VIN_High_Byte_7
            CDS_CRC: DcmDspDidDataPos=120, DcmDspDidDataRef=Read_Write_coding_data_string_CDS_CDS_CRC
            CDS_Format_Byte_High_Byte_0: DcmDspDidDataPos=72, DcmDspDidDataRef=Read_Write_coding_data_string_CDS_CDS_Format_Byte_High_Byte_0
            CDS_Format_Byte_High_Byte_1: DcmDspDidDataPos=80, DcmDspDidDataRef=Read_Write_coding_data_string_CDS_CDS_Format_Byte_High_Byte_1
            Reserved2: DcmDspDidDataPos=104, DcmDspDidDataRef=Read_Write_coding_data_string_CDS_Reserved2
            Version_Byte_0: DcmDspDidDataPos=0, DcmDspDidDataRef=Read_Write_coding_data_string_CDS_Version_Byte_0
            Reserved1: DcmDspDidDataPos=96, DcmDspDidDataRef=Read_Write_coding_data_string_CDS_Reserved1
            Reserved3: DcmDspDidDataPos=112, DcmDspDidDataRef=Read_Write_coding_data_string_CDS_Reserved3
            Version_Byte_1: DcmDspDidDataPos=8, DcmDspDidDataRef=Read_Write_coding_data_string_CDS_Version_Byte_1
            CDS_Short_VIN_High_Byte_4: DcmDspDidDataPos=48, DcmDspDidDataRef=Read_Write_coding_data_string_CDS_CDS_Short_VIN_High_Byte_4
            Configuration: DcmDspDidDataPos=88, DcmDspDidDataRef=Read_Write_coding_data_string_CDS_Configuration
            CDS_Short_VIN_High_Byte_3: DcmDspDidDataPos=40, DcmDspDidDataRef=Read_Write_coding_data_string_CDS_CDS_Short_VIN_High_Byte_3
            CDS_Short_VIN_High_Byte_5: DcmDspDidDataPos=56, DcmDspDidDataRef=Read_Write_coding_data_string_CDS_CDS_Short_VIN_High_Byte_5
            CDS_Short_VIN_High_Byte_0: DcmDspDidDataPos=16, DcmDspDidDataRef=Read_Write_coding_data_string_CDS_CDS_Short_VIN_High_Byte_0
            CDS_Short_VIN_High_Byte_2: DcmDspDidDataPos=32, DcmDspDidDataRef=Read_Write_coding_data_string_CDS_CDS_Short_VIN_High_Byte_2
            CDS_Short_VIN_High_Byte_1: DcmDspDidDataPos=24, DcmDspDidDataRef=Read_Write_coding_data_string_CDS_CDS_Short_VIN_High_Byte_1
        VCU_AccPealparameter_VCU_AccelerationPedal (DcmDspData):
          DcmDspDataSize = 16
          DcmDspDataType = UINT16
          DcmDspDataUsePort = USE_DATA_ASYNCH_CLIENT_SERVER
          DcmDspDataInfoRef = DataInfo_VCU_AccPealparameter_VCU_AccelerationPedal
        DataInfo_BS_base_information4_BS_SOC (DcmDspDataInfo): DcmDspDataFixedLength=true
        Date_And_Time_Date_And_Time_Year (DcmDspData):
          DcmDspDataSize = 8
          DcmDspDataType = UINT8
          DcmDspDataUsePort = USE_DATA_ASYNCH_CLIENT_SERVER
          DcmDspDataInfoRef = DataInfo_Date_And_Time_Date_And_Time_Year
        7 x DcmDspDataInfo, all with DcmDspDataFixedLength=true:
          DataInfo_HV_part_work_mode_HV_part_work_mode2
          DataInfo_HV_part_work_mode_HV_part_work_mode1
          DataInfo_Read_Write_complete_VIN_Vehicle_Description_Section
          DataInfo_SerialNumber_Supplier_name
          DataInfo_Read_Write_coding_data_string_CDS_CDS_Short_VIN_High_Byte_4
          DataInfo_Read_Write_coding_data_string_CDS_CDS_Short_VIN_High_Byte_5
          DataInfo_Read_Write_coding_data_string_CDS_CDS_Short_VIN_High_Byte_7
        Read_Vehicle_Security_related_events_Brute_Force_UDS_0x27_servic_Event_occurance_time_Day_5 (DcmDspData):
          DcmDspDataSize = 8
          DcmDspDataType = UINT8
          DcmDspDataUsePort = USE_DATA_ASYNCH_CLIENT_SERVER
          DcmDspDataInfoRef = DataInfo_Read_Vehicle_Security_related_events_Brute_Force_UDS_0x27_servic_Event_occurance_time_Day_5
        Last_service_date (DcmDspDid): DcmDspDidIdentifier=61711, DcmDspDidUsed=true, DcmDspDidUsePort=USE_DATA_ELEMENT_SPECIFIC_INTERFACES, DcmDspDidInfoRef=DidInfo_Last_service_date
          3 x DcmDspDidSignal:
            Day: DcmDspDidDataPos=16, DcmDspDidDataRef=Last_service_date_Day
            Month: DcmDspDidDataPos=8, DcmDspDidDataRef=Last_service_date_Month
            Year: DcmDspDidDataPos=0, DcmDspDidDataRef=Last_service_date_Year
        5 x DcmDspDataInfo, all with DcmDspDataFixedLength=true:
          DataInfo_Read_Write_coding_data_string_CDS_CDS_Short_VIN_High_Byte_0
          DataInfo_BS_base_information4_SOH
          DataInfo_Read_Write_coding_data_string_CDS_CDS_Short_VIN_High_Byte_{1..3}
        VCU_PowerMaxAllowed_parameter3_ACSystemPower (DcmDspData):
          DcmDspDataSize = 8
          DcmDspDataType = UINT8
          DcmDspDataUsePort = USE_DATA_ASYNCH_CLIENT_SERVER
          DcmDspDataInfoRef = DataInfo_VCU_PowerMaxAllowed_parameter3_ACSystemPower
        DataInfo_SerialNumber_ECU_Name (DcmDspDataInfo): DcmDspDataFixedLength=true
        4 x DcmDspData, all with DcmDspDataSize=8, DcmDspDataType=UINT8, DcmDspDataUsePort=USE_DATA_ASYNCH_CLIENT_SERVER:
          Read_Vehicle_Security_related_events_Brute_Force_UDS_0x27_servic_Event_occurance_time_Day_4: DcmDspDataInfoRef=DataInfo_Read_Vehicle_Security_related_events_Brute_Force_UDS_0x27_servic_Event_occurance_time_Day_4
          Read_Vehicle_Security_related_events_Brute_Force_UDS_0x27_servic_Event_occurance_time_Day_3: DcmDspDataInfoRef=DataInfo_Read_Vehicle_Security_related_events_Brute_Force_UDS_0x27_servic_Event_occurance_time_Day_3
          Read_Vehicle_Security_related_events_Brute_Force_UDS_0x27_servic_Event_occurance_time_Day_2: DcmDspDataInfoRef=DataInfo_Read_Vehicle_Security_related_events_Brute_Force_UDS_0x27_servic_Event_occurance_time_Day_2
          Read_Vehicle_Security_related_events_Brute_Force_UDS_0x27_servic_Event_occurance_time_Day_1: DcmDspDataInfoRef=DataInfo_Read_Vehicle_Security_related_events_Brute_Force_UDS_0x27_servic_Event_occurance_time_Day_1
        DidInfo_Write_Level4_OEM_Key (DcmDspDidInfo)
          DcmDspDidAccess
            DcmDspDidWrite: DcmDspDidWriteSessionRef=DcmDspSession/Extended, DcmDspDidWriteSecurityLevelRef=Unlocked_Level_4
        DidInfo_Read_Level4_OEM_Key_written_status (DcmDspDidInfo)
          DcmDspDidAccess
            DcmDspDidRead: DcmDspDidReadSessionRef=DcmDspSession/Default, DcmDspDidReadSessionRef=DcmDspSession/Extended, DcmDspDidReadSessionRef=Coding_Session
        Coding_for_CDS_fingerprint_codingDate_byte_3_DD (DcmDspData):
          DcmDspDataSize = 8
          DcmDspDataType = UINT8
          DcmDspDataUsePort = USE_DATA_ASYNCH_CLIENT_SERVER
          DcmDspDataInfoRef = DataInfo_Coding_for_CDS_fingerprint_codingDate_byte_3_DD
        DidInfo_ECU_application_software_ASW_version_number (DcmDspDidInfo)
          DcmDspDidAccess
            DcmDspDidRead: DcmDspDidReadSessionRef=DcmDspSession/Default, DcmDspDidReadSessionRef=DcmDspSession/Extended, DcmDspDidReadSessionRef=Coding_Session
        Date_And_Time (DcmDspDid): DcmDspDidIdentifier=61860, DcmDspDidUsed=true, DcmDspDidUsePort=USE_DATA_ELEMENT_SPECIFIC_INTERFACES, DcmDspDidInfoRef=DidInfo_Date_And_Time
          6 x DcmDspDidSignal:
            Date_And_Time_Minute: DcmDspDidDataPos=8, DcmDspDidDataRef=Date_And_Time_Date_And_Time_Minute
            Date_And_Time_Hour: DcmDspDidDataPos=16, DcmDspDidDataRef=Date_And_Time_Date_And_Time_Hour
            Date_And_Time_Year: DcmDspDidDataPos=40, DcmDspDidDataRef=Date_And_Time_Date_And_Time_Year
            Date_And_Time_Second: DcmDspDidDataPos=0, DcmDspDidDataRef=Date_And_Time_Date_And_Time_Second
            Date_And_Time_Month: DcmDspDidDataPos=32, DcmDspDidDataRef=Date_And_Time_Date_And_Time_Month
            Date_And_Time_Day: DcmDspDidDataPos=24, DcmDspDidDataRef=Date_And_Time_Date_And_Time_Day
        VCU_Torque_parameter (DcmDspDid): DcmDspDidIdentifier=7426, DcmDspDidUsed=true, DcmDspDidUsePort=USE_DATA_ELEMENT_SPECIFIC_INTERFACES, DcmDspDidInfoRef=DidInfo_VCU_Torque_parameter
          4 x DcmDspDidSignal:
            VCU_RegenTorqueCap: DcmDspDidDataPos=48, DcmDspDidDataRef=VCU_Torque_parameter_VCU_RegenTorqueCap
            Torque_MaxAllowed: DcmDspDidDataPos=32, DcmDspDidDataRef=VCU_Torque_parameter_Torque_MaxAllowed
            VCU_MCUDesiredTorque: DcmDspDidDataPos=0, DcmDspDidDataRef=VCU_Torque_parameter_VCU_MCUDesiredTorque
            Torque_MinAllowed: DcmDspDidDataPos=16, DcmDspDidDataRef=VCU_Torque_parameter_Torque_MinAllowed
        Read_ECU_Part_Number_Group (DcmDspData): DcmDspDataSize=16, DcmDspDataType=UINT8_N, DcmDspDataUsePort=USE_DATA_ASYNCH_CLIENT_SERVER, DcmDspDataInfoRef=DataInfo_Read_ECU_Part_Number_Group
        DataInfo_VCU_PowerMaxAllowed_parameter3_PackPTCPower (DcmDspDataInfo): DcmDspDataFixedLength=true
        ECU_application_software_ASW_version_number (DcmDspDid):
          DcmDspDidIdentifier = 61700
          DcmDspDidUsed = true
          DcmDspDidUsePort = USE_DATA_ELEMENT_SPECIFIC_INTERFACES
          DcmDspDidInfoRef = DidInfo_ECU_application_software_ASW_version_number
          3 x DcmDspDidSignal:
            Major_release: DcmDspDidDataPos=0, DcmDspDidDataRef=ECU_application_software_ASW_version_number_Major_release
            Minor_release: DcmDspDidDataPos=8, DcmDspDidDataRef=ECU_application_software_ASW_version_number_Minor_release
            No_functional_content_change: DcmDspDidDataPos=16, DcmDspDidDataRef=ECU_application_software_ASW_version_number_No_functional_content_change
        5 x DcmDspDataInfo, all with DcmDspDataFixedLength=true:
          DataInfo_Read_Vehicle_Security_related_events_Software_configuration_inte_Event_occurance_time_Month_5
          DataInfo_Read_Vehicle_Security_related_events_Software_configuration_inte_Event_occurance_time_Month_4
          DataInfo_Read_Vehicle_Security_related_events_Software_configuration_inte_Event_occurance_time_Month_3
          DataInfo_Read_Write_complete_VIN_World_Manufacturers_Identification
          DataInfo_Read_Vehicle_Security_related_events_Software_configuration_inte_Event_occurance_time_Month_2
        Bootloader_version_number_Minor_release (DcmDspData):
          DcmDspDataSize = 8
          DcmDspDataType = UINT8
          DcmDspDataUsePort = USE_DATA_ASYNCH_CLIENT_SERVER
          DcmDspDataInfoRef = DataInfo_Bootloader_version_number_Minor_release
        DataInfo_Read_Vehicle_Security_related_events_Software_configuration_inte_Event_occurance_time_Month_1 (DcmDspDataInfo): DcmDspDataFixedLength=true
        RoutineInfo_CheckProgrammingDependencies (DcmDspRoutineInfo)
          DcmDspRoutineAuthorization: DcmDspRoutineSessionRef=DcmDspSession/Programming, DcmDspRoutineSecurityLevelRef=Unlocked_Level_4
          DcmDspStartRoutineOut
            Out_routineResult (DcmDspStartRoutineOutSignal): DcmDspRoutineSignalLength=8, DcmDspRoutineSignalType=UINT8, DcmDspRoutineSignalPos=0
        Read_Write_complete_VIN_Vehicle_Identification_Section (DcmDspData):
          DcmDspDataSize = 72
          DcmDspDataType = UINT8_N
          DcmDspDataUsePort = USE_DATA_ASYNCH_CLIENT_SERVER
          DcmDspDataInfoRef = DataInfo_Read_Write_complete_VIN_Vehicle_Identification_Section
        Read_Level3_OEM_Key_written_status (DcmDspDid):
          DcmDspDidIdentifier = 61461
          DcmDspDidUsed = true
          DcmDspDidUsePort = USE_DATA_ELEMENT_SPECIFIC_INTERFACES
          DcmDspDidInfoRef = DidInfo_Read_Level3_OEM_Key_written_status
          Read_Level3_OEM_Key_rewrite_counter (DcmDspDidSignal): DcmDspDidDataPos=0, DcmDspDidDataRef=Read_Level3_OEM_Key_written_status_Read_Level3_OEM_Key_rewrite_counter
        AC_charging_parameter_POD_OBC_OutputDCChargeCurrent (DcmDspData):
          DcmDspDataSize = 16
          DcmDspDataType = UINT16
          DcmDspDataUsePort = USE_DATA_ASYNCH_CLIENT_SERVER
          DcmDspDataInfoRef = DataInfo_AC_charging_parameter_POD_OBC_OutputDCChargeCurrent
        Vehicle_speed_Vehicle_speed (DcmDspData): DcmDspDataSize=16, DcmDspDataType=UINT16, DcmDspDataUsePort=USE_DATA_ASYNCH_CLIENT_SERVER, DcmDspDataInfoRef=DataInfo_Vehicle_speed_Vehicle_speed
        DataInfo_Write_Level3_OEM_Key_CRC (DcmDspDataInfo): DcmDspDataFixedLength=true
        DidInfo_Vehicle_speed (DcmDspDidInfo)
          DcmDspDidAccess
            DcmDspDidRead: DcmDspDidReadSessionRef=DcmDspSession/Default, DcmDspDidReadSessionRef=DcmDspSession/Extended, DcmDspDidReadSessionRef=Coding_Session
        DataInfo_VCU_Torque_parameter_Torque_MaxAllowed (DcmDspDataInfo): DcmDspDataFixedLength=true
        Write_Level1_OEM_Key (DcmDspDid):
          DcmDspDidIdentifier = 61456
          DcmDspDidUsed = true
          DcmDspDidUsePort = USE_DATA_ELEMENT_SPECIFIC_INTERFACES
          DcmDspDidInfoRef = DidInfo_Write_Level1_OEM_Key
          OEM_Key_Value (DcmDspDidSignal): DcmDspDidDataPos=0, DcmDspDidDataRef=Write_Level1_OEM_Key_OEM_Key_Value
          CRC (DcmDspDidSignal): DcmDspDidDataPos=128, DcmDspDidDataRef=Write_Level1_OEM_Key_CRC
        3 x DcmDspData, all with DcmDspDataType=UINT8_N, DcmDspDataUsePort=USE_DATA_ASYNCH_CLIENT_SERVER:
          Read_ECU_Part_Number_Specific_Vehicle_Code_WMI: DcmDspDataSize=48, DcmDspDataInfoRef=DataInfo_Read_ECU_Part_Number_Specific_Vehicle_Code_WMI
          Total_Odometer_Total_Odometer: DcmDspDataSize=24, DcmDspDataInfoRef=DataInfo_Total_Odometer_Total_Odometer
          Read_Write_complete_VIN_Vehicle_Description_Section: DcmDspDataSize=40, DcmDspDataInfoRef=DataInfo_Read_Write_complete_VIN_Vehicle_Description_Section
        DataInfo_Read_Level4_OEM_Key_written_status_Read_Level4_OEM_Key_rewrite_counter (DcmDspDataInfo): DcmDspDataFixedLength=true
        Read_Write_complete_VIN (DcmDspDid):
          DcmDspDidIdentifier = 61840
          DcmDspDidUsed = true
          DcmDspDidUsePort = USE_DATA_ELEMENT_SPECIFIC_INTERFACES
          DcmDspDidInfoRef = DidInfo_Read_Write_complete_VIN
          3 x DcmDspDidSignal:
            World_Manufacturers_Identification: DcmDspDidDataPos=0, DcmDspDidDataRef=Read_Write_complete_VIN_World_Manufacturers_Identification
            Vehicle_Description_Section: DcmDspDidDataPos=24, DcmDspDidDataRef=Read_Write_complete_VIN_Vehicle_Description_Section
            Vehicle_Identification_Section: DcmDspDidDataPos=64, DcmDspDidDataRef=Read_Write_complete_VIN_Vehicle_Identification_Section
        3 x DcmDspData, all with DcmDspDataSize=8, DcmDspDataType=UINT8, DcmDspDataUsePort=USE_DATA_ASYNCH_CLIENT_SERVER:
          Read_Vehicle_Security_related_events_Software_configuration_inte_Event_occurance_time_Year_1: DcmDspDataInfoRef=DataInfo_Read_Vehicle_Security_related_events_Software_configuration_inte_Event_occurance_time_Year_1
          Read_Vehicle_Security_related_events_Software_configuration_inte_Event_occurance_time_Year_2: DcmDspDataInfoRef=DataInfo_Read_Vehicle_Security_related_events_Software_configuration_inte_Event_occurance_time_Year_2
          Last_service_date_Day: DcmDspDataInfoRef=DataInfo_Last_service_date_Day
        Turn_Off_HV_Turn_Off_Charging (DcmDspRoutine):
          DcmDspRequestResultsRoutineSupported = false
          DcmDspStopRoutineSupported = true
          DcmDspRoutineIdentifier = 61440
          DcmDspRoutineFixedLength = false
          DcmDspRoutineUsePort = true
          DcmDspRoutineUsed = true
          DcmDspRoutineInfoRef = RoutineInfo_Turn_Off_HV_Turn_Off_Charging
        DataInfo_Write_Level2_OEM_Key_OEM_Key_Value (DcmDspDataInfo): DcmDspDataFixedLength=true
        VCU_PowerMaxAllowed_parameter3_PackPTCPower (DcmDspData):
          DcmDspDataSize = 8
          DcmDspDataType = UINT8
          DcmDspDataUsePort = USE_DATA_ASYNCH_CLIENT_SERVER
          DcmDspDataInfoRef = DataInfo_VCU_PowerMaxAllowed_parameter3_PackPTCPower
        DataInfo_Total_Odometer_Total_Odometer (DcmDspDataInfo): DcmDspDataFixedLength=true
        DidInfo_Chargestatus (DcmDspDidInfo)
          DcmDspDidAccess
            DcmDspDidRead: DcmDspDidReadSessionRef=DcmDspSession/Default, DcmDspDidReadSessionRef=DcmDspSession/Extended, DcmDspDidReadSessionRef=Coding_Session
        DataInfo_ECU_application_software_ASW_version_number_Major_release (DcmDspDataInfo): DcmDspDataFixedLength=true
        Check_Memory (DcmDspRoutine):
          DcmDspRequestResultsRoutineSupported = false
          DcmDspStopRoutineSupported = false
          DcmDspRoutineIdentifier = 514
          DcmDspRoutineFixedLength = false
          DcmDspRoutineUsePort = true
          DcmDspRoutineUsed = true
          DcmDspRoutineInfoRef = RoutineInfo_Check_Memory
        Coding_for_CDS_fingerprint_repairShopCodeorTesterSerialNumber_byte_1_27_MSB (DcmDspData):
          DcmDspDataSize = 216
          DcmDspDataType = UINT8_N
          DcmDspDataUsePort = USE_DATA_ASYNCH_CLIENT_SERVER
          DcmDspDataInfoRef = DataInfo_Coding_for_CDS_fingerprint_repairShopCodeorTesterSerialNumber_byte_1_27_MSB
      DcmPageBufferCfg: DcmPagedBufferEnabled=true
