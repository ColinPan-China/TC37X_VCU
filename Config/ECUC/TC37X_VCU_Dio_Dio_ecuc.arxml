AUTOSAR XML (schema 00048)
package /Dio
  module config Dio: implementation-config-variant=VARIANT-LINK-TIME, module-description=Dio_Impl
    CommonPublishedInformation:
      ArMajorVersion = 4
      ArMinorVersion = 2
      ArPatchVersion = 2
      ModuleId = 120
      Release = _TRICORE_TC377
      SwMajorVersion = 10
      SwMinorVersion = 40
      SwPatchVersion = 0
      VendorId = 17
    DioConfig
      10 x DioPort:
        DioPort_13: DioPortId=13
          4 x DioChannel:
            DioChannel_P13_0_D107: DioChannelId=0
            DioChannel_P13_1_D108: DioChannelId=1
            DioChannel_P13_2_D109: DioChannelId=2
            DioChannel_P13_3_D110: DioChannelId=3
        DioPort_21: DioPortId=21
          8 x DioChannel:
            DioChannel_P21_{0..7}: DioChannelId={0..7}
        DioPort_33: DioPortId=33
          3 x DioChannel:
            DioChannel_P33_12_KL15: DioChannelId=12
            DioChannel_P33_0_EXT_D_IN2: DioChannelId=0
            DioChannel_P33_8_MON: DioChannelId=8
        DioPort23: DioPortId=23
          3 x DioChannel:
            DioChannel_P23_5_LIN_SLP: DioChannelId=5
            DioChannel_P23_6_LIN_SLP: DioChannelId=6
            DioChannel_P23_0_CH_CAN_RX: DioChannelId=0
        DioPort_15: DioPortId=15
          DioChannel_P15_0_ASCLIN1_TX (DioChannel): DioChannelId=0
          DioChannel_P15_1_ASCLIN1_RX (DioChannel): DioChannelId=1
        DioPort02: DioPortId=2
          12 x DioChannel:
            DioChannel_P2_0_IN12: DioChannelId=0
            DioChannel_P2_1_IN11: DioChannelId=1
            DioChannel_P2_2_IN10: DioChannelId=2
            DioChannel_P2_3_IN9: DioChannelId=3
            DioChannel_P2_8_IN4: DioChannelId=8
            DioChannel_P2_9_IN3: DioChannelId=9
            DioChannel_P2_10_IN2: DioChannelId=10
            DioChannel_P2_11_IN1: DioChannelId=11
            DioChannel_P2_4_IN8: DioChannelId=4
            DioChannel_P2_5_IN7: DioChannelId=5
            DioChannel_P2_6_IN6: DioChannelId=6
            DioChannel_P2_7_IN5: DioChannelId=7
        DioPort_10: DioPortId=10
          DioChannel_P10_8_KEY (DioChannel): DioChannelId=8
          DioChannel_P10_7_TLE4252_EN (DioChannel): DioChannelId=7
        DioPort_00: DioPortId=0
          7 x DioChannel:
            DioChannel_P00_7_IN0: DioChannelId=7
            DioChannel_P00_8_IN1: DioChannelId=8
            DioChannel_P00_9_IN2: DioChannelId=9
            DioChannel_P00_10_IN3: DioChannelId=10
            DioChannel_P00_11_DSEL0: DioChannelId=11
            DioChannel_P00_12_DSEL1: DioChannelId=12
            DioChannel_P00_3_PT_CAN_RX: DioChannelId=3
        DioPort_20: DioPortId=20
          3 x DioChannel:
            DioChannel_P20_11_TLE_DIR: DioChannelId=11
            DioChannel_P20_12_TLE_PWM: DioChannelId=12
            DioChannel_P20_13_TLE_DIS: DioChannelId=13
        DioPort_32: DioPortId=32
          DioChannel_P32_2 (DioChannel): DioChannelId=2
          DioChannel_P32_3 (DioChannel): DioChannelId=3
    DioGeneral: DioDevErrorDetect=false, DioFlipChannelApi=false, DioSafetyEnable=false, DioVersionInfoApi=false
