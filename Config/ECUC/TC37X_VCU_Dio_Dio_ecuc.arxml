AUTOSAR XML (schema 00048)
package /Dio
  module config Dio: implementation-config-variant=VARIANT-LINK-TIME, module-description=Dio_Impl
    CommonPublishedInformation:
      ArMajorVersion = 4
      ArMinorVersion = 2
      ArPatchVersion = 2
      ModuleId = 120
      Release = _TRICORE_TC377
      SwMajorVersion = 10
      SwMinorVersion = 40
      SwPatchVersion = 0
      VendorId = 17
    DioConfig
      DioPort_13 (DioPort): DioPortId=13
        4 x DioChannel:
          DioChannel_P13_0_D107: DioChannelId=0
          DioChannel_P13_1_D108: DioChannelId=1
          DioChannel_P13_2_D109: DioChannelId=2
          DioChannel_P13_3_D110: DioChannelId=3
      DioPort_21 (DioPort): DioPortId=21
        8 x DioChannel:
          DioChannel_P21_0: DioChannelId=0
          DioChannel_P21_1: DioChannelId=1
          DioChannel_P21_2_KL15: DioChannelId=2
          DioChannel_P21_{3..7}: DioChannelId={3..7}
    DioGeneral: DioDevErrorDetect=false, DioFlipChannelApi=false, DioSafetyEnable=false, DioVersionInfoApi=false
