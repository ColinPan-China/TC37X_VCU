AUTOSAR XML (schema 00048)
package /Dio
  module config Dio: implementation-config-variant=VARIANT-LINK-TIME, module-description=Dio_Impl
    CommonPublishedInformation:
      ArMajorVersion = 4
      ArMinorVersion = 2
      ArPatchVersion = 2
      ModuleId = 120
      Release = _TRICORE_TC377
      SwMajorVersion = 10
      SwMinorVersion = 40
      SwPatchVersion = 0
      VendorId = 17
    DioConfig
      5 x DioPort:
        DioPort_13: DioPortId=13
          4 x DioChannel:
            DioChannel_P13_0_D107: DioChannelId=0
            DioChannel_P13_1_D108: DioChannelId=1
            DioChannel_P13_2_D109: DioChannelId=2
            DioChannel_P13_3_D110: DioChannelId=3
        DioPort_21: DioPortId=21
          8 x DioChannel:
            DioChannel_P21_{0..7}: DioChannelId={0..7}
        DioPort_33: DioPortId=33
          DioChannel_P33_12_KL15 (DioChannel): DioChannelId=12
        DioPort23: DioPortId=23
          DioChannel_P23_5_LIN_SLP (DioChannel): DioChannelId=5
        DioPort_15: DioPortId=15
          DioChannel_P15_0_ASCLIN1_TX (DioChannel): DioChannelId=0
          DioChannel_P15_1_ASCLIN1_RX (DioChannel): DioChannelId=1
    DioGeneral: DioDevErrorDetect=false, DioFlipChannelApi=false, DioSafetyEnable=false, DioVersionInfoApi=false
