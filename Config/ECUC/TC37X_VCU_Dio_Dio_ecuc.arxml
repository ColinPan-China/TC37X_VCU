AUTOSAR XML (schema 00049)
package /Dio
  module config Dio: implementation-config-variant=VARIANT-LINK-TIME, module-description=Dio_Impl
    CommonPublishedInformation:
      ArMajorVersion = 4
      ArMinorVersion = 2
      ArPatchVersion = 2
      ModuleId = 120
      Release = _TRICORE_TC377
      SwMajorVersion = 10
      SwMinorVersion = 40
      SwPatchVersion = 0
      VendorId = 17
    DioConfig
      DioPort_13 (DioPort): DioPortId=13
        4 x DioChannel:
          DioChannel_P13_0_D107: DioChannelId=0
          DioChannel_P13_1_D108: DioChannelId=1
          DioChannel_P13_2_D109: DioChannelId=2
          DioChannel_P13_3_D110: DioChannelId=3
    DioGeneral: DioDevErrorDetect=false, DioFlipChannelApi=false, DioSafetyEnable=false, DioVersionInfoApi=false
