AUTOSAR XML (schema 00048)
package /ActiveEcuC
  module config CanNm: implementation-config-variant=VARIANT-PRE-COMPILE, module-description=CanNm_Impl
    CanNmGlobalConfig:
      CanNmComUserDataSupport = true
      CanNmPnEiraCalcEnabled = true
      CanNmUserDataEnabled = true
      CanNmBusLoadReductionEnabled = false
      CanNmBusSynchronizationEnabled = false
      CanNmCoordinatorSyncSupport = false
      CanNmDevErrorDetect = true
      CanNmImmediateTxconfEnabled = false
      CanNmMainFunctionPeriod = 0.01
      CanNmPassiveModeEnabled = false
      CanNmPduRxIndicationEnabled = false
      CanNmRemoteSleepIndEnabled = false
      CanNmStateChangeIndEnabled = true
      CanNmVersionInfoApi = false
      CanNmDisableTxErrReport = false
      CanNmApiOptimization = false
      CanNmCanIfRangeConfigDLCCheck = true
      CanNmRuntimeMeasurementSupport = false
      CanNmSafeBswChecks = false
      CanNmNodeIdEnabled = true
      CanNmPnResetTime = 1.5
      CanNmPnEiraRxNSduRef = PNC_CanNm2PduR_PduRx
      CanNmGeneration: CanNmOutOfBoundsWriteSanitizer=false, CanNmOutOfBoundsReadSanitizer=false, CanNmInterfacesForDeactivatedData=false
      3 x CanNmChannelConfig, all with CanNmMsgCycleOffset=0, CanNmMsgCycleTime=0.5, CanNmMsgReducedTime=0.32, CanNmNodeId=28, CanNmPduCbvPosition=CANNM_PDU_BYTE_1, CanNmRepeatMessageTime=1.5, CanNmTimeoutTime=2, CanNmUserDataLength=6, CanNmWaitBusSleepTime=2, CanNmBusLoadReductionActive=false, CanNmCarWakeUpRxEnabled=false, CanNmImmediateNmTransmissions=0, CanNmMsgTimeoutTime=0.06, CanNmPduNidPosition=CANNM_PDU_BYTE_0, CanNmRemoteSleepIndTime=0.5, CanNmNodeDetectionEnabled=false, CanNmRepeatMsgIndEnabled=false, CanNmImmediateRestartEnabled=false, CanNmCriBitAlwaysEnabled=false:
        TC37X_VCU_CAN01_CAN_f1ec184a: CanNmActiveWakeupBitEnabled=false, CanNmNodeIdEnabled=false, CanNmComControlEnabled=false, CanNmComMNetworkHandleRef=CN_TC37X_VCU_CAN01_70b1f95e
          VCU_Tx_51Ch_NM_oTC37X_VCU_CAN01_9aba5863_Tx (CanNmTxPdu): CanNmTxConfirmationPduId=2, CanNmTxPduRef=VCU_Tx_51Ch_NM_oTC37X_VCU_CAN01_9aba5863_Tx
          CanNmRxPdu_1 (CanNmRxPdu): CanNmRxPduId=2, CanNmRxPduRef=VCU_Rx_500h_NM_oTC37X_VCU_CAN01_54a3f814_Rx
          VCU_Tx_51Ch_NM_oTC37X_VCU_CAN01_b5ef0a1c (CanNmUserDataTxPdu): CanNmTxUserDataPduId=2, CanNmTxUserDataPduRef=VCU_Tx_51Ch_NM_oTC37X_VCU_CAN01_b1a53ae9_Tx
        ATOM_CANFD_Matrix_CH_V600_202502_CAN_b5bd2095: CanNmActiveWakeupBitEnabled=true, CanNmNodeIdEnabled=true, CanNmComControlEnabled=false, CanNmAllNmMessagesKeepAwake=false, CanNmPnEnabled=true, CanNmPnEraCalcEnabled=true, CanNmComMNetworkHandleRef=CN_ATOM_CANFD_Matrix_CH_V600_202502_a4d436ac, CanNmPnEraRxNSduRef=PNC_ERA_CH_CanNm2PduR_PduRx
          ATOM_CANFD_Matrix_CH_V600_202502_CAN_b5bd2095_Rx (CanNmRxPdu): CanNmRxPduId=0, CanNmRxPduRef=VCU_3966faea_Rx
          NM_VCU_oATOM_CANFD_Matrix_CH_V600_202502_7321f2c3_Tx (CanNmTxPdu): CanNmTxConfirmationPduId=0, CanNmTxPduRef=NM_VCU_oATOM_CANFD_Matrix_CH_V600_202502_7321f2c3_Tx
          NM_VCU_oATOM_CANFD_Matrix_CH_V600_202502_a4360fde (CanNmUserDataTxPdu): CanNmTxUserDataPduId=0, CanNmTxUserDataPduRef=NM_VCU_oATOM_CANFD_Matrix_CH_V600_202502_00753c97_Tx
        ATOM_CAN_Matrix_PT_V600_20250211_CAN_5212fbaf: CanNmActiveWakeupBitEnabled=true, CanNmNodeIdEnabled=true, CanNmComControlEnabled=true, CanNmAllNmMessagesKeepAwake=false, CanNmPnEnabled=true, CanNmPnEraCalcEnabled=true, CanNmComMNetworkHandleRef=CN_ATOM_CAN_Matrix_PT_V600_20250211_9b894f3d, CanNmPnEraRxNSduRef=PNC_ERA_PT_CanNm2PduR_PduRx
          NM_VCU_oATOM_CAN_Matrix_PT_V600_20250211_16e84d4a_Tx (CanNmTxPdu): CanNmTxConfirmationPduId=1, CanNmTxPduRef=NM_VCU_oATOM_CAN_Matrix_PT_V600_20250211_16e84d4a_Tx
          ATOM_CAN_Matrix_PT_V600_20250211_CAN_5212fbaf_Rx (CanNmRxPdu): CanNmRxPduId=1, CanNmRxPduRef=VCU_f2fc806b_Rx
          NM_VCU_oATOM_CAN_Matrix_PT_V600_20250211_ecb79d3b (CanNmUserDataTxPdu): CanNmTxUserDataPduId=1, CanNmTxUserDataPduRef=NM_VCU_oATOM_CAN_Matrix_PT_V600_20250211_3f284506_Tx
      CanNmPnInfo: CanNmPnInfoLength=6, CanNmPnInfoOffset=2
        6 x CanNmPnFilterMaskByte:
          CanNmPnFilterMaskByte0: CanNmPnFilterMaskByteIndex=0, CanNmPnFilterMaskByteValue=0
          CanNmPnFilterMaskByte1: CanNmPnFilterMaskByteIndex=1, CanNmPnFilterMaskByteValue=133
          CanNmPnFilterMaskByte{2..5}: CanNmPnFilterMaskByteIndex={2..5}, CanNmPnFilterMaskByteValue=0
