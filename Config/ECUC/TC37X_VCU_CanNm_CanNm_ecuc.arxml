AUTOSAR XML (schema 00048)
package /ActiveEcuC
  module config CanNm: implementation-config-variant=VARIANT-PRE-COMPILE, module-description=CanNm_Impl
    CanNmGlobalConfig:
      CanNmComUserDataSupport = true
      CanNmPnEiraCalcEnabled = true
      CanNmUserDataEnabled = true
      CanNmBusLoadReductionEnabled = false
      CanNmBusSynchronizationEnabled = false
      CanNmCoordinatorSyncSupport = false
      CanNmDevErrorDetect = true
      CanNmImmediateTxconfEnabled = false
      CanNmMainFunctionPeriod = 0.01
      CanNmPassiveModeEnabled = false
      CanNmPduRxIndicationEnabled = false
      CanNmRemoteSleepIndEnabled = false
      CanNmStateChangeIndEnabled = true
      CanNmVersionInfoApi = false
      CanNmDisableTxErrReport = false
      CanNmApiOptimization = false
      CanNmCanIfRangeConfigDLCCheck = true
      CanNmRuntimeMeasurementSupport = false
      CanNmSafeBswChecks = false
      CanNmNodeIdEnabled = true
      CanNmPnResetTime = 1.5
      CanNmPnEiraRxNSduRef = PNC_Can00_CanNm2PduR_PduRx
      TC37X_VCU_CAN00_CAN_cc8c31fa (CanNmChannelConfig):
        CanNmMsgCycleOffset = 0
        CanNmMsgCycleTime = 0.5
        CanNmMsgReducedTime = 0.32
        CanNmNodeId = 28
        CanNmPduCbvPosition = CANNM_PDU_BYTE_1
        CanNmRepeatMessageTime = 1.5
        CanNmTimeoutTime = 2
        CanNmUserDataLength = 6
        CanNmWaitBusSleepTime = 2
        CanNmBusLoadReductionActive = false
        CanNmCarWakeUpRxEnabled = false
        CanNmImmediateNmTransmissions = 12
        CanNmMsgTimeoutTime = 0.06
        CanNmPduNidPosition = CANNM_PDU_BYTE_0
        CanNmRemoteSleepIndTime = 0.5
        CanNmActiveWakeupBitEnabled = true
        CanNmNodeIdEnabled = true
        CanNmNodeDetectionEnabled = false
        CanNmRepeatMsgIndEnabled = false
        CanNmImmediateRestartEnabled = false
        CanNmComControlEnabled = true
        CanNmCriBitAlwaysEnabled = false
        CanNmAllNmMessagesKeepAwake = false
        CanNmImmediateNmCycleTime = 0.01
        CanNmRetryFirstMessageRequest = false
        CanNmPnEnabled = true
        CanNmPnEraCalcEnabled = false
        CanNmComMNetworkHandleRef = CN_TC37X_VCU_CAN00_07b6c9c8
        VCU_Tx_51Ch_NM_oTC37X_VCU_CAN00_0aa0ce62_Tx (CanNmTxPdu): CanNmTxConfirmationPduId=0, CanNmTxPduRef=VCU_Tx_51Ch_NM_oTC37X_VCU_CAN00_0aa0ce62_Tx
        CanNmRxPdu: CanNmRxPduId=0, CanNmRxPduRef=VCU_Rx_500h_NM_oTC37X_VCU_CAN00_c4b96e15_Rx
        VCU_Tx_51Ch_NM_oTC37X_VCU_CAN00_d088315a (CanNmUserDataTxPdu): CanNmTxUserDataPduId=0, CanNmTxUserDataPduRef=VCU_Tx_51Ch_NM_oTC37X_VCU_CAN00_c6a20a7f_Tx
      CanNmGeneration: CanNmOutOfBoundsWriteSanitizer=false, CanNmOutOfBoundsReadSanitizer=false, CanNmInterfacesForDeactivatedData=false
      TC37X_VCU_CAN01_CAN_f1ec184a (CanNmChannelConfig):
        CanNmMsgCycleOffset = 0
        CanNmMsgCycleTime = 0.5
        CanNmMsgReducedTime = 0.32
        CanNmNodeId = 28
        CanNmPduCbvPosition = CANNM_PDU_BYTE_1
        CanNmRepeatMessageTime = 1.5
        CanNmTimeoutTime = 2
        CanNmUserDataLength = 6
        CanNmWaitBusSleepTime = 2
        CanNmBusLoadReductionActive = false
        CanNmCarWakeUpRxEnabled = false
        CanNmImmediateNmTransmissions = 0
        CanNmMsgTimeoutTime = 0.06
        CanNmPduNidPosition = CANNM_PDU_BYTE_0
        CanNmRemoteSleepIndTime = 0.5
        CanNmActiveWakeupBitEnabled = true
        CanNmNodeIdEnabled = true
        CanNmNodeDetectionEnabled = false
        CanNmRepeatMsgIndEnabled = false
        CanNmImmediateRestartEnabled = false
        CanNmComControlEnabled = true
        CanNmCriBitAlwaysEnabled = false
        CanNmAllNmMessagesKeepAwake = false
        CanNmPnEraCalcEnabled = false
        CanNmPnEnabled = true
        CanNmComMNetworkHandleRef = CN_TC37X_VCU_CAN01_70b1f95e
        VCU_Tx_51Ch_NM_oTC37X_VCU_CAN01_9aba5863_Tx (CanNmTxPdu): CanNmTxConfirmationPduId=1, CanNmTxPduRef=VCU_Tx_51Ch_NM_oTC37X_VCU_CAN01_9aba5863_Tx
        CanNmRxPdu_1 (CanNmRxPdu): CanNmRxPduId=1, CanNmRxPduRef=VCU_Rx_500h_NM_oTC37X_VCU_CAN01_54a3f814_Rx
        VCU_Tx_51Ch_NM_oTC37X_VCU_CAN01_b5ef0a1c (CanNmUserDataTxPdu): CanNmTxUserDataPduId=1, CanNmTxUserDataPduRef=VCU_Tx_51Ch_NM_oTC37X_VCU_CAN01_b1a53ae9_Tx
      CanNmPnInfo: CanNmPnInfoLength=6, CanNmPnInfoOffset=2
        6 x CanNmPnFilterMaskByte:
          CanNmPnFilterMaskByte0: CanNmPnFilterMaskByteIndex=0, CanNmPnFilterMaskByteValue=0
          CanNmPnFilterMaskByte1: CanNmPnFilterMaskByteIndex=1, CanNmPnFilterMaskByteValue=133
          CanNmPnFilterMaskByte{2..5}: CanNmPnFilterMaskByteIndex={2..5}, CanNmPnFilterMaskByteValue=0
      TC37X_VCU_CAN03_CAN_8b2c4b2a (CanNmChannelConfig):
        CanNmMsgCycleOffset = 0
        CanNmMsgCycleTime = 0.5
        CanNmMsgReducedTime = 0.32
        CanNmNodeId = 28
        CanNmPduCbvPosition = CANNM_PDU_BYTE_1
        CanNmRepeatMessageTime = 1.5
        CanNmTimeoutTime = 2
        CanNmUserDataLength = 6
        CanNmWaitBusSleepTime = 2
        CanNmBusLoadReductionActive = false
        CanNmCarWakeUpRxEnabled = false
        CanNmImmediateNmTransmissions = 0
        CanNmMsgTimeoutTime = 0.06
        CanNmPduNidPosition = CANNM_PDU_BYTE_0
        CanNmRemoteSleepIndTime = 0.5
        CanNmActiveWakeupBitEnabled = false
        CanNmNodeIdEnabled = false
        CanNmNodeDetectionEnabled = false
        CanNmRepeatMsgIndEnabled = false
        CanNmImmediateRestartEnabled = false
        CanNmComControlEnabled = false
        CanNmCriBitAlwaysEnabled = false
        CanNmComMNetworkHandleRef = CN_TC37X_VCU_CAN03_9ebf9872
        VCU_Tx_51Ch_NM_oTC37X_VCU_CAN03_7f217c90 (CanNmUserDataTxPdu): CanNmTxUserDataPduId=2, CanNmTxUserDataPduRef=VCU_Tx_51Ch_NM_oTC37X_VCU_CAN03_5fab5bc5_Tx
        VCU_Tx_51Ch_NM_oTC37X_VCU_CAN03_61fe7220_Tx (CanNmTxPdu): CanNmTxConfirmationPduId=2, CanNmTxPduRef=VCU_Tx_51Ch_NM_oTC37X_VCU_CAN03_61fe7220_Tx
        CanNmRxPdu_001 (CanNmRxPdu): CanNmRxPduId=2, CanNmRxPduRef=VCU_Rx_500h_NM_oTC37X_VCU_CAN03_afe7d257_Rx
