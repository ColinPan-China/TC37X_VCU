AUTOSAR XML (schema 00048)
package /ActiveEcuC
  module config CanNm: implementation-config-variant=VARIANT-PRE-COMPILE, module-description=CanNm_Impl
    CanNmGlobalConfig:
      CanNmPnEiraCalcEnabled = false
      CanNmUserDataEnabled = true
      CanNmBusLoadReductionEnabled = false
      CanNmBusSynchronizationEnabled = false
      CanNmComUserDataSupport = false
      CanNmCoordinatorSyncSupport = false
      CanNmDevErrorDetect = true
      CanNmImmediateTxconfEnabled = false
      CanNmMainFunctionPeriod = 0.01
      CanNmPassiveModeEnabled = false
      CanNmPduRxIndicationEnabled = false
      CanNmRemoteSleepIndEnabled = false
      CanNmStateChangeIndEnabled = true
      CanNmVersionInfoApi = false
      CanNmDisableTxErrReport = false
      CanNmApiOptimization = false
      CanNmCanIfRangeConfigDLCCheck = true
      CanNmRuntimeMeasurementSupport = false
      CanNmSafeBswChecks = false
      CanNmNodeIdEnabled = true
      CanNmGeneration: CanNmOutOfBoundsWriteSanitizer=false, CanNmOutOfBoundsReadSanitizer=false, CanNmInterfacesForDeactivatedData=false
      4 x CanNmChannelConfig, all with CanNmMsgCycleOffset=0, CanNmMsgCycleTime=0.5, CanNmMsgReducedTime=0.32, CanNmNodeId=28, CanNmRepeatMessageTime=1.5, CanNmTimeoutTime=2, CanNmUserDataLength=6, CanNmWaitBusSleepTime=2, CanNmBusLoadReductionActive=false, CanNmCarWakeUpRxEnabled=false, CanNmImmediateNmTransmissions=0, CanNmMsgTimeoutTime=0.06, CanNmPduCbvPosition=CANNM_PDU_BYTE_1, CanNmPduNidPosition=CANNM_PDU_BYTE_0, CanNmRemoteSleepIndTime=0.5, CanNmActiveWakeupBitEnabled=false, CanNmNodeDetectionEnabled=false, CanNmRepeatMsgIndEnabled=false, CanNmImmediateRestartEnabled=false, CanNmCriBitAlwaysEnabled=false:
        TC37X_VCU_CAN01_CAN_f1ec184a: CanNmNodeIdEnabled=false, CanNmComControlEnabled=false, CanNmComMNetworkHandleRef=CN_TC37X_VCU_CAN01_70b1f95e
          VCU_Tx_51Ch_NM_oTC37X_VCU_CAN01_9aba5863_Tx (CanNmTxPdu): CanNmTxConfirmationPduId=2, CanNmTxPduRef=VCU_Tx_51Ch_NM_oTC37X_VCU_CAN01_9aba5863_Tx
          CanNmRxPdu_1 (CanNmRxPdu): CanNmRxPduId=2, CanNmRxPduRef=VCU_Rx_500h_NM_oTC37X_VCU_CAN01_54a3f814_Rx
        TC37X_VCU_CAN03_CAN_8b2c4b2a: CanNmNodeIdEnabled=false, CanNmComControlEnabled=false, CanNmComMNetworkHandleRef=CN_TC37X_VCU_CAN03_9ebf9872
          VCU_Tx_51Ch_NM_oTC37X_VCU_CAN03_61fe7220_Tx (CanNmTxPdu): CanNmTxConfirmationPduId=3, CanNmTxPduRef=VCU_Tx_51Ch_NM_oTC37X_VCU_CAN03_61fe7220_Tx
          CanNmRxPdu_002 (CanNmRxPdu): CanNmRxPduId=3, CanNmRxPduRef=VCU_Rx_500h_NM_oTC37X_VCU_CAN03_afe7d257_Rx
        ATOM_CANFD_Matrix_CH_V600_202502_CAN_b5bd2095: CanNmNodeIdEnabled=false, CanNmComControlEnabled=false, CanNmComMNetworkHandleRef=CN_ATOM_CANFD_Matrix_CH_V600_202502_a4d436ac
          ATOM_CANFD_Matrix_CH_V600_202502_CAN_b5bd2095_Rx (CanNmRxPdu): CanNmRxPduId=0, CanNmRxPduRef=VCU_3966faea_Rx
          NM_VCU_oATOM_CANFD_Matrix_CH_V600_202502_7321f2c3_Tx (CanNmTxPdu): CanNmTxConfirmationPduId=0, CanNmTxPduRef=NM_VCU_oATOM_CANFD_Matrix_CH_V600_202502_7321f2c3_Tx
        ATOM_CAN_Matrix_PT_V600_20250211_CAN_5212fbaf: CanNmNodeIdEnabled=true, CanNmComControlEnabled=true, CanNmComMNetworkHandleRef=CN_ATOM_CAN_Matrix_PT_V600_20250211_9b894f3d
          NM_VCU_oATOM_CAN_Matrix_PT_V600_20250211_16e84d4a_Tx (CanNmTxPdu): CanNmTxConfirmationPduId=1, CanNmTxPduRef=NM_VCU_oATOM_CAN_Matrix_PT_V600_20250211_16e84d4a_Tx
          ATOM_CAN_Matrix_PT_V600_20250211_CAN_5212fbaf_Rx (CanNmRxPdu): CanNmRxPduId=1, CanNmRxPduRef=VCU_f2fc806b_Rx
