AUTOSAR XML (schema 00048)
package /ActiveEcuC
  module config CanNm: implementation-config-variant=VARIANT-PRE-COMPILE, module-description=CanNm_Impl
    CanNmGlobalConfig:
      CanNmPnEiraCalcEnabled = false
      CanNmUserDataEnabled = true
      CanNmBusLoadReductionEnabled = false
      CanNmBusSynchronizationEnabled = false
      CanNmComUserDataSupport = false
      CanNmCoordinatorSyncSupport = false
      CanNmDevErrorDetect = true
      CanNmImmediateTxconfEnabled = false
      CanNmMainFunctionPeriod = 0.01
      CanNmPassiveModeEnabled = false
      CanNmPduRxIndicationEnabled = false
      CanNmRemoteSleepIndEnabled = false
      CanNmStateChangeIndEnabled = true
      CanNmVersionInfoApi = false
      CanNmDisableTxErrReport = false
      CanNmApiOptimization = false
      CanNmCanIfRangeConfigDLCCheck = true
      CanNmRuntimeMeasurementSupport = false
      CanNmSafeBswChecks = false
      CanNmNodeIdEnabled = true
      TC37X_VCU_CAN00_CAN_cc8c31fa (CanNmChannelConfig):
        CanNmMsgCycleOffset = 0
        CanNmMsgCycleTime = 0.5
        CanNmMsgReducedTime = 0.32
        CanNmNodeId = 28
        CanNmRepeatMessageTime = 1.5
        CanNmTimeoutTime = 2
        CanNmUserDataLength = 6
        CanNmWaitBusSleepTime = 2
        CanNmBusLoadReductionActive = false
        CanNmCarWakeUpRxEnabled = false
        CanNmImmediateNmTransmissions = 12
        CanNmMsgTimeoutTime = 0.06
        CanNmPduCbvPosition = CANNM_PDU_BYTE_1
        CanNmPduNidPosition = CANNM_PDU_BYTE_0
        CanNmRemoteSleepIndTime = 0.5
        CanNmActiveWakeupBitEnabled = false
        CanNmNodeIdEnabled = true
        CanNmNodeDetectionEnabled = false
        CanNmRepeatMsgIndEnabled = false
        CanNmImmediateRestartEnabled = false
        CanNmComControlEnabled = true
        CanNmCriBitAlwaysEnabled = false
        CanNmAllNmMessagesKeepAwake = true
        CanNmImmediateNmCycleTime = 0.01
        CanNmRetryFirstMessageRequest = false
        CanNmComMNetworkHandleRef = CN_TC37X_VCU_CAN00_07b6c9c8
        VCU_Tx_51Ch_NM_oTC37X_VCU_CAN00_0aa0ce62_Tx (CanNmTxPdu): CanNmTxConfirmationPduId=0, CanNmTxPduRef=VCU_Tx_51Ch_NM_oTC37X_VCU_CAN00_0aa0ce62_Tx
        CanNmRxPdu: CanNmRxPduId=0, CanNmRxPduRef=VCU_Rx_500h_NM_oTC37X_VCU_CAN00_c4b96e15_Rx
      CanNmGeneration: CanNmOutOfBoundsWriteSanitizer=false, CanNmOutOfBoundsReadSanitizer=false, CanNmInterfacesForDeactivatedData=false
      TC37X_VCU_CAN01_CAN_f1ec184a (CanNmChannelConfig):
        CanNmMsgCycleOffset = 0
        CanNmMsgCycleTime = 0.5
        CanNmMsgReducedTime = 0.32
        CanNmNodeId = 28
        CanNmRepeatMessageTime = 1.5
        CanNmTimeoutTime = 2
        CanNmUserDataLength = 6
        CanNmWaitBusSleepTime = 2
        CanNmBusLoadReductionActive = false
        CanNmCarWakeUpRxEnabled = false
        CanNmImmediateNmTransmissions = 0
        CanNmMsgTimeoutTime = 0.06
        CanNmPduCbvPosition = CANNM_PDU_BYTE_1
        CanNmPduNidPosition = CANNM_PDU_BYTE_0
        CanNmRemoteSleepIndTime = 0.5
        CanNmActiveWakeupBitEnabled = false
        CanNmNodeIdEnabled = false
        CanNmNodeDetectionEnabled = false
        CanNmRepeatMsgIndEnabled = false
        CanNmImmediateRestartEnabled = false
        CanNmComControlEnabled = false
        CanNmCriBitAlwaysEnabled = false
        CanNmComMNetworkHandleRef = CN_TC37X_VCU_CAN01_70b1f95e
        VCU_Tx_51Ch_NM_oTC37X_VCU_CAN01_9aba5863_Tx (CanNmTxPdu): CanNmTxConfirmationPduId=1, CanNmTxPduRef=VCU_Tx_51Ch_NM_oTC37X_VCU_CAN01_9aba5863_Tx
        CanNmRxPdu_1 (CanNmRxPdu): CanNmRxPduId=1, CanNmRxPduRef=VCU_Rx_500h_NM_oTC37X_VCU_CAN01_54a3f814_Rx
      TC37X_VCU_CAN12_CAN_7d10b13f (CanNmChannelConfig):
        CanNmMsgCycleOffset = 0
        CanNmMsgCycleTime = 0.5
        CanNmMsgReducedTime = 0.32
        CanNmNodeId = 28
        CanNmRepeatMessageTime = 1.5
        CanNmTimeoutTime = 2
        CanNmUserDataLength = 6
        CanNmWaitBusSleepTime = 2
        CanNmBusLoadReductionActive = false
        CanNmCarWakeUpRxEnabled = false
        CanNmImmediateNmTransmissions = 0
        CanNmMsgTimeoutTime = 0.06
        CanNmPduCbvPosition = CANNM_PDU_BYTE_1
        CanNmPduNidPosition = CANNM_PDU_BYTE_0
        CanNmRemoteSleepIndTime = 0.5
        CanNmActiveWakeupBitEnabled = false
        CanNmNodeIdEnabled = false
        CanNmNodeDetectionEnabled = false
        CanNmRepeatMsgIndEnabled = false
        CanNmImmediateRestartEnabled = false
        CanNmComControlEnabled = false
        CanNmCriBitAlwaysEnabled = false
        CanNmComMNetworkHandleRef = CN_TC37X_VCU_CAN12_f0a399a5
        VCU_Tx_51Ch_NM_oTC37X_VCU_CAN12_8673ce21_Tx (CanNmTxPdu): CanNmTxConfirmationPduId=2, CanNmTxPduRef=VCU_Tx_51Ch_NM_oTC37X_VCU_CAN12_8673ce21_Tx
        CanNmRxPdu_001 (CanNmRxPdu): CanNmRxPduId=2, CanNmRxPduRef=VCU_Rx_500h_NM_oTC37X_VCU_CAN12_486a6e56_Rx
