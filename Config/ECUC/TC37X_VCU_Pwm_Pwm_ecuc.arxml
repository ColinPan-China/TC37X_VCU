AUTOSAR XML (schema 00048)
package /Pwm
  module config Pwm: implementation-config-variant=VARIANT-POST-BUILD, module-description=Pwm_Impl
    CommonPublishedInformation:
      ArMajorVersion = 4
      ArMinorVersion = 2
      ArPatchVersion = 2
      ModuleId = 121
      Release = _TRICORE_TC377
      SwMajorVersion = 10
      SwMinorVersion = 40
      SwPatchVersion = 2
      VendorApiInfix = GtmCcu6
      VendorId = 17
    PwmChannelConfigSet
      5 x PwmChannel, all with PwmAssignedHwUnit=GTM, PwmChannelClass=PWM_VARIABLE_PERIOD, PwmDutycycleDefault=16384, PwmPeriodDefault=400, PwmPolarity=PWM_HIGH, PwmShiftValue=0, PwmMcuClockReferencePoint=McuClockReferencePoint_GTM:
        PwmChannel_PWM_P00_0: PwmChannelId=2, PwmIdleState=PWM_HIGH, PwmReferenceChannel=PwmChannel_PWM_P00_0
          GtmTimerOutputModuleConfiguration_0 (GtmTimerOutputModuleConfiguration): GtmTimerClockSelect=GTM_FIXED_CLOCK_2, GtmTimerUsed=McuGtmTomChannelAllocationConf_0
          CCU6CC6Configuration:
            CCU6TimerUsed = T12
            Cc6xChannel = Cc60
            CCU6TimerClockSelect = CCU6_CONFIGURABLE_CLOCK_0
            CCU6TimerPrescalarEnabled = false
            CCU6KernelUsed = McuCcu6ModuleAllocationConf_0
        PwmChannel_PWM_P00_1: PwmChannelId=3, PwmIdleState=PWM_HIGH, PwmReferenceChannel=PwmChannel_PWM_P00_1
          GtmTimerOutputModuleConfiguration_0 (GtmTimerOutputModuleConfiguration): GtmTimerClockSelect=GTM_FIXED_CLOCK_2, GtmTimerUsed=McuGtmTomChannelAllocationConf_1
          CCU6CC6Configuration:
            CCU6TimerUsed = T12
            Cc6xChannel = Cc60
            CCU6TimerClockSelect = CCU6_CONFIGURABLE_CLOCK_0
            CCU6TimerPrescalarEnabled = false
            CCU6KernelUsed = McuCcu6ModuleAllocationConf_1
        PwmChannel_PWM_P00_4: PwmChannelId=1, PwmIdleState=PWM_HIGH, PwmReferenceChannel=PwmChannel_PWM_P00_4
          GtmTimerOutputModuleConfiguration_0 (GtmTimerOutputModuleConfiguration): GtmTimerClockSelect=GTM_FIXED_CLOCK_2, GtmTimerUsed=McuGtmTomChannelAllocationConf_3
          CCU6CC6Configuration:
            CCU6TimerUsed = T12
            Cc6xChannel = Cc60
            CCU6TimerClockSelect = CCU6_CONFIGURABLE_CLOCK_0
            CCU6TimerPrescalarEnabled = false
            CCU6KernelUsed = McuCcu6ModuleAllocationConf_0
        PwmChannel_PWM_P00_5: PwmChannelId=0, PwmIdleState=PWM_HIGH, PwmReferenceChannel=PwmChannel_PWM_P00_5
          GtmTimerOutputModuleConfiguration_0 (GtmTimerOutputModuleConfiguration): GtmTimerClockSelect=GTM_FIXED_CLOCK_2, GtmTimerUsed=McuGtmTomChannelAllocationConf_4
          CCU6CC6Configuration:
            CCU6TimerUsed = T12
            Cc6xChannel = Cc60
            CCU6TimerClockSelect = CCU6_CONFIGURABLE_CLOCK_0
            CCU6TimerPrescalarEnabled = false
            CCU6KernelUsed = McuCcu6ModuleAllocationConf_1
        PwmChannel_PWM_P02_5_IN7_IGN3: PwmChannelId=4, PwmIdleState=PWM_LOW, PwmReferenceChannel=PwmChannel_PWM_P02_5_IN7_IGN3
          GtmTimerOutputModuleConfiguration_0 (GtmTimerOutputModuleConfiguration): GtmTimerClockSelect=GTM_FIXED_CLOCK_2, GtmTimerUsed=McuGtmTomChannelAllocationConf_2
          CCU6CC6Configuration:
            CCU6TimerUsed = T12
            Cc6xChannel = Cc60
            CCU6TimerClockSelect = CCU6_CONFIGURABLE_CLOCK_0
            CCU6TimerPrescalarEnabled = false
            CCU6KernelUsed = McuCcu6ModuleAllocationConf_1
    PwmConfigurationOfOptApiServices: PwmDeInitApi=true, PwmGetOutputState=true, PwmSetDutyCycle=true, PwmSetOutputToIdle=true, PwmSetPeriodAndDuty=true, PwmVersionInfoApi=false
    PwmGeneral:
      PwmChannelCoherentSelection = false
      PwmDevErrorDetect = false
      PwmDutyShiftInTicks = false
      PwmDutycycleUpdatedEndperiod = false
      PwmEnable0Or100DutyNotification = false
      PwmHandleShiftByOffset = false
      PwmIndex = 0
      PwmInitCheckApi = true
      PwmMultiCoreErrorDetect = false
      PwmNotificationSupported = false
      PwmPeriodUpdatedEndperiod = false
      PwmPowerStateAsynchTransitionMode = false
      PwmSafetyEnable = false
