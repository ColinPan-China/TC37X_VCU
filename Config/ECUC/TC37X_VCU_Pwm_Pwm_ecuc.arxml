AUTOSAR XML (schema 00048)
package /Pwm
  module config Pwm: implementation-config-variant=VARIANT-POST-BUILD, module-description=Pwm_Impl
    CommonPublishedInformation:
      ArMajorVersion = 4
      ArMinorVersion = 2
      ArPatchVersion = 2
      ModuleId = 121
      Release = _TRICORE_TC377
      SwMajorVersion = 10
      SwMinorVersion = 40
      SwPatchVersion = 2
      VendorApiInfix = GtmCcu6
      VendorId = 17
    PwmChannelConfigSet
      PwmChannel_PWM_OUT1 (PwmChannel):
        PwmAssignedHwUnit = GTM
        PwmChannelClass = PWM_VARIABLE_PERIOD
        PwmChannelId = 0
        PwmDutycycleDefault = 16384
        PwmIdleState = PWM_LOW
        PwmPeriodDefault = 400
        PwmPolarity = PWM_HIGH
        PwmShiftValue = 0
        PwmMcuClockReferencePoint = McuClockReferencePoint_GTM
        PwmReferenceChannel = PwmChannel_PWM_OUT1
        GtmTimerOutputModuleConfiguration_0 (GtmTimerOutputModuleConfiguration): GtmTimerClockSelect=GTM_FIXED_CLOCK_2, GtmTimerUsed=McuGtmTomChannelAllocationConf_4
        CCU6CC6Configuration:
          CCU6TimerUsed = T12
          Cc6xChannel = Cc60
          CCU6TimerClockSelect = CCU6_CONFIGURABLE_CLOCK_0
          CCU6TimerPrescalarEnabled = false
          CCU6KernelUsed = McuCcu6ModuleAllocationConf_0
      PwmChannel_PWM_OUT2 (PwmChannel):
        PwmAssignedHwUnit = GTM
        PwmChannelClass = PWM_VARIABLE_PERIOD
        PwmChannelId = 1
        PwmDutycycleDefault = 16384
        PwmIdleState = PWM_LOW
        PwmPeriodDefault = 400
        PwmPolarity = PWM_HIGH
        PwmShiftValue = 0
        PwmMcuClockReferencePoint = McuClockReferencePoint_GTM
        PwmReferenceChannel = PwmChannel_PWM_OUT2
        GtmTimerOutputModuleConfiguration_0 (GtmTimerOutputModuleConfiguration): GtmTimerClockSelect=GTM_FIXED_CLOCK_2, GtmTimerUsed=McuGtmTomChannelAllocationConf_3
        CCU6CC6Configuration:
          CCU6TimerUsed = T12
          Cc6xChannel = Cc60
          CCU6TimerClockSelect = CCU6_CONFIGURABLE_CLOCK_0
          CCU6TimerPrescalarEnabled = false
          CCU6KernelUsed = McuCcu6ModuleAllocationConf_1
    PwmConfigurationOfOptApiServices: PwmDeInitApi=true, PwmGetOutputState=true, PwmSetDutyCycle=true, PwmSetOutputToIdle=true, PwmSetPeriodAndDuty=true, PwmVersionInfoApi=false
    PwmGeneral:
      PwmChannelCoherentSelection = false
      PwmDevErrorDetect = false
      PwmDutyShiftInTicks = false
      PwmDutycycleUpdatedEndperiod = false
      PwmEnable0Or100DutyNotification = false
      PwmHandleShiftByOffset = false
      PwmIndex = 0
      PwmInitCheckApi = true
      PwmMultiCoreErrorDetect = false
      PwmNotificationSupported = false
      PwmPeriodUpdatedEndperiod = false
      PwmPowerStateAsynchTransitionMode = false
      PwmSafetyEnable = false
