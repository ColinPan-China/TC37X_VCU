AUTOSAR XML (schema 00048)
package /ActiveEcuC
  module config IoHwAb: implementation-config-variant=VARIANT-PRE-COMPILE, module-description=IoHwAb_Impl
    IoHwAbDatatypes
      9 x IoHwAbBaseType:
        float64: IoHwAbBaseDataType=IOHWAB_FLOAT64
        float32: IoHwAbBaseDataType=IOHWAB_FLOAT32
        sint32: IoHwAbBaseDataType=IOHWAB_SINT32
        sint16: IoHwAbBaseDataType=IOHWAB_SINT16
        sint8: IoHwAbBaseDataType=IOHWAB_SINT8
        uint32: IoHwAbBaseDataType=IOHWAB_UINT32
        uint16: IoHwAbBaseDataType=IOHWAB_UINT16
        uint8: IoHwAbBaseDataType=IOHWAB_UINT8
        boolean: IoHwAbBaseDataType=IOHWAB_BOOL
      IoHwAbImplementationTypes
    IoHwAbGeneral: IoHwAbDevErrorDetect=true, IoHwAbVersionInfoApi=false, IoHwAbUseInitFunction=true
    IoHwAbCSPortInterface: IoHwAbTemplate=IoHwAb_Template_None
      IoHwAb_Dio_WriteChannel (IoHwAbOperation)
        ChannelId (IoHwAbOperationArgument): IoHwAbArgDirection=IOHWAB_IN, IoHwAbOperationArgumentPosition=0, IoHwAbArgTypeRef=uint16
        Level (IoHwAbOperationArgument): IoHwAbArgDirection=IOHWAB_IN, IoHwAbOperationArgumentPosition=1, IoHwAbArgTypeRef=uint8
      IoHwAbApplicationError: IoHwAbErrorCode=1
    IoHwAbCSPortPrototype: IoHwAbCSDirection=IOHWAB_SERVER, IoHwAbCSPortInterfaceRef=IoHwAbCSPortInterface
    IoHwAbRunnable_10ms (IoHwAbRunnable): IoHwAbTriggerPeriod=10, IoHwAbTimebase=IoHwAbMSec
    IoHwAbRunnable_500ms (IoHwAbRunnable): IoHwAbTriggerPeriod=500, IoHwAbTimebase=IoHwAbMSec
