/*********************************************************************************************************************
* COPYRIGHT *
* Copyright (c) 2013 - 2025 by Vector Informatik GmbH. All rights reserved. *
* This software is copyright protected and proprietary to Vector Informatik GmbH. *
* Vector Informatik GmbH grants to you only those rights as set out in the license conditions. *
* All other rights remain with Vector Informatik GmbH. *
* FILE DESCRIPTION *
* File: McData.a2l *
* Description: MICROSAR A2L file *
* Generated at: 2025-10-23 10:39:14 *
* Generator: MICROSAR McDataConverter, Version 1.1.0.0 *
* CUSTOMER INFORMATION *
* Customer: SAIC TTTech Auto Technology Co., Ltd. *
* Serial Number: CBD2100764 *
* Delivery Number: 0 *
* Expiry Date: *
*********************************************************************************************************************/
/begin RECORD_LAYOUT VECTOR_RL_BOOLEAN FNC_VALUES 1 UBYTE ROW_DIR DIRECT /end RECORD_LAYOUT
/begin RECORD_LAYOUT VECTOR_RL_FLOAT32_IEEE FNC_VALUES 1 FLOAT32_IEEE ROW_DIR DIRECT /end RECORD_LAYOUT
/begin RECORD_LAYOUT VECTOR_RL_FLOAT64_IEEE FNC_VALUES 1 FLOAT64_IEEE ROW_DIR DIRECT /end RECORD_LAYOUT
/begin RECORD_LAYOUT VECTOR_RL_SBYTE FNC_VALUES 1 SBYTE ROW_DIR DIRECT /end RECORD_LAYOUT
/begin RECORD_LAYOUT VECTOR_RL_SLONG FNC_VALUES 1 SLONG ROW_DIR DIRECT /end RECORD_LAYOUT
/begin RECORD_LAYOUT VECTOR_RL_SWORD FNC_VALUES 1 SWORD ROW_DIR DIRECT /end RECORD_LAYOUT
/begin RECORD_LAYOUT VECTOR_RL_UBYTE FNC_VALUES 1 UBYTE ROW_DIR DIRECT /end RECORD_LAYOUT
/begin RECORD_LAYOUT VECTOR_RL_ULONG FNC_VALUES 1 ULONG ROW_DIR DIRECT /end RECORD_LAYOUT
/begin RECORD_LAYOUT VECTOR_RL_UWORD FNC_VALUES 1 UWORD ROW_DIR DIRECT /end RECORD_LAYOUT
/begin GROUP BswM "" /end GROUP
/begin GROUP CanIf "" /end GROUP
/begin GROUP CanNm "" /end GROUP
/begin GROUP CanSM "" /end GROUP
/begin GROUP CanTp "" /end GROUP
/begin GROUP CanTrcv_30_Tja1040 "" /end GROUP
/begin GROUP Com "" /end GROUP
/begin GROUP ComM "" /end GROUP
/begin GROUP EcuM "" /end GROUP
/begin GROUP LinIf "" /end GROUP
/begin GROUP LinSM "" /end GROUP
/begin GROUP Nm "" /end GROUP
/begin GROUP NvM "" /end GROUP
