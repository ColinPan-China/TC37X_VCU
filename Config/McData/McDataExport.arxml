AUTOSAR XML (schema 00048)
package /MICROSAR
  12 x bsw implementation, all with programming-language=C, vendor-id=30, ar-release-version=4.00.03:
    BswM_Impl: sw-version=14.00.00, used-code-generator=DaVinci Configurator, behavior=BswMBehavior
    CanIf_Impl: sw-version=8.03.00, used-code-generator=cMSR, behavior=CanIf_Behavior
    CanNm_Impl: sw-version=10.00.01, used-code-generator=DaVinci Configurator, behavior=CanNmBehavior
    CanSM_Impl: sw-version=4.00.00, used-code-generator=DaVinci Configurator, behavior=CanSMBehavior
    CanTp_Impl: sw-version=5.00.00, used-code-generator=DaVinci Configurator, behavior=CanTpBehavior
    Com_Impl: sw-version=22.02.01, used-code-generator=DaVinci Configurator, behavior=ComBehavior
    ComM_Impl: sw-version=14.01.01, used-code-generator=DaVinci Configurator, behavior=ComMBehavior
    EcuM_Impl: sw-version=11.00.01, used-code-generator=DaVinci Configurator, behavior=EcuMBehavior
    LinIf_Impl: sw-version=9.00.00, used-code-generator=DaVinci Configurator, behavior=LinIfBehavior
    LinSM_Impl: sw-version=7.00.02, used-code-generator=DaVinci Configurator, behavior=LinSMBehavior
    Nm_Impl: sw-version=14.01.00, used-code-generator=DaVinci Configurator, behavior=NmBehavior
    NvM_Impl: sw-version=9.01.00, used-code-generator=DaVinci Configurator, behavior=NvMBehavior
package /MICROSAR/CanTrcv_Tja1040
  bsw implementation CanTrcv_Impl: programming-language=C, sw-version=4.03.00, used-code-generator=DaVinci Configurator5, vendor-id=30, ar-release-version=4.00.03, behavior=CanTrcv_Tja1040_Behavior, vendor-api-infix=Tja1040
package /MICROSAR/BswM_ib_bswmd/BswModuleDescriptions
  bsw module description BswM
    bsw internal behavior BswMBehavior
      exclusive area BSWM_EXCLUSIVE_AREA_0
      bsw schedulable entity BswM_MainFunction: implemented-entry=BswM_MainFunction
      bsw timing event BswM_MainFunctionTimingEvent0: starts-on-event=BswM_MainFunction, period=0.01
  bsw module entry BswM_MainFunction: call-type=SCHEDULED, execution-context=TASK
package /MICROSAR/CanIf_ib_bswmd/BswModuleDescriptions
  bsw module description CanIf
    bsw internal behavior CanIf_Behavior
      8 x exclusive area:
        CANIF_EXCLUSIVE_AREA_{0..7}
package /MICROSAR/CanNm_ib_bswmd/BswModuleDescriptions
  bsw module description CanNm
    bsw internal behavior CanNmBehavior
      7 x exclusive area:
        CANNM_EXCLUSIVE_AREA_0  # No interruption by any interrupt allowed (i.e. global interrupt locks).
        CANNM_EXCLUSIVE_AREA_1  # No interruption of CanNm_MainFunction or CanNm_RequestBusSynchronization by CanNm_SetUserData or CanNm_SetSleepReadyBit allowed.
        CANNM_EXCLUSIVE_AREA_2  # No interruption of CanNm_SetUserData by CanNm_MainFunction or CanNm_RequestBusSynchronization allowed.
        CANNM_EXCLUSIVE_AREA_3  # No interruption of CanNm_SetSleepReadyBit by CanNm_MainFunction or CanNm_RequestBusSynchronization allowed.
        CANNM_EXCLUSIVE_AREA_4  # No interruption of CanNm_RxIndication by CanNm_GetUserData or CanNm_GetPduData allowed.
        CANNM_EXCLUSIVE_AREA_5  # No interruption of CanNm_GetUserData or CanNm_GetPduData by CanNm_RxIndication allowed.
        CANNM_EXCLUSIVE_AREA_6  # No interruption of CanNm_MainFunction by CanNm_RequestBusSynchronization allowed. Note: This critical section can be left empty when CanNm_MainFunction and Nm_MainFunction have the same task.
      bsw schedulable entity CanNm_MainFunction: implemented-entry=CanNm_MainFunction
      bsw timing event CanNm_MainFunctionTimingEvent0: starts-on-event=CanNm_MainFunction, period=0.01
  bsw module entry CanNm_MainFunction: call-type=SCHEDULED, execution-context=TASK
package /MICROSAR/CanSM_ib_bswmd/BswModuleDescriptions
  bsw module description CanSM
    bsw internal behavior CanSMBehavior
      6 x exclusive area:
        CANSM_EXCLUSIVE_AREA_{1..6}
      bsw schedulable entity CanSM_MainFunction: implemented-entry=CanSM_MainFunction
      bsw timing event CanSM_MainFunctionTimingEvent0: starts-on-event=CanSM_MainFunction, period=0.01
  bsw module entry CanSM_MainFunction: call-type=SCHEDULED, execution-context=TASK
package /MICROSAR/CanTp_ib_bswmd/BswModuleDescriptions
  bsw module description CanTp
    bsw internal behavior CanTpBehavior
      exclusive area CANTP_EXCLUSIVE_AREA_0
      bsw schedulable entity CanTp_MainFunction: implemented-entry=CanTp_MainFunction
      bsw timing event CanTp_MainFunctionTimingEvent0: starts-on-event=CanTp_MainFunction, period=0.005
  bsw module entry CanTp_MainFunction: call-type=SCHEDULED, execution-context=TASK
package /MICROSAR/CanTrcv_Tja1040_ib_bswmd/BswModuleDescriptions
  bsw module description CanTrcv
    bsw internal behavior CanTrcv_Tja1040_Behavior
      exclusive area CANTRCV_30_TJA1040_EXCLUSIVE_AREA_0
      bsw schedulable entity CanTrcv_30_Tja1040_MainFunction: implemented-entry=CanTrcv_30_Tja1040_MainFunction
      bsw timing event CanTrcv_30_Tja1040_MainFunctionTimingEvent0: starts-on-event=CanTrcv_30_Tja1040_MainFunction, period=0.01
  bsw module entry CanTrcv_30_Tja1040_MainFunction: call-type=SCHEDULED, execution-context=TASK
package /MICROSAR/ComM_ib_bswmd/BswModuleDescriptions
  bsw module description ComM
    bsw internal behavior ComMBehavior
      8 x exclusive area:
        COMM_EXCLUSIVE_AREA_0
        COMM_EXCLUSIVE_AREA_1
        COMM_EXCLUSIVE_AREA_{2..7}  # This exclusive area is only used in case of multi-partition. It must be configured as a spinlock to allow access to some variables simultaneously from multiple cores.
      8 x bsw schedulable entity:
        ComM_MainFunction_{0..7}: implemented-entry=ComM_MainFunction_{0..7}
      8 x bsw timing event, all with period=0.02:
        ComM_MainFunction_{0..7}TimingEvent0: starts-on-event=ComM_MainFunction_{0..7}
  8 x bsw module entry, all with call-type=SCHEDULED, execution-context=TASK:
    ComM_MainFunction_{0..7}
package /MICROSAR/Com_ib_bswmd/BswModuleDescriptions
  bsw module description Com
    bsw internal behavior ComBehavior
      exclusive area COM_EXCLUSIVE_AREA_TX  # This critical section protects Tx ressources that can be accessed from various contexts. Therefore the critical section enclosed with COM_EXCLUSIVE_AREA_TX should never be interrupted by any Com API which accesses Tx ressources. For more details, see DocTechRef.
      exclusive area COM_EXCLUSIVE_AREA_RX  # This critical section protects Rx ressources that can be accessed from various contexts.Therefore the critical section enclosed with COM_EXCLUSIVE_AREA_RX should never be interrupted by any Com API which accesses Rx ressources. For more details, see DocTechRef.
      exclusive area COM_EXCLUSIVE_AREA_BOTH  # This critical section protects Rx and Tx ressources that are being accessed in context of Com_MainFunctionRouteSignals for signal gateway routings or description routings with configured deferred description source. For more details, see DocTechRef.
      7 x bsw schedulable entity:
        Com_MainFunctionRx_ComMainFunctionRx: implemented-entry=Com_MainFunctionRx_ComMainFunctionRx
        Com_MainFunctionTx_ComMainFunctionTx: implemented-entry=Com_MainFunctionTx_ComMainFunctionTx
        Com_MainFunctionTx_ComMainFunctionTx_10ms: implemented-entry=Com_MainFunctionTx_ComMainFunctionTx_10ms
        Com_MainFunctionTx_ComMainFunctionTx_20ms: implemented-entry=Com_MainFunctionTx_ComMainFunctionTx_20ms
        Com_MainFunctionTx_ComMainFunctionTx_50ms: implemented-entry=Com_MainFunctionTx_ComMainFunctionTx_50ms
        Com_MainFunctionTx_ComMainFunctionTx_100ms: implemented-entry=Com_MainFunctionTx_ComMainFunctionTx_100ms
        Com_MainFunctionTx_ComMainFunctionTx_200ms: implemented-entry=Com_MainFunctionTx_ComMainFunctionTx_200ms
      7 x bsw timing event, all with period=0.01:
        Com_MainFunctionRx_ComMainFunctionRxTimingEvent0: starts-on-event=Com_MainFunctionRx_ComMainFunctionRx
        Com_MainFunctionTx_ComMainFunctionTxTimingEvent0: starts-on-event=Com_MainFunctionTx_ComMainFunctionTx
        Com_MainFunctionTx_ComMainFunctionTx_10msTimingEvent0: starts-on-event=Com_MainFunctionTx_ComMainFunctionTx_10ms
        Com_MainFunctionTx_ComMainFunctionTx_20msTimingEvent0: starts-on-event=Com_MainFunctionTx_ComMainFunctionTx_20ms
        Com_MainFunctionTx_ComMainFunctionTx_50msTimingEvent0: starts-on-event=Com_MainFunctionTx_ComMainFunctionTx_50ms
        Com_MainFunctionTx_ComMainFunctionTx_100msTimingEvent0: starts-on-event=Com_MainFunctionTx_ComMainFunctionTx_100ms
        Com_MainFunctionTx_ComMainFunctionTx_200msTimingEvent0: starts-on-event=Com_MainFunctionTx_ComMainFunctionTx_200ms
  7 x bsw module entry, all with call-type=SCHEDULED, execution-context=TASK:
    Com_MainFunctionRx_ComMainFunctionRx
    Com_MainFunctionTx_ComMainFunctionTx
    Com_MainFunctionTx_ComMainFunctionTx_10ms
    Com_MainFunctionTx_ComMainFunctionTx_20ms
    Com_MainFunctionTx_ComMainFunctionTx_50ms
    Com_MainFunctionTx_ComMainFunctionTx_100ms
    Com_MainFunctionTx_ComMainFunctionTx_200ms
package /MICROSAR/EcuM_ib_bswmd/BswModuleDescriptions
  bsw module description EcuM
    bsw internal behavior EcuMBehavior
      4 x exclusive area:
        ECUM_EXCLUSIVE_AREA_0  # This exclusive area shall disable all wake up interrupts to prevent overwriting of some global variables.
        ECUM_EXCLUSIVE_AREA_1  # This exclusive area is only used in case of multi core and if the the EcuM is configured to handle also the slave cores. It must be configured as a spinlock to allow access to some variables simultaneously from multiple cores.
        ECUM_EXCLUSIVE_AREA_2  # This exclusive area is used for accessing the clock variable. It shall disable GPT interrupts and task changes. Only necessary if 32 Bit access is not atomic and Alarm Clock is present.
        ECUM_EXCLUSIVE_AREA_3  # This This exclusive area must be configured as a spin lock to protect access on global shutdown target variables.
      bsw schedulable entity EcuM_MainFunction: implemented-entry=EcuM_MainFunction
      bsw timing event EcuM_MainFunctionTimingEvent{0..2}: starts-on-event=EcuM_MainFunction, period=0.01
  bsw module entry EcuM_MainFunction: call-type=SCHEDULED, execution-context=TASK
package /MICROSAR/LinIf_ib_bswmd/BswModuleDescriptions
  bsw module description LinIf
    bsw internal behavior LinIfBehavior
      exclusive area LINIF_EXCLUSIVE_AREA_0  # Exclusive area for LinIf channel main function
      exclusive area LINIF_EXCLUSIVE_AREA_1  # Exclusive area for asynchronous API functions
      exclusive area LINIF_EXCLUSIVE_AREA_2  # Exclusive area for callback functions from LIN driver in interrupt context
      bsw schedulable entity LinIf_MainFunction: implemented-entry=LinIf_MainFunction
      bsw timing event LinIf_MainFunctionTimingEvent0: starts-on-event=LinIf_MainFunction, period=0.005
  bsw module entry LinIf_MainFunction: call-type=SCHEDULED, execution-context=TASK
package /MICROSAR/LinSM_ib_bswmd/BswModuleDescriptions
  bsw module description LinSM
    bsw internal behavior LinSMBehavior
      5 x exclusive area:
        LINSM_EXCLUSIVE_AREA_0  # Must lock task interrupts, if LinIf_MainFunction(), LinSM_MainFunction() or BswM action BswMLinScheduleSwitch priority level is higher than the level of ComM_MainFunction().
        LINSM_EXCLUSIVE_AREA_1  # Must lock task interrupts, if ComM_MainFunction(), LinSM_MainFunction() or BswM action BswMLinScheduleSwitch priority level is higher than the level of LinIf_MainFunction().
        LINSM_EXCLUSIVE_AREA_2  # Must lock task interrupts, if ComM_MainFunction(), LinIf_MainFunction() or BswM action BswMLinScheduleSwitch priority level is higher than the level of LinSM_MainFunction().
        LINSM_EXCLUSIVE_AREA_3  # Must lock task interrupts, if ComM_MainFunction(), LinIf_MainFunction() or LinSM_MainFunction() interrupt priority level is higher than the level of the BswM action BswMLinScheduleSwitch.
        LINSM_EXCLUSIVE_AREA_4  # Must lock task interrupts if the function LinSM_GotoSleepIndication() may be interrupted by any of the functions LinSM_MainFunction(), LinSM_RequestComMode(), LinSM_WakeupConfirmation() or LinSM_GotoSleepConfirmation().
      bsw schedulable entity LinSM_MainFunction: implemented-entry=LinSM_MainFunction
      bsw timing event LinSM_MainFunctionTimingEvent0: starts-on-event=LinSM_MainFunction, period=0.01
  bsw module entry LinSM_MainFunction: call-type=SCHEDULED, execution-context=TASK
package /MICROSAR/Nm_ib_bswmd/BswModuleDescriptions
  bsw module description Nm
    bsw internal behavior NmBehavior
      4 x exclusive area:
        NM_EXCLUSIVE_AREA_0  # No interruption by any interrupt allowed
        NM_EXCLUSIVE_AREA_1  # Interrupt locks are required if any of these functions are executed in an interrupt context: Nm_NetworkMode, Nm_PrepareBusSleepMode, Nm_BusSleepMode, Nm_RemoteSleepIndication, Nm_RemoteSleepCancellation, Nm_CoordReadyToSleepIndication, Nm_CoordReadyToSleepCancellation
        NM_EXCLUSIVE_AREA_2  # This exclusive area is only used in case of multi-partition. No interruption allowed by Nm_NetworkRequest, Nm_PassiveStartup, Nm_NetworkMode, Nm_RemoteSleepCancellation, Nm_CoordReadyToSleepCancellation
        NM_EXCLUSIVE_AREA_3  # This exclusive area is only used in case of multi-partition. It must be configured as a spinlock to allow access to some variables simultaneously from multiple partitions.
package /MICROSAR/NvM_ib_bswmd/BswModuleDescriptions
  bsw module description NvM
    bsw internal behavior NvMBehavior
      exclusive area NVM_EXCLUSIVE_AREA_0
      bsw schedulable entity NvM_MainFunction: implemented-entry=NvM_MainFunction
      bsw timing event NvM_MainFunctionTimingEvent0: starts-on-event=NvM_MainFunction, period=0.01
  bsw module entry NvM_MainFunction: call-type=SCHEDULED, execution-context=TASK
