/**********************************************************************************************************************
* COPYRIGHT
* \verbatim
* This software is copyright protected and proprietary to Vector Informatik GmbH.
* Vector Informatik GmbH grants to you only those rights as set out in the license conditions.
* All other rights remain with Vector Informatik GmbH.
* \endverbatim
* LICENSE
* Module: Xcp
* Program: MSR_Vector_SLP4
* Customer: Zeekr Automobile (Ningbo Hangzhou Bay New Zoon) Co., Ltd
* Expiry Date: Not restricted
* Ordered Derivat.: TC397_StepB
* License Scope : The usage is restricted to CBD2101138_D00
* FILE DESCRIPTION
* File: CanXcp_CT_TC37X_VCU_CAN00_22cb8fec_1542.a2l
* Generation Time: 2024-10-10 15:21:33
* Project: TC37X_VCU - Version 1.0
* Delivery: CBD2101138_D00
* Tool Version: DaVinci Configurator 5.24.40 SP2
*********************************************************************************************************************/
/begin XCP_ON_CAN 0x0102 /* XCP on CAN version */ CAN_ID_MASTER 1542 /* CMD/STIM */ CAN_ID_SLAVE 1073743367 /* RES/ERR/EV/SERV/DAQ */ BAUDRATE 500000 /* BAUDRATE */ SAMPLE_POINT 75 /* SAMPLE_POINT */ SAMPLE_RATE SINGLE /* SAMPLE_RATE */ BTL_CYCLES 80 /* BTL_CYCLES */ SJW 1 /* length synchr. segment */
 /begin CAN_FD MAX_DLC 8 /* DLC of CAN frame */ CAN_FD_DATA_TRANSFER_BAUDRATE 2000000 /* Baudrate [Hz] */ SAMPLE_POINT 75 /* Sample Point Receiver */ BTL_CYCLES 20 /* BTL_CYCLES */ SJW 5 /* length synchr. segment */ SECONDARY_SAMPLE_POINT 0 /* Sender Sample Point */ TRANSCEIVER_DELAY_COMPENSATION OFF /end CAN_FD
 /begin PROTOCOL_LAYER 0x0104 2000 10000 2000 2000 2000 2000 0 8 /* kXcpMaxCto */ 8 /* kXcpMaxDto */ BYTE_ORDER_MSB_LAST /* Byte Order */ ADDRESS_GRANULARITY_BYTE OPTIONAL_CMD SET_MTA OPTIONAL_CMD UPLOAD OPTIONAL_CMD SHORT_UPLOAD OPTIONAL_CMD DOWNLOAD OPTIONAL_CMD DOWNLOAD_MAX OPTIONAL_CMD SET_CAL_PAGE OPTIONAL_CMD GET_CAL_PAGE OPTIONAL_CMD SET_DAQ_PTR OPTIONAL_CMD WRITE_DAQ OPTIONAL_CMD SET_DAQ_LIST_MODE OPTIONAL_CMD GET_DAQ_LIST_MODE OPTIONAL_CMD START_STOP_DAQ_LIST OPTIONAL_CMD START_STOP_SYNCH OPTIONAL_CMD GET_DAQ_PROCESSOR_INFO OPTIONAL_CMD GET_DAQ_RESOLUTION_INFO OPTIONAL_CMD GET_DAQ_EVENT_INFO OPTIONAL_CMD FREE_DAQ OPTIONAL_CMD ALLOC_DAQ OPTIONAL_CMD ALLOC_ODT OPTIONAL_CMD ALLOC_ODT_ENTRY /end PROTOCOL_LAYER
/end XCP_ON_CAN
