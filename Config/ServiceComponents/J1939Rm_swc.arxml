AUTOSAR XML (schema 00048)
package /MICROSAR/J1939Rm_swc/DataTypes
  4 x impl type:
    NetworkHandleType: range raw 0..255, implementation-data-type=uint8, type-emitter=J1939Rm
    J1939Rm_AckCode: compu {0=J1939RM_ACK_POSITIVE, 1=J1939RM_ACK_NEGATIVE, 2=J1939RM_ACK_ACCESS_DENIED, 3=J1939RM_ACK_CANNOT_RESPOND}, range raw 0..3, implementation-data-type=uint8  # This type represents the available kinds of acknowledgements.
    J1939Rm_ExtIdType: compu {0=J1939RM_EXTID_NONE, 1=J1939RM_EXTID_ONE, 2=J1939RM_EXTID_TWO, 3=J1939RM_EXTID_THREE, 4=J1939RM_EXTID_GF}, range raw 0..4, implementation-data-type=uint8  # This type represents the available kinds of extended identifier usage.
    J1939Rm_ExtIdInfoType: category=STRUCTURE  # This type represents a set of extended identifiers.
      4 x element, all with category=TYPE_REFERENCE:
        ExtIdType: implementation-data-type=J1939Rm_ExtIdType
        ExtId{1..3}: implementation-data-type=uint8
package /MICROSAR/J1939Rm_swc/ComponentTypes
  service sw component type J1939Rm: category=SERVICE_COMPONENT
    behavior J1939RmInternalBehavior: handle-termination-and-restart=NO-SUPPORT, included-data-type-set=data-type=[J1939Rm_AckCode, J1939Rm_ExtIdType, J1939Rm_ExtIdInfoType]
      timing event Timer_J1939Rm_MainFunction: start-on-event=J1939Rm_MainFunction, period=0.01
      runnable J1939Rm_MainFunction
  swc implementation J1939RmImplementation: programming-language=C, behavior=J1939RmInternalBehavior
    resource consumption J1939RmResourceConsumption
      5 x memory section:
        J1939Rm_START_SEC_CODE: sw-addrmethod=CODE, symbol=CODE
        J1939Rm_START_SEC_CONST_UNSPECIFIED: alignment=UNSPECIFIED, sw-addrmethod=CONST, symbol=CONST_UNSPECIFIED
        J1939Rm_START_SEC_VAR_NOINIT_UNSPECIFIED: alignment=UNSPECIFIED, sw-addrmethod=VAR_NO_INIT, symbol=VAR_NOINIT_UNSPECIFIED
        J1939Rm_START_SEC_VAR_INIT_UNSPECIFIED: alignment=UNSPECIFIED, sw-addrmethod=VAR_INIT, symbol=VAR_INIT_UNSPECIFIED
        J1939Rm_START_SEC_VAR_ZERO_INIT_UNSPECIFIED: alignment=UNSPECIFIED, sw-addrmethod=VAR_CLEARED, symbol=VAR_ZERO_INIT_UNSPECIFIED
