[part 1 of 2: packages /MICROSAR/Dcm_swc to /MICROSAR/Dcm_swc/Interfaces]
AUTOSAR XML (schema 00048)
package /MICROSAR/Dcm_swc
  4 x mode declaration group, all with category=EXPLICIT_ORDER:
    DcmControlDtcSetting: initial-mode=ENABLEDTCSETTING, on-transition-value=2
      mode ENABLEDTCSETTING: value=0
      mode DISABLEDTCSETTING: value=1
    DcmCommunicationControl: initial-mode=DCM_ENABLE_RX_TX_NORM, on-transition-value=12
      12 x mode:
        DCM_ENABLE_RX_TX_NORM: value=0
        DCM_ENABLE_RX_DISABLE_TX_NORM: value=1
        DCM_DISABLE_RX_ENABLE_TX_NORM: value=2
        DCM_DISABLE_RX_TX_NORMAL: value=3
        DCM_ENABLE_RX_TX_NM: value=4
        DCM_ENABLE_RX_DISABLE_TX_NM: value=5
        DCM_DISABLE_RX_ENABLE_TX_NM: value=6
        DCM_DISABLE_RX_TX_NM: value=7
        DCM_ENABLE_RX_TX_NORM_NM: value=8
        DCM_ENABLE_RX_DISABLE_TX_NORM_NM: value=9
        DCM_DISABLE_RX_ENABLE_TX_NORM_NM: value=10
        DCM_DISABLE_RX_TX_NORM_NM: value=11
    DcmEcuReset: initial-mode=NONE, on-transition-value=7
      7 x mode:
        NONE: value=0
        HARD: value=1
        KEYONOFF: value=2
        SOFT: value=3
        JUMPTOBOOTLOADER: value=4
        JUMPTOSYSSUPPLIERBOOTLOADER: value=5
        EXECUTE: value=6
    DcmDiagnosticSessionControl: initial-mode=DEFAULT_SESSION, on-transition-value=255
      4 x mode:
        DEFAULT_SESSION: value=1
        PROGRAMMING_SESSION: value=2
        EXTENDED_SESSION: value=3
        Coding_Session: value=65
  data type mapping set DcmMappingSet  # Contains mapping for ModeDeclarationGroups which are provided by Dcm.
    mode-request-type-maps:
      implementation-data-type=Dcm_ControlDtcSettingType, mode-group=DcmControlDtcSetting
      implementation-data-type=Dcm_EcuResetType, mode-group=DcmEcuReset
      implementation-data-type=Dcm_DiagnosticSessionControlType, mode-group=DcmDiagnosticSessionControl
      implementation-data-type=Dcm_CommunicationModeType, mode-group=DcmCommunicationControl
package /MICROSAR/Dcm_swc/DataTypes
  43 x impl type:
    Dcm_ConfirmationStatusType: compu {0=DCM_RES_POS_OK, 1=DCM_RES_POS_NOT_OK, 2=DCM_RES_NEG_OK, 3=DCM_RES_NEG_NOT_OK}, range raw 0..3, implementation-data-type=uint8
    Dcm_OpStatusType: compu {0=DCM_INITIAL, 1=DCM_PENDING, 2=DCM_CANCEL, 3=DCM_FORCE_RCRRP_OK, 64=DCM_FORCE_RCRRP_NOT_OK}, range raw 0..64, implementation-data-type=uint8
    Dcm_NegativeResponseCodeType:
      compu {0=DCM_E_POSITIVERESPONSE, 16=DCM_E_GENERALREJECT, 17=DCM_E_SERVICENOTSUPPORTED, 18=DCM_E_SUBFUNCTIONNOTSUPPORTED, 19=DCM_E_INCORRECTMESSAGELENGTHORINVALIDFORMAT, 20=DCM_E_RESPONSETOOLONG, 33=DCM_E_BUSYREPEATREQUEST, 34=DCM_E_CONDITIONSNOTCORRECT, 36=DCM_E_REQUESTSEQUENCEERROR, 37=DCM_E_NORESPONSEFROMSUBNETCOMPONENT, 38=DCM_E_FAILUREPREVENTSEXECUTIONOFREQUESTEDACTION, 49=DCM_E_REQUESTOUTOFRANGE, 51=DCM_E_SECURITYACCESSDENIED, 52=DCM_E_AUTHENTICATIONREQUIRED, 53=DCM_E_INVALIDKEY, 54=DCM_E_EXCEEDNUMBEROFATTEMPTS, 55=DCM_E_REQUIREDTIMEDELAYNOTEXPIRED, 80=DCM_E_CVF_INVALIDTIMEPERIOD, 81=DCM_E_CVF_INVALIDSIGNATURE, 82=DCM_E_CVF_INVALIDCHAINOFTRUST, 83=DCM_E_CVF_INVALIDTYPE, 84=DCM_E_CVF_INVALIDFORMAT, 85=DCM_E_CVF_INVALIDCONTENT, 86=DCM_E_CVF_INVALIDSCOPE, 87=DCM_E_CVF_INVALIDCERTIFICATEREVOKED, 88=DCM_E_OWNERSHIPVERIFICATIONFAILED, 89=DCM_E_CHALLENGECALCULATIONFAILED, 112=DCM_E_UPLOADDOWNLOADNOTACCEPTED, 113=DCM_E_TRANSFERDATASUSPENDED, 114=DCM_E_GENERALPROGRAMMINGFAILURE, 115=DCM_E_WRONGBLOCKSEQUENCECOUNTER, 120=DCM_E_REQUESTCORRECTLYRECEIVEDRESPONSEPENDING, 126=DCM_E_SUBFUNCTIONNOTSUPPORTEDINACTIVESESSION, 127=DCM_E_SERVICENOTSUPPORTEDINACTIVESESSION, 129=DCM_E_RPMTOOHIGH, 130=DCM_E_RPMTOOLOW, 131=DCM_E_ENGINEISRUNNING, 132=DCM_E_ENGINEISNOTRUNNING, 133=DCM_E_ENGINERUNTIMETOOLOW, 134=DCM_E_TEMPERATURETOOHIGH, 135=DCM_E_TEMPERATURETOOLOW, 136=DCM_E_VEHICLESPEEDTOOHIGH, 137=DCM_E_VEHICLESPEEDTOOLOW, 138=DCM_E_THROTTLE_PEDALTOOHIGH, 139=DCM_E_THROTTLE_PEDALTOOLOW, 140=DCM_E_TRANSMISSIONRANGENOTINNEUTRAL, 141=DCM_E_TRANSMISSIONRANGENOTINGEAR, 143=DCM_E_BRAKESWITCH_NOTCLOSED, 144=DCM_E_SHIFTERLEVERNOTINPARK, 145=DCM_E_TORQUECONVERTERCLUTCHLOCKED, 146=DCM_E_VOLTAGETOOHIGH, 147=DCM_E_VOLTAGETOOLOW, 240..249=DCM_E_VMSCNC_0..DCM_E_VMSCNC_9, 250=DCM_E_VMSCNC_A, 251=DCM_E_VMSCNC_B, 252=DCM_E_VMSCNC_C, 253=DCM_E_VMSCNC_D, 254=DCM_E_VMSCNC_E}
      range raw 0..255
      implementation-data-type=uint8
    Dcm_ProtocolType: compu {0=DCM_OBD_ON_CAN, 1=DCM_OBD_ON_FLEXRAY, 2=DCM_OBD_ON_IP, 3=DCM_UDS_ON_CAN, 4=DCM_UDS_ON_FLEXRAY, 5=DCM_UDS_ON_IP, 12=DCM_NO_ACTIVE_PROTOCOL, 240..254=DCM_SUPPLIER_1..DCM_SUPPLIER_15}, range raw 0..254, implementation-data-type=uint8
    Dcm_RequestKindType: compu {0=DCM_REQ_KIND_NONE, 1=DCM_REQ_KIND_EXTERNAL, 2=DCM_REQ_KIND_ROE}, range raw 0..2, implementation-data-type=uint8
    Dcm_ControlDtcSettingType: compu {0=DCM_ENUM_ENABLEDTCSETTING, 1=DCM_ENUM_DISABLEDTCSETTING}, range raw 0..255, implementation-data-type=uint8
    Dcm_CommunicationModeType:
      compu {0=DCM_ENABLE_RX_TX_NORM, 1=DCM_ENABLE_RX_DISABLE_TX_NORM, 2=DCM_DISABLE_RX_ENABLE_TX_NORM, 3=DCM_DISABLE_RX_TX_NORMAL, 4=DCM_ENABLE_RX_TX_NM, 5=DCM_ENABLE_RX_DISABLE_TX_NM, 6=DCM_DISABLE_RX_ENABLE_TX_NM, 7=DCM_DISABLE_RX_TX_NM, 8=DCM_ENABLE_RX_TX_NORM_NM, 9=DCM_ENABLE_RX_DISABLE_TX_NORM_NM, 10=DCM_DISABLE_RX_ENABLE_TX_NORM_NM, 11=DCM_DISABLE_RX_TX_NORM_NM}
      range raw 0..255
      implementation-data-type=uint8
    Dcm_Data2ByteType: category=ARRAY, sw-calibration-access=READ-ONLY
      element Dcm_Data2ByteTypeElement: array-size=2, array-size-semantics=FIXED-SIZE, implementation-data-type=uint8
    Dcm_Data1ByteType: category=ARRAY, sw-calibration-access=READ-ONLY
      element Dcm_Data1ByteTypeElement: array-size=1, array-size-semantics=FIXED-SIZE, implementation-data-type=uint8
    Dcm_EcuResetType: compu {0=DCM_ENUM_NONE, 1=DCM_ENUM_HARD, 2=DCM_ENUM_KEYONOFF, 3=DCM_ENUM_SOFT, 4=DCM_ENUM_JUMPTOBOOTLOADER, 5=DCM_ENUM_JUMPTOSYSSUPPLIERBOOTLOADER, 6=DCM_ENUM_EXECUTE}, range raw 0..255, implementation-data-type=uint8
    Dcm_SecLevelType: compu {0=DCM_SEC_LEV_LOCKED, 1..4=DCM_SEC_LEV_L1..DCM_SEC_LEV_L4}, range raw 0..4, implementation-data-type=uint8
    Dcm_SesCtrlType: compu {1=DCM_DEFAULT_SESSION, 2=DCM_PROGRAMMING_SESSION, 3=DCM_EXTENDED_DIAGNOSTIC_SESSION, 65=DCM_Coding_Session}, range raw 0..65, implementation-data-type=uint8
    Dcm_DiagnosticSessionControlType: compu {1=DCM_ENUM_DEFAULT_SESSION, 2=DCM_ENUM_PROGRAMMING_SESSION, 3=DCM_ENUM_EXTENDED_SESSION, 65=DCM_ENUM_Coding_Session}, range raw 0..255, implementation-data-type=uint8
    Dcm_Data16ByteType: category=ARRAY, sw-calibration-access=READ-ONLY
      element Dcm_Data16ByteTypeElement: array-size=16, array-size-semantics=FIXED-SIZE, implementation-data-type=uint8
    Dcm_StartDataOut_CheckCodingState_Out_routineResultPrimitiveType: implementation-data-type=uint8
    Dcm_StartDataOut_CheckCodingState_Out_routineResultType: implementation-data-type=Dcm_StartDataOut_CheckCodingState_Out_routineResultPrimitiveType
    Dcm_StartDataIn_Check_Memory_In_checksumPrimitiveType: implementation-data-type=uint32
    Dcm_StartDataIn_Check_Memory_In_checksumType: implementation-data-type=Dcm_StartDataIn_Check_Memory_In_checksumPrimitiveType
    Dcm_StartDataOut_Check_Memory_Out_routineResultPrimitiveType: implementation-data-type=uint8
    Dcm_StartDataOut_Check_Memory_Out_routineResultType: implementation-data-type=Dcm_StartDataOut_Check_Memory_Out_routineResultPrimitiveType
    Dcm_StartDataOut_CheckProgrammingPreCondition_Out_programmingPreConditionListArrayType: implementation-data-type=uint8
    Dcm_StartDataOut_CheckProgrammingPreCondition_Out_programmingPreConditionListType: category=ARRAY, sw-calibration-access=READ-ONLY
      element Dcm_StartDataOut_CheckProgrammingPreCondition_Out_programmingPreConditionListTypeElement: array-size=1, array-size-semantics=FIXED-SIZE, implementation-data-type=Dcm_StartDataOut_CheckProgrammingPreCondition_Out_programmingPreConditionListArrayType
    Dcm_StartDataOut_Erase_Mileage_Provisional_Parameter_Out_routineResultPrimitiveType: implementation-data-type=uint8
    Dcm_StartDataOut_Erase_Mileage_Provisional_Parameter_Out_routineResultType: implementation-data-type=Dcm_StartDataOut_Erase_Mileage_Provisional_Parameter_Out_routineResultPrimitiveType
    Dcm_StartDataOut_Turn_Off_HV_Turn_Off_Charging_Out_routineResultPrimitiveType: implementation-data-type=uint8
    Dcm_StartDataOut_Turn_Off_HV_Turn_Off_Charging_Out_routineResultType: implementation-data-type=Dcm_StartDataOut_Turn_Off_HV_Turn_Off_Charging_Out_routineResultPrimitiveType
    Dcm_StopDataOut_Turn_Off_HV_Turn_Off_Charging_Out_routineResultPrimitiveType: implementation-data-type=uint8
    Dcm_StopDataOut_Turn_Off_HV_Turn_Off_Charging_Out_routineResultType: implementation-data-type=Dcm_StopDataOut_Turn_Off_HV_Turn_Off_Charging_Out_routineResultPrimitiveType
    Dcm_StartDataIn_Erase_Memory_In_addressAndLengthFormatIdentifierPrimitiveType: implementation-data-type=uint8
    Dcm_StartDataIn_Erase_Memory_In_addressAndLengthFormatIdentifierType: implementation-data-type=Dcm_StartDataIn_Erase_Memory_In_addressAndLengthFormatIdentifierPrimitiveType
    Dcm_StartDataIn_Erase_Memory_In_memoryAddressPrimitiveType: implementation-data-type=uint32
    Dcm_StartDataIn_Erase_Memory_In_memoryAddressType: implementation-data-type=Dcm_StartDataIn_Erase_Memory_In_memoryAddressPrimitiveType
    Dcm_StartDataIn_Erase_Memory_In_memorySizePrimitiveType: implementation-data-type=uint32
    Dcm_StartDataIn_Erase_Memory_In_memorySizeType: implementation-data-type=Dcm_StartDataIn_Erase_Memory_In_memorySizePrimitiveType
    Dcm_StartDataOut_Erase_Memory_Out_routineResultPrimitiveType: implementation-data-type=uint8
    Dcm_StartDataOut_Erase_Memory_Out_routineResultType: implementation-data-type=Dcm_StartDataOut_Erase_Memory_Out_routineResultPrimitiveType
    Dcm_StartDataOut_CheckProgrammingDependencies_Out_routineResultPrimitiveType: implementation-data-type=uint8
    Dcm_StartDataOut_CheckProgrammingDependencies_Out_routineResultType: implementation-data-type=Dcm_StartDataOut_CheckProgrammingDependencies_Out_routineResultPrimitiveType
    Dcm_Data3ByteType: category=ARRAY, sw-calibration-access=READ-ONLY
      element Dcm_Data3ByteTypeElement: array-size=3, array-size-semantics=FIXED-SIZE, implementation-data-type=uint8
    Dcm_Data6ByteType: category=ARRAY, sw-calibration-access=READ-ONLY
      element Dcm_Data6ByteTypeElement: array-size=6, array-size-semantics=FIXED-SIZE, implementation-data-type=uint8
    Dcm_Data5ByteType: category=ARRAY, sw-calibration-access=READ-ONLY
      element Dcm_Data5ByteTypeElement: array-size=5, array-size-semantics=FIXED-SIZE, implementation-data-type=uint8
    Dcm_Data27ByteType: category=ARRAY, sw-calibration-access=READ-ONLY
      element Dcm_Data27ByteTypeElement: array-size=27, array-size-semantics=FIXED-SIZE, implementation-data-type=uint8
    Dcm_Data9ByteType: category=ARRAY, sw-calibration-access=READ-ONLY
      element Dcm_Data9ByteTypeElement: array-size=9, array-size-semantics=FIXED-SIZE, implementation-data-type=uint8
package /MICROSAR/Dcm_swc/Interfaces
  mode switch interface DcmControlDtcSetting: is-service=true, service-kind=DIAGNOSTIC-COMMUNICATION-MANAGER
    mode group DcmControlDtcSetting: type=DcmControlDtcSetting
  mode switch interface DcmDiagnosticSessionControl: is-service=true, service-kind=DIAGNOSTIC-COMMUNICATION-MANAGER
    mode group DcmDiagnosticSessionControl: type=DcmDiagnosticSessionControl
  mode switch interface DcmCommunicationControl_ComMConf_ComMChannel_CN_TC37X_VCU_CAN00_07b6c9c8: is-service=true, service-kind=DIAGNOSTIC-COMMUNICATION-MANAGER
    mode group DcmCommunicationControl_ComMConf_ComMChannel_CN_TC37X_VCU_CAN00_07b6c9c8: type=DcmCommunicationControl
  client server interface DCMServices: is-service=true, service-kind=DIAGNOSTIC-COMMUNICATION-MANAGER
    6 x operation:
      GetActiveProtocol: possible-error=E_OK
        arg ActiveProtocol: type=Dcm_ProtocolType, direction=OUT
      GetSesCtrlType: possible-error=E_OK
        arg SesCtrlType: type=Dcm_SesCtrlType, direction=OUT
      ResetToDefaultSession: possible-error=E_OK
      GetSecurityLevel: possible-error=E_OK
        arg SecLevel: type=Dcm_SecLevelType, direction=OUT
      SetActiveDiagnostic: possible-error=E_OK
        arg active: type=boolean, direction=IN
      GetRequestKind: possible-error=DCMServices/E_NOT_OK
        arg TesterSourceAddress: type=uint16, direction=IN
        arg RequestKind: type=Dcm_RequestKindType, direction=OUT
    error E_OK: error-code=0
    error E_NOT_OK: error-code=1
  client server interface SecurityAccess_UnlockedL1: is-service=true, service-kind=DIAGNOSTIC-COMMUNICATION-MANAGER
    operation GetSeed: possible-error=[SecurityAccess_UnlockedL1/E_NOT_OK, SecurityAccess_UnlockedL1/DCM_E_PENDING]
      arg OpStatus: type=Dcm_OpStatusType, direction=IN
      arg Seed: type=Dcm_Data16ByteType, direction=OUT
      arg ErrorCode: type=Dcm_NegativeResponseCodeType, direction=OUT
    operation CompareKey: possible-error=[SecurityAccess_UnlockedL1/E_NOT_OK, SecurityAccess_UnlockedL1/DCM_E_PENDING, SecurityAccess_UnlockedL1/DCM_E_COMPARE_KEY_FAILED]
      arg Key: type=Dcm_Data16ByteType, direction=IN
      arg OpStatus: type=Dcm_OpStatusType, direction=IN
      arg ErrorCode: type=Dcm_NegativeResponseCodeType, direction=OUT
    error E_NOT_OK: error-code=1
    error DCM_E_PENDING: error-code=10
    error DCM_E_COMPARE_KEY_FAILED: error-code=11
  mode switch interface DcmEcuReset: is-service=true, service-kind=DIAGNOSTIC-COMMUNICATION-MANAGER
    mode group DcmEcuReset: type=DcmEcuReset
  mode switch interface DcmCommunicationControl_ComMConf_ComMChannel_CN_ATOM_CAN_Matrix_PT_V600_20250211_9b894f3d: is-service=true, service-kind=DIAGNOSTIC-COMMUNICATION-MANAGER
    mode group DcmCommunicationControl_ComMConf_ComMChannel_CN_ATOM_CAN_Matrix_PT_V600_20250211_9b894f3d: type=DcmCommunicationControl
  181 x client server interface, all with is-service=true, service-kind=DIAGNOSTIC-COMMUNICATION-MANAGER:
    SecurityAccess_Unlocked_Level_2
      operation GetSeed: possible-error=[SecurityAccess_Unlocked_Level_2/E_NOT_OK, SecurityAccess_Unlocked_Level_2/DCM_E_PENDING]
        arg OpStatus: type=Dcm_OpStatusType, direction=IN
        arg Seed: type=Dcm_Data16ByteType, direction=OUT
        arg ErrorCode: type=Dcm_NegativeResponseCodeType, direction=OUT
      operation CompareKey: possible-error=[SecurityAccess_Unlocked_Level_2/E_NOT_OK, SecurityAccess_Unlocked_Level_2/DCM_E_PENDING, SecurityAccess_Unlocked_Level_2/DCM_E_COMPARE_KEY_FAILED]
        arg Key: type=Dcm_Data16ByteType, direction=IN
        arg OpStatus: type=Dcm_OpStatusType, direction=IN
        arg ErrorCode: type=Dcm_NegativeResponseCodeType, direction=OUT
      error E_NOT_OK: error-code=1
      error DCM_E_PENDING: error-code=10
      error DCM_E_COMPARE_KEY_FAILED: error-code=11
    SecurityAccess_Unlocked_Level_3
      operation GetSeed: possible-error=[SecurityAccess_Unlocked_Level_3/E_NOT_OK, SecurityAccess_Unlocked_Level_3/DCM_E_PENDING]
        arg OpStatus: type=Dcm_OpStatusType, direction=IN
        arg Seed: type=Dcm_Data16ByteType, direction=OUT
        arg ErrorCode: type=Dcm_NegativeResponseCodeType, direction=OUT
      operation CompareKey: possible-error=[SecurityAccess_Unlocked_Level_3/E_NOT_OK, SecurityAccess_Unlocked_Level_3/DCM_E_PENDING, SecurityAccess_Unlocked_Level_3/DCM_E_COMPARE_KEY_FAILED]
        arg Key: type=Dcm_Data16ByteType, direction=IN
        arg OpStatus: type=Dcm_OpStatusType, direction=IN
        arg ErrorCode: type=Dcm_NegativeResponseCodeType, direction=OUT
      error E_NOT_OK: error-code=1
      error DCM_E_PENDING: error-code=10
      error DCM_E_COMPARE_KEY_FAILED: error-code=11
    SecurityAccess_Unlocked_Level_4
      operation GetSeed: possible-error=[SecurityAccess_Unlocked_Level_4/E_NOT_OK, SecurityAccess_Unlocked_Level_4/DCM_E_PENDING]
        arg OpStatus: type=Dcm_OpStatusType, direction=IN
        arg Seed: type=Dcm_Data16ByteType, direction=OUT
        arg ErrorCode: type=Dcm_NegativeResponseCodeType, direction=OUT
      operation CompareKey: possible-error=[SecurityAccess_Unlocked_Level_4/E_NOT_OK, SecurityAccess_Unlocked_Level_4/DCM_E_PENDING, SecurityAccess_Unlocked_Level_4/DCM_E_COMPARE_KEY_FAILED]
        arg Key: type=Dcm_Data16ByteType, direction=IN
        arg OpStatus: type=Dcm_OpStatusType, direction=IN
        arg ErrorCode: type=Dcm_NegativeResponseCodeType, direction=OUT
      error E_NOT_OK: error-code=1
      error DCM_E_PENDING: error-code=10
      error DCM_E_COMPARE_KEY_FAILED: error-code=11
    RoutineServices_CheckCodingState
      operation Start: possible-error=[RoutineServices_CheckCodingState/E_NOT_OK, RoutineServices_CheckCodingState/DCM_E_PENDING, RoutineServices_CheckCodingState/DCM_E_FORCE_RCRRP]
        arg OpStatus: type=Dcm_OpStatusType, direction=IN
        arg Out_routineResult: type=Dcm_StartDataOut_CheckCodingState_Out_routineResultType, direction=OUT
        arg ErrorCode: type=Dcm_NegativeResponseCodeType, direction=OUT
      error E_NOT_OK: error-code=1
      error DCM_E_PENDING: error-code=10
      error DCM_E_FORCE_RCRRP: error-code=12
    RoutineServices_Check_Memory
      operation Start: possible-error=[RoutineServices_Check_Memory/E_NOT_OK, RoutineServices_Check_Memory/DCM_E_PENDING, RoutineServices_Check_Memory/DCM_E_FORCE_RCRRP]
        4 x arg:
          In_checksum: type=Dcm_StartDataIn_Check_Memory_In_checksumType, direction=IN
          OpStatus: type=Dcm_OpStatusType, direction=IN
          Out_routineResult: type=Dcm_StartDataOut_Check_Memory_Out_routineResultType, direction=OUT
          ErrorCode: type=Dcm_NegativeResponseCodeType, direction=OUT
      error E_NOT_OK: error-code=1
      error DCM_E_PENDING: error-code=10
      error DCM_E_FORCE_RCRRP: error-code=12
    RoutineServices_CheckProgrammingPreCondition
      operation Start: possible-error=[RoutineServices_CheckProgrammingPreCondition/E_NOT_OK, RoutineServices_CheckProgrammingPreCondition/DCM_E_PENDING, RoutineServices_CheckProgrammingPreCondition/DCM_E_FORCE_RCRRP]
        arg OpStatus: type=Dcm_OpStatusType, direction=IN
        arg Out_programmingPreConditionList: type=Dcm_StartDataOut_CheckProgrammingPreCondition_Out_programmingPreConditionListType, direction=OUT
        arg ErrorCode: type=Dcm_NegativeResponseCodeType, direction=OUT
      error E_NOT_OK: error-code=1
      error DCM_E_PENDING: error-code=10
      error DCM_E_FORCE_RCRRP: error-code=12
    RoutineServices_Erase_Mileage_Provisional_Parameter
      operation Start: possible-error=[RoutineServices_Erase_Mileage_Provisional_Parameter/E_NOT_OK, RoutineServices_Erase_Mileage_Provisional_Parameter/DCM_E_PENDING, RoutineServices_Erase_Mileage_Provisional_Parameter/DCM_E_FORCE_RCRRP]
        arg OpStatus: type=Dcm_OpStatusType, direction=IN
        arg Out_routineResult: type=Dcm_StartDataOut_Erase_Mileage_Provisional_Parameter_Out_routineResultType, direction=OUT
        arg ErrorCode: type=Dcm_NegativeResponseCodeType, direction=OUT
      error E_NOT_OK: error-code=1
      error DCM_E_PENDING: error-code=10
      error DCM_E_FORCE_RCRRP: error-code=12
    RoutineServices_Turn_Off_HV_Turn_Off_Charging
      operation Start: possible-error=[RoutineServices_Turn_Off_HV_Turn_Off_Charging/E_NOT_OK, RoutineServices_Turn_Off_HV_Turn_Off_Charging/DCM_E_PENDING, RoutineServices_Turn_Off_HV_Turn_Off_Charging/DCM_E_FORCE_RCRRP]
        arg OpStatus: type=Dcm_OpStatusType, direction=IN
        arg Out_routineResult: type=Dcm_StartDataOut_Turn_Off_HV_Turn_Off_Charging_Out_routineResultType, direction=OUT
        arg ErrorCode: type=Dcm_NegativeResponseCodeType, direction=OUT
      operation Stop: possible-error=[RoutineServices_Turn_Off_HV_Turn_Off_Charging/E_NOT_OK, RoutineServices_Turn_Off_HV_Turn_Off_Charging/DCM_E_PENDING, RoutineServices_Turn_Off_HV_Turn_Off_Charging/DCM_E_FORCE_RCRRP]
        arg OpStatus: type=Dcm_OpStatusType, direction=IN
        arg Out_routineResult: type=Dcm_StopDataOut_Turn_Off_HV_Turn_Off_Charging_Out_routineResultType, direction=OUT
        arg ErrorCode: type=Dcm_NegativeResponseCodeType, direction=OUT
      error E_NOT_OK: error-code=1
      error DCM_E_PENDING: error-code=10
      error DCM_E_FORCE_RCRRP: error-code=12
    RoutineServices_Erase_Memory
      operation Start: possible-error=[RoutineServices_Erase_Memory/E_NOT_OK, RoutineServices_Erase_Memory/DCM_E_PENDING, RoutineServices_Erase_Memory/DCM_E_FORCE_RCRRP]
        6 x arg:
          In_addressAndLengthFormatIdentifier: type=Dcm_StartDataIn_Erase_Memory_In_addressAndLengthFormatIdentifierType, direction=IN
          In_memoryAddress: type=Dcm_StartDataIn_Erase_Memory_In_memoryAddressType, direction=IN
          In_memorySize: type=Dcm_StartDataIn_Erase_Memory_In_memorySizeType, direction=IN
          OpStatus: type=Dcm_OpStatusType, direction=IN
          Out_routineResult: type=Dcm_StartDataOut_Erase_Memory_Out_routineResultType, direction=OUT
          ErrorCode: type=Dcm_NegativeResponseCodeType, direction=OUT
      error E_NOT_OK: error-code=1
      error DCM_E_PENDING: error-code=10
      error DCM_E_FORCE_RCRRP: error-code=12
    RoutineServices_CheckProgrammingDependencies
      operation Start: possible-error=[RoutineServices_CheckProgrammingDependencies/E_NOT_OK, RoutineServices_CheckProgrammingDependencies/DCM_E_PENDING, RoutineServices_CheckProgrammingDependencies/DCM_E_FORCE_RCRRP]
        arg OpStatus: type=Dcm_OpStatusType, direction=IN
        arg Out_routineResult: type=Dcm_StartDataOut_CheckProgrammingDependencies_Out_routineResultType, direction=OUT
        arg ErrorCode: type=Dcm_NegativeResponseCodeType, direction=OUT
      error E_NOT_OK: error-code=1
      error DCM_E_PENDING: error-code=10
      error DCM_E_FORCE_RCRRP: error-code=12
    DataServices_DevelopmentData_Country_code
      operation ReadData: possible-error=[DataServices_DevelopmentData_Country_code/E_NOT_OK, DataServices_DevelopmentData_Country_code/DCM_E_PENDING]
        arg OpStatus: type=Dcm_OpStatusType, direction=IN
        arg Data: type=Dcm_Data2ByteType, direction=OUT
      operation ConditionCheckRead: possible-error=[DataServices_DevelopmentData_Country_code/E_NOT_OK, DataServices_DevelopmentData_Country_code/DCM_E_PENDING]
        arg OpStatus: type=Dcm_OpStatusType, direction=IN
        arg ErrorCode: type=Dcm_NegativeResponseCodeType, direction=OUT
      error E_NOT_OK: error-code=1
      error DCM_E_PENDING: error-code=10
    DataServices_DevelopmentData_Supplier_code
      operation ReadData: possible-error=[DataServices_DevelopmentData_Supplier_code/E_NOT_OK, DataServices_DevelopmentData_Supplier_code/DCM_E_PENDING]
        arg OpStatus: type=Dcm_OpStatusType, direction=IN
        arg Data: type=Dcm_Data1ByteType, direction=OUT
      operation ConditionCheckRead: possible-error=[DataServices_DevelopmentData_Supplier_code/E_NOT_OK, DataServices_DevelopmentData_Supplier_code/DCM_E_PENDING]
        arg OpStatus: type=Dcm_OpStatusType, direction=IN
        arg ErrorCode: type=Dcm_NegativeResponseCodeType, direction=OUT
      error E_NOT_OK: error-code=1
      error DCM_E_PENDING: error-code=10
    DataServices_DevelopmentData_Supplier_family_code
      operation ReadData: possible-error=[DataServices_DevelopmentData_Supplier_family_code/E_NOT_OK, DataServices_DevelopmentData_Supplier_family_code/DCM_E_PENDING]
        arg OpStatus: type=Dcm_OpStatusType, direction=IN
        arg Data: type=Dcm_Data3ByteType, direction=OUT
      operation ConditionCheckRead: possible-error=[DataServices_DevelopmentData_Supplier_family_code/E_NOT_OK, DataServices_DevelopmentData_Supplier_family_code/DCM_E_PENDING]
        arg OpStatus: type=Dcm_OpStatusType, direction=IN
        arg ErrorCode: type=Dcm_NegativeResponseCodeType, direction=OUT
      error E_NOT_OK: error-code=1
      error DCM_E_PENDING: error-code=10
    DataServices_EcuIdentification_Specific_Vehicle_Code_WMI
      operation ReadData: possible-error=[DataServices_EcuIdentification_Specific_Vehicle_Code_WMI/E_NOT_OK, DataServices_EcuIdentification_Specific_Vehicle_Code_WMI/DCM_E_PENDING]
        arg OpStatus: type=Dcm_OpStatusType, direction=IN
        arg Data: type=Dcm_Data6ByteType, direction=OUT
      operation ConditionCheckRead: possible-error=[DataServices_EcuIdentification_Specific_Vehicle_Code_WMI/E_NOT_OK, DataServices_EcuIdentification_Specific_Vehicle_Code_WMI/DCM_E_PENDING]
        arg OpStatus: type=Dcm_OpStatusType, direction=IN
        arg ErrorCode: type=Dcm_NegativeResponseCodeType, direction=OUT
      operation WriteData: possible-error=[DataServices_EcuIdentification_Specific_Vehicle_Code_WMI/E_NOT_OK, DataServices_EcuIdentification_Specific_Vehicle_Code_WMI/DCM_E_PENDING]
        arg Data: type=Dcm_Data6ByteType, direction=IN
        arg OpStatus: type=Dcm_OpStatusType, direction=IN
        arg ErrorCode: type=Dcm_NegativeResponseCodeType, direction=OUT
      error E_NOT_OK: error-code=1
      error DCM_E_PENDING: error-code=10
    DataServices_EcuIdentification_Detail_Code
      operation ReadData: possible-error=[DataServices_EcuIdentification_Detail_Code/E_NOT_OK, DataServices_EcuIdentification_Detail_Code/DCM_E_PENDING]
        arg OpStatus: type=Dcm_OpStatusType, direction=IN
        arg Data: type=Dcm_Data3ByteType, direction=OUT
      operation ConditionCheckRead: possible-error=[DataServices_EcuIdentification_Detail_Code/E_NOT_OK, DataServices_EcuIdentification_Detail_Code/DCM_E_PENDING]
        arg OpStatus: type=Dcm_OpStatusType, direction=IN
        arg ErrorCode: type=Dcm_NegativeResponseCodeType, direction=OUT
      operation WriteData: possible-error=[DataServices_EcuIdentification_Detail_Code/E_NOT_OK, DataServices_EcuIdentification_Detail_Code/DCM_E_PENDING]
        arg Data: type=Dcm_Data3ByteType, direction=IN
        arg OpStatus: type=Dcm_OpStatusType, direction=IN
        arg ErrorCode: type=Dcm_NegativeResponseCodeType, direction=OUT
      error E_NOT_OK: error-code=1
      error DCM_E_PENDING: error-code=10
    DataServices_EcuIdentification_Execution_Package
      operation ReadData: possible-error=[DataServices_EcuIdentification_Execution_Package/E_NOT_OK, DataServices_EcuIdentification_Execution_Package/DCM_E_PENDING]
        arg OpStatus: type=Dcm_OpStatusType, direction=IN
        arg Data: type=Dcm_Data2ByteType, direction=OUT
      operation ConditionCheckRead: possible-error=[DataServices_EcuIdentification_Execution_Package/E_NOT_OK, DataServices_EcuIdentification_Execution_Package/DCM_E_PENDING]
        arg OpStatus: type=Dcm_OpStatusType, direction=IN
        arg ErrorCode: type=Dcm_NegativeResponseCodeType, direction=OUT
      operation WriteData: possible-error=[DataServices_EcuIdentification_Execution_Package/E_NOT_OK, DataServices_EcuIdentification_Execution_Package/DCM_E_PENDING]
        arg Data: type=Dcm_Data2ByteType, direction=IN
        arg OpStatus: type=Dcm_OpStatusType, direction=IN
        arg ErrorCode: type=Dcm_NegativeResponseCodeType, direction=OUT
      error E_NOT_OK: error-code=1
      error DCM_E_PENDING: error-code=10
    DataServices_EcuIdentification_Subgroup
      operation ReadData: possible-error=[DataServices_EcuIdentification_Subgroup/E_NOT_OK, DataServices_EcuIdentification_Subgroup/DCM_E_PENDING]
        arg OpStatus: type=Dcm_OpStatusType, direction=IN
        arg Data: type=Dcm_Data2ByteType, direction=OUT
      operation ConditionCheckRead: possible-error=[DataServices_EcuIdentification_Subgroup/E_NOT_OK, DataServices_EcuIdentification_Subgroup/DCM_E_PENDING]
        arg OpStatus: type=Dcm_OpStatusType, direction=IN
        arg ErrorCode: type=Dcm_NegativeResponseCodeType, direction=OUT
      operation WriteData: possible-error=[DataServices_EcuIdentification_Subgroup/E_NOT_OK, DataServices_EcuIdentification_Subgroup/DCM_E_PENDING]
        arg Data: type=Dcm_Data2ByteType, direction=IN
        arg OpStatus: type=Dcm_OpStatusType, direction=IN
        arg ErrorCode: type=Dcm_NegativeResponseCodeType, direction=OUT
      error E_NOT_OK: error-code=1
      error DCM_E_PENDING: error-code=10
    DataServices_EcuIdentification_Group
      operation ReadData: possible-error=[DataServices_EcuIdentification_Group/E_NOT_OK, DataServices_EcuIdentification_Group/DCM_E_PENDING]
        arg OpStatus: type=Dcm_OpStatusType, direction=IN
        arg Data: type=Dcm_Data2ByteType, direction=OUT
      operation ConditionCheckRead: possible-error=[DataServices_EcuIdentification_Group/E_NOT_OK, DataServices_EcuIdentification_Group/DCM_E_PENDING]
        arg OpStatus: type=Dcm_OpStatusType, direction=IN
        arg ErrorCode: type=Dcm_NegativeResponseCodeType, direction=OUT
      operation WriteData: possible-error=[DataServices_EcuIdentification_Group/E_NOT_OK, DataServices_EcuIdentification_Group/DCM_E_PENDING]
        arg Data: type=Dcm_Data2ByteType, direction=IN
        arg OpStatus: type=Dcm_OpStatusType, direction=IN
        arg ErrorCode: type=Dcm_NegativeResponseCodeType, direction=OUT
      error E_NOT_OK: error-code=1
      error DCM_E_PENDING: error-code=10
    DataServices_SerialNumber_ECU_Name
      operation ReadData: possible-error=[DataServices_SerialNumber_ECU_Name/E_NOT_OK, DataServices_SerialNumber_ECU_Name/DCM_E_PENDING]
        arg OpStatus: type=Dcm_OpStatusType, direction=IN
        arg Data: type=Dcm_Data3ByteType, direction=OUT
      operation ConditionCheckRead: possible-error=[DataServices_SerialNumber_ECU_Name/E_NOT_OK, DataServices_SerialNumber_ECU_Name/DCM_E_PENDING]
        arg OpStatus: type=Dcm_OpStatusType, direction=IN
        arg ErrorCode: type=Dcm_NegativeResponseCodeType, direction=OUT
      error E_NOT_OK: error-code=1
      error DCM_E_PENDING: error-code=10
    DataServices_SerialNumber_ECU_index_number
      operation ReadData: possible-error=[DataServices_SerialNumber_ECU_index_number/E_NOT_OK, DataServices_SerialNumber_ECU_index_number/DCM_E_PENDING]
        arg OpStatus: type=Dcm_OpStatusType, direction=IN
        arg Data: type=Dcm_Data6ByteType, direction=OUT
      operation ConditionCheckRead: possible-error=[DataServices_SerialNumber_ECU_index_number/E_NOT_OK, DataServices_SerialNumber_ECU_index_number/DCM_E_PENDING]
        arg OpStatus: type=Dcm_OpStatusType, direction=IN
        arg ErrorCode: type=Dcm_NegativeResponseCodeType, direction=OUT
      error E_NOT_OK: error-code=1
      error DCM_E_PENDING: error-code=10
    DataServices_SerialNumber_ECU_production_date_in_DD_MM_YY_format
      operation ReadData: possible-error=[DataServices_SerialNumber_ECU_production_date_in_DD_MM_YY_format/E_NOT_OK, DataServices_SerialNumber_ECU_production_date_in_DD_MM_YY_format/DCM_E_PENDING]
        arg OpStatus: type=Dcm_OpStatusType, direction=IN
        arg Data: type=Dcm_Data6ByteType, direction=OUT
      operation ConditionCheckRead: possible-error=[DataServices_SerialNumber_ECU_production_date_in_DD_MM_YY_format/E_NOT_OK, DataServices_SerialNumber_ECU_production_date_in_DD_MM_YY_format/DCM_E_PENDING]
        arg OpStatus: type=Dcm_OpStatusType, direction=IN
        arg ErrorCode: type=Dcm_NegativeResponseCodeType, direction=OUT
      error E_NOT_OK: error-code=1
      error DCM_E_PENDING: error-code=10
    DataServices_SerialNumber_Supplier_name
      operation ReadData: possible-error=[DataServices_SerialNumber_Supplier_name/E_NOT_OK, DataServices_SerialNumber_Supplier_name/DCM_E_PENDING]
        arg OpStatus: type=Dcm_OpStatusType, direction=IN
        arg Data: type=Dcm_Data5ByteType, direction=OUT
      operation ConditionCheckRead: possible-error=[DataServices_SerialNumber_Supplier_name/E_NOT_OK, DataServices_SerialNumber_Supplier_name/DCM_E_PENDING]
        arg OpStatus: type=Dcm_OpStatusType, direction=IN
        arg ErrorCode: type=Dcm_NegativeResponseCodeType, direction=OUT
      error E_NOT_OK: error-code=1
      error DCM_E_PENDING: error-code=10
    DataServices_AC_charging_parameter_VCU_OBC_ChargeCurrentCommand
      operation ReadData: possible-error=[DataServices_AC_charging_parameter_VCU_OBC_ChargeCurrentCommand/E_NOT_OK, DataServices_AC_charging_parameter_VCU_OBC_ChargeCurrentCommand/DCM_E_PENDING]
        arg OpStatus: type=Dcm_OpStatusType, direction=IN
        arg Data: type=Dcm_Data2ByteType, direction=OUT
      operation ConditionCheckRead: possible-error=[DataServices_AC_charging_parameter_VCU_OBC_ChargeCurrentCommand/E_NOT_OK, DataServices_AC_charging_parameter_VCU_OBC_ChargeCurrentCommand/DCM_E_PENDING]
        arg OpStatus: type=Dcm_OpStatusType, direction=IN
        arg ErrorCode: type=Dcm_NegativeResponseCodeType, direction=OUT
      error E_NOT_OK: error-code=1
      error DCM_E_PENDING: error-code=10
    DataServices_AC_charging_parameter_POD_OBC_InputACVoltage
      operation ReadData: possible-error=[DataServices_AC_charging_parameter_POD_OBC_InputACVoltage/E_NOT_OK, DataServices_AC_charging_parameter_POD_OBC_InputACVoltage/DCM_E_PENDING]
        arg OpStatus: type=Dcm_OpStatusType, direction=IN
        arg Data: type=Dcm_Data2ByteType, direction=OUT
      operation ConditionCheckRead: possible-error=[DataServices_AC_charging_parameter_POD_OBC_InputACVoltage/E_NOT_OK, DataServices_AC_charging_parameter_POD_OBC_InputACVoltage/DCM_E_PENDING]
        arg OpStatus: type=Dcm_OpStatusType, direction=IN
        arg ErrorCode: type=Dcm_NegativeResponseCodeType, direction=OUT
      error E_NOT_OK: error-code=1
      error DCM_E_PENDING: error-code=10
    DataServices_AC_charging_parameter_POD_OBC_OutputDCChargeVoltage
      operation ReadData: possible-error=[DataServices_AC_charging_parameter_POD_OBC_OutputDCChargeVoltage/E_NOT_OK, DataServices_AC_charging_parameter_POD_OBC_OutputDCChargeVoltage/DCM_E_PENDING]
        arg OpStatus: type=Dcm_OpStatusType, direction=IN
        arg Data: type=Dcm_Data2ByteType, direction=OUT
      operation ConditionCheckRead: possible-error=[DataServices_AC_charging_parameter_POD_OBC_OutputDCChargeVoltage/E_NOT_OK, DataServices_AC_charging_parameter_POD_OBC_OutputDCChargeVoltage/DCM_E_PENDING]
        arg OpStatus: type=Dcm_OpStatusType, direction=IN
        arg ErrorCode: type=Dcm_NegativeResponseCodeType, direction=OUT
      error E_NOT_OK: error-code=1
      error DCM_E_PENDING: error-code=10
    DataServices_AC_charging_parameter_POD_OBC_OutputDCChargeCurrent
      operation ReadData: possible-error=[DataServices_AC_charging_parameter_POD_OBC_OutputDCChargeCurrent/E_NOT_OK, DataServices_AC_charging_parameter_POD_OBC_OutputDCChargeCurrent/DCM_E_PENDING]
        arg OpStatus: type=Dcm_OpStatusType, direction=IN
        arg Data: type=Dcm_Data2ByteType, direction=OUT
      operation ConditionCheckRead: possible-error=[DataServices_AC_charging_parameter_POD_OBC_OutputDCChargeCurrent/E_NOT_OK, DataServices_AC_charging_parameter_POD_OBC_OutputDCChargeCurrent/DCM_E_PENDING]
        arg OpStatus: type=Dcm_OpStatusType, direction=IN
        arg ErrorCode: type=Dcm_NegativeResponseCodeType, direction=OUT
      error E_NOT_OK: error-code=1
      error DCM_E_PENDING: error-code=10
    DataServices_Write_Level3_OEM_Key_OEM_Key_Value
      operation WriteData: possible-error=[DataServices_Write_Level3_OEM_Key_OEM_Key_Value/E_NOT_OK, DataServices_Write_Level3_OEM_Key_OEM_Key_Value/DCM_E_PENDING]
        arg Data: type=Dcm_Data16ByteType, direction=IN
        arg OpStatus: type=Dcm_OpStatusType, direction=IN
        arg ErrorCode: type=Dcm_NegativeResponseCodeType, direction=OUT
      error E_NOT_OK: error-code=1
      error DCM_E_PENDING: error-code=10
    DataServices_Write_Level3_OEM_Key_CRC
      operation WriteData: possible-error=[DataServices_Write_Level3_OEM_Key_CRC/E_NOT_OK, DataServices_Write_Level3_OEM_Key_CRC/DCM_E_PENDING]
        arg Data: type=Dcm_Data1ByteType, direction=IN
        arg OpStatus: type=Dcm_OpStatusType, direction=IN
        arg ErrorCode: type=Dcm_NegativeResponseCodeType, direction=OUT
      error E_NOT_OK: error-code=1
      error DCM_E_PENDING: error-code=10
    DataServices_Read_Vehicle_Security_related_events_Software_configuration_inte_Event_occurance_time_Year_1
      operation ReadData: possible-error=[DataServices_Read_Vehicle_Security_related_events_Software_configuration_inte_Event_occurance_time_Year_1/E_NOT_OK, DataServices_Read_Vehicle_Security_related_events_Software_configuration_inte_Event_occurance_time_Year_1/DCM_E_PENDING]
        arg OpStatus: type=Dcm_OpStatusType, direction=IN
        arg Data: type=Dcm_Data1ByteType, direction=OUT
      operation ConditionCheckRead: possible-error=[DataServices_Read_Vehicle_Security_related_events_Software_configuration_inte_Event_occurance_time_Year_1/E_NOT_OK, DataServices_Read_Vehicle_Security_related_events_Software_configuration_inte_Event_occurance_time_Year_1/DCM_E_PENDING]
        arg OpStatus: type=Dcm_OpStatusType, direction=IN
        arg ErrorCode: type=Dcm_NegativeResponseCodeType, direction=OUT
      error E_NOT_OK: error-code=1
      error DCM_E_PENDING: error-code=10
    DataServices_Read_Vehicle_Security_related_events_Software_configuration_inte_Event_occurance_time_Day_1
      operation ReadData: possible-error=[DataServices_Read_Vehicle_Security_related_events_Software_configuration_inte_Event_occurance_time_Day_1/E_NOT_OK, DataServices_Read_Vehicle_Security_related_events_Software_configuration_inte_Event_occurance_time_Day_1/DCM_E_PENDING]
        arg OpStatus: type=Dcm_OpStatusType, direction=IN
        arg Data: type=Dcm_Data1ByteType, direction=OUT
      operation ConditionCheckRead: possible-error=[DataServices_Read_Vehicle_Security_related_events_Software_configuration_inte_Event_occurance_time_Day_1/E_NOT_OK, DataServices_Read_Vehicle_Security_related_events_Software_configuration_inte_Event_occurance_time_Day_1/DCM_E_PENDING]
        arg OpStatus: type=Dcm_OpStatusType, direction=IN
        arg ErrorCode: type=Dcm_NegativeResponseCodeType, direction=OUT
      error E_NOT_OK: error-code=1
      error DCM_E_PENDING: error-code=10
    DataServices_Read_Vehicle_Security_related_events_Software_configuration_inte_Software_configuration_integrity_check_fa_B04CEA39
      operation ReadData: possible-error=[DataServices_Read_Vehicle_Security_related_events_Software_configuration_inte_Software_configuration_integrity_check_fa_B04CEA39/E_NOT_OK, DataServices_Read_Vehicle_Security_related_events_Software_configuration_inte_Software_configuration_integrity_check_fa_B04CEA39/DCM_E_PENDING]
        arg OpStatus: type=Dcm_OpStatusType, direction=IN
        arg Data: type=Dcm_Data2ByteType, direction=OUT
      operation ConditionCheckRead: possible-error=[DataServices_Read_Vehicle_Security_related_events_Software_configuration_inte_Software_configuration_integrity_check_fa_B04CEA39/E_NOT_OK, DataServices_Read_Vehicle_Security_related_events_Software_configuration_inte_Software_configuration_integrity_check_fa_B04CEA39/DCM_E_PENDING]
        arg OpStatus: type=Dcm_OpStatusType, direction=IN
        arg ErrorCode: type=Dcm_NegativeResponseCodeType, direction=OUT
      error E_NOT_OK: error-code=1
      error DCM_E_PENDING: error-code=10
    DataServices_Read_Vehicle_Security_related_events_Software_configuration_inte_Event_occurance_time_Day_2
      operation ReadData: possible-error=[DataServices_Read_Vehicle_Security_related_events_Software_configuration_inte_Event_occurance_time_Day_2/E_NOT_OK, DataServices_Read_Vehicle_Security_related_events_Software_configuration_inte_Event_occurance_time_Day_2/DCM_E_PENDING]
        arg OpStatus: type=Dcm_OpStatusType, direction=IN
        arg Data: type=Dcm_Data1ByteType, direction=OUT
      operation ConditionCheckRead: possible-error=[DataServices_Read_Vehicle_Security_related_events_Software_configuration_inte_Event_occurance_time_Day_2/E_NOT_OK, DataServices_Read_Vehicle_Security_related_events_Software_configuration_inte_Event_occurance_time_Day_2/DCM_E_PENDING]
        arg OpStatus: type=Dcm_OpStatusType, direction=IN
        arg ErrorCode: type=Dcm_NegativeResponseCodeType, direction=OUT
      error E_NOT_OK: error-code=1
      error DCM_E_PENDING: error-code=10
    DataServices_Read_Vehicle_Security_related_events_Software_configuration_inte_Event_occurance_time_Day_3
      operation ReadData: possible-error=[DataServices_Read_Vehicle_Security_related_events_Software_configuration_inte_Event_occurance_time_Day_3/E_NOT_OK, DataServices_Read_Vehicle_Security_related_events_Software_configuration_inte_Event_occurance_time_Day_3/DCM_E_PENDING]
        arg OpStatus: type=Dcm_OpStatusType, direction=IN
        arg Data: type=Dcm_Data1ByteType, direction=OUT
      operation ConditionCheckRead: possible-error=[DataServices_Read_Vehicle_Security_related_events_Software_configuration_inte_Event_occurance_time_Day_3/E_NOT_OK, DataServices_Read_Vehicle_Security_related_events_Software_configuration_inte_Event_occurance_time_Day_3/DCM_E_PENDING]
        arg OpStatus: type=Dcm_OpStatusType, direction=IN
        arg ErrorCode: type=Dcm_NegativeResponseCodeType, direction=OUT
      error E_NOT_OK: error-code=1
      error DCM_E_PENDING: error-code=10
    DataServices_Read_Vehicle_Security_related_events_Software_configuration_inte_Event_occurance_time_Day_4
      operation ReadData: possible-error=[DataServices_Read_Vehicle_Security_related_events_Software_configuration_inte_Event_occurance_time_Day_4/E_NOT_OK, DataServices_Read_Vehicle_Security_related_events_Software_configuration_inte_Event_occurance_time_Day_4/DCM_E_PENDING]
        arg OpStatus: type=Dcm_OpStatusType, direction=IN
        arg Data: type=Dcm_Data1ByteType, direction=OUT
      operation ConditionCheckRead: possible-error=[DataServices_Read_Vehicle_Security_related_events_Software_configuration_inte_Event_occurance_time_Day_4/E_NOT_OK, DataServices_Read_Vehicle_Security_related_events_Software_configuration_inte_Event_occurance_time_Day_4/DCM_E_PENDING]
        arg OpStatus: type=Dcm_OpStatusType, direction=IN
        arg ErrorCode: type=Dcm_NegativeResponseCodeType, direction=OUT
      error E_NOT_OK: error-code=1
      error DCM_E_PENDING: error-code=10
    DataServices_Read_Vehicle_Security_related_events_Software_configuration_inte_Event_occurance_time_Day_5
      operation ReadData: possible-error=[DataServices_Read_Vehicle_Security_related_events_Software_configuration_inte_Event_occurance_time_Day_5/E_NOT_OK, DataServices_Read_Vehicle_Security_related_events_Software_configuration_inte_Event_occurance_time_Day_5/DCM_E_PENDING]
        arg OpStatus: type=Dcm_OpStatusType, direction=IN
        arg Data: type=Dcm_Data1ByteType, direction=OUT
      operation ConditionCheckRead: possible-error=[DataServices_Read_Vehicle_Security_related_events_Software_configuration_inte_Event_occurance_time_Day_5/E_NOT_OK, DataServices_Read_Vehicle_Security_related_events_Software_configuration_inte_Event_occurance_time_Day_5/DCM_E_PENDING]
        arg OpStatus: type=Dcm_OpStatusType, direction=IN
        arg ErrorCode: type=Dcm_NegativeResponseCodeType, direction=OUT
      error E_NOT_OK: error-code=1
      error DCM_E_PENDING: error-code=10
    DataServices_Read_Vehicle_Security_related_events_Software_configuration_inte_Software_configuration_integrity_check_5
      operation ReadData: possible-error=[DataServices_Read_Vehicle_Security_related_events_Software_configuration_inte_Software_configuration_integrity_check_5/E_NOT_OK, DataServices_Read_Vehicle_Security_related_events_Software_configuration_inte_Software_configuration_integrity_check_5/DCM_E_PENDING]
        arg OpStatus: type=Dcm_OpStatusType, direction=IN
        arg Data: type=Dcm_Data1ByteType, direction=OUT
      operation ConditionCheckRead: possible-error=[DataServices_Read_Vehicle_Security_related_events_Software_configuration_inte_Software_configuration_integrity_check_5/E_NOT_OK, DataServices_Read_Vehicle_Security_related_events_Software_configuration_inte_Software_configuration_integrity_check_5/DCM_E_PENDING]
        arg OpStatus: type=Dcm_OpStatusType, direction=IN
        arg ErrorCode: type=Dcm_NegativeResponseCodeType, direction=OUT
      error E_NOT_OK: error-code=1
      error DCM_E_PENDING: error-code=10
    DataServices_Read_Vehicle_Security_related_events_Software_configuration_inte_Event_occurance_time_Month_2
      operation ReadData: possible-error=[DataServices_Read_Vehicle_Security_related_events_Software_configuration_inte_Event_occurance_time_Month_2/E_NOT_OK, DataServices_Read_Vehicle_Security_related_events_Software_configuration_inte_Event_occurance_time_Month_2/DCM_E_PENDING]
        arg OpStatus: type=Dcm_OpStatusType, direction=IN
        arg Data: type=Dcm_Data1ByteType, direction=OUT
      operation ConditionCheckRead: possible-error=[DataServices_Read_Vehicle_Security_related_events_Software_configuration_inte_Event_occurance_time_Month_2/E_NOT_OK, DataServices_Read_Vehicle_Security_related_events_Software_configuration_inte_Event_occurance_time_Month_2/DCM_E_PENDING]
        arg OpStatus: type=Dcm_OpStatusType, direction=IN
        arg ErrorCode: type=Dcm_NegativeResponseCodeType, direction=OUT
      error E_NOT_OK: error-code=1
      error DCM_E_PENDING: error-code=10
    DataServices_Read_Vehicle_Security_related_events_Software_configuration_inte_Event_occurance_time_Month_1
      operation ReadData: possible-error=[DataServices_Read_Vehicle_Security_related_events_Software_configuration_inte_Event_occurance_time_Month_1/E_NOT_OK, DataServices_Read_Vehicle_Security_related_events_Software_configuration_inte_Event_occurance_time_Month_1/DCM_E_PENDING]
        arg OpStatus: type=Dcm_OpStatusType, direction=IN
        arg Data: type=Dcm_Data1ByteType, direction=OUT
      operation ConditionCheckRead: possible-error=[DataServices_Read_Vehicle_Security_related_events_Software_configuration_inte_Event_occurance_time_Month_1/E_NOT_OK, DataServices_Read_Vehicle_Security_related_events_Software_configuration_inte_Event_occurance_time_Month_1/DCM_E_PENDING]
        arg OpStatus: type=Dcm_OpStatusType, direction=IN
        arg ErrorCode: type=Dcm_NegativeResponseCodeType, direction=OUT
      error E_NOT_OK: error-code=1
      error DCM_E_PENDING: error-code=10
    DataServices_Read_Vehicle_Security_related_events_Software_configuration_inte_Event_occurance_time_Month_4
      operation ReadData: possible-error=[DataServices_Read_Vehicle_Security_related_events_Software_configuration_inte_Event_occurance_time_Month_4/E_NOT_OK, DataServices_Read_Vehicle_Security_related_events_Software_configuration_inte_Event_occurance_time_Month_4/DCM_E_PENDING]
        arg OpStatus: type=Dcm_OpStatusType, direction=IN
        arg Data: type=Dcm_Data1ByteType, direction=OUT
      operation ConditionCheckRead: possible-error=[DataServices_Read_Vehicle_Security_related_events_Software_configuration_inte_Event_occurance_time_Month_4/E_NOT_OK, DataServices_Read_Vehicle_Security_related_events_Software_configuration_inte_Event_occurance_time_Month_4/DCM_E_PENDING]
        arg OpStatus: type=Dcm_OpStatusType, direction=IN
        arg ErrorCode: type=Dcm_NegativeResponseCodeType, direction=OUT
      error E_NOT_OK: error-code=1
      error DCM_E_PENDING: error-code=10
    DataServices_Read_Vehicle_Security_related_events_Software_configuration_inte_Software_configuration_integrity_check_3
      operation ReadData: possible-error=[DataServices_Read_Vehicle_Security_related_events_Software_configuration_inte_Software_configuration_integrity_check_3/E_NOT_OK, DataServices_Read_Vehicle_Security_related_events_Software_configuration_inte_Software_configuration_integrity_check_3/DCM_E_PENDING]
        arg OpStatus: type=Dcm_OpStatusType, direction=IN
        arg Data: type=Dcm_Data1ByteType, direction=OUT
      operation ConditionCheckRead: possible-error=[DataServices_Read_Vehicle_Security_related_events_Software_configuration_inte_Software_configuration_integrity_check_3/E_NOT_OK, DataServices_Read_Vehicle_Security_related_events_Software_configuration_inte_Software_configuration_integrity_check_3/DCM_E_PENDING]
        arg OpStatus: type=Dcm_OpStatusType, direction=IN
        arg ErrorCode: type=Dcm_NegativeResponseCodeType, direction=OUT
      error E_NOT_OK: error-code=1
      error DCM_E_PENDING: error-code=10
    DataServices_Read_Vehicle_Security_related_events_Software_configuration_inte_Software_configuration_integrity_check_4
      operation ReadData: possible-error=[DataServices_Read_Vehicle_Security_related_events_Software_configuration_inte_Software_configuration_integrity_check_4/E_NOT_OK, DataServices_Read_Vehicle_Security_related_events_Software_configuration_inte_Software_configuration_integrity_check_4/DCM_E_PENDING]
        arg OpStatus: type=Dcm_OpStatusType, direction=IN
        arg Data: type=Dcm_Data1ByteType, direction=OUT
      operation ConditionCheckRead: possible-error=[DataServices_Read_Vehicle_Security_related_events_Software_configuration_inte_Software_configuration_integrity_check_4/E_NOT_OK, DataServices_Read_Vehicle_Security_related_events_Software_configuration_inte_Software_configuration_integrity_check_4/DCM_E_PENDING]
        arg OpStatus: type=Dcm_OpStatusType, direction=IN
        arg ErrorCode: type=Dcm_NegativeResponseCodeType, direction=OUT
      error E_NOT_OK: error-code=1
      error DCM_E_PENDING: error-code=10
    DataServices_Read_Vehicle_Security_related_events_Software_configuration_inte_Event_occurance_time_Month_3
      operation ReadData: possible-error=[DataServices_Read_Vehicle_Security_related_events_Software_configuration_inte_Event_occurance_time_Month_3/E_NOT_OK, DataServices_Read_Vehicle_Security_related_events_Software_configuration_inte_Event_occurance_time_Month_3/DCM_E_PENDING]
        arg OpStatus: type=Dcm_OpStatusType, direction=IN
        arg Data: type=Dcm_Data1ByteType, direction=OUT
      operation ConditionCheckRead: possible-error=[DataServices_Read_Vehicle_Security_related_events_Software_configuration_inte_Event_occurance_time_Month_3/E_NOT_OK, DataServices_Read_Vehicle_Security_related_events_Software_configuration_inte_Event_occurance_time_Month_3/DCM_E_PENDING]
        arg OpStatus: type=Dcm_OpStatusType, direction=IN
        arg ErrorCode: type=Dcm_NegativeResponseCodeType, direction=OUT
      error E_NOT_OK: error-code=1
      error DCM_E_PENDING: error-code=10
    DataServices_Read_Vehicle_Security_related_events_Software_configuration_inte_Software_configuration_integrity_check_1
      operation ReadData: possible-error=[DataServices_Read_Vehicle_Security_related_events_Software_configuration_inte_Software_configuration_integrity_check_1/E_NOT_OK, DataServices_Read_Vehicle_Security_related_events_Software_configuration_inte_Software_configuration_integrity_check_1/DCM_E_PENDING]
        arg OpStatus: type=Dcm_OpStatusType, direction=IN
        arg Data: type=Dcm_Data1ByteType, direction=OUT
      operation ConditionCheckRead: possible-error=[DataServices_Read_Vehicle_Security_related_events_Software_configuration_inte_Software_configuration_integrity_check_1/E_NOT_OK, DataServices_Read_Vehicle_Security_related_events_Software_configuration_inte_Software_configuration_integrity_check_1/DCM_E_PENDING]
        arg OpStatus: type=Dcm_OpStatusType, direction=IN
        arg ErrorCode: type=Dcm_NegativeResponseCodeType, direction=OUT
      error E_NOT_OK: error-code=1
      error DCM_E_PENDING: error-code=10
    DataServices_Read_Vehicle_Security_related_events_Software_configuration_inte_Event_occurance_time_Month_5
      operation ReadData: possible-error=[DataServices_Read_Vehicle_Security_related_events_Software_configuration_inte_Event_occurance_time_Month_5/E_NOT_OK, DataServices_Read_Vehicle_Security_related_events_Software_configuration_inte_Event_occurance_time_Month_5/DCM_E_PENDING]
        arg OpStatus: type=Dcm_OpStatusType, direction=IN
        arg Data: type=Dcm_Data1ByteType, direction=OUT
      operation ConditionCheckRead: possible-error=[DataServices_Read_Vehicle_Security_related_events_Software_configuration_inte_Event_occurance_time_Month_5/E_NOT_OK, DataServices_Read_Vehicle_Security_related_events_Software_configuration_inte_Event_occurance_time_Month_5/DCM_E_PENDING]
        arg OpStatus: type=Dcm_OpStatusType, direction=IN
        arg ErrorCode: type=Dcm_NegativeResponseCodeType, direction=OUT
      error E_NOT_OK: error-code=1
      error DCM_E_PENDING: error-code=10
    DataServices_Read_Vehicle_Security_related_events_Software_configuration_inte_Software_configuration_integrity_check_2
      operation ReadData: possible-error=[DataServices_Read_Vehicle_Security_related_events_Software_configuration_inte_Software_configuration_integrity_check_2/E_NOT_OK, DataServices_Read_Vehicle_Security_related_events_Software_configuration_inte_Software_configuration_integrity_check_2/DCM_E_PENDING]
        arg OpStatus: type=Dcm_OpStatusType, direction=IN
        arg Data: type=Dcm_Data1ByteType, direction=OUT
      operation ConditionCheckRead: possible-error=[DataServices_Read_Vehicle_Security_related_events_Software_configuration_inte_Software_configuration_integrity_check_2/E_NOT_OK, DataServices_Read_Vehicle_Security_related_events_Software_configuration_inte_Software_configuration_integrity_check_2/DCM_E_PENDING]
        arg OpStatus: type=Dcm_OpStatusType, direction=IN
        arg ErrorCode: type=Dcm_NegativeResponseCodeType, direction=OUT
      error E_NOT_OK: error-code=1
      error DCM_E_PENDING: error-code=10
    DataServices_Read_Vehicle_Security_related_events_Software_configuration_inte_Event_occurance_time_Year_4
      operation ReadData: possible-error=[DataServices_Read_Vehicle_Security_related_events_Software_configuration_inte_Event_occurance_time_Year_4/E_NOT_OK, DataServices_Read_Vehicle_Security_related_events_Software_configuration_inte_Event_occurance_time_Year_4/DCM_E_PENDING]
        arg OpStatus: type=Dcm_OpStatusType, direction=IN
        arg Data: type=Dcm_Data1ByteType, direction=OUT
      operation ConditionCheckRead: possible-error=[DataServices_Read_Vehicle_Security_related_events_Software_configuration_inte_Event_occurance_time_Year_4/E_NOT_OK, DataServices_Read_Vehicle_Security_related_events_Software_configuration_inte_Event_occurance_time_Year_4/DCM_E_PENDING]
        arg OpStatus: type=Dcm_OpStatusType, direction=IN
        arg ErrorCode: type=Dcm_NegativeResponseCodeType, direction=OUT
      error E_NOT_OK: error-code=1
      error DCM_E_PENDING: error-code=10
    DataServices_Read_Vehicle_Security_related_events_Software_configuration_inte_Event_occurance_time_Year_5
      operation ReadData: possible-error=[DataServices_Read_Vehicle_Security_related_events_Software_configuration_inte_Event_occurance_time_Year_5/E_NOT_OK, DataServices_Read_Vehicle_Security_related_events_Software_configuration_inte_Event_occurance_time_Year_5/DCM_E_PENDING]
        arg OpStatus: type=Dcm_OpStatusType, direction=IN
        arg Data: type=Dcm_Data1ByteType, direction=OUT
      operation ConditionCheckRead: possible-error=[DataServices_Read_Vehicle_Security_related_events_Software_configuration_inte_Event_occurance_time_Year_5/E_NOT_OK, DataServices_Read_Vehicle_Security_related_events_Software_configuration_inte_Event_occurance_time_Year_5/DCM_E_PENDING]
        arg OpStatus: type=Dcm_OpStatusType, direction=IN
        arg ErrorCode: type=Dcm_NegativeResponseCodeType, direction=OUT
      error E_NOT_OK: error-code=1
      error DCM_E_PENDING: error-code=10
    DataServices_Read_Vehicle_Security_related_events_Software_configuration_inte_Event_occurance_time_Year_2
      operation ReadData: possible-error=[DataServices_Read_Vehicle_Security_related_events_Software_configuration_inte_Event_occurance_time_Year_2/E_NOT_OK, DataServices_Read_Vehicle_Security_related_events_Software_configuration_inte_Event_occurance_time_Year_2/DCM_E_PENDING]
        arg OpStatus: type=Dcm_OpStatusType, direction=IN
        arg Data: type=Dcm_Data1ByteType, direction=OUT
      operation ConditionCheckRead: possible-error=[DataServices_Read_Vehicle_Security_related_events_Software_configuration_inte_Event_occurance_time_Year_2/E_NOT_OK, DataServices_Read_Vehicle_Security_related_events_Software_configuration_inte_Event_occurance_time_Year_2/DCM_E_PENDING]
        arg OpStatus: type=Dcm_OpStatusType, direction=IN
        arg ErrorCode: type=Dcm_NegativeResponseCodeType, direction=OUT
      error E_NOT_OK: error-code=1
      error DCM_E_PENDING: error-code=10
    DataServices_Read_Vehicle_Security_related_events_Software_configuration_inte_Event_occurance_time_Year_3
      operation ReadData: possible-error=[DataServices_Read_Vehicle_Security_related_events_Software_configuration_inte_Event_occurance_time_Year_3/E_NOT_OK, DataServices_Read_Vehicle_Security_related_events_Software_configuration_inte_Event_occurance_time_Year_3/DCM_E_PENDING]
        arg OpStatus: type=Dcm_OpStatusType, direction=IN
        arg Data: type=Dcm_Data1ByteType, direction=OUT
      operation ConditionCheckRead: possible-error=[DataServices_Read_Vehicle_Security_related_events_Software_configuration_inte_Event_occurance_time_Year_3/E_NOT_OK, DataServices_Read_Vehicle_Security_related_events_Software_configuration_inte_Event_occurance_time_Year_3/DCM_E_PENDING]
        arg OpStatus: type=Dcm_OpStatusType, direction=IN
        arg ErrorCode: type=Dcm_NegativeResponseCodeType, direction=OUT
      error E_NOT_OK: error-code=1
      error DCM_E_PENDING: error-code=10
    DataServices_BS_base_information4_SOF_V2
      operation ReadData: possible-error=[DataServices_BS_base_information4_SOF_V2/E_NOT_OK, DataServices_BS_base_information4_SOF_V2/DCM_E_PENDING]
        arg OpStatus: type=Dcm_OpStatusType, direction=IN
        arg Data: type=Dcm_Data1ByteType, direction=OUT
      operation ConditionCheckRead: possible-error=[DataServices_BS_base_information4_SOF_V2/E_NOT_OK, DataServices_BS_base_information4_SOF_V2/DCM_E_PENDING]
        arg OpStatus: type=Dcm_OpStatusType, direction=IN
        arg ErrorCode: type=Dcm_NegativeResponseCodeType, direction=OUT
      error E_NOT_OK: error-code=1
      error DCM_E_PENDING: error-code=10
    DataServices_BS_base_information4_VCU_BS_Hcurrent
      operation ReadData: possible-error=[DataServices_BS_base_information4_VCU_BS_Hcurrent/E_NOT_OK, DataServices_BS_base_information4_VCU_BS_Hcurrent/DCM_E_PENDING]
        arg OpStatus: type=Dcm_OpStatusType, direction=IN
        arg Data: type=Dcm_Data2ByteType, direction=OUT
      operation ConditionCheckRead: possible-error=[DataServices_BS_base_information4_VCU_BS_Hcurrent/E_NOT_OK, DataServices_BS_base_information4_VCU_BS_Hcurrent/DCM_E_PENDING]
        arg OpStatus: type=Dcm_OpStatusType, direction=IN
        arg ErrorCode: type=Dcm_NegativeResponseCodeType, direction=OUT
      error E_NOT_OK: error-code=1
      error DCM_E_PENDING: error-code=10
    DataServices_BS_base_information4_SOF_V1
      operation ReadData: possible-error=[DataServices_BS_base_information4_SOF_V1/E_NOT_OK, DataServices_BS_base_information4_SOF_V1/DCM_E_PENDING]
        arg OpStatus: type=Dcm_OpStatusType, direction=IN
        arg Data: type=Dcm_Data1ByteType, direction=OUT
      operation ConditionCheckRead: possible-error=[DataServices_BS_base_information4_SOF_V1/E_NOT_OK, DataServices_BS_base_information4_SOF_V1/DCM_E_PENDING]
        arg OpStatus: type=Dcm_OpStatusType, direction=IN
        arg ErrorCode: type=Dcm_NegativeResponseCodeType, direction=OUT
      error E_NOT_OK: error-code=1
      error DCM_E_PENDING: error-code=10
    DataServices_BS_base_information4_SOH
      operation ReadData: possible-error=[DataServices_BS_base_information4_SOH/E_NOT_OK, DataServices_BS_base_information4_SOH/DCM_E_PENDING]
        arg OpStatus: type=Dcm_OpStatusType, direction=IN
        arg Data: type=Dcm_Data1ByteType, direction=OUT
      operation ConditionCheckRead: possible-error=[DataServices_BS_base_information4_SOH/E_NOT_OK, DataServices_BS_base_information4_SOH/DCM_E_PENDING]
        arg OpStatus: type=Dcm_OpStatusType, direction=IN
        arg ErrorCode: type=Dcm_NegativeResponseCodeType, direction=OUT
      error E_NOT_OK: error-code=1
      error DCM_E_PENDING: error-code=10
    DataServices_BS_base_information4_BS_SOC
      operation ReadData: possible-error=[DataServices_BS_base_information4_BS_SOC/E_NOT_OK, DataServices_BS_base_information4_BS_SOC/DCM_E_PENDING]
        arg OpStatus: type=Dcm_OpStatusType, direction=IN
        arg Data: type=Dcm_Data1ByteType, direction=OUT
      operation ConditionCheckRead: possible-error=[DataServices_BS_base_information4_BS_SOC/E_NOT_OK, DataServices_BS_base_information4_BS_SOC/DCM_E_PENDING]
        arg OpStatus: type=Dcm_OpStatusType, direction=IN
        arg ErrorCode: type=Dcm_NegativeResponseCodeType, direction=OUT
      error E_NOT_OK: error-code=1
      error DCM_E_PENDING: error-code=10
    DataServices_BS_base_information4_T_BATT
      operation ReadData: possible-error=[DataServices_BS_base_information4_T_BATT/E_NOT_OK, DataServices_BS_base_information4_T_BATT/DCM_E_PENDING]
        arg OpStatus: type=Dcm_OpStatusType, direction=IN
        arg Data: type=Dcm_Data1ByteType, direction=OUT
      operation ConditionCheckRead: possible-error=[DataServices_BS_base_information4_T_BATT/E_NOT_OK, DataServices_BS_base_information4_T_BATT/DCM_E_PENDING]
        arg OpStatus: type=Dcm_OpStatusType, direction=IN
        arg ErrorCode: type=Dcm_NegativeResponseCodeType, direction=OUT
      error E_NOT_OK: error-code=1
      error DCM_E_PENDING: error-code=10
    DataServices_Read_Level4_OEM_Key_written_status_Read_Level4_OEM_Key_rewrite_counter
      operation ReadData: possible-error=[DataServices_Read_Level4_OEM_Key_written_status_Read_Level4_OEM_Key_rewrite_counter/E_NOT_OK, DataServices_Read_Level4_OEM_Key_written_status_Read_Level4_OEM_Key_rewrite_counter/DCM_E_PENDING]
        arg OpStatus: type=Dcm_OpStatusType, direction=IN
        arg Data: type=Dcm_Data1ByteType, direction=OUT
      operation ConditionCheckRead: possible-error=[DataServices_Read_Level4_OEM_Key_written_status_Read_Level4_OEM_Key_rewrite_counter/E_NOT_OK, DataServices_Read_Level4_OEM_Key_written_status_Read_Level4_OEM_Key_rewrite_counter/DCM_E_PENDING]
        arg OpStatus: type=Dcm_OpStatusType, direction=IN
        arg ErrorCode: type=Dcm_NegativeResponseCodeType, direction=OUT
      error E_NOT_OK: error-code=1
      error DCM_E_PENDING: error-code=10
    DataServices_Read_active_diagnostic_session_Active_diagnostic_session
      operation ReadData: possible-error=[DataServices_Read_active_diagnostic_session_Active_diagnostic_session/E_NOT_OK, DataServices_Read_active_diagnostic_session_Active_diagnostic_session/DCM_E_PENDING]
        arg OpStatus: type=Dcm_OpStatusType, direction=IN
        arg Data: type=Dcm_Data1ByteType, direction=OUT
      operation ConditionCheckRead: possible-error=[DataServices_Read_active_diagnostic_session_Active_diagnostic_session/E_NOT_OK, DataServices_Read_active_diagnostic_session_Active_diagnostic_session/DCM_E_PENDING]
        arg OpStatus: type=Dcm_OpStatusType, direction=IN
        arg ErrorCode: type=Dcm_NegativeResponseCodeType, direction=OUT
      error E_NOT_OK: error-code=1
      error DCM_E_PENDING: error-code=10
    DataServices_Total_Odometer_VCU_Total_Odometer_VCU
      operation ReadData: possible-error=[DataServices_Total_Odometer_VCU_Total_Odometer_VCU/E_NOT_OK, DataServices_Total_Odometer_VCU_Total_Odometer_VCU/DCM_E_PENDING]
        arg OpStatus: type=Dcm_OpStatusType, direction=IN
        arg Data: type=Dcm_Data3ByteType, direction=OUT
      operation ConditionCheckRead: possible-error=[DataServices_Total_Odometer_VCU_Total_Odometer_VCU/E_NOT_OK, DataServices_Total_Odometer_VCU_Total_Odometer_VCU/DCM_E_PENDING]
        arg OpStatus: type=Dcm_OpStatusType, direction=IN
        arg ErrorCode: type=Dcm_NegativeResponseCodeType, direction=OUT
      operation WriteData: possible-error=[DataServices_Total_Odometer_VCU_Total_Odometer_VCU/E_NOT_OK, DataServices_Total_Odometer_VCU_Total_Odometer_VCU/DCM_E_PENDING]
        arg Data: type=Dcm_Data3ByteType, direction=IN
        arg OpStatus: type=Dcm_OpStatusType, direction=IN
        arg ErrorCode: type=Dcm_NegativeResponseCodeType, direction=OUT
      error E_NOT_OK: error-code=1
      error DCM_E_PENDING: error-code=10
    DataServices_VCU_HVStatus_VCU_HVStatus
      operation ReadData: possible-error=[DataServices_VCU_HVStatus_VCU_HVStatus/E_NOT_OK, DataServices_VCU_HVStatus_VCU_HVStatus/DCM_E_PENDING]
        arg OpStatus: type=Dcm_OpStatusType, direction=IN
        arg Data: type=Dcm_Data1ByteType, direction=OUT
      operation ConditionCheckRead: possible-error=[DataServices_VCU_HVStatus_VCU_HVStatus/E_NOT_OK, DataServices_VCU_HVStatus_VCU_HVStatus/DCM_E_PENDING]
        arg OpStatus: type=Dcm_OpStatusType, direction=IN
        arg ErrorCode: type=Dcm_NegativeResponseCodeType, direction=OUT
      error E_NOT_OK: error-code=1
      error DCM_E_PENDING: error-code=10
    DataServices_Vehicle_speed_Vehicle_speed
      operation ReadData: possible-error=[DataServices_Vehicle_speed_Vehicle_speed/E_NOT_OK, DataServices_Vehicle_speed_Vehicle_speed/DCM_E_PENDING]
        arg OpStatus: type=Dcm_OpStatusType, direction=IN
        arg Data: type=Dcm_Data2ByteType, direction=OUT
      operation ConditionCheckRead: possible-error=[DataServices_Vehicle_speed_Vehicle_speed/E_NOT_OK, DataServices_Vehicle_speed_Vehicle_speed/DCM_E_PENDING]
        arg OpStatus: type=Dcm_OpStatusType, direction=IN
        arg ErrorCode: type=Dcm_NegativeResponseCodeType, direction=OUT
      error E_NOT_OK: error-code=1
      error DCM_E_PENDING: error-code=10
    DataServices_Read_ECU_manufacturing_date_ECU_Manufacturing_Date_Day
      operation ReadData: possible-error=[DataServices_Read_ECU_manufacturing_date_ECU_Manufacturing_Date_Day/E_NOT_OK, DataServices_Read_ECU_manufacturing_date_ECU_Manufacturing_Date_Day/DCM_E_PENDING]
        arg OpStatus: type=Dcm_OpStatusType, direction=IN
        arg Data: type=Dcm_Data1ByteType, direction=OUT
      operation ConditionCheckRead: possible-error=[DataServices_Read_ECU_manufacturing_date_ECU_Manufacturing_Date_Day/E_NOT_OK, DataServices_Read_ECU_manufacturing_date_ECU_Manufacturing_Date_Day/DCM_E_PENDING]
        arg OpStatus: type=Dcm_OpStatusType, direction=IN
        arg ErrorCode: type=Dcm_NegativeResponseCodeType, direction=OUT
      error E_NOT_OK: error-code=1
      error DCM_E_PENDING: error-code=10
    DataServices_Read_ECU_manufacturing_date_ECU_Manufacturing_Date_Month
      operation ReadData: possible-error=[DataServices_Read_ECU_manufacturing_date_ECU_Manufacturing_Date_Month/E_NOT_OK, DataServices_Read_ECU_manufacturing_date_ECU_Manufacturing_Date_Month/DCM_E_PENDING]
        arg OpStatus: type=Dcm_OpStatusType, direction=IN
        arg Data: type=Dcm_Data1ByteType, direction=OUT
      operation ConditionCheckRead: possible-error=[DataServices_Read_ECU_manufacturing_date_ECU_Manufacturing_Date_Month/E_NOT_OK, DataServices_Read_ECU_manufacturing_date_ECU_Manufacturing_Date_Month/DCM_E_PENDING]
        arg OpStatus: type=Dcm_OpStatusType, direction=IN
        arg ErrorCode: type=Dcm_NegativeResponseCodeType, direction=OUT
      error E_NOT_OK: error-code=1
      error DCM_E_PENDING: error-code=10
    DataServices_Read_ECU_manufacturing_date_ECU_Manufacturing_Date_Year
      operation ReadData: possible-error=[DataServices_Read_ECU_manufacturing_date_ECU_Manufacturing_Date_Year/E_NOT_OK, DataServices_Read_ECU_manufacturing_date_ECU_Manufacturing_Date_Year/DCM_E_PENDING]
        arg OpStatus: type=Dcm_OpStatusType, direction=IN
        arg Data: type=Dcm_Data1ByteType, direction=OUT
      operation ConditionCheckRead: possible-error=[DataServices_Read_ECU_manufacturing_date_ECU_Manufacturing_Date_Year/E_NOT_OK, DataServices_Read_ECU_manufacturing_date_ECU_Manufacturing_Date_Year/DCM_E_PENDING]
        arg OpStatus: type=Dcm_OpStatusType, direction=IN
        arg ErrorCode: type=Dcm_NegativeResponseCodeType, direction=OUT
      error E_NOT_OK: error-code=1
      error DCM_E_PENDING: error-code=10
    DataServices_HV_Status_and_Charging_Status_HV_status_and_charging_status
      operation ReadData: possible-error=[DataServices_HV_Status_and_Charging_Status_HV_status_and_charging_status/E_NOT_OK, DataServices_HV_Status_and_Charging_Status_HV_status_and_charging_status/DCM_E_PENDING]
        arg OpStatus: type=Dcm_OpStatusType, direction=IN
        arg Data: type=Dcm_Data1ByteType, direction=OUT
      operation ConditionCheckRead: possible-error=[DataServices_HV_Status_and_Charging_Status_HV_status_and_charging_status/E_NOT_OK, DataServices_HV_Status_and_Charging_Status_HV_status_and_charging_status/DCM_E_PENDING]
        arg OpStatus: type=Dcm_OpStatusType, direction=IN
        arg ErrorCode: type=Dcm_NegativeResponseCodeType, direction=OUT
      error E_NOT_OK: error-code=1
      error DCM_E_PENDING: error-code=10
    DataServices_SOC_SOC
      operation ReadData: possible-error=[DataServices_SOC_SOC/E_NOT_OK, DataServices_SOC_SOC/DCM_E_PENDING]
        arg OpStatus: type=Dcm_OpStatusType, direction=IN
        arg Data: type=Dcm_Data2ByteType, direction=OUT
      operation ConditionCheckRead: possible-error=[DataServices_SOC_SOC/E_NOT_OK, DataServices_SOC_SOC/DCM_E_PENDING]
        arg OpStatus: type=Dcm_OpStatusType, direction=IN
        arg ErrorCode: type=Dcm_NegativeResponseCodeType, direction=OUT
      error E_NOT_OK: error-code=1
      error DCM_E_PENDING: error-code=10
    DataServices_Supplier_ECU_hardware_part_number_Major_release
      operation ReadData: possible-error=[DataServices_Supplier_ECU_hardware_part_number_Major_release/E_NOT_OK, DataServices_Supplier_ECU_hardware_part_number_Major_release/DCM_E_PENDING]
        arg OpStatus: type=Dcm_OpStatusType, direction=IN
        arg Data: type=Dcm_Data1ByteType, direction=OUT
      operation ConditionCheckRead: possible-error=[DataServices_Supplier_ECU_hardware_part_number_Major_release/E_NOT_OK, DataServices_Supplier_ECU_hardware_part_number_Major_release/DCM_E_PENDING]
        arg OpStatus: type=Dcm_OpStatusType, direction=IN
        arg ErrorCode: type=Dcm_NegativeResponseCodeType, direction=OUT
      error E_NOT_OK: error-code=1
      error DCM_E_PENDING: error-code=10
    DataServices_Supplier_ECU_hardware_part_number_Changes_in_electronic_components_level
      operation ReadData: possible-error=[DataServices_Supplier_ECU_hardware_part_number_Changes_in_electronic_components_level/E_NOT_OK, DataServices_Supplier_ECU_hardware_part_number_Changes_in_electronic_components_level/DCM_E_PENDING]
        arg OpStatus: type=Dcm_OpStatusType, direction=IN
        arg Data: type=Dcm_Data1ByteType, direction=OUT
      operation ConditionCheckRead: possible-error=[DataServices_Supplier_ECU_hardware_part_number_Changes_in_electronic_components_level/E_NOT_OK, DataServices_Supplier_ECU_hardware_part_number_Changes_in_electronic_components_level/DCM_E_PENDING]
        arg OpStatus: type=Dcm_OpStatusType, direction=IN
        arg ErrorCode: type=Dcm_NegativeResponseCodeType, direction=OUT
      error E_NOT_OK: error-code=1
      error DCM_E_PENDING: error-code=10
    DataServices_Write_Level4_OEM_Key_OEM_Key_Value
      operation WriteData: possible-error=[DataServices_Write_Level4_OEM_Key_OEM_Key_Value/E_NOT_OK, DataServices_Write_Level4_OEM_Key_OEM_Key_Value/DCM_E_PENDING]
        arg Data: type=Dcm_Data16ByteType, direction=IN
        arg OpStatus: type=Dcm_OpStatusType, direction=IN
        arg ErrorCode: type=Dcm_NegativeResponseCodeType, direction=OUT
      error E_NOT_OK: error-code=1
      error DCM_E_PENDING: error-code=10
    DataServices_Write_Level4_OEM_Key_CRC
      operation WriteData: possible-error=[DataServices_Write_Level4_OEM_Key_CRC/E_NOT_OK, DataServices_Write_Level4_OEM_Key_CRC/DCM_E_PENDING]
        arg Data: type=Dcm_Data1ByteType, direction=IN
        arg OpStatus: type=Dcm_OpStatusType, direction=IN
        arg ErrorCode: type=Dcm_NegativeResponseCodeType, direction=OUT
      error E_NOT_OK: error-code=1
      error DCM_E_PENDING: error-code=10
    DataServices_VCU_AccPealparameter_VCU_AccelerationPedal
      operation ReadData: possible-error=[DataServices_VCU_AccPealparameter_VCU_AccelerationPedal/E_NOT_OK, DataServices_VCU_AccPealparameter_VCU_AccelerationPedal/DCM_E_PENDING]
        arg OpStatus: type=Dcm_OpStatusType, direction=IN
        arg Data: type=Dcm_Data2ByteType, direction=OUT
      operation ConditionCheckRead: possible-error=[DataServices_VCU_AccPealparameter_VCU_AccelerationPedal/E_NOT_OK, DataServices_VCU_AccPealparameter_VCU_AccelerationPedal/DCM_E_PENDING]
        arg OpStatus: type=Dcm_OpStatusType, direction=IN
        arg ErrorCode: type=Dcm_NegativeResponseCodeType, direction=OUT
      error E_NOT_OK: error-code=1
      error DCM_E_PENDING: error-code=10
    DataServices_VCU_AccPealparameter_Accelerator_pedal_sensor_2_voltage
      operation ReadData: possible-error=[DataServices_VCU_AccPealparameter_Accelerator_pedal_sensor_2_voltage/E_NOT_OK, DataServices_VCU_AccPealparameter_Accelerator_pedal_sensor_2_voltage/DCM_E_PENDING]
        arg OpStatus: type=Dcm_OpStatusType, direction=IN
        arg Data: type=Dcm_Data2ByteType, direction=OUT
      operation ConditionCheckRead: possible-error=[DataServices_VCU_AccPealparameter_Accelerator_pedal_sensor_2_voltage/E_NOT_OK, DataServices_VCU_AccPealparameter_Accelerator_pedal_sensor_2_voltage/DCM_E_PENDING]
        arg OpStatus: type=Dcm_OpStatusType, direction=IN
        arg ErrorCode: type=Dcm_NegativeResponseCodeType, direction=OUT
      error E_NOT_OK: error-code=1
      error DCM_E_PENDING: error-code=10
    DataServices_VCU_AccPealparameter_Accelerator_pedal_sensor_1_voltage
      operation ReadData: possible-error=[DataServices_VCU_AccPealparameter_Accelerator_pedal_sensor_1_voltage/E_NOT_OK, DataServices_VCU_AccPealparameter_Accelerator_pedal_sensor_1_voltage/DCM_E_PENDING]
        arg OpStatus: type=Dcm_OpStatusType, direction=IN
        arg Data: type=Dcm_Data2ByteType, direction=OUT
      operation ConditionCheckRead: possible-error=[DataServices_VCU_AccPealparameter_Accelerator_pedal_sensor_1_voltage/E_NOT_OK, DataServices_VCU_AccPealparameter_Accelerator_pedal_sensor_1_voltage/DCM_E_PENDING]
        arg OpStatus: type=Dcm_OpStatusType, direction=IN
        arg ErrorCode: type=Dcm_NegativeResponseCodeType, direction=OUT
      error E_NOT_OK: error-code=1
      error DCM_E_PENDING: error-code=10
    DataServices_VCU_AccPealparameter_VCU_VehicleSpeed
      operation ReadData: possible-error=[DataServices_VCU_AccPealparameter_VCU_VehicleSpeed/E_NOT_OK, DataServices_VCU_AccPealparameter_VCU_VehicleSpeed/DCM_E_PENDING]
        arg OpStatus: type=Dcm_OpStatusType, direction=IN
        arg Data: type=Dcm_Data2ByteType, direction=OUT
      operation ConditionCheckRead: possible-error=[DataServices_VCU_AccPealparameter_VCU_VehicleSpeed/E_NOT_OK, DataServices_VCU_AccPealparameter_VCU_VehicleSpeed/DCM_E_PENDING]
        arg OpStatus: type=Dcm_OpStatusType, direction=IN
        arg ErrorCode: type=Dcm_NegativeResponseCodeType, direction=OUT
      error E_NOT_OK: error-code=1
      error DCM_E_PENDING: error-code=10
    DataServices_HV_part_work_mode_HV_part_work_mode1
      operation ReadData: possible-error=[DataServices_HV_part_work_mode_HV_part_work_mode1/E_NOT_OK, DataServices_HV_part_work_mode_HV_part_work_mode1/DCM_E_PENDING]
        arg OpStatus: type=Dcm_OpStatusType, direction=IN
        arg Data: type=Dcm_Data1ByteType, direction=OUT
      operation ConditionCheckRead: possible-error=[DataServices_HV_part_work_mode_HV_part_work_mode1/E_NOT_OK, DataServices_HV_part_work_mode_HV_part_work_mode1/DCM_E_PENDING]
        arg OpStatus: type=Dcm_OpStatusType, direction=IN
        arg ErrorCode: type=Dcm_NegativeResponseCodeType, direction=OUT
      error E_NOT_OK: error-code=1
      error DCM_E_PENDING: error-code=10
    DataServices_HV_part_work_mode_HV_part_work_mode2
      operation ReadData: possible-error=[DataServices_HV_part_work_mode_HV_part_work_mode2/E_NOT_OK, DataServices_HV_part_work_mode_HV_part_work_mode2/DCM_E_PENDING]
        arg OpStatus: type=Dcm_OpStatusType, direction=IN
        arg Data: type=Dcm_Data1ByteType, direction=OUT
      operation ConditionCheckRead: possible-error=[DataServices_HV_part_work_mode_HV_part_work_mode2/E_NOT_OK, DataServices_HV_part_work_mode_HV_part_work_mode2/DCM_E_PENDING]
        arg OpStatus: type=Dcm_OpStatusType, direction=IN
        arg ErrorCode: type=Dcm_NegativeResponseCodeType, direction=OUT
      error E_NOT_OK: error-code=1
      error DCM_E_PENDING: error-code=10
    DataServices_Bootloader_version_number_Major_release
      operation ReadData: possible-error=[DataServices_Bootloader_version_number_Major_release/E_NOT_OK, DataServices_Bootloader_version_number_Major_release/DCM_E_PENDING]
        arg OpStatus: type=Dcm_OpStatusType, direction=IN
        arg Data: type=Dcm_Data1ByteType, direction=OUT
      operation ConditionCheckRead: possible-error=[DataServices_Bootloader_version_number_Major_release/E_NOT_OK, DataServices_Bootloader_version_number_Major_release/DCM_E_PENDING]
        arg OpStatus: type=Dcm_OpStatusType, direction=IN
        arg ErrorCode: type=Dcm_NegativeResponseCodeType, direction=OUT
      error E_NOT_OK: error-code=1
      error DCM_E_PENDING: error-code=10
    DataServices_Bootloader_version_number_Minor_release
      operation ReadData: possible-error=[DataServices_Bootloader_version_number_Minor_release/E_NOT_OK, DataServices_Bootloader_version_number_Minor_release/DCM_E_PENDING]
        arg OpStatus: type=Dcm_OpStatusType, direction=IN
        arg Data: type=Dcm_Data1ByteType, direction=OUT
      operation ConditionCheckRead: possible-error=[DataServices_Bootloader_version_number_Minor_release/E_NOT_OK, DataServices_Bootloader_version_number_Minor_release/DCM_E_PENDING]
        arg OpStatus: type=Dcm_OpStatusType, direction=IN
        arg ErrorCode: type=Dcm_NegativeResponseCodeType, direction=OUT
      error E_NOT_OK: error-code=1
      error DCM_E_PENDING: error-code=10
    DataServices_Bootloader_version_number_No_functional_content_change
      operation ReadData: possible-error=[DataServices_Bootloader_version_number_No_functional_content_change/E_NOT_OK, DataServices_Bootloader_version_number_No_functional_content_change/DCM_E_PENDING]
        arg OpStatus: type=Dcm_OpStatusType, direction=IN
        arg Data: type=Dcm_Data1ByteType, direction=OUT
      operation ConditionCheckRead: possible-error=[DataServices_Bootloader_version_number_No_functional_content_change/E_NOT_OK, DataServices_Bootloader_version_number_No_functional_content_change/DCM_E_PENDING]
        arg OpStatus: type=Dcm_OpStatusType, direction=IN
        arg ErrorCode: type=Dcm_NegativeResponseCodeType, direction=OUT
      error E_NOT_OK: error-code=1
      error DCM_E_PENDING: error-code=10
    DataServices_Read_Level1_OEM_Key_written_status_Read_Level1_OEM_Key_rewrite_counter
      operation ReadData: possible-error=[DataServices_Read_Level1_OEM_Key_written_status_Read_Level1_OEM_Key_rewrite_counter/E_NOT_OK, DataServices_Read_Level1_OEM_Key_written_status_Read_Level1_OEM_Key_rewrite_counter/DCM_E_PENDING]
        arg OpStatus: type=Dcm_OpStatusType, direction=IN
        arg Data: type=Dcm_Data1ByteType, direction=OUT
      operation ConditionCheckRead: possible-error=[DataServices_Read_Level1_OEM_Key_written_status_Read_Level1_OEM_Key_rewrite_counter/E_NOT_OK, DataServices_Read_Level1_OEM_Key_written_status_Read_Level1_OEM_Key_rewrite_counter/DCM_E_PENDING]
        arg OpStatus: type=Dcm_OpStatusType, direction=IN
        arg ErrorCode: type=Dcm_NegativeResponseCodeType, direction=OUT
      error E_NOT_OK: error-code=1
      error DCM_E_PENDING: error-code=10
    DataServices_Coding_for_CDS_fingerprint_codingDate_byte_3_DD
      operation ReadData: possible-error=[DataServices_Coding_for_CDS_fingerprint_codingDate_byte_3_DD/E_NOT_OK, DataServices_Coding_for_CDS_fingerprint_codingDate_byte_3_DD/DCM_E_PENDING]
        arg OpStatus: type=Dcm_OpStatusType, direction=IN
        arg Data: type=Dcm_Data1ByteType, direction=OUT
      operation ConditionCheckRead: possible-error=[DataServices_Coding_for_CDS_fingerprint_codingDate_byte_3_DD/E_NOT_OK, DataServices_Coding_for_CDS_fingerprint_codingDate_byte_3_DD/DCM_E_PENDING]
        arg OpStatus: type=Dcm_OpStatusType, direction=IN
        arg ErrorCode: type=Dcm_NegativeResponseCodeType, direction=OUT
      operation WriteData: possible-error=[DataServices_Coding_for_CDS_fingerprint_codingDate_byte_3_DD/E_NOT_OK, DataServices_Coding_for_CDS_fingerprint_codingDate_byte_3_DD/DCM_E_PENDING]
        arg Data: type=Dcm_Data1ByteType, direction=IN
        arg OpStatus: type=Dcm_OpStatusType, direction=IN
        arg ErrorCode: type=Dcm_NegativeResponseCodeType, direction=OUT
      error E_NOT_OK: error-code=1
      error DCM_E_PENDING: error-code=10
    DataServices_Coding_for_CDS_fingerprint_codingDate_byte_2_MM
      operation ReadData: possible-error=[DataServices_Coding_for_CDS_fingerprint_codingDate_byte_2_MM/E_NOT_OK, DataServices_Coding_for_CDS_fingerprint_codingDate_byte_2_MM/DCM_E_PENDING]
        arg OpStatus: type=Dcm_OpStatusType, direction=IN
        arg Data: type=Dcm_Data1ByteType, direction=OUT
      operation ConditionCheckRead: possible-error=[DataServices_Coding_for_CDS_fingerprint_codingDate_byte_2_MM/E_NOT_OK, DataServices_Coding_for_CDS_fingerprint_codingDate_byte_2_MM/DCM_E_PENDING]
        arg OpStatus: type=Dcm_OpStatusType, direction=IN
        arg ErrorCode: type=Dcm_NegativeResponseCodeType, direction=OUT
      operation WriteData: possible-error=[DataServices_Coding_for_CDS_fingerprint_codingDate_byte_2_MM/E_NOT_OK, DataServices_Coding_for_CDS_fingerprint_codingDate_byte_2_MM/DCM_E_PENDING]
        arg Data: type=Dcm_Data1ByteType, direction=IN
        arg OpStatus: type=Dcm_OpStatusType, direction=IN
        arg ErrorCode: type=Dcm_NegativeResponseCodeType, direction=OUT
      error E_NOT_OK: error-code=1
      error DCM_E_PENDING: error-code=10
    DataServices_Coding_for_CDS_fingerprint_codingDate_byte_1_YY
      operation ReadData: possible-error=[DataServices_Coding_for_CDS_fingerprint_codingDate_byte_1_YY/E_NOT_OK, DataServices_Coding_for_CDS_fingerprint_codingDate_byte_1_YY/DCM_E_PENDING]
        arg OpStatus: type=Dcm_OpStatusType, direction=IN
        arg Data: type=Dcm_Data1ByteType, direction=OUT
      operation ConditionCheckRead: possible-error=[DataServices_Coding_for_CDS_fingerprint_codingDate_byte_1_YY/E_NOT_OK, DataServices_Coding_for_CDS_fingerprint_codingDate_byte_1_YY/DCM_E_PENDING]
        arg OpStatus: type=Dcm_OpStatusType, direction=IN
        arg ErrorCode: type=Dcm_NegativeResponseCodeType, direction=OUT
      operation WriteData: possible-error=[DataServices_Coding_for_CDS_fingerprint_codingDate_byte_1_YY/E_NOT_OK, DataServices_Coding_for_CDS_fingerprint_codingDate_byte_1_YY/DCM_E_PENDING]
        arg Data: type=Dcm_Data1ByteType, direction=IN
        arg OpStatus: type=Dcm_OpStatusType, direction=IN
        arg ErrorCode: type=Dcm_NegativeResponseCodeType, direction=OUT
      error E_NOT_OK: error-code=1
      error DCM_E_PENDING: error-code=10
    DataServices_Coding_for_CDS_fingerprint_repairShopCodeorTesterSerialNumber_byte_1_27_MSB
      operation ReadData: possible-error=[DataServices_Coding_for_CDS_fingerprint_repairShopCodeorTesterSerialNumber_byte_1_27_MSB/E_NOT_OK, DataServices_Coding_for_CDS_fingerprint_repairShopCodeorTesterSerialNumber_byte_1_27_MSB/DCM_E_PENDING]
        arg OpStatus: type=Dcm_OpStatusType, direction=IN
        arg Data: type=Dcm_Data27ByteType, direction=OUT
      operation ConditionCheckRead: possible-error=[DataServices_Coding_for_CDS_fingerprint_repairShopCodeorTesterSerialNumber_byte_1_27_MSB/E_NOT_OK, DataServices_Coding_for_CDS_fingerprint_repairShopCodeorTesterSerialNumber_byte_1_27_MSB/DCM_E_PENDING]
        arg OpStatus: type=Dcm_OpStatusType, direction=IN
        arg ErrorCode: type=Dcm_NegativeResponseCodeType, direction=OUT
      operation WriteData: possible-error=[DataServices_Coding_for_CDS_fingerprint_repairShopCodeorTesterSerialNumber_byte_1_27_MSB/E_NOT_OK, DataServices_Coding_for_CDS_fingerprint_repairShopCodeorTesterSerialNumber_byte_1_27_MSB/DCM_E_PENDING]
        arg Data: type=Dcm_Data27ByteType, direction=IN
        arg OpStatus: type=Dcm_OpStatusType, direction=IN
        arg ErrorCode: type=Dcm_NegativeResponseCodeType, direction=OUT
      error E_NOT_OK: error-code=1
      error DCM_E_PENDING: error-code=10
    DataServices_VCU_control_main_relay_Mainrealy1
      operation ReadData: possible-error=[DataServices_VCU_control_main_relay_Mainrealy1/E_NOT_OK, DataServices_VCU_control_main_relay_Mainrealy1/DCM_E_PENDING]
        arg OpStatus: type=Dcm_OpStatusType, direction=IN
        arg Data: type=Dcm_Data1ByteType, direction=OUT
      operation ConditionCheckRead: possible-error=[DataServices_VCU_control_main_relay_Mainrealy1/E_NOT_OK, DataServices_VCU_control_main_relay_Mainrealy1/DCM_E_PENDING]
        arg OpStatus: type=Dcm_OpStatusType, direction=IN
        arg ErrorCode: type=Dcm_NegativeResponseCodeType, direction=OUT
      error E_NOT_OK: error-code=1
      error DCM_E_PENDING: error-code=10
    DataServices_VCU_control_main_relay_Mainrelay2
      operation ReadData: possible-error=[DataServices_VCU_control_main_relay_Mainrelay2/E_NOT_OK, DataServices_VCU_control_main_relay_Mainrelay2/DCM_E_PENDING]
        arg OpStatus: type=Dcm_OpStatusType, direction=IN
        arg Data: type=Dcm_Data1ByteType, direction=OUT
      operation ConditionCheckRead: possible-error=[DataServices_VCU_control_main_relay_Mainrelay2/E_NOT_OK, DataServices_VCU_control_main_relay_Mainrelay2/DCM_E_PENDING]
        arg OpStatus: type=Dcm_OpStatusType, direction=IN
        arg ErrorCode: type=Dcm_NegativeResponseCodeType, direction=OUT
      error E_NOT_OK: error-code=1
      error DCM_E_PENDING: error-code=10
    DataServices_VCU_control_S2_status_New_Bit_Field
      operation ReadData: possible-error=[DataServices_VCU_control_S2_status_New_Bit_Field/E_NOT_OK, DataServices_VCU_control_S2_status_New_Bit_Field/DCM_E_PENDING]
        arg OpStatus: type=Dcm_OpStatusType, direction=IN
        arg Data: type=Dcm_Data1ByteType, direction=OUT
      operation ConditionCheckRead: possible-error=[DataServices_VCU_control_S2_status_New_Bit_Field/E_NOT_OK, DataServices_VCU_control_S2_status_New_Bit_Field/DCM_E_PENDING]
        arg OpStatus: type=Dcm_OpStatusType, direction=IN
        arg ErrorCode: type=Dcm_NegativeResponseCodeType, direction=OUT
      error E_NOT_OK: error-code=1
      error DCM_E_PENDING: error-code=10
    DataServices_Electronic_lock_state_Electronic_lock_state
      operation ReadData: possible-error=[DataServices_Electronic_lock_state_Electronic_lock_state/E_NOT_OK, DataServices_Electronic_lock_state_Electronic_lock_state/DCM_E_PENDING]
        arg OpStatus: type=Dcm_OpStatusType, direction=IN
        arg Data: type=Dcm_Data1ByteType, direction=OUT
      operation ConditionCheckRead: possible-error=[DataServices_Electronic_lock_state_Electronic_lock_state/E_NOT_OK, DataServices_Electronic_lock_state_Electronic_lock_state/DCM_E_PENDING]
        arg OpStatus: type=Dcm_OpStatusType, direction=IN
        arg ErrorCode: type=Dcm_NegativeResponseCodeType, direction=OUT
      error E_NOT_OK: error-code=1
      error DCM_E_PENDING: error-code=10
    DataServices_DC_Charging_port_Temperature_POD_DCInletTempA
      operation ReadData: possible-error=[DataServices_DC_Charging_port_Temperature_POD_DCInletTempA/E_NOT_OK, DataServices_DC_Charging_port_Temperature_POD_DCInletTempA/DCM_E_PENDING]
        arg OpStatus: type=Dcm_OpStatusType, direction=IN
        arg Data: type=Dcm_Data1ByteType, direction=OUT
      operation ConditionCheckRead: possible-error=[DataServices_DC_Charging_port_Temperature_POD_DCInletTempA/E_NOT_OK, DataServices_DC_Charging_port_Temperature_POD_DCInletTempA/DCM_E_PENDING]
        arg OpStatus: type=Dcm_OpStatusType, direction=IN
        arg ErrorCode: type=Dcm_NegativeResponseCodeType, direction=OUT
      error E_NOT_OK: error-code=1
      error DCM_E_PENDING: error-code=10
    DataServices_DC_Charging_port_Temperature_POD_DCInletTempB
      operation ReadData: possible-error=[DataServices_DC_Charging_port_Temperature_POD_DCInletTempB/E_NOT_OK, DataServices_DC_Charging_port_Temperature_POD_DCInletTempB/DCM_E_PENDING]
        arg OpStatus: type=Dcm_OpStatusType, direction=IN
        arg Data: type=Dcm_Data1ByteType, direction=OUT
      operation ConditionCheckRead: possible-error=[DataServices_DC_Charging_port_Temperature_POD_DCInletTempB/E_NOT_OK, DataServices_DC_Charging_port_Temperature_POD_DCInletTempB/DCM_E_PENDING]
        arg OpStatus: type=Dcm_OpStatusType, direction=IN
        arg ErrorCode: type=Dcm_NegativeResponseCodeType, direction=OUT
      error E_NOT_OK: error-code=1
      error DCM_E_PENDING: error-code=10
    DataServices_Total_Odometer_Total_Odometer
      operation ReadData: possible-error=[DataServices_Total_Odometer_Total_Odometer/E_NOT_OK, DataServices_Total_Odometer_Total_Odometer/DCM_E_PENDING]
        arg OpStatus: type=Dcm_OpStatusType, direction=IN
        arg Data: type=Dcm_Data3ByteType, direction=OUT
      operation ConditionCheckRead: possible-error=[DataServices_Total_Odometer_Total_Odometer/E_NOT_OK, DataServices_Total_Odometer_Total_Odometer/DCM_E_PENDING]
        arg OpStatus: type=Dcm_OpStatusType, direction=IN
        arg ErrorCode: type=Dcm_NegativeResponseCodeType, direction=OUT
      error E_NOT_OK: error-code=1
      error DCM_E_PENDING: error-code=10
    DataServices_VCU_HV_InterLock_PWM_pfrequency_VCU_HVIL
      operation ReadData: possible-error=[DataServices_VCU_HV_InterLock_PWM_pfrequency_VCU_HVIL/E_NOT_OK, DataServices_VCU_HV_InterLock_PWM_pfrequency_VCU_HVIL/DCM_E_PENDING]
        arg OpStatus: type=Dcm_OpStatusType, direction=IN
        arg Data: type=Dcm_Data1ByteType, direction=OUT
      operation ConditionCheckRead: possible-error=[DataServices_VCU_HV_InterLock_PWM_pfrequency_VCU_HVIL/E_NOT_OK, DataServices_VCU_HV_InterLock_PWM_pfrequency_VCU_HVIL/DCM_E_PENDING]
        arg OpStatus: type=Dcm_OpStatusType, direction=IN
        arg ErrorCode: type=Dcm_NegativeResponseCodeType, direction=OUT
      error E_NOT_OK: error-code=1
      error DCM_E_PENDING: error-code=10
    DataServices_PWT_vehicle_fault_PWT_ErrorLevel1
      operation ReadData: possible-error=[DataServices_PWT_vehicle_fault_PWT_ErrorLevel1/E_NOT_OK, DataServices_PWT_vehicle_fault_PWT_ErrorLevel1/DCM_E_PENDING]
        arg OpStatus: type=Dcm_OpStatusType, direction=IN
        arg Data: type=Dcm_Data1ByteType, direction=OUT
      operation ConditionCheckRead: possible-error=[DataServices_PWT_vehicle_fault_PWT_ErrorLevel1/E_NOT_OK, DataServices_PWT_vehicle_fault_PWT_ErrorLevel1/DCM_E_PENDING]
        arg OpStatus: type=Dcm_OpStatusType, direction=IN
        arg ErrorCode: type=Dcm_NegativeResponseCodeType, direction=OUT
      error E_NOT_OK: error-code=1
      error DCM_E_PENDING: error-code=10
    DataServices_PWT_vehicle_fault_PWT_ErrorLevel2
      operation ReadData: possible-error=[DataServices_PWT_vehicle_fault_PWT_ErrorLevel2/E_NOT_OK, DataServices_PWT_vehicle_fault_PWT_ErrorLevel2/DCM_E_PENDING]
        arg OpStatus: type=Dcm_OpStatusType, direction=IN
        arg Data: type=Dcm_Data1ByteType, direction=OUT
      operation ConditionCheckRead: possible-error=[DataServices_PWT_vehicle_fault_PWT_ErrorLevel2/E_NOT_OK, DataServices_PWT_vehicle_fault_PWT_ErrorLevel2/DCM_E_PENDING]
        arg OpStatus: type=Dcm_OpStatusType, direction=IN
        arg ErrorCode: type=Dcm_NegativeResponseCodeType, direction=OUT
      error E_NOT_OK: error-code=1
      error DCM_E_PENDING: error-code=10
    DataServices_PWT_vehicle_fault_PWT_ErrorLevel3
      operation ReadData: possible-error=[DataServices_PWT_vehicle_fault_PWT_ErrorLevel3/E_NOT_OK, DataServices_PWT_vehicle_fault_PWT_ErrorLevel3/DCM_E_PENDING]
        arg OpStatus: type=Dcm_OpStatusType, direction=IN
        arg Data: type=Dcm_Data1ByteType, direction=OUT
      operation ConditionCheckRead: possible-error=[DataServices_PWT_vehicle_fault_PWT_ErrorLevel3/E_NOT_OK, DataServices_PWT_vehicle_fault_PWT_ErrorLevel3/DCM_E_PENDING]
        arg OpStatus: type=Dcm_OpStatusType, direction=IN
        arg ErrorCode: type=Dcm_NegativeResponseCodeType, direction=OUT
      error E_NOT_OK: error-code=1
      error DCM_E_PENDING: error-code=10
    DataServices_VCU_PowerMaxAllowed_parameter1_VCU_DisChgPowerLimit
      operation ReadData: possible-error=[DataServices_VCU_PowerMaxAllowed_parameter1_VCU_DisChgPowerLimit/E_NOT_OK, DataServices_VCU_PowerMaxAllowed_parameter1_VCU_DisChgPowerLimit/DCM_E_PENDING]
        arg OpStatus: type=Dcm_OpStatusType, direction=IN
        arg Data: type=Dcm_Data1ByteType, direction=OUT
      operation ConditionCheckRead: possible-error=[DataServices_VCU_PowerMaxAllowed_parameter1_VCU_DisChgPowerLimit/E_NOT_OK, DataServices_VCU_PowerMaxAllowed_parameter1_VCU_DisChgPowerLimit/DCM_E_PENDING]
        arg OpStatus: type=Dcm_OpStatusType, direction=IN
        arg ErrorCode: type=Dcm_NegativeResponseCodeType, direction=OUT
      error E_NOT_OK: error-code=1
      error DCM_E_PENDING: error-code=10
    DataServices_VCU_PowerMaxAllowed_parameter1_VCU_TCUPowerAllowed
      operation ReadData: possible-error=[DataServices_VCU_PowerMaxAllowed_parameter1_VCU_TCUPowerAllowed/E_NOT_OK, DataServices_VCU_PowerMaxAllowed_parameter1_VCU_TCUPowerAllowed/DCM_E_PENDING]
        arg OpStatus: type=Dcm_OpStatusType, direction=IN
        arg Data: type=Dcm_Data2ByteType, direction=OUT
      operation ConditionCheckRead: possible-error=[DataServices_VCU_PowerMaxAllowed_parameter1_VCU_TCUPowerAllowed/E_NOT_OK, DataServices_VCU_PowerMaxAllowed_parameter1_VCU_TCUPowerAllowed/DCM_E_PENDING]
        arg OpStatus: type=Dcm_OpStatusType, direction=IN
        arg ErrorCode: type=Dcm_NegativeResponseCodeType, direction=OUT
      error E_NOT_OK: error-code=1
      error DCM_E_PENDING: error-code=10
    DataServices_VCU_PowerMaxAllowed_parameter1_VCU_DCDCPowerLimit
      operation ReadData: possible-error=[DataServices_VCU_PowerMaxAllowed_parameter1_VCU_DCDCPowerLimit/E_NOT_OK, DataServices_VCU_PowerMaxAllowed_parameter1_VCU_DCDCPowerLimit/DCM_E_PENDING]
        arg OpStatus: type=Dcm_OpStatusType, direction=IN
        arg Data: type=Dcm_Data1ByteType, direction=OUT
      operation ConditionCheckRead: possible-error=[DataServices_VCU_PowerMaxAllowed_parameter1_VCU_DCDCPowerLimit/E_NOT_OK, DataServices_VCU_PowerMaxAllowed_parameter1_VCU_DCDCPowerLimit/DCM_E_PENDING]
        arg OpStatus: type=Dcm_OpStatusType, direction=IN
        arg ErrorCode: type=Dcm_NegativeResponseCodeType, direction=OUT
      error E_NOT_OK: error-code=1
      error DCM_E_PENDING: error-code=10
    DataServices_VCU_PowerMaxAllowed_parameter1_MCUPowerLimit
      operation ReadData: possible-error=[DataServices_VCU_PowerMaxAllowed_parameter1_MCUPowerLimit/E_NOT_OK, DataServices_VCU_PowerMaxAllowed_parameter1_MCUPowerLimit/DCM_E_PENDING]
        arg OpStatus: type=Dcm_OpStatusType, direction=IN
        arg Data: type=Dcm_Data2ByteType, direction=OUT
      operation ConditionCheckRead: possible-error=[DataServices_VCU_PowerMaxAllowed_parameter1_MCUPowerLimit/E_NOT_OK, DataServices_VCU_PowerMaxAllowed_parameter1_MCUPowerLimit/DCM_E_PENDING]
        arg OpStatus: type=Dcm_OpStatusType, direction=IN
        arg ErrorCode: type=Dcm_NegativeResponseCodeType, direction=OUT
      error E_NOT_OK: error-code=1
      error DCM_E_PENDING: error-code=10
    DataServices_VCU_PowerMaxAllowed_parameter2_BMSChgPowerLimit
      operation ReadData: possible-error=[DataServices_VCU_PowerMaxAllowed_parameter2_BMSChgPowerLimit/E_NOT_OK, DataServices_VCU_PowerMaxAllowed_parameter2_BMSChgPowerLimit/DCM_E_PENDING]
        arg OpStatus: type=Dcm_OpStatusType, direction=IN
        arg Data: type=Dcm_Data2ByteType, direction=OUT
      operation ConditionCheckRead: possible-error=[DataServices_VCU_PowerMaxAllowed_parameter2_BMSChgPowerLimit/E_NOT_OK, DataServices_VCU_PowerMaxAllowed_parameter2_BMSChgPowerLimit/DCM_E_PENDING]
        arg OpStatus: type=Dcm_OpStatusType, direction=IN
        arg ErrorCode: type=Dcm_NegativeResponseCodeType, direction=OUT
      error E_NOT_OK: error-code=1
      error DCM_E_PENDING: error-code=10
    DataServices_VCU_PowerMaxAllowed_parameter2_MCUFeedbackPowerLimit
      operation ReadData: possible-error=[DataServices_VCU_PowerMaxAllowed_parameter2_MCUFeedbackPowerLimit/E_NOT_OK, DataServices_VCU_PowerMaxAllowed_parameter2_MCUFeedbackPowerLimit/DCM_E_PENDING]
        arg OpStatus: type=Dcm_OpStatusType, direction=IN
        arg Data: type=Dcm_Data2ByteType, direction=OUT
      operation ConditionCheckRead: possible-error=[DataServices_VCU_PowerMaxAllowed_parameter2_MCUFeedbackPowerLimit/E_NOT_OK, DataServices_VCU_PowerMaxAllowed_parameter2_MCUFeedbackPowerLimit/DCM_E_PENDING]
        arg OpStatus: type=Dcm_OpStatusType, direction=IN
        arg ErrorCode: type=Dcm_NegativeResponseCodeType, direction=OUT
      error E_NOT_OK: error-code=1
      error DCM_E_PENDING: error-code=10
    DataServices_VCU_PowerMaxAllowed_parameter2_BMSDisChgPowerLimit
      operation ReadData: possible-error=[DataServices_VCU_PowerMaxAllowed_parameter2_BMSDisChgPowerLimit/E_NOT_OK, DataServices_VCU_PowerMaxAllowed_parameter2_BMSDisChgPowerLimit/DCM_E_PENDING]
        arg OpStatus: type=Dcm_OpStatusType, direction=IN
        arg Data: type=Dcm_Data2ByteType, direction=OUT
      operation ConditionCheckRead: possible-error=[DataServices_VCU_PowerMaxAllowed_parameter2_BMSDisChgPowerLimit/E_NOT_OK, DataServices_VCU_PowerMaxAllowed_parameter2_BMSDisChgPowerLimit/DCM_E_PENDING]
        arg OpStatus: type=Dcm_OpStatusType, direction=IN
        arg ErrorCode: type=Dcm_NegativeResponseCodeType, direction=OUT
      error E_NOT_OK: error-code=1
      error DCM_E_PENDING: error-code=10
    DataServices_VCU_PowerMaxAllowed_parameter3_ACSystemPower
      operation ReadData: possible-error=[DataServices_VCU_PowerMaxAllowed_parameter3_ACSystemPower/E_NOT_OK, DataServices_VCU_PowerMaxAllowed_parameter3_ACSystemPower/DCM_E_PENDING]
        arg OpStatus: type=Dcm_OpStatusType, direction=IN
        arg Data: type=Dcm_Data1ByteType, direction=OUT
      operation ConditionCheckRead: possible-error=[DataServices_VCU_PowerMaxAllowed_parameter3_ACSystemPower/E_NOT_OK, DataServices_VCU_PowerMaxAllowed_parameter3_ACSystemPower/DCM_E_PENDING]
        arg OpStatus: type=Dcm_OpStatusType, direction=IN
        arg ErrorCode: type=Dcm_NegativeResponseCodeType, direction=OUT
      error E_NOT_OK: error-code=1
      error DCM_E_PENDING: error-code=10
    DataServices_VCU_PowerMaxAllowed_parameter3_V2LPower
      operation ReadData: possible-error=[DataServices_VCU_PowerMaxAllowed_parameter3_V2LPower/E_NOT_OK, DataServices_VCU_PowerMaxAllowed_parameter3_V2LPower/DCM_E_PENDING]
        arg OpStatus: type=Dcm_OpStatusType, direction=IN
        arg Data: type=Dcm_Data1ByteType, direction=OUT
      operation ConditionCheckRead: possible-error=[DataServices_VCU_PowerMaxAllowed_parameter3_V2LPower/E_NOT_OK, DataServices_VCU_PowerMaxAllowed_parameter3_V2LPower/DCM_E_PENDING]
        arg OpStatus: type=Dcm_OpStatusType, direction=IN
        arg ErrorCode: type=Dcm_NegativeResponseCodeType, direction=OUT
      error E_NOT_OK: error-code=1
      error DCM_E_PENDING: error-code=10
    DataServices_VCU_PowerMaxAllowed_parameter3_PackPTCPower
      operation ReadData: possible-error=[DataServices_VCU_PowerMaxAllowed_parameter3_PackPTCPower/E_NOT_OK, DataServices_VCU_PowerMaxAllowed_parameter3_PackPTCPower/DCM_E_PENDING]
        arg OpStatus: type=Dcm_OpStatusType, direction=IN
        arg Data: type=Dcm_Data1ByteType, direction=OUT
      operation ConditionCheckRead: possible-error=[DataServices_VCU_PowerMaxAllowed_parameter3_PackPTCPower/E_NOT_OK, DataServices_VCU_PowerMaxAllowed_parameter3_PackPTCPower/DCM_E_PENDING]
        arg OpStatus: type=Dcm_OpStatusType, direction=IN
        arg ErrorCode: type=Dcm_NegativeResponseCodeType, direction=OUT
      error E_NOT_OK: error-code=1
      error DCM_E_PENDING: error-code=10
    DataServices_VCU_PowerMaxAllowed_parameter3_MCUPower
      operation ReadData: possible-error=[DataServices_VCU_PowerMaxAllowed_parameter3_MCUPower/E_NOT_OK, DataServices_VCU_PowerMaxAllowed_parameter3_MCUPower/DCM_E_PENDING]
        arg OpStatus: type=Dcm_OpStatusType, direction=IN
        arg Data: type=Dcm_Data1ByteType, direction=OUT
      operation ConditionCheckRead: possible-error=[DataServices_VCU_PowerMaxAllowed_parameter3_MCUPower/E_NOT_OK, DataServices_VCU_PowerMaxAllowed_parameter3_MCUPower/DCM_E_PENDING]
        arg OpStatus: type=Dcm_OpStatusType, direction=IN
        arg ErrorCode: type=Dcm_NegativeResponseCodeType, direction=OUT
      error E_NOT_OK: error-code=1
      error DCM_E_PENDING: error-code=10
    DataServices_VCU_PowerMaxAllowed_parameter3_DCDCPower
      operation ReadData: possible-error=[DataServices_VCU_PowerMaxAllowed_parameter3_DCDCPower/E_NOT_OK, DataServices_VCU_PowerMaxAllowed_parameter3_DCDCPower/DCM_E_PENDING]
        arg OpStatus: type=Dcm_OpStatusType, direction=IN
        arg Data: type=Dcm_Data1ByteType, direction=OUT
      operation ConditionCheckRead: possible-error=[DataServices_VCU_PowerMaxAllowed_parameter3_DCDCPower/E_NOT_OK, DataServices_VCU_PowerMaxAllowed_parameter3_DCDCPower/DCM_E_PENDING]
        arg OpStatus: type=Dcm_OpStatusType, direction=IN
        arg ErrorCode: type=Dcm_NegativeResponseCodeType, direction=OUT
      error E_NOT_OK: error-code=1
      error DCM_E_PENDING: error-code=10
    DataServices_Gear_Gear
      operation ReadData: possible-error=[DataServices_Gear_Gear/E_NOT_OK, DataServices_Gear_Gear/DCM_E_PENDING]
        arg OpStatus: type=Dcm_OpStatusType, direction=IN
        arg Data: type=Dcm_Data1ByteType, direction=OUT
      operation ConditionCheckRead: possible-error=[DataServices_Gear_Gear/E_NOT_OK, DataServices_Gear_Gear/DCM_E_PENDING]
        arg OpStatus: type=Dcm_OpStatusType, direction=IN
        arg ErrorCode: type=Dcm_NegativeResponseCodeType, direction=OUT
      error E_NOT_OK: error-code=1
      error DCM_E_PENDING: error-code=10
    DataServices_Chargestatus_Chargestatus
      operation ReadData: possible-error=[DataServices_Chargestatus_Chargestatus/E_NOT_OK, DataServices_Chargestatus_Chargestatus/DCM_E_PENDING]
        arg OpStatus: type=Dcm_OpStatusType, direction=IN
        arg Data: type=Dcm_Data1ByteType, direction=OUT
      operation ConditionCheckRead: possible-error=[DataServices_Chargestatus_Chargestatus/E_NOT_OK, DataServices_Chargestatus_Chargestatus/DCM_E_PENDING]
        arg OpStatus: type=Dcm_OpStatusType, direction=IN
        arg ErrorCode: type=Dcm_NegativeResponseCodeType, direction=OUT
      error E_NOT_OK: error-code=1
      error DCM_E_PENDING: error-code=10
    DataServices_Read_Level2_OEM_Key_written_status_Read_Level2_OEM_Key_rewrite_counter
      operation ReadData: possible-error=[DataServices_Read_Level2_OEM_Key_written_status_Read_Level2_OEM_Key_rewrite_counter/E_NOT_OK, DataServices_Read_Level2_OEM_Key_written_status_Read_Level2_OEM_Key_rewrite_counter/DCM_E_PENDING]
        arg OpStatus: type=Dcm_OpStatusType, direction=IN
        arg Data: type=Dcm_Data1ByteType, direction=OUT
      operation ConditionCheckRead: possible-error=[DataServices_Read_Level2_OEM_Key_written_status_Read_Level2_OEM_Key_rewrite_counter/E_NOT_OK, DataServices_Read_Level2_OEM_Key_written_status_Read_Level2_OEM_Key_rewrite_counter/DCM_E_PENDING]
        arg OpStatus: type=Dcm_OpStatusType, direction=IN
        arg ErrorCode: type=Dcm_NegativeResponseCodeType, direction=OUT
      error E_NOT_OK: error-code=1
      error DCM_E_PENDING: error-code=10
    DataServices_Vehicle_State_Ignition_Switch_Signal
      operation ReadData: possible-error=[DataServices_Vehicle_State_Ignition_Switch_Signal/E_NOT_OK, DataServices_Vehicle_State_Ignition_Switch_Signal/DCM_E_PENDING]
        arg OpStatus: type=Dcm_OpStatusType, direction=IN
        arg Data: type=Dcm_Data1ByteType, direction=OUT
      operation ConditionCheckRead: possible-error=[DataServices_Vehicle_State_Ignition_Switch_Signal/E_NOT_OK, DataServices_Vehicle_State_Ignition_Switch_Signal/DCM_E_PENDING]
        arg OpStatus: type=Dcm_OpStatusType, direction=IN
        arg ErrorCode: type=Dcm_NegativeResponseCodeType, direction=OUT
      error E_NOT_OK: error-code=1
      error DCM_E_PENDING: error-code=10
    DataServices_Read_ECU_Part_Number_Specific_Vehicle_Code_WMI
      operation ReadData: possible-error=[DataServices_Read_ECU_Part_Number_Specific_Vehicle_Code_WMI/E_NOT_OK, DataServices_Read_ECU_Part_Number_Specific_Vehicle_Code_WMI/DCM_E_PENDING]
        arg OpStatus: type=Dcm_OpStatusType, direction=IN
        arg Data: type=Dcm_Data6ByteType, direction=OUT
      operation ConditionCheckRead: possible-error=[DataServices_Read_ECU_Part_Number_Specific_Vehicle_Code_WMI/E_NOT_OK, DataServices_Read_ECU_Part_Number_Specific_Vehicle_Code_WMI/DCM_E_PENDING]
        arg OpStatus: type=Dcm_OpStatusType, direction=IN
        arg ErrorCode: type=Dcm_NegativeResponseCodeType, direction=OUT
      error E_NOT_OK: error-code=1
      error DCM_E_PENDING: error-code=10
    DataServices_Read_ECU_Part_Number_Detail_Code
      operation ReadData: possible-error=[DataServices_Read_ECU_Part_Number_Detail_Code/E_NOT_OK, DataServices_Read_ECU_Part_Number_Detail_Code/DCM_E_PENDING]
        arg OpStatus: type=Dcm_OpStatusType, direction=IN
        arg Data: type=Dcm_Data3ByteType, direction=OUT
      operation ConditionCheckRead: possible-error=[DataServices_Read_ECU_Part_Number_Detail_Code/E_NOT_OK, DataServices_Read_ECU_Part_Number_Detail_Code/DCM_E_PENDING]
        arg OpStatus: type=Dcm_OpStatusType, direction=IN
        arg ErrorCode: type=Dcm_NegativeResponseCodeType, direction=OUT
      error E_NOT_OK: error-code=1
      error DCM_E_PENDING: error-code=10
    DataServices_Read_ECU_Part_Number_Execution_Package
      operation ReadData: possible-error=[DataServices_Read_ECU_Part_Number_Execution_Package/E_NOT_OK, DataServices_Read_ECU_Part_Number_Execution_Package/DCM_E_PENDING]
        arg OpStatus: type=Dcm_OpStatusType, direction=IN
        arg Data: type=Dcm_Data2ByteType, direction=OUT
      operation ConditionCheckRead: possible-error=[DataServices_Read_ECU_Part_Number_Execution_Package/E_NOT_OK, DataServices_Read_ECU_Part_Number_Execution_Package/DCM_E_PENDING]
        arg OpStatus: type=Dcm_OpStatusType, direction=IN
        arg ErrorCode: type=Dcm_NegativeResponseCodeType, direction=OUT
      error E_NOT_OK: error-code=1
      error DCM_E_PENDING: error-code=10
    DataServices_Read_ECU_Part_Number_Subgroup
      operation ReadData: possible-error=[DataServices_Read_ECU_Part_Number_Subgroup/E_NOT_OK, DataServices_Read_ECU_Part_Number_Subgroup/DCM_E_PENDING]
        arg OpStatus: type=Dcm_OpStatusType, direction=IN
        arg Data: type=Dcm_Data2ByteType, direction=OUT
      operation ConditionCheckRead: possible-error=[DataServices_Read_ECU_Part_Number_Subgroup/E_NOT_OK, DataServices_Read_ECU_Part_Number_Subgroup/DCM_E_PENDING]
        arg OpStatus: type=Dcm_OpStatusType, direction=IN
        arg ErrorCode: type=Dcm_NegativeResponseCodeType, direction=OUT
      error E_NOT_OK: error-code=1
      error DCM_E_PENDING: error-code=10
    DataServices_Read_ECU_Part_Number_Group
      operation ReadData: possible-error=[DataServices_Read_ECU_Part_Number_Group/E_NOT_OK, DataServices_Read_ECU_Part_Number_Group/DCM_E_PENDING]
        arg OpStatus: type=Dcm_OpStatusType, direction=IN
        arg Data: type=Dcm_Data2ByteType, direction=OUT
      operation ConditionCheckRead: possible-error=[DataServices_Read_ECU_Part_Number_Group/E_NOT_OK, DataServices_Read_ECU_Part_Number_Group/DCM_E_PENDING]
        arg OpStatus: type=Dcm_OpStatusType, direction=IN
        arg ErrorCode: type=Dcm_NegativeResponseCodeType, direction=OUT
      error E_NOT_OK: error-code=1
      error DCM_E_PENDING: error-code=10
    DataServices_Write_Level2_OEM_Key_OEM_Key_Value
      operation WriteData: possible-error=[DataServices_Write_Level2_OEM_Key_OEM_Key_Value/E_NOT_OK, DataServices_Write_Level2_OEM_Key_OEM_Key_Value/DCM_E_PENDING]
        arg Data: type=Dcm_Data16ByteType, direction=IN
        arg OpStatus: type=Dcm_OpStatusType, direction=IN
        arg ErrorCode: type=Dcm_NegativeResponseCodeType, direction=OUT
      error E_NOT_OK: error-code=1
      error DCM_E_PENDING: error-code=10
    DataServices_Write_Level2_OEM_Key_CRC
      operation WriteData: possible-error=[DataServices_Write_Level2_OEM_Key_CRC/E_NOT_OK, DataServices_Write_Level2_OEM_Key_CRC/DCM_E_PENDING]
        arg Data: type=Dcm_Data1ByteType, direction=IN
        arg OpStatus: type=Dcm_OpStatusType, direction=IN
        arg ErrorCode: type=Dcm_NegativeResponseCodeType, direction=OUT
      error E_NOT_OK: error-code=1
      error DCM_E_PENDING: error-code=10
    DataServices_BSW_version_number_Major_release
      operation ReadData: possible-error=[DataServices_BSW_version_number_Major_release/E_NOT_OK, DataServices_BSW_version_number_Major_release/DCM_E_PENDING]
        arg OpStatus: type=Dcm_OpStatusType, direction=IN
        arg Data: type=Dcm_Data1ByteType, direction=OUT
      operation ConditionCheckRead: possible-error=[DataServices_BSW_version_number_Major_release/E_NOT_OK, DataServices_BSW_version_number_Major_release/DCM_E_PENDING]
        arg OpStatus: type=Dcm_OpStatusType, direction=IN
        arg ErrorCode: type=Dcm_NegativeResponseCodeType, direction=OUT
      error E_NOT_OK: error-code=1
      error DCM_E_PENDING: error-code=10
    DataServices_BSW_version_number_Minor_release
      operation ReadData: possible-error=[DataServices_BSW_version_number_Minor_release/E_NOT_OK, DataServices_BSW_version_number_Minor_release/DCM_E_PENDING]
        arg OpStatus: type=Dcm_OpStatusType, direction=IN
        arg Data: type=Dcm_Data1ByteType, direction=OUT
      operation ConditionCheckRead: possible-error=[DataServices_BSW_version_number_Minor_release/E_NOT_OK, DataServices_BSW_version_number_Minor_release/DCM_E_PENDING]
        arg OpStatus: type=Dcm_OpStatusType, direction=IN
        arg ErrorCode: type=Dcm_NegativeResponseCodeType, direction=OUT
      error E_NOT_OK: error-code=1
      error DCM_E_PENDING: error-code=10
    DataServices_BSW_version_number_No_functional_content_change
      operation ReadData: possible-error=[DataServices_BSW_version_number_No_functional_content_change/E_NOT_OK, DataServices_BSW_version_number_No_functional_content_change/DCM_E_PENDING]
        arg OpStatus: type=Dcm_OpStatusType, direction=IN
        arg Data: type=Dcm_Data1ByteType, direction=OUT
      operation ConditionCheckRead: possible-error=[DataServices_BSW_version_number_No_functional_content_change/E_NOT_OK, DataServices_BSW_version_number_No_functional_content_change/DCM_E_PENDING]
        arg OpStatus: type=Dcm_OpStatusType, direction=IN
        arg ErrorCode: type=Dcm_NegativeResponseCodeType, direction=OUT
      error E_NOT_OK: error-code=1
      error DCM_E_PENDING: error-code=10
    DataServices_Read_Vehicle_Security_related_events_Brute_Force_UDS_0x27_servic_Event_occurance_time_Year_1
      operation ReadData: possible-error=[DataServices_Read_Vehicle_Security_related_events_Brute_Force_UDS_0x27_servic_Event_occurance_time_Year_1/E_NOT_OK, DataServices_Read_Vehicle_Security_related_events_Brute_Force_UDS_0x27_servic_Event_occurance_time_Year_1/DCM_E_PENDING]
        arg OpStatus: type=Dcm_OpStatusType, direction=IN
        arg Data: type=Dcm_Data1ByteType, direction=OUT
      operation ConditionCheckRead: possible-error=[DataServices_Read_Vehicle_Security_related_events_Brute_Force_UDS_0x27_servic_Event_occurance_time_Year_1/E_NOT_OK, DataServices_Read_Vehicle_Security_related_events_Brute_Force_UDS_0x27_servic_Event_occurance_time_Year_1/DCM_E_PENDING]
        arg OpStatus: type=Dcm_OpStatusType, direction=IN
        arg ErrorCode: type=Dcm_NegativeResponseCodeType, direction=OUT
      error E_NOT_OK: error-code=1
      error DCM_E_PENDING: error-code=10
    DataServices_Read_Vehicle_Security_related_events_Brute_Force_UDS_0x27_servic_Brute_Force_UDS_0x27_service_Event_occurr_0DEE2FAA
      operation ReadData: possible-error=[DataServices_Read_Vehicle_Security_related_events_Brute_Force_UDS_0x27_servic_Brute_Force_UDS_0x27_service_Event_occurr_0DEE2FAA/E_NOT_OK, DataServices_Read_Vehicle_Security_related_events_Brute_Force_UDS_0x27_servic_Brute_Force_UDS_0x27_service_Event_occurr_0DEE2FAA/DCM_E_PENDING]
        arg OpStatus: type=Dcm_OpStatusType, direction=IN
        arg Data: type=Dcm_Data2ByteType, direction=OUT
      operation ConditionCheckRead: possible-error=[DataServices_Read_Vehicle_Security_related_events_Brute_Force_UDS_0x27_servic_Brute_Force_UDS_0x27_service_Event_occurr_0DEE2FAA/E_NOT_OK, DataServices_Read_Vehicle_Security_related_events_Brute_Force_UDS_0x27_servic_Brute_Force_UDS_0x27_service_Event_occurr_0DEE2FAA/DCM_E_PENDING]
        arg OpStatus: type=Dcm_OpStatusType, direction=IN
        arg ErrorCode: type=Dcm_NegativeResponseCodeType, direction=OUT
      error E_NOT_OK: error-code=1
      error DCM_E_PENDING: error-code=10
    DataServices_Read_Vehicle_Security_related_events_Brute_Force_UDS_0x27_servic_Event_occurance_time_Day_1
      operation ReadData: possible-error=[DataServices_Read_Vehicle_Security_related_events_Brute_Force_UDS_0x27_servic_Event_occurance_time_Day_1/E_NOT_OK, DataServices_Read_Vehicle_Security_related_events_Brute_Force_UDS_0x27_servic_Event_occurance_time_Day_1/DCM_E_PENDING]
        arg OpStatus: type=Dcm_OpStatusType, direction=IN
        arg Data: type=Dcm_Data1ByteType, direction=OUT
      operation ConditionCheckRead: possible-error=[DataServices_Read_Vehicle_Security_related_events_Brute_Force_UDS_0x27_servic_Event_occurance_time_Day_1/E_NOT_OK, DataServices_Read_Vehicle_Security_related_events_Brute_Force_UDS_0x27_servic_Event_occurance_time_Day_1/DCM_E_PENDING]
        arg OpStatus: type=Dcm_OpStatusType, direction=IN
        arg ErrorCode: type=Dcm_NegativeResponseCodeType, direction=OUT
      error E_NOT_OK: error-code=1
      error DCM_E_PENDING: error-code=10
    DataServices_Read_Vehicle_Security_related_events_Brute_Force_UDS_0x27_servic_Event_occurance_time_Day_2
      operation ReadData: possible-error=[DataServices_Read_Vehicle_Security_related_events_Brute_Force_UDS_0x27_servic_Event_occurance_time_Day_2/E_NOT_OK, DataServices_Read_Vehicle_Security_related_events_Brute_Force_UDS_0x27_servic_Event_occurance_time_Day_2/DCM_E_PENDING]
        arg OpStatus: type=Dcm_OpStatusType, direction=IN
        arg Data: type=Dcm_Data1ByteType, direction=OUT
      operation ConditionCheckRead: possible-error=[DataServices_Read_Vehicle_Security_related_events_Brute_Force_UDS_0x27_servic_Event_occurance_time_Day_2/E_NOT_OK, DataServices_Read_Vehicle_Security_related_events_Brute_Force_UDS_0x27_servic_Event_occurance_time_Day_2/DCM_E_PENDING]
        arg OpStatus: type=Dcm_OpStatusType, direction=IN
        arg ErrorCode: type=Dcm_NegativeResponseCodeType, direction=OUT
      error E_NOT_OK: error-code=1
      error DCM_E_PENDING: error-code=10
    DataServices_Read_Vehicle_Security_related_events_Brute_Force_UDS_0x27_servic_Brute_Force_UDS_0x27_service_4
      operation ReadData: possible-error=[DataServices_Read_Vehicle_Security_related_events_Brute_Force_UDS_0x27_servic_Brute_Force_UDS_0x27_service_4/E_NOT_OK, DataServices_Read_Vehicle_Security_related_events_Brute_Force_UDS_0x27_servic_Brute_Force_UDS_0x27_service_4/DCM_E_PENDING]
        arg OpStatus: type=Dcm_OpStatusType, direction=IN
        arg Data: type=Dcm_Data1ByteType, direction=OUT
      operation ConditionCheckRead: possible-error=[DataServices_Read_Vehicle_Security_related_events_Brute_Force_UDS_0x27_servic_Brute_Force_UDS_0x27_service_4/E_NOT_OK, DataServices_Read_Vehicle_Security_related_events_Brute_Force_UDS_0x27_servic_Brute_Force_UDS_0x27_service_4/DCM_E_PENDING]
        arg OpStatus: type=Dcm_OpStatusType, direction=IN
        arg ErrorCode: type=Dcm_NegativeResponseCodeType, direction=OUT
      error E_NOT_OK: error-code=1
      error DCM_E_PENDING: error-code=10
    DataServices_Read_Vehicle_Security_related_events_Brute_Force_UDS_0x27_servic_Event_occurance_time_Day_3
      operation ReadData: possible-error=[DataServices_Read_Vehicle_Security_related_events_Brute_Force_UDS_0x27_servic_Event_occurance_time_Day_3/E_NOT_OK, DataServices_Read_Vehicle_Security_related_events_Brute_Force_UDS_0x27_servic_Event_occurance_time_Day_3/DCM_E_PENDING]
        arg OpStatus: type=Dcm_OpStatusType, direction=IN
        arg Data: type=Dcm_Data1ByteType, direction=OUT
      operation ConditionCheckRead: possible-error=[DataServices_Read_Vehicle_Security_related_events_Brute_Force_UDS_0x27_servic_Event_occurance_time_Day_3/E_NOT_OK, DataServices_Read_Vehicle_Security_related_events_Brute_Force_UDS_0x27_servic_Event_occurance_time_Day_3/DCM_E_PENDING]
        arg OpStatus: type=Dcm_OpStatusType, direction=IN
        arg ErrorCode: type=Dcm_NegativeResponseCodeType, direction=OUT
      error E_NOT_OK: error-code=1
      error DCM_E_PENDING: error-code=10
    DataServices_Read_Vehicle_Security_related_events_Brute_Force_UDS_0x27_servic_Event_occurance_time_Day_4
      operation ReadData: possible-error=[DataServices_Read_Vehicle_Security_related_events_Brute_Force_UDS_0x27_servic_Event_occurance_time_Day_4/E_NOT_OK, DataServices_Read_Vehicle_Security_related_events_Brute_Force_UDS_0x27_servic_Event_occurance_time_Day_4/DCM_E_PENDING]
        arg OpStatus: type=Dcm_OpStatusType, direction=IN
        arg Data: type=Dcm_Data1ByteType, direction=OUT
      operation ConditionCheckRead: possible-error=[DataServices_Read_Vehicle_Security_related_events_Brute_Force_UDS_0x27_servic_Event_occurance_time_Day_4/E_NOT_OK, DataServices_Read_Vehicle_Security_related_events_Brute_Force_UDS_0x27_servic_Event_occurance_time_Day_4/DCM_E_PENDING]
        arg OpStatus: type=Dcm_OpStatusType, direction=IN
        arg ErrorCode: type=Dcm_NegativeResponseCodeType, direction=OUT
      error E_NOT_OK: error-code=1
      error DCM_E_PENDING: error-code=10
    DataServices_Read_Vehicle_Security_related_events_Brute_Force_UDS_0x27_servic_Brute_Force_UDS_0x27_service_3
      operation ReadData: possible-error=[DataServices_Read_Vehicle_Security_related_events_Brute_Force_UDS_0x27_servic_Brute_Force_UDS_0x27_service_3/E_NOT_OK, DataServices_Read_Vehicle_Security_related_events_Brute_Force_UDS_0x27_servic_Brute_Force_UDS_0x27_service_3/DCM_E_PENDING]
        arg OpStatus: type=Dcm_OpStatusType, direction=IN
        arg Data: type=Dcm_Data1ByteType, direction=OUT
      operation ConditionCheckRead: possible-error=[DataServices_Read_Vehicle_Security_related_events_Brute_Force_UDS_0x27_servic_Brute_Force_UDS_0x27_service_3/E_NOT_OK, DataServices_Read_Vehicle_Security_related_events_Brute_Force_UDS_0x27_servic_Brute_Force_UDS_0x27_service_3/DCM_E_PENDING]
        arg OpStatus: type=Dcm_OpStatusType, direction=IN
        arg ErrorCode: type=Dcm_NegativeResponseCodeType, direction=OUT
      error E_NOT_OK: error-code=1
      error DCM_E_PENDING: error-code=10
    DataServices_Read_Vehicle_Security_related_events_Brute_Force_UDS_0x27_servic_Event_occurance_time_Day_5
      operation ReadData: possible-error=[DataServices_Read_Vehicle_Security_related_events_Brute_Force_UDS_0x27_servic_Event_occurance_time_Day_5/E_NOT_OK, DataServices_Read_Vehicle_Security_related_events_Brute_Force_UDS_0x27_servic_Event_occurance_time_Day_5/DCM_E_PENDING]
        arg OpStatus: type=Dcm_OpStatusType, direction=IN
        arg Data: type=Dcm_Data1ByteType, direction=OUT
      operation ConditionCheckRead: possible-error=[DataServices_Read_Vehicle_Security_related_events_Brute_Force_UDS_0x27_servic_Event_occurance_time_Day_5/E_NOT_OK, DataServices_Read_Vehicle_Security_related_events_Brute_Force_UDS_0x27_servic_Event_occurance_time_Day_5/DCM_E_PENDING]
        arg OpStatus: type=Dcm_OpStatusType, direction=IN
        arg ErrorCode: type=Dcm_NegativeResponseCodeType, direction=OUT
      error E_NOT_OK: error-code=1
      error DCM_E_PENDING: error-code=10
    DataServices_Read_Vehicle_Security_related_events_Brute_Force_UDS_0x27_servic_Event_occurance_time_Month_2
      operation ReadData: possible-error=[DataServices_Read_Vehicle_Security_related_events_Brute_Force_UDS_0x27_servic_Event_occurance_time_Month_2/E_NOT_OK, DataServices_Read_Vehicle_Security_related_events_Brute_Force_UDS_0x27_servic_Event_occurance_time_Month_2/DCM_E_PENDING]
        arg OpStatus: type=Dcm_OpStatusType, direction=IN
        arg Data: type=Dcm_Data1ByteType, direction=OUT
      operation ConditionCheckRead: possible-error=[DataServices_Read_Vehicle_Security_related_events_Brute_Force_UDS_0x27_servic_Event_occurance_time_Month_2/E_NOT_OK, DataServices_Read_Vehicle_Security_related_events_Brute_Force_UDS_0x27_servic_Event_occurance_time_Month_2/DCM_E_PENDING]
        arg OpStatus: type=Dcm_OpStatusType, direction=IN
        arg ErrorCode: type=Dcm_NegativeResponseCodeType, direction=OUT
      error E_NOT_OK: error-code=1
      error DCM_E_PENDING: error-code=10
    DataServices_Read_Vehicle_Security_related_events_Brute_Force_UDS_0x27_servic_Brute_Force_UDS_0x27_service_5
      operation ReadData: possible-error=[DataServices_Read_Vehicle_Security_related_events_Brute_Force_UDS_0x27_servic_Brute_Force_UDS_0x27_service_5/E_NOT_OK, DataServices_Read_Vehicle_Security_related_events_Brute_Force_UDS_0x27_servic_Brute_Force_UDS_0x27_service_5/DCM_E_PENDING]
        arg OpStatus: type=Dcm_OpStatusType, direction=IN
        arg Data: type=Dcm_Data1ByteType, direction=OUT
      operation ConditionCheckRead: possible-error=[DataServices_Read_Vehicle_Security_related_events_Brute_Force_UDS_0x27_servic_Brute_Force_UDS_0x27_service_5/E_NOT_OK, DataServices_Read_Vehicle_Security_related_events_Brute_Force_UDS_0x27_servic_Brute_Force_UDS_0x27_service_5/DCM_E_PENDING]
        arg OpStatus: type=Dcm_OpStatusType, direction=IN
        arg ErrorCode: type=Dcm_NegativeResponseCodeType, direction=OUT
      error E_NOT_OK: error-code=1
      error DCM_E_PENDING: error-code=10
    DataServices_Read_Vehicle_Security_related_events_Brute_Force_UDS_0x27_servic_Event_occurance_time_Month_1
      operation ReadData: possible-error=[DataServices_Read_Vehicle_Security_related_events_Brute_Force_UDS_0x27_servic_Event_occurance_time_Month_1/E_NOT_OK, DataServices_Read_Vehicle_Security_related_events_Brute_Force_UDS_0x27_servic_Event_occurance_time_Month_1/DCM_E_PENDING]
        arg OpStatus: type=Dcm_OpStatusType, direction=IN
        arg Data: type=Dcm_Data1ByteType, direction=OUT
      operation ConditionCheckRead: possible-error=[DataServices_Read_Vehicle_Security_related_events_Brute_Force_UDS_0x27_servic_Event_occurance_time_Month_1/E_NOT_OK, DataServices_Read_Vehicle_Security_related_events_Brute_Force_UDS_0x27_servic_Event_occurance_time_Month_1/DCM_E_PENDING]
        arg OpStatus: type=Dcm_OpStatusType, direction=IN
        arg ErrorCode: type=Dcm_NegativeResponseCodeType, direction=OUT
      error E_NOT_OK: error-code=1
      error DCM_E_PENDING: error-code=10
    DataServices_Read_Vehicle_Security_related_events_Brute_Force_UDS_0x27_servic_Event_occurance_time_Month_4
      operation ReadData: possible-error=[DataServices_Read_Vehicle_Security_related_events_Brute_Force_UDS_0x27_servic_Event_occurance_time_Month_4/E_NOT_OK, DataServices_Read_Vehicle_Security_related_events_Brute_Force_UDS_0x27_servic_Event_occurance_time_Month_4/DCM_E_PENDING]
        arg OpStatus: type=Dcm_OpStatusType, direction=IN
        arg Data: type=Dcm_Data1ByteType, direction=OUT
      operation ConditionCheckRead: possible-error=[DataServices_Read_Vehicle_Security_related_events_Brute_Force_UDS_0x27_servic_Event_occurance_time_Month_4/E_NOT_OK, DataServices_Read_Vehicle_Security_related_events_Brute_Force_UDS_0x27_servic_Event_occurance_time_Month_4/DCM_E_PENDING]
        arg OpStatus: type=Dcm_OpStatusType, direction=IN
        arg ErrorCode: type=Dcm_NegativeResponseCodeType, direction=OUT
      error E_NOT_OK: error-code=1
      error DCM_E_PENDING: error-code=10
    DataServices_Read_Vehicle_Security_related_events_Brute_Force_UDS_0x27_servic_Event_occurance_time_Month_3
      operation ReadData: possible-error=[DataServices_Read_Vehicle_Security_related_events_Brute_Force_UDS_0x27_servic_Event_occurance_time_Month_3/E_NOT_OK, DataServices_Read_Vehicle_Security_related_events_Brute_Force_UDS_0x27_servic_Event_occurance_time_Month_3/DCM_E_PENDING]
        arg OpStatus: type=Dcm_OpStatusType, direction=IN
        arg Data: type=Dcm_Data1ByteType, direction=OUT
      operation ConditionCheckRead: possible-error=[DataServices_Read_Vehicle_Security_related_events_Brute_Force_UDS_0x27_servic_Event_occurance_time_Month_3/E_NOT_OK, DataServices_Read_Vehicle_Security_related_events_Brute_Force_UDS_0x27_servic_Event_occurance_time_Month_3/DCM_E_PENDING]
        arg OpStatus: type=Dcm_OpStatusType, direction=IN
        arg ErrorCode: type=Dcm_NegativeResponseCodeType, direction=OUT
      error E_NOT_OK: error-code=1
      error DCM_E_PENDING: error-code=10
    DataServices_Read_Vehicle_Security_related_events_Brute_Force_UDS_0x27_servic_Event_occurance_time_Month_5
      operation ReadData: possible-error=[DataServices_Read_Vehicle_Security_related_events_Brute_Force_UDS_0x27_servic_Event_occurance_time_Month_5/E_NOT_OK, DataServices_Read_Vehicle_Security_related_events_Brute_Force_UDS_0x27_servic_Event_occurance_time_Month_5/DCM_E_PENDING]
        arg OpStatus: type=Dcm_OpStatusType, direction=IN
        arg Data: type=Dcm_Data1ByteType, direction=OUT
      operation ConditionCheckRead: possible-error=[DataServices_Read_Vehicle_Security_related_events_Brute_Force_UDS_0x27_servic_Event_occurance_time_Month_5/E_NOT_OK, DataServices_Read_Vehicle_Security_related_events_Brute_Force_UDS_0x27_servic_Event_occurance_time_Month_5/DCM_E_PENDING]
        arg OpStatus: type=Dcm_OpStatusType, direction=IN
        arg ErrorCode: type=Dcm_NegativeResponseCodeType, direction=OUT
      error E_NOT_OK: error-code=1
      error DCM_E_PENDING: error-code=10
    DataServices_Read_Vehicle_Security_related_events_Brute_Force_UDS_0x27_servic_Event_occurance_time_Year_4
      operation ReadData: possible-error=[DataServices_Read_Vehicle_Security_related_events_Brute_Force_UDS_0x27_servic_Event_occurance_time_Year_4/E_NOT_OK, DataServices_Read_Vehicle_Security_related_events_Brute_Force_UDS_0x27_servic_Event_occurance_time_Year_4/DCM_E_PENDING]
        arg OpStatus: type=Dcm_OpStatusType, direction=IN
        arg Data: type=Dcm_Data1ByteType, direction=OUT
      operation ConditionCheckRead: possible-error=[DataServices_Read_Vehicle_Security_related_events_Brute_Force_UDS_0x27_servic_Event_occurance_time_Year_4/E_NOT_OK, DataServices_Read_Vehicle_Security_related_events_Brute_Force_UDS_0x27_servic_Event_occurance_time_Year_4/DCM_E_PENDING]
        arg OpStatus: type=Dcm_OpStatusType, direction=IN
        arg ErrorCode: type=Dcm_NegativeResponseCodeType, direction=OUT
      error E_NOT_OK: error-code=1
      error DCM_E_PENDING: error-code=10
    DataServices_Read_Vehicle_Security_related_events_Brute_Force_UDS_0x27_servic_Event_occurance_time_Year_5
      operation ReadData: possible-error=[DataServices_Read_Vehicle_Security_related_events_Brute_Force_UDS_0x27_servic_Event_occurance_time_Year_5/E_NOT_OK, DataServices_Read_Vehicle_Security_related_events_Brute_Force_UDS_0x27_servic_Event_occurance_time_Year_5/DCM_E_PENDING]
        arg OpStatus: type=Dcm_OpStatusType, direction=IN
        arg Data: type=Dcm_Data1ByteType, direction=OUT
      operation ConditionCheckRead: possible-error=[DataServices_Read_Vehicle_Security_related_events_Brute_Force_UDS_0x27_servic_Event_occurance_time_Year_5/E_NOT_OK, DataServices_Read_Vehicle_Security_related_events_Brute_Force_UDS_0x27_servic_Event_occurance_time_Year_5/DCM_E_PENDING]
        arg OpStatus: type=Dcm_OpStatusType, direction=IN
        arg ErrorCode: type=Dcm_NegativeResponseCodeType, direction=OUT
      error E_NOT_OK: error-code=1
      error DCM_E_PENDING: error-code=10
    DataServices_Read_Vehicle_Security_related_events_Brute_Force_UDS_0x27_servic_Event_occurance_time_Year_2
      operation ReadData: possible-error=[DataServices_Read_Vehicle_Security_related_events_Brute_Force_UDS_0x27_servic_Event_occurance_time_Year_2/E_NOT_OK, DataServices_Read_Vehicle_Security_related_events_Brute_Force_UDS_0x27_servic_Event_occurance_time_Year_2/DCM_E_PENDING]
        arg OpStatus: type=Dcm_OpStatusType, direction=IN
        arg Data: type=Dcm_Data1ByteType, direction=OUT
      operation ConditionCheckRead: possible-error=[DataServices_Read_Vehicle_Security_related_events_Brute_Force_UDS_0x27_servic_Event_occurance_time_Year_2/E_NOT_OK, DataServices_Read_Vehicle_Security_related_events_Brute_Force_UDS_0x27_servic_Event_occurance_time_Year_2/DCM_E_PENDING]
        arg OpStatus: type=Dcm_OpStatusType, direction=IN
        arg ErrorCode: type=Dcm_NegativeResponseCodeType, direction=OUT
      error E_NOT_OK: error-code=1
      error DCM_E_PENDING: error-code=10
    DataServices_Read_Vehicle_Security_related_events_Brute_Force_UDS_0x27_servic_Event_occurance_time_Year_3
      operation ReadData: possible-error=[DataServices_Read_Vehicle_Security_related_events_Brute_Force_UDS_0x27_servic_Event_occurance_time_Year_3/E_NOT_OK, DataServices_Read_Vehicle_Security_related_events_Brute_Force_UDS_0x27_servic_Event_occurance_time_Year_3/DCM_E_PENDING]
        arg OpStatus: type=Dcm_OpStatusType, direction=IN
        arg Data: type=Dcm_Data1ByteType, direction=OUT
      operation ConditionCheckRead: possible-error=[DataServices_Read_Vehicle_Security_related_events_Brute_Force_UDS_0x27_servic_Event_occurance_time_Year_3/E_NOT_OK, DataServices_Read_Vehicle_Security_related_events_Brute_Force_UDS_0x27_servic_Event_occurance_time_Year_3/DCM_E_PENDING]
        arg OpStatus: type=Dcm_OpStatusType, direction=IN
        arg ErrorCode: type=Dcm_NegativeResponseCodeType, direction=OUT
      error E_NOT_OK: error-code=1
      error DCM_E_PENDING: error-code=10
    DataServices_Read_Vehicle_Security_related_events_Brute_Force_UDS_0x27_servic_Brute_Force_UDS_0x27_service_2
      operation ReadData: possible-error=[DataServices_Read_Vehicle_Security_related_events_Brute_Force_UDS_0x27_servic_Brute_Force_UDS_0x27_service_2/E_NOT_OK, DataServices_Read_Vehicle_Security_related_events_Brute_Force_UDS_0x27_servic_Brute_Force_UDS_0x27_service_2/DCM_E_PENDING]
        arg OpStatus: type=Dcm_OpStatusType, direction=IN
        arg Data: type=Dcm_Data1ByteType, direction=OUT
      operation ConditionCheckRead: possible-error=[DataServices_Read_Vehicle_Security_related_events_Brute_Force_UDS_0x27_servic_Brute_Force_UDS_0x27_service_2/E_NOT_OK, DataServices_Read_Vehicle_Security_related_events_Brute_Force_UDS_0x27_servic_Brute_Force_UDS_0x27_service_2/DCM_E_PENDING]
        arg OpStatus: type=Dcm_OpStatusType, direction=IN
        arg ErrorCode: type=Dcm_NegativeResponseCodeType, direction=OUT
      error E_NOT_OK: error-code=1
      error DCM_E_PENDING: error-code=10
    DataServices_Read_Vehicle_Security_related_events_Brute_Force_UDS_0x27_servic_Brute_Force_UDS_0x27_service_1
      operation ReadData: possible-error=[DataServices_Read_Vehicle_Security_related_events_Brute_Force_UDS_0x27_servic_Brute_Force_UDS_0x27_service_1/E_NOT_OK, DataServices_Read_Vehicle_Security_related_events_Brute_Force_UDS_0x27_servic_Brute_Force_UDS_0x27_service_1/DCM_E_PENDING]
        arg OpStatus: type=Dcm_OpStatusType, direction=IN
        arg Data: type=Dcm_Data1ByteType, direction=OUT
      operation ConditionCheckRead: possible-error=[DataServices_Read_Vehicle_Security_related_events_Brute_Force_UDS_0x27_servic_Brute_Force_UDS_0x27_service_1/E_NOT_OK, DataServices_Read_Vehicle_Security_related_events_Brute_Force_UDS_0x27_servic_Brute_Force_UDS_0x27_service_1/DCM_E_PENDING]
        arg OpStatus: type=Dcm_OpStatusType, direction=IN
        arg ErrorCode: type=Dcm_NegativeResponseCodeType, direction=OUT
      error E_NOT_OK: error-code=1
      error DCM_E_PENDING: error-code=10
    DataServices_Driver_Mode_Driver_Mode
      operation ReadData: possible-error=[DataServices_Driver_Mode_Driver_Mode/E_NOT_OK, DataServices_Driver_Mode_Driver_Mode/DCM_E_PENDING]
        arg OpStatus: type=Dcm_OpStatusType, direction=IN
        arg Data: type=Dcm_Data1ByteType, direction=OUT
      operation ConditionCheckRead: possible-error=[DataServices_Driver_Mode_Driver_Mode/E_NOT_OK, DataServices_Driver_Mode_Driver_Mode/DCM_E_PENDING]
        arg OpStatus: type=Dcm_OpStatusType, direction=IN
        arg ErrorCode: type=Dcm_NegativeResponseCodeType, direction=OUT
      error E_NOT_OK: error-code=1
      error DCM_E_PENDING: error-code=10
    DataServices_Battery_Voltage_Battery_Voltage
      operation ReadData: possible-error=[DataServices_Battery_Voltage_Battery_Voltage/E_NOT_OK, DataServices_Battery_Voltage_Battery_Voltage/DCM_E_PENDING]
        arg OpStatus: type=Dcm_OpStatusType, direction=IN
        arg Data: type=Dcm_Data2ByteType, direction=OUT
      operation ConditionCheckRead: possible-error=[DataServices_Battery_Voltage_Battery_Voltage/E_NOT_OK, DataServices_Battery_Voltage_Battery_Voltage/DCM_E_PENDING]
        arg OpStatus: type=Dcm_OpStatusType, direction=IN
        arg ErrorCode: type=Dcm_NegativeResponseCodeType, direction=OUT
      error E_NOT_OK: error-code=1
      error DCM_E_PENDING: error-code=10
    DataServices_Read_Write_coding_data_string_CDS_CDS_Short_VIN_High_Byte_7
      operation ReadData: possible-error=[DataServices_Read_Write_coding_data_string_CDS_CDS_Short_VIN_High_Byte_7/E_NOT_OK, DataServices_Read_Write_coding_data_string_CDS_CDS_Short_VIN_High_Byte_7/DCM_E_PENDING]
        arg OpStatus: type=Dcm_OpStatusType, direction=IN
        arg Data: type=Dcm_Data1ByteType, direction=OUT
      operation ConditionCheckRead: possible-error=[DataServices_Read_Write_coding_data_string_CDS_CDS_Short_VIN_High_Byte_7/E_NOT_OK, DataServices_Read_Write_coding_data_string_CDS_CDS_Short_VIN_High_Byte_7/DCM_E_PENDING]
        arg OpStatus: type=Dcm_OpStatusType, direction=IN
        arg ErrorCode: type=Dcm_NegativeResponseCodeType, direction=OUT
      operation WriteData: possible-error=[DataServices_Read_Write_coding_data_string_CDS_CDS_Short_VIN_High_Byte_7/E_NOT_OK, DataServices_Read_Write_coding_data_string_CDS_CDS_Short_VIN_High_Byte_7/DCM_E_PENDING]
        arg Data: type=Dcm_Data1ByteType, direction=IN
        arg OpStatus: type=Dcm_OpStatusType, direction=IN
        arg ErrorCode: type=Dcm_NegativeResponseCodeType, direction=OUT
      error E_NOT_OK: error-code=1
      error DCM_E_PENDING: error-code=10
    DataServices_Read_Write_coding_data_string_CDS_CDS_CRC
      operation ReadData: possible-error=[DataServices_Read_Write_coding_data_string_CDS_CDS_CRC/E_NOT_OK, DataServices_Read_Write_coding_data_string_CDS_CDS_CRC/DCM_E_PENDING]
        arg OpStatus: type=Dcm_OpStatusType, direction=IN
        arg Data: type=Dcm_Data1ByteType, direction=OUT
      operation ConditionCheckRead: possible-error=[DataServices_Read_Write_coding_data_string_CDS_CDS_CRC/E_NOT_OK, DataServices_Read_Write_coding_data_string_CDS_CDS_CRC/DCM_E_PENDING]
        arg OpStatus: type=Dcm_OpStatusType, direction=IN
        arg ErrorCode: type=Dcm_NegativeResponseCodeType, direction=OUT
      operation WriteData: possible-error=[DataServices_Read_Write_coding_data_string_CDS_CDS_CRC/E_NOT_OK, DataServices_Read_Write_coding_data_string_CDS_CDS_CRC/DCM_E_PENDING]
        arg Data: type=Dcm_Data1ByteType, direction=IN
        arg OpStatus: type=Dcm_OpStatusType, direction=IN
        arg ErrorCode: type=Dcm_NegativeResponseCodeType, direction=OUT
      error E_NOT_OK: error-code=1
      error DCM_E_PENDING: error-code=10
    DataServices_Read_Write_coding_data_string_CDS_CDS_Format_Byte_High_Byte_0
      operation ReadData: possible-error=[DataServices_Read_Write_coding_data_string_CDS_CDS_Format_Byte_High_Byte_0/E_NOT_OK, DataServices_Read_Write_coding_data_string_CDS_CDS_Format_Byte_High_Byte_0/DCM_E_PENDING]
        arg OpStatus: type=Dcm_OpStatusType, direction=IN
        arg Data: type=Dcm_Data1ByteType, direction=OUT
      operation ConditionCheckRead: possible-error=[DataServices_Read_Write_coding_data_string_CDS_CDS_Format_Byte_High_Byte_0/E_NOT_OK, DataServices_Read_Write_coding_data_string_CDS_CDS_Format_Byte_High_Byte_0/DCM_E_PENDING]
        arg OpStatus: type=Dcm_OpStatusType, direction=IN
        arg ErrorCode: type=Dcm_NegativeResponseCodeType, direction=OUT
      operation WriteData: possible-error=[DataServices_Read_Write_coding_data_string_CDS_CDS_Format_Byte_High_Byte_0/E_NOT_OK, DataServices_Read_Write_coding_data_string_CDS_CDS_Format_Byte_High_Byte_0/DCM_E_PENDING]
        arg Data: type=Dcm_Data1ByteType, direction=IN
        arg OpStatus: type=Dcm_OpStatusType, direction=IN
        arg ErrorCode: type=Dcm_NegativeResponseCodeType, direction=OUT
      error E_NOT_OK: error-code=1
      error DCM_E_PENDING: error-code=10
    DataServices_Read_Write_coding_data_string_CDS_CDS_Format_Byte_High_Byte_1
      operation ReadData: possible-error=[DataServices_Read_Write_coding_data_string_CDS_CDS_Format_Byte_High_Byte_1/E_NOT_OK, DataServices_Read_Write_coding_data_string_CDS_CDS_Format_Byte_High_Byte_1/DCM_E_PENDING]
        arg OpStatus: type=Dcm_OpStatusType, direction=IN
        arg Data: type=Dcm_Data1ByteType, direction=OUT
      operation ConditionCheckRead: possible-error=[DataServices_Read_Write_coding_data_string_CDS_CDS_Format_Byte_High_Byte_1/E_NOT_OK, DataServices_Read_Write_coding_data_string_CDS_CDS_Format_Byte_High_Byte_1/DCM_E_PENDING]
        arg OpStatus: type=Dcm_OpStatusType, direction=IN
        arg ErrorCode: type=Dcm_NegativeResponseCodeType, direction=OUT
      operation WriteData: possible-error=[DataServices_Read_Write_coding_data_string_CDS_CDS_Format_Byte_High_Byte_1/E_NOT_OK, DataServices_Read_Write_coding_data_string_CDS_CDS_Format_Byte_High_Byte_1/DCM_E_PENDING]
        arg Data: type=Dcm_Data1ByteType, direction=IN
        arg OpStatus: type=Dcm_OpStatusType, direction=IN
        arg ErrorCode: type=Dcm_NegativeResponseCodeType, direction=OUT
      error E_NOT_OK: error-code=1
      error DCM_E_PENDING: error-code=10
    DataServices_Read_Write_coding_data_string_CDS_Reserved2
      operation ReadData: possible-error=[DataServices_Read_Write_coding_data_string_CDS_Reserved2/E_NOT_OK, DataServices_Read_Write_coding_data_string_CDS_Reserved2/DCM_E_PENDING]
        arg OpStatus: type=Dcm_OpStatusType, direction=IN
        arg Data: type=Dcm_Data1ByteType, direction=OUT
      operation ConditionCheckRead: possible-error=[DataServices_Read_Write_coding_data_string_CDS_Reserved2/E_NOT_OK, DataServices_Read_Write_coding_data_string_CDS_Reserved2/DCM_E_PENDING]
        arg OpStatus: type=Dcm_OpStatusType, direction=IN
        arg ErrorCode: type=Dcm_NegativeResponseCodeType, direction=OUT
      operation WriteData: possible-error=[DataServices_Read_Write_coding_data_string_CDS_Reserved2/E_NOT_OK, DataServices_Read_Write_coding_data_string_CDS_Reserved2/DCM_E_PENDING]
        arg Data: type=Dcm_Data1ByteType, direction=IN
        arg OpStatus: type=Dcm_OpStatusType, direction=IN
        arg ErrorCode: type=Dcm_NegativeResponseCodeType, direction=OUT
      error E_NOT_OK: error-code=1
      error DCM_E_PENDING: error-code=10
    DataServices_Read_Write_coding_data_string_CDS_Version_Byte_0
      operation ReadData: possible-error=[DataServices_Read_Write_coding_data_string_CDS_Version_Byte_0/E_NOT_OK, DataServices_Read_Write_coding_data_string_CDS_Version_Byte_0/DCM_E_PENDING]
        arg OpStatus: type=Dcm_OpStatusType, direction=IN
        arg Data: type=Dcm_Data1ByteType, direction=OUT
      operation ConditionCheckRead: possible-error=[DataServices_Read_Write_coding_data_string_CDS_Version_Byte_0/E_NOT_OK, DataServices_Read_Write_coding_data_string_CDS_Version_Byte_0/DCM_E_PENDING]
        arg OpStatus: type=Dcm_OpStatusType, direction=IN
        arg ErrorCode: type=Dcm_NegativeResponseCodeType, direction=OUT
      operation WriteData: possible-error=[DataServices_Read_Write_coding_data_string_CDS_Version_Byte_0/E_NOT_OK, DataServices_Read_Write_coding_data_string_CDS_Version_Byte_0/DCM_E_PENDING]
        arg Data: type=Dcm_Data1ByteType, direction=IN
        arg OpStatus: type=Dcm_OpStatusType, direction=IN
        arg ErrorCode: type=Dcm_NegativeResponseCodeType, direction=OUT
      error E_NOT_OK: error-code=1
      error DCM_E_PENDING: error-code=10
    DataServices_Read_Write_coding_data_string_CDS_Reserved1
      operation ReadData: possible-error=[DataServices_Read_Write_coding_data_string_CDS_Reserved1/E_NOT_OK, DataServices_Read_Write_coding_data_string_CDS_Reserved1/DCM_E_PENDING]
        arg OpStatus: type=Dcm_OpStatusType, direction=IN
        arg Data: type=Dcm_Data1ByteType, direction=OUT
      operation ConditionCheckRead: possible-error=[DataServices_Read_Write_coding_data_string_CDS_Reserved1/E_NOT_OK, DataServices_Read_Write_coding_data_string_CDS_Reserved1/DCM_E_PENDING]
        arg OpStatus: type=Dcm_OpStatusType, direction=IN
        arg ErrorCode: type=Dcm_NegativeResponseCodeType, direction=OUT
      operation WriteData: possible-error=[DataServices_Read_Write_coding_data_string_CDS_Reserved1/E_NOT_OK, DataServices_Read_Write_coding_data_string_CDS_Reserved1/DCM_E_PENDING]
        arg Data: type=Dcm_Data1ByteType, direction=IN
        arg OpStatus: type=Dcm_OpStatusType, direction=IN
        arg ErrorCode: type=Dcm_NegativeResponseCodeType, direction=OUT
      error E_NOT_OK: error-code=1
      error DCM_E_PENDING: error-code=10
    DataServices_Read_Write_coding_data_string_CDS_Reserved3
      operation ReadData: possible-error=[DataServices_Read_Write_coding_data_string_CDS_Reserved3/E_NOT_OK, DataServices_Read_Write_coding_data_string_CDS_Reserved3/DCM_E_PENDING]
        arg OpStatus: type=Dcm_OpStatusType, direction=IN
        arg Data: type=Dcm_Data1ByteType, direction=OUT
      operation ConditionCheckRead: possible-error=[DataServices_Read_Write_coding_data_string_CDS_Reserved3/E_NOT_OK, DataServices_Read_Write_coding_data_string_CDS_Reserved3/DCM_E_PENDING]
        arg OpStatus: type=Dcm_OpStatusType, direction=IN
        arg ErrorCode: type=Dcm_NegativeResponseCodeType, direction=OUT
      operation WriteData: possible-error=[DataServices_Read_Write_coding_data_string_CDS_Reserved3/E_NOT_OK, DataServices_Read_Write_coding_data_string_CDS_Reserved3/DCM_E_PENDING]
        arg Data: type=Dcm_Data1ByteType, direction=IN
        arg OpStatus: type=Dcm_OpStatusType, direction=IN
        arg ErrorCode: type=Dcm_NegativeResponseCodeType, direction=OUT
      error E_NOT_OK: error-code=1
      error DCM_E_PENDING: error-code=10
    DataServices_Read_Write_coding_data_string_CDS_Version_Byte_1
      operation ReadData: possible-error=[DataServices_Read_Write_coding_data_string_CDS_Version_Byte_1/E_NOT_OK, DataServices_Read_Write_coding_data_string_CDS_Version_Byte_1/DCM_E_PENDING]
        arg OpStatus: type=Dcm_OpStatusType, direction=IN
        arg Data: type=Dcm_Data1ByteType, direction=OUT
      operation ConditionCheckRead: possible-error=[DataServices_Read_Write_coding_data_string_CDS_Version_Byte_1/E_NOT_OK, DataServices_Read_Write_coding_data_string_CDS_Version_Byte_1/DCM_E_PENDING]
        arg OpStatus: type=Dcm_OpStatusType, direction=IN
        arg ErrorCode: type=Dcm_NegativeResponseCodeType, direction=OUT
      operation WriteData: possible-error=[DataServices_Read_Write_coding_data_string_CDS_Version_Byte_1/E_NOT_OK, DataServices_Read_Write_coding_data_string_CDS_Version_Byte_1/DCM_E_PENDING]
        arg Data: type=Dcm_Data1ByteType, direction=IN
        arg OpStatus: type=Dcm_OpStatusType, direction=IN
        arg ErrorCode: type=Dcm_NegativeResponseCodeType, direction=OUT
      error E_NOT_OK: error-code=1
      error DCM_E_PENDING: error-code=10
    DataServices_Read_Write_coding_data_string_CDS_CDS_Short_VIN_High_Byte_4
      operation ReadData: possible-error=[DataServices_Read_Write_coding_data_string_CDS_CDS_Short_VIN_High_Byte_4/E_NOT_OK, DataServices_Read_Write_coding_data_string_CDS_CDS_Short_VIN_High_Byte_4/DCM_E_PENDING]
        arg OpStatus: type=Dcm_OpStatusType, direction=IN
        arg Data: type=Dcm_Data1ByteType, direction=OUT
      operation ConditionCheckRead: possible-error=[DataServices_Read_Write_coding_data_string_CDS_CDS_Short_VIN_High_Byte_4/E_NOT_OK, DataServices_Read_Write_coding_data_string_CDS_CDS_Short_VIN_High_Byte_4/DCM_E_PENDING]
        arg OpStatus: type=Dcm_OpStatusType, direction=IN
        arg ErrorCode: type=Dcm_NegativeResponseCodeType, direction=OUT
      operation WriteData: possible-error=[DataServices_Read_Write_coding_data_string_CDS_CDS_Short_VIN_High_Byte_4/E_NOT_OK, DataServices_Read_Write_coding_data_string_CDS_CDS_Short_VIN_High_Byte_4/DCM_E_PENDING]
        arg Data: type=Dcm_Data1ByteType, direction=IN
        arg OpStatus: type=Dcm_OpStatusType, direction=IN
        arg ErrorCode: type=Dcm_NegativeResponseCodeType, direction=OUT
      error E_NOT_OK: error-code=1
      error DCM_E_PENDING: error-code=10
    DataServices_Read_Write_coding_data_string_CDS_Configuration
      operation ReadData: possible-error=[DataServices_Read_Write_coding_data_string_CDS_Configuration/E_NOT_OK, DataServices_Read_Write_coding_data_string_CDS_Configuration/DCM_E_PENDING]
        arg OpStatus: type=Dcm_OpStatusType, direction=IN
        arg Data: type=Dcm_Data1ByteType, direction=OUT
      operation ConditionCheckRead: possible-error=[DataServices_Read_Write_coding_data_string_CDS_Configuration/E_NOT_OK, DataServices_Read_Write_coding_data_string_CDS_Configuration/DCM_E_PENDING]
        arg OpStatus: type=Dcm_OpStatusType, direction=IN
        arg ErrorCode: type=Dcm_NegativeResponseCodeType, direction=OUT
      operation WriteData: possible-error=[DataServices_Read_Write_coding_data_string_CDS_Configuration/E_NOT_OK, DataServices_Read_Write_coding_data_string_CDS_Configuration/DCM_E_PENDING]
        arg Data: type=Dcm_Data1ByteType, direction=IN
        arg OpStatus: type=Dcm_OpStatusType, direction=IN
        arg ErrorCode: type=Dcm_NegativeResponseCodeType, direction=OUT
      error E_NOT_OK: error-code=1
      error DCM_E_PENDING: error-code=10
    DataServices_Read_Write_coding_data_string_CDS_CDS_Short_VIN_High_Byte_3
      operation ReadData: possible-error=[DataServices_Read_Write_coding_data_string_CDS_CDS_Short_VIN_High_Byte_3/E_NOT_OK, DataServices_Read_Write_coding_data_string_CDS_CDS_Short_VIN_High_Byte_3/DCM_E_PENDING]
        arg OpStatus: type=Dcm_OpStatusType, direction=IN
        arg Data: type=Dcm_Data1ByteType, direction=OUT
      operation ConditionCheckRead: possible-error=[DataServices_Read_Write_coding_data_string_CDS_CDS_Short_VIN_High_Byte_3/E_NOT_OK, DataServices_Read_Write_coding_data_string_CDS_CDS_Short_VIN_High_Byte_3/DCM_E_PENDING]
        arg OpStatus: type=Dcm_OpStatusType, direction=IN
        arg ErrorCode: type=Dcm_NegativeResponseCodeType, direction=OUT
      operation WriteData: possible-error=[DataServices_Read_Write_coding_data_string_CDS_CDS_Short_VIN_High_Byte_3/E_NOT_OK, DataServices_Read_Write_coding_data_string_CDS_CDS_Short_VIN_High_Byte_3/DCM_E_PENDING]
        arg Data: type=Dcm_Data1ByteType, direction=IN
        arg OpStatus: type=Dcm_OpStatusType, direction=IN
        arg ErrorCode: type=Dcm_NegativeResponseCodeType, direction=OUT
      error E_NOT_OK: error-code=1
      error DCM_E_PENDING: error-code=10
    DataServices_Read_Write_coding_data_string_CDS_CDS_Short_VIN_High_Byte_5
      operation ReadData: possible-error=[DataServices_Read_Write_coding_data_string_CDS_CDS_Short_VIN_High_Byte_5/E_NOT_OK, DataServices_Read_Write_coding_data_string_CDS_CDS_Short_VIN_High_Byte_5/DCM_E_PENDING]
        arg OpStatus: type=Dcm_OpStatusType, direction=IN
        arg Data: type=Dcm_Data1ByteType, direction=OUT
      operation ConditionCheckRead: possible-error=[DataServices_Read_Write_coding_data_string_CDS_CDS_Short_VIN_High_Byte_5/E_NOT_OK, DataServices_Read_Write_coding_data_string_CDS_CDS_Short_VIN_High_Byte_5/DCM_E_PENDING]
        arg OpStatus: type=Dcm_OpStatusType, direction=IN
        arg ErrorCode: type=Dcm_NegativeResponseCodeType, direction=OUT
      operation WriteData: possible-error=[DataServices_Read_Write_coding_data_string_CDS_CDS_Short_VIN_High_Byte_5/E_NOT_OK, DataServices_Read_Write_coding_data_string_CDS_CDS_Short_VIN_High_Byte_5/DCM_E_PENDING]
        arg Data: type=Dcm_Data1ByteType, direction=IN
        arg OpStatus: type=Dcm_OpStatusType, direction=IN
        arg ErrorCode: type=Dcm_NegativeResponseCodeType, direction=OUT
      error E_NOT_OK: error-code=1
      error DCM_E_PENDING: error-code=10
    DataServices_Read_Write_coding_data_string_CDS_CDS_Short_VIN_High_Byte_0
      operation ReadData: possible-error=[DataServices_Read_Write_coding_data_string_CDS_CDS_Short_VIN_High_Byte_0/E_NOT_OK, DataServices_Read_Write_coding_data_string_CDS_CDS_Short_VIN_High_Byte_0/DCM_E_PENDING]
        arg OpStatus: type=Dcm_OpStatusType, direction=IN
        arg Data: type=Dcm_Data1ByteType, direction=OUT
      operation ConditionCheckRead: possible-error=[DataServices_Read_Write_coding_data_string_CDS_CDS_Short_VIN_High_Byte_0/E_NOT_OK, DataServices_Read_Write_coding_data_string_CDS_CDS_Short_VIN_High_Byte_0/DCM_E_PENDING]
        arg OpStatus: type=Dcm_OpStatusType, direction=IN
        arg ErrorCode: type=Dcm_NegativeResponseCodeType, direction=OUT
      operation WriteData: possible-error=[DataServices_Read_Write_coding_data_string_CDS_CDS_Short_VIN_High_Byte_0/E_NOT_OK, DataServices_Read_Write_coding_data_string_CDS_CDS_Short_VIN_High_Byte_0/DCM_E_PENDING]
        arg Data: type=Dcm_Data1ByteType, direction=IN
        arg OpStatus: type=Dcm_OpStatusType, direction=IN
        arg ErrorCode: type=Dcm_NegativeResponseCodeType, direction=OUT
      error E_NOT_OK: error-code=1
      error DCM_E_PENDING: error-code=10
    DataServices_Read_Write_coding_data_string_CDS_CDS_Short_VIN_High_Byte_2
      operation ReadData: possible-error=[DataServices_Read_Write_coding_data_string_CDS_CDS_Short_VIN_High_Byte_2/E_NOT_OK, DataServices_Read_Write_coding_data_string_CDS_CDS_Short_VIN_High_Byte_2/DCM_E_PENDING]
        arg OpStatus: type=Dcm_OpStatusType, direction=IN
        arg Data: type=Dcm_Data1ByteType, direction=OUT
      operation ConditionCheckRead: possible-error=[DataServices_Read_Write_coding_data_string_CDS_CDS_Short_VIN_High_Byte_2/E_NOT_OK, DataServices_Read_Write_coding_data_string_CDS_CDS_Short_VIN_High_Byte_2/DCM_E_PENDING]
        arg OpStatus: type=Dcm_OpStatusType, direction=IN
        arg ErrorCode: type=Dcm_NegativeResponseCodeType, direction=OUT
      operation WriteData: possible-error=[DataServices_Read_Write_coding_data_string_CDS_CDS_Short_VIN_High_Byte_2/E_NOT_OK, DataServices_Read_Write_coding_data_string_CDS_CDS_Short_VIN_High_Byte_2/DCM_E_PENDING]
        arg Data: type=Dcm_Data1ByteType, direction=IN
        arg OpStatus: type=Dcm_OpStatusType, direction=IN
        arg ErrorCode: type=Dcm_NegativeResponseCodeType, direction=OUT
      error E_NOT_OK: error-code=1
      error DCM_E_PENDING: error-code=10
    DataServices_Read_Write_coding_data_string_CDS_CDS_Short_VIN_High_Byte_1
      operation ReadData: possible-error=[DataServices_Read_Write_coding_data_string_CDS_CDS_Short_VIN_High_Byte_1/E_NOT_OK, DataServices_Read_Write_coding_data_string_CDS_CDS_Short_VIN_High_Byte_1/DCM_E_PENDING]
        arg OpStatus: type=Dcm_OpStatusType, direction=IN
        arg Data: type=Dcm_Data1ByteType, direction=OUT
      operation ConditionCheckRead: possible-error=[DataServices_Read_Write_coding_data_string_CDS_CDS_Short_VIN_High_Byte_1/E_NOT_OK, DataServices_Read_Write_coding_data_string_CDS_CDS_Short_VIN_High_Byte_1/DCM_E_PENDING]
        arg OpStatus: type=Dcm_OpStatusType, direction=IN
        arg ErrorCode: type=Dcm_NegativeResponseCodeType, direction=OUT
      operation WriteData: possible-error=[DataServices_Read_Write_coding_data_string_CDS_CDS_Short_VIN_High_Byte_1/E_NOT_OK, DataServices_Read_Write_coding_data_string_CDS_CDS_Short_VIN_High_Byte_1/DCM_E_PENDING]
        arg Data: type=Dcm_Data1ByteType, direction=IN
        arg OpStatus: type=Dcm_OpStatusType, direction=IN
        arg ErrorCode: type=Dcm_NegativeResponseCodeType, direction=OUT
      error E_NOT_OK: error-code=1
      error DCM_E_PENDING: error-code=10
    DataServices_Last_service_date_Day
      operation ReadData: possible-error=[DataServices_Last_service_date_Day/E_NOT_OK, DataServices_Last_service_date_Day/DCM_E_PENDING]
        arg OpStatus: type=Dcm_OpStatusType, direction=IN
        arg Data: type=Dcm_Data1ByteType, direction=OUT
      operation ConditionCheckRead: possible-error=[DataServices_Last_service_date_Day/E_NOT_OK, DataServices_Last_service_date_Day/DCM_E_PENDING]
        arg OpStatus: type=Dcm_OpStatusType, direction=IN
        arg ErrorCode: type=Dcm_NegativeResponseCodeType, direction=OUT
      operation WriteData: possible-error=[DataServices_Last_service_date_Day/E_NOT_OK, DataServices_Last_service_date_Day/DCM_E_PENDING]
        arg Data: type=Dcm_Data1ByteType, direction=IN
        arg OpStatus: type=Dcm_OpStatusType, direction=IN
        arg ErrorCode: type=Dcm_NegativeResponseCodeType, direction=OUT
      error E_NOT_OK: error-code=1
      error DCM_E_PENDING: error-code=10
    DataServices_Last_service_date_Month
      operation ReadData: possible-error=[DataServices_Last_service_date_Month/E_NOT_OK, DataServices_Last_service_date_Month/DCM_E_PENDING]
        arg OpStatus: type=Dcm_OpStatusType, direction=IN
        arg Data: type=Dcm_Data1ByteType, direction=OUT
      operation ConditionCheckRead: possible-error=[DataServices_Last_service_date_Month/E_NOT_OK, DataServices_Last_service_date_Month/DCM_E_PENDING]
        arg OpStatus: type=Dcm_OpStatusType, direction=IN
        arg ErrorCode: type=Dcm_NegativeResponseCodeType, direction=OUT
      operation WriteData: possible-error=[DataServices_Last_service_date_Month/E_NOT_OK, DataServices_Last_service_date_Month/DCM_E_PENDING]
        arg Data: type=Dcm_Data1ByteType, direction=IN
        arg OpStatus: type=Dcm_OpStatusType, direction=IN
        arg ErrorCode: type=Dcm_NegativeResponseCodeType, direction=OUT
      error E_NOT_OK: error-code=1
      error DCM_E_PENDING: error-code=10
    DataServices_Last_service_date_Year
      operation ReadData: possible-error=[DataServices_Last_service_date_Year/E_NOT_OK, DataServices_Last_service_date_Year/DCM_E_PENDING]
        arg OpStatus: type=Dcm_OpStatusType, direction=IN
        arg Data: type=Dcm_Data1ByteType, direction=OUT
      operation ConditionCheckRead: possible-error=[DataServices_Last_service_date_Year/E_NOT_OK, DataServices_Last_service_date_Year/DCM_E_PENDING]
        arg OpStatus: type=Dcm_OpStatusType, direction=IN
        arg ErrorCode: type=Dcm_NegativeResponseCodeType, direction=OUT
      operation WriteData: possible-error=[DataServices_Last_service_date_Year/E_NOT_OK, DataServices_Last_service_date_Year/DCM_E_PENDING]
        arg Data: type=Dcm_Data1ByteType, direction=IN
        arg OpStatus: type=Dcm_OpStatusType, direction=IN
        arg ErrorCode: type=Dcm_NegativeResponseCodeType, direction=OUT
      error E_NOT_OK: error-code=1
      error DCM_E_PENDING: error-code=10
    DataServices_Date_And_Time_Date_And_Time_Minute
      operation ReadData: possible-error=[DataServices_Date_And_Time_Date_And_Time_Minute/E_NOT_OK, DataServices_Date_And_Time_Date_And_Time_Minute/DCM_E_PENDING]
        arg OpStatus: type=Dcm_OpStatusType, direction=IN
        arg Data: type=Dcm_Data1ByteType, direction=OUT
      operation ConditionCheckRead: possible-error=[DataServices_Date_And_Time_Date_And_Time_Minute/E_NOT_OK, DataServices_Date_And_Time_Date_And_Time_Minute/DCM_E_PENDING]
        arg OpStatus: type=Dcm_OpStatusType, direction=IN
        arg ErrorCode: type=Dcm_NegativeResponseCodeType, direction=OUT
      error E_NOT_OK: error-code=1
      error DCM_E_PENDING: error-code=10
    DataServices_Date_And_Time_Date_And_Time_Hour
      operation ReadData: possible-error=[DataServices_Date_And_Time_Date_And_Time_Hour/E_NOT_OK, DataServices_Date_And_Time_Date_And_Time_Hour/DCM_E_PENDING]
        arg OpStatus: type=Dcm_OpStatusType, direction=IN
        arg Data: type=Dcm_Data1ByteType, direction=OUT
      operation ConditionCheckRead: possible-error=[DataServices_Date_And_Time_Date_And_Time_Hour/E_NOT_OK, DataServices_Date_And_Time_Date_And_Time_Hour/DCM_E_PENDING]
        arg OpStatus: type=Dcm_OpStatusType, direction=IN
        arg ErrorCode: type=Dcm_NegativeResponseCodeType, direction=OUT
      error E_NOT_OK: error-code=1
      error DCM_E_PENDING: error-code=10
    DataServices_Date_And_Time_Date_And_Time_Year
      operation ReadData: possible-error=[DataServices_Date_And_Time_Date_And_Time_Year/E_NOT_OK, DataServices_Date_And_Time_Date_And_Time_Year/DCM_E_PENDING]
        arg OpStatus: type=Dcm_OpStatusType, direction=IN
        arg Data: type=Dcm_Data1ByteType, direction=OUT
      operation ConditionCheckRead: possible-error=[DataServices_Date_And_Time_Date_And_Time_Year/E_NOT_OK, DataServices_Date_And_Time_Date_And_Time_Year/DCM_E_PENDING]
        arg OpStatus: type=Dcm_OpStatusType, direction=IN
        arg ErrorCode: type=Dcm_NegativeResponseCodeType, direction=OUT
      error E_NOT_OK: error-code=1
      error DCM_E_PENDING: error-code=10
    DataServices_Date_And_Time_Date_And_Time_Second
      operation ReadData: possible-error=[DataServices_Date_And_Time_Date_And_Time_Second/E_NOT_OK, DataServices_Date_And_Time_Date_And_Time_Second/DCM_E_PENDING]
        arg OpStatus: type=Dcm_OpStatusType, direction=IN
        arg Data: type=Dcm_Data1ByteType, direction=OUT
      operation ConditionCheckRead: possible-error=[DataServices_Date_And_Time_Date_And_Time_Second/E_NOT_OK, DataServices_Date_And_Time_Date_And_Time_Second/DCM_E_PENDING]
        arg OpStatus: type=Dcm_OpStatusType, direction=IN
        arg ErrorCode: type=Dcm_NegativeResponseCodeType, direction=OUT
      error E_NOT_OK: error-code=1
      error DCM_E_PENDING: error-code=10
    DataServices_Date_And_Time_Date_And_Time_Month
      operation ReadData: possible-error=[DataServices_Date_And_Time_Date_And_Time_Month/E_NOT_OK, DataServices_Date_And_Time_Date_And_Time_Month/DCM_E_PENDING]
        arg OpStatus: type=Dcm_OpStatusType, direction=IN
        arg Data: type=Dcm_Data1ByteType, direction=OUT
      operation ConditionCheckRead: possible-error=[DataServices_Date_And_Time_Date_And_Time_Month/E_NOT_OK, DataServices_Date_And_Time_Date_And_Time_Month/DCM_E_PENDING]
        arg OpStatus: type=Dcm_OpStatusType, direction=IN
        arg ErrorCode: type=Dcm_NegativeResponseCodeType, direction=OUT
      error E_NOT_OK: error-code=1
      error DCM_E_PENDING: error-code=10
    DataServices_Date_And_Time_Date_And_Time_Day
      operation ReadData: possible-error=[DataServices_Date_And_Time_Date_And_Time_Day/E_NOT_OK, DataServices_Date_And_Time_Date_And_Time_Day/DCM_E_PENDING]
        arg OpStatus: type=Dcm_OpStatusType, direction=IN
        arg Data: type=Dcm_Data1ByteType, direction=OUT
      operation ConditionCheckRead: possible-error=[DataServices_Date_And_Time_Date_And_Time_Day/E_NOT_OK, DataServices_Date_And_Time_Date_And_Time_Day/DCM_E_PENDING]
        arg OpStatus: type=Dcm_OpStatusType, direction=IN
        arg ErrorCode: type=Dcm_NegativeResponseCodeType, direction=OUT
      error E_NOT_OK: error-code=1
      error DCM_E_PENDING: error-code=10
    DataServices_VCU_Torque_parameter_VCU_RegenTorqueCap
      operation ReadData: possible-error=[DataServices_VCU_Torque_parameter_VCU_RegenTorqueCap/E_NOT_OK, DataServices_VCU_Torque_parameter_VCU_RegenTorqueCap/DCM_E_PENDING]
        arg OpStatus: type=Dcm_OpStatusType, direction=IN
        arg Data: type=Dcm_Data2ByteType, direction=OUT
      operation ConditionCheckRead: possible-error=[DataServices_VCU_Torque_parameter_VCU_RegenTorqueCap/E_NOT_OK, DataServices_VCU_Torque_parameter_VCU_RegenTorqueCap/DCM_E_PENDING]
        arg OpStatus: type=Dcm_OpStatusType, direction=IN
        arg ErrorCode: type=Dcm_NegativeResponseCodeType, direction=OUT
      error E_NOT_OK: error-code=1
      error DCM_E_PENDING: error-code=10
    DataServices_VCU_Torque_parameter_Torque_MaxAllowed
      operation ReadData: possible-error=[DataServices_VCU_Torque_parameter_Torque_MaxAllowed/E_NOT_OK, DataServices_VCU_Torque_parameter_Torque_MaxAllowed/DCM_E_PENDING]
        arg OpStatus: type=Dcm_OpStatusType, direction=IN
        arg Data: type=Dcm_Data2ByteType, direction=OUT
      operation ConditionCheckRead: possible-error=[DataServices_VCU_Torque_parameter_Torque_MaxAllowed/E_NOT_OK, DataServices_VCU_Torque_parameter_Torque_MaxAllowed/DCM_E_PENDING]
        arg OpStatus: type=Dcm_OpStatusType, direction=IN
        arg ErrorCode: type=Dcm_NegativeResponseCodeType, direction=OUT
      error E_NOT_OK: error-code=1
      error DCM_E_PENDING: error-code=10
    DataServices_VCU_Torque_parameter_VCU_MCUDesiredTorque
      operation ReadData: possible-error=[DataServices_VCU_Torque_parameter_VCU_MCUDesiredTorque/E_NOT_OK, DataServices_VCU_Torque_parameter_VCU_MCUDesiredTorque/DCM_E_PENDING]
        arg OpStatus: type=Dcm_OpStatusType, direction=IN
        arg Data: type=Dcm_Data2ByteType, direction=OUT
      operation ConditionCheckRead: possible-error=[DataServices_VCU_Torque_parameter_VCU_MCUDesiredTorque/E_NOT_OK, DataServices_VCU_Torque_parameter_VCU_MCUDesiredTorque/DCM_E_PENDING]
        arg OpStatus: type=Dcm_OpStatusType, direction=IN
        arg ErrorCode: type=Dcm_NegativeResponseCodeType, direction=OUT
      error E_NOT_OK: error-code=1
      error DCM_E_PENDING: error-code=10
    DataServices_VCU_Torque_parameter_Torque_MinAllowed
      operation ReadData: possible-error=[DataServices_VCU_Torque_parameter_Torque_MinAllowed/E_NOT_OK, DataServices_VCU_Torque_parameter_Torque_MinAllowed/DCM_E_PENDING]
        arg OpStatus: type=Dcm_OpStatusType, direction=IN
        arg Data: type=Dcm_Data2ByteType, direction=OUT
      operation ConditionCheckRead: possible-error=[DataServices_VCU_Torque_parameter_Torque_MinAllowed/E_NOT_OK, DataServices_VCU_Torque_parameter_Torque_MinAllowed/DCM_E_PENDING]
        arg OpStatus: type=Dcm_OpStatusType, direction=IN
        arg ErrorCode: type=Dcm_NegativeResponseCodeType, direction=OUT
      error E_NOT_OK: error-code=1
      error DCM_E_PENDING: error-code=10
    DataServices_ECU_application_software_ASW_version_number_Major_release
      operation ReadData: possible-error=[DataServices_ECU_application_software_ASW_version_number_Major_release/E_NOT_OK, DataServices_ECU_application_software_ASW_version_number_Major_release/DCM_E_PENDING]
        arg OpStatus: type=Dcm_OpStatusType, direction=IN
        arg Data: type=Dcm_Data1ByteType, direction=OUT
      operation ConditionCheckRead: possible-error=[DataServices_ECU_application_software_ASW_version_number_Major_release/E_NOT_OK, DataServices_ECU_application_software_ASW_version_number_Major_release/DCM_E_PENDING]
        arg OpStatus: type=Dcm_OpStatusType, direction=IN
        arg ErrorCode: type=Dcm_NegativeResponseCodeType, direction=OUT
      error E_NOT_OK: error-code=1
      error DCM_E_PENDING: error-code=10
    DataServices_ECU_application_software_ASW_version_number_Minor_release
      operation ReadData: possible-error=[DataServices_ECU_application_software_ASW_version_number_Minor_release/E_NOT_OK, DataServices_ECU_application_software_ASW_version_number_Minor_release/DCM_E_PENDING]
        arg OpStatus: type=Dcm_OpStatusType, direction=IN
        arg Data: type=Dcm_Data1ByteType, direction=OUT
      operation ConditionCheckRead: possible-error=[DataServices_ECU_application_software_ASW_version_number_Minor_release/E_NOT_OK, DataServices_ECU_application_software_ASW_version_number_Minor_release/DCM_E_PENDING]
        arg OpStatus: type=Dcm_OpStatusType, direction=IN
        arg ErrorCode: type=Dcm_NegativeResponseCodeType, direction=OUT
      error E_NOT_OK: error-code=1
      error DCM_E_PENDING: error-code=10
    DataServices_ECU_application_software_ASW_version_number_No_functional_content_change
      operation ReadData: possible-error=[DataServices_ECU_application_software_ASW_version_number_No_functional_content_change/E_NOT_OK, DataServices_ECU_application_software_ASW_version_number_No_functional_content_change/DCM_E_PENDING]
        arg OpStatus: type=Dcm_OpStatusType, direction=IN
        arg Data: type=Dcm_Data1ByteType, direction=OUT
      operation ConditionCheckRead: possible-error=[DataServices_ECU_application_software_ASW_version_number_No_functional_content_change/E_NOT_OK, DataServices_ECU_application_software_ASW_version_number_No_functional_content_change/DCM_E_PENDING]
        arg OpStatus: type=Dcm_OpStatusType, direction=IN
        arg ErrorCode: type=Dcm_NegativeResponseCodeType, direction=OUT
      error E_NOT_OK: error-code=1
      error DCM_E_PENDING: error-code=10
    DataServices_Read_Level3_OEM_Key_written_status_Read_Level3_OEM_Key_rewrite_counter
      operation ReadData: possible-error=[DataServices_Read_Level3_OEM_Key_written_status_Read_Level3_OEM_Key_rewrite_counter/E_NOT_OK, DataServices_Read_Level3_OEM_Key_written_status_Read_Level3_OEM_Key_rewrite_counter/DCM_E_PENDING]
        arg OpStatus: type=Dcm_OpStatusType, direction=IN
        arg Data: type=Dcm_Data1ByteType, direction=OUT
      operation ConditionCheckRead: possible-error=[DataServices_Read_Level3_OEM_Key_written_status_Read_Level3_OEM_Key_rewrite_counter/E_NOT_OK, DataServices_Read_Level3_OEM_Key_written_status_Read_Level3_OEM_Key_rewrite_counter/DCM_E_PENDING]
        arg OpStatus: type=Dcm_OpStatusType, direction=IN
        arg ErrorCode: type=Dcm_NegativeResponseCodeType, direction=OUT
      error E_NOT_OK: error-code=1
      error DCM_E_PENDING: error-code=10
    DataServices_Write_Level1_OEM_Key_OEM_Key_Value
      operation WriteData: possible-error=[DataServices_Write_Level1_OEM_Key_OEM_Key_Value/E_NOT_OK, DataServices_Write_Level1_OEM_Key_OEM_Key_Value/DCM_E_PENDING]
        arg Data: type=Dcm_Data16ByteType, direction=IN
        arg OpStatus: type=Dcm_OpStatusType, direction=IN
        arg ErrorCode: type=Dcm_NegativeResponseCodeType, direction=OUT
      error E_NOT_OK: error-code=1
      error DCM_E_PENDING: error-code=10
    DataServices_Write_Level1_OEM_Key_CRC
      operation WriteData: possible-error=[DataServices_Write_Level1_OEM_Key_CRC/E_NOT_OK, DataServices_Write_Level1_OEM_Key_CRC/DCM_E_PENDING]
        arg Data: type=Dcm_Data1ByteType, direction=IN
        arg OpStatus: type=Dcm_OpStatusType, direction=IN
        arg ErrorCode: type=Dcm_NegativeResponseCodeType, direction=OUT
      error E_NOT_OK: error-code=1
      error DCM_E_PENDING: error-code=10
    DataServices_Read_Write_complete_VIN_World_Manufacturers_Identification
      operation ReadData: possible-error=[DataServices_Read_Write_complete_VIN_World_Manufacturers_Identification/E_NOT_OK, DataServices_Read_Write_complete_VIN_World_Manufacturers_Identification/DCM_E_PENDING]
        arg OpStatus: type=Dcm_OpStatusType, direction=IN
        arg Data: type=Dcm_Data3ByteType, direction=OUT
      operation ConditionCheckRead: possible-error=[DataServices_Read_Write_complete_VIN_World_Manufacturers_Identification/E_NOT_OK, DataServices_Read_Write_complete_VIN_World_Manufacturers_Identification/DCM_E_PENDING]
        arg OpStatus: type=Dcm_OpStatusType, direction=IN
        arg ErrorCode: type=Dcm_NegativeResponseCodeType, direction=OUT
      operation WriteData: possible-error=[DataServices_Read_Write_complete_VIN_World_Manufacturers_Identification/E_NOT_OK, DataServices_Read_Write_complete_VIN_World_Manufacturers_Identification/DCM_E_PENDING]
        arg Data: type=Dcm_Data3ByteType, direction=IN
        arg OpStatus: type=Dcm_OpStatusType, direction=IN
        arg ErrorCode: type=Dcm_NegativeResponseCodeType, direction=OUT
      error E_NOT_OK: error-code=1
      error DCM_E_PENDING: error-code=10
    DataServices_Read_Write_complete_VIN_Vehicle_Description_Section
      operation ReadData: possible-error=[DataServices_Read_Write_complete_VIN_Vehicle_Description_Section/E_NOT_OK, DataServices_Read_Write_complete_VIN_Vehicle_Description_Section/DCM_E_PENDING]
        arg OpStatus: type=Dcm_OpStatusType, direction=IN
        arg Data: type=Dcm_Data5ByteType, direction=OUT
      operation ConditionCheckRead: possible-error=[DataServices_Read_Write_complete_VIN_Vehicle_Description_Section/E_NOT_OK, DataServices_Read_Write_complete_VIN_Vehicle_Description_Section/DCM_E_PENDING]
        arg OpStatus: type=Dcm_OpStatusType, direction=IN
        arg ErrorCode: type=Dcm_NegativeResponseCodeType, direction=OUT
      operation WriteData: possible-error=[DataServices_Read_Write_complete_VIN_Vehicle_Description_Section/E_NOT_OK, DataServices_Read_Write_complete_VIN_Vehicle_Description_Section/DCM_E_PENDING]
        arg Data: type=Dcm_Data5ByteType, direction=IN
        arg OpStatus: type=Dcm_OpStatusType, direction=IN
        arg ErrorCode: type=Dcm_NegativeResponseCodeType, direction=OUT
      error E_NOT_OK: error-code=1
      error DCM_E_PENDING: error-code=10
    DataServices_Read_Write_complete_VIN_Vehicle_Identification_Section
      operation ReadData: possible-error=[DataServices_Read_Write_complete_VIN_Vehicle_Identification_Section/E_NOT_OK, DataServices_Read_Write_complete_VIN_Vehicle_Identification_Section/DCM_E_PENDING]
        arg OpStatus: type=Dcm_OpStatusType, direction=IN
        arg Data: type=Dcm_Data9ByteType, direction=OUT
      operation ConditionCheckRead: possible-error=[DataServices_Read_Write_complete_VIN_Vehicle_Identification_Section/E_NOT_OK, DataServices_Read_Write_complete_VIN_Vehicle_Identification_Section/DCM_E_PENDING]
        arg OpStatus: type=Dcm_OpStatusType, direction=IN
        arg ErrorCode: type=Dcm_NegativeResponseCodeType, direction=OUT
      operation WriteData: possible-error=[DataServices_Read_Write_complete_VIN_Vehicle_Identification_Section/E_NOT_OK, DataServices_Read_Write_complete_VIN_Vehicle_Identification_Section/DCM_E_PENDING]
        arg Data: type=Dcm_Data9ByteType, direction=IN
        arg OpStatus: type=Dcm_OpStatusType, direction=IN
        arg ErrorCode: type=Dcm_NegativeResponseCodeType, direction=OUT
      error E_NOT_OK: error-code=1
      error DCM_E_PENDING: error-code=10
