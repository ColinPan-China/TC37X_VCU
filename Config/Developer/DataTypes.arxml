AUTOSAR XML (schema 00046)
standard types defined: sint16, uint8, uint16, boolean
package /Predefined_DEV/ImplementationDataTypes
  impl type NvM_RequestResultType: compu {0=NVM_REQ_OK, 1=NVM_REQ_NOT_OK, 2=NVM_REQ_PENDING, 3=NVM_REQ_INTEGRITY_FAILED, 4=NVM_REQ_BLOCK_SKIPPED, 5=NVM_REQ_NV_INVALIDATED, 6=NVM_REQ_CANCELED, 7=NVM_REQ_REDUNDANCY_FAILED, 8=NVM_REQ_RESTORED_FROM_ROM}, implementation-data-type=uint8
  impl type NvM_ServiceIdType: compu {6=NVM_READ_BLOCK, 7=NVM_WRITE_BLOCK, 8=NVM_RESTORE_BLOCK_DEFAULTS, 9=NVM_ERASE_BLOCK, 11=NVM_INVALIDATE_NV_BLOCK, 12=NVM_READ_ALL}, implementation-data-type=uint8
  impl type Dem_UdsStatusByteType: compu {mask 1: 1=DEM_UDS_STATUS_TF, mask 2: 2=DEM_UDS_STATUS_TFTOC, mask 4: 4=DEM_UDS_STATUS_PDTC, mask 8: 8=DEM_UDS_STATUS_CDTC, mask 16: 16=DEM_UDS_STATUS_TNCSLC, mask 32: 32=DEM_UDS_STATUS_TFSLC, mask 64: 64=DEM_UDS_STATUS_TNCTOC, mask 128: 128=DEM_UDS_STATUS_WIR}, range raw 0..255, implementation-data-type=uint8
package /DataType
  base type uint8_6_none: category=FIXED_LENGTH, base-type-size=8, base-type-encoding=NONE
package /DataType/Constraint
  range DC_VcuAdcTxMsg1_Sig{0..3}: raw -32768..32767
  range DC_VcuAdcTxMsg2_Sig{0..3}: raw -32768..32767
  range DC_VcuRxMsg3_Sig{0..3}: raw -32768..32767
  range DC_VcuRxMsg4_Sig{0..3}: raw -32768..32767
  range DC_Vcu_Lin0_RxMsg1_Sig0: raw 0..255
  range DC_Vcu_Lin0_RxMsg1_Sig1: raw 0..255
  range DC_Vcu_Lin0_RxMsg2_Sig{0..3}: raw 0..255
  range DC_Vcu_Lin0_TxMsg1_Sig{0..3}: raw 0..255
  range DC_Vcu_Lin0_TxMsg2_Sig{0..3}: raw 0..255
  range DC_Act_Pos_sta: raw 0..3600
  range DC_Blockage_Fault_STA: raw 0..1
  range DC_Breakage_Fault_STA: raw 0..1
  range DC_Calibration_cmd: raw 0..1
  range DC_Calibration_sta: raw 0..3
  range DC_EDCU_EXV2_Cmd_Init_Rq: raw 0..7
  range DC_EDCU_EXV2_Cmd_Move_Enbl: raw 0..1
  range DC_EDCU_EXV2_Cmd_Set_Rq: raw 0..576
  range DC_EXV1_CurrentInitState: raw 0..3
  range DC_EXV1_CurrentPosition: raw 0..500
  range DC_EXV1_FaultState: raw 0..4
  range DC_EXV1_ResponseError: raw 0..1
  range DC_EXV1_RunState: raw 0..1
  range DC_EXV1_TemperatureWarn: raw 0..1
  range DC_EXV1_VoltageState: raw 0..2
  range DC_EXV2_curInit_Stat: raw 0..3
  range DC_EXV2_CurrentInitState: raw 0..3
  range DC_EXV2_CurrentPosition: raw 0..500
  range DC_EXV2_Fault_Stat: raw 0..5
  range DC_EXV2_FaultState: raw 0..4
  range DC_EXV2_OvrTemp_Warn: raw 0..3
  range DC_EXV2_Pos: raw 0..576
  range DC_EXV2_ResponseError: raw 0..1
  range DC_EXV2_Run_Stat: raw 0..1
  range DC_EXV2_RunState: raw 0..1
  range DC_EXV2_TemperatureWarn: raw 0..1
  range DC_EXV2_Volt_Stat: raw 0..3
  range DC_EXV2_VoltageState: raw 0..2
  range DC_HVCH_CurrSens_Flt: raw 0..31
  range DC_HVCH_defectHeaterCircuits: raw 0..7
  range DC_HVCH_DutyCycle: raw 0..255
  range DC_HVCH_ExtPwrSup_Flt: raw 0..1
  range DC_HVCH_HV_DC_curr: raw 0..255
  range DC_HVCH_HV_voltage: raw 0..255
  range DC_HVCH_HV_Voltage_Valid: raw 0..3
  range DC_HVCH_IntelTemp: raw 0..255
  range DC_HVCH_InternalPCBTemp: raw 0..255
  range DC_HVCH_LIN_Flt: raw 0..1
  range DC_HVCH_MediumTemp: raw 0..255
  range DC_HVCH_Off_ShrtCurr: raw 0..1
  range DC_HVCH_RsErr: raw 0..1
  range DC_HVCH_Status: raw 0..7
  range DC_HVCH_TempLim: raw 0..1
  range DC_HVCH_TempSens_Flt: raw 0..1
  range DC_LIN_Resp_Error_sta: raw 0..1
  range DC_PMP2_PumpDryRunningSta: raw 0..1
  range DC_PMP2_PumpInputVolt: raw 0..30
  range DC_PMP2_PumpMotorSta: raw 0..3
  range DC_PMP2_PumpPowerSta: raw 0..3
  range DC_PMP2_PumpTempSta: raw 0..3
  range DC_PMP2_RealRPM: raw 0..100
  range DC_PMP2_RESP_ERROR: raw 0..1
  range DC_PMP3_PumpDryRunningSta: raw 0..1
  range DC_PMP3_PumpInputVolt: raw 0..30
  range DC_PMP3_PumpMotorSta: raw 0..3
  range DC_PMP3_PumpPowerSta: raw 0..3
  range DC_PMP3_PumpTempSta: raw 0..3
  range DC_PMP3_RealRPM: raw 0..100
  range DC_PMP3_RESP_ERROR: raw 0..1
  range DC_RsErr_EXV2: raw 0..1
  range DC_Target_Pos_cmd: raw 0..3600
  range DC_TCU_HVCH_heating_rq: raw 0..100
  range DC_TCU_HVCH_On_Rq: raw 0..3
  range DC_TCU_HVCH_TmaxLim_output: raw 0..255
  range DC_TCU_HVCHMaxPowerLimit: raw 0..255
  range DC_TMM_EXV1_EnableRequest: raw 0..1
  range DC_TMM_EXV1_initRequest: raw 0..7
  range DC_TMM_EXV1_PositionRequest: raw 0..500
  range DC_TMM_EXV2_EnableRequest: raw 0..1
  range DC_TMM_EXV2_initRequest: raw 0..7
  range DC_TMM_EXV2_PositionRequest: raw 0..500
  range DC_A_I_Actuator_With_F_B_request: raw 0..2
  range DC_A_I_F_B: raw 0..50
  range DC_COMP_Pdis: raw 0..50
  range DC_COMP_Psuc: raw 0..50
  range DC_COMP_Tdis: raw 0..50
  range DC_COMP_Tsuc: raw 0..50
  range DC_COOLING_FAN_request: raw 0..100
  range DC_HVAC_Blower_request: raw 0..100
  range DC_Mode_Actuator_request: raw 0..2
  range DC_MODE_F_B: raw 0..50
  range DC_SV{1..3}_request: raw 0..1
  range DC_Tamb: raw 0..50
  range DC_Tevap_Tchiller_out: raw 0..50
  range DC_Tincar: raw 0..50
  range DC_Tohx_in: raw 0..50
  range DC_Tohx_out: raw 0..50
  range DC_VCU_Tx_51Ch_NM_PNCData: raw 0..281474976710655
  range DC_VCU_Tx_51Ch_NM_UserData: raw 0..281474976710655
package /DataType/Semantics
  compu method CM_VcuRxMsg1_Sig{0..3}: identical
  compu method CM_VcuRxMsg2_Sig{0..3}: identical
  compu method CM_VcuTxMsg1_Sig{0..3}: identical
  compu method CM_VcuTxMsg2_Sig{0..3}: identical
  compu method CM_VcuAdcTxMsg1_Sig{0..3}: identical
  compu method CM_VcuAdcTxMsg2_Sig{0..3}: identical
  compu method CM_VcuRxMsg3_Sig{0..3}: identical
  compu method CM_VcuRxMsg4_Sig{0..3}: identical
  compu method CM_Vcu_Lin0_RxMsg1_Sig0: identical
  compu method CM_Vcu_Lin0_RxMsg1_Sig1: identical
  compu method CM_Vcu_Lin0_RxMsg2_Sig{0..3}: identical
  compu method CM_Vcu_Lin0_TxMsg1_Sig{0..3}: identical
  compu method CM_Vcu_Lin0_TxMsg2_Sig{0..3}: identical
  compu method CM_EXT_A_IN{1..4}: identical
  compu method CM_EXT{1..4}_Valid: identical
  compu method CM_EXT_A_IN{10..16}: identical
  compu method CM_EXT_A_IN{5..9}: identical
  compu method CM_EXT{10..16}_Valid: identical
  compu method CM_EXT{5..9}_Valid: identical
  compu method CM_Act_Pos_sta: phys=raw*0.1-5 for raw 0..3600; unit Degree
  compu method CM_Blockage_Fault_STA: 0=Cx0_False, 1=Cx1_True
  compu method CM_Breakage_Fault_STA: 0=Cx0_False, 1=Cx1_True
  compu method CM_Calibration_cmd: 0=Cx0_Normal, 1=Cx1_SVA_performs_calibration (SVA performs calibration)
  compu method CM_Calibration_sta: 0=Cx0_not_calibration (not calibration), 1=Cx1_calibration_ongoing (calibration ongoing), 2=Cx2_calibration_finished (calibration finished), 3=Cx3_calibration_failed (calibration failed)
  compu method CM_ECC_PMP2_SpdSet: phys=raw*0.4 for raw 0..100; unit %
  compu method CM_ECC_PMP3_SpdSet: phys=raw*0.4 for raw 0..100; unit %
  compu method CM_EDCU_EXV2_Cmd_Init_Rq: 0=Cx0_NO_RQ, 1=Cx1_START_INIT_SQC, 2=Cx2_WAIT_SQC_FINISH
  compu method CM_EDCU_EXV2_Cmd_Move_Enbl: 0=Cx0_DSABL, 1=Cx1_ENBL
  compu method CM_EDCU_EXV2_Cmd_Set_Rq: identical
  compu method CM_EXV1_CurrentInitState: 0=Cx0_NO_INIT, 1=Cx1_INIT_IN_PROCESS, 2=Cx2_Initialized
  compu method CM_EXV1_CurrentPosition: identical
  compu method CM_EXV1_FaultState: 0=Cx0_No_Fault (No Fault), 1=Cx1_COIL_SHRT, 2=Cx2_COIL_OPN, 3=Cx3_Over_temp_shut_down (Over temp shut down), 4=Cx4_Reserved
  compu method CM_EXV1_ResponseError: 0=Cx0_No_Comm_Error (No Comm Error), 1=Cx1_Comm_Error_Active (Comm Error Active)
  compu method CM_EXV1_RunState: 0=Cx0_NO_MOVEMENT, 1=Cx1_ACT_MOVING
  compu method CM_EXV1_TemperatureWarn: 0=Cx0_OK_, 1=Cx1_WARNING
  compu method CM_EXV1_VoltageState: 0=Cx0_Voltage_Range_OK_ (Voltage Range OK), 1=Cx1_Over_Voltage_ (Over Voltage), 2=Cx2_Under_Voltage (Under Voltage)
  compu method CM_EXV2_curInit_Stat: 0=Cx0_NO_INIT, 1=Cx1_INIT_IN_PROCESS, 2=Cx2_INIT_READY, 3=Cx3_Invalid
  compu method CM_EXV2_CurrentInitState: 0=Cx0_NO_INIT, 1=Cx1_INIT_IN_PROCESS, 2=Cx2_Initialized
  compu method CM_EXV2_CurrentPosition: identical
  compu method CM_EXV2_Fault_Stat: 0=Cx0_Actuator_Not_Faulted (Actuator Not Faulted), 1=Cx1_Motor_Coil_shorted (Motor-Coil shorted), 2=Cx2_Motor_Coil_open_load (Motor-Coil open load), 3=Cx3_Over_temperature_shutdown (Over temperature shutdown), 4=Cx4_not_defined (not defined), 5=Cx5_Motor_Stall_ (Motor_Stall?????????)  # Source signal range: [0,4]
  compu method CM_EXV2_FaultState: 0=Cx0_No_Fault (No Fault), 1=Cx1_COIL_SHRT, 2=Cx2_COIL_OPN, 3=Cx3_Over_temp_shut_down (Over temp shut down), 4=Cx4_Reserved
  compu method CM_EXV2_OvrTemp_Warn: 0=Cx0_Ok, 1=Cx1_High_Temperature_Warning (High Temperature Warning), 2=Cx2_not_defined (not defined), 3=Cx3_not_defined (not defined)  # Source signal range: [0,1]
  compu method CM_EXV2_Pos: identical
  compu method CM_EXV2_ResponseError: 0=Cx0_No_Comm_Error (No Comm Error), 1=Cx1_Comm_Error_Active (Comm Error Active)
  compu method CM_EXV2_Run_Stat: 0=Cx0_NO_MOVEMENT, 1=Cx1_ACT_MOVING
  compu method CM_EXV2_RunState: 0=Cx0_NO_MOVEMENT, 1=Cx1_ACT_MOVING
  compu method CM_EXV2_TemperatureWarn: 0=Cx0_OK_, 1=Cx1_WARNING
  compu method CM_EXV2_Volt_Stat: 0=Cx0_VOLT_RANGE_OK, 1=Cx1_OVERVOLTAGE, 2=Cx2_UNDERVOLTAGE, 3=Cx3_not_defined (not defined)  # Source signal range: [0,2]
  compu method CM_EXV2_VoltageState: 0=Cx0_Voltage_Range_OK_ (Voltage Range OK), 1=Cx1_Over_Voltage_ (Over Voltage), 2=Cx2_Under_Voltage (Under Voltage)
  compu method CM_HVCH_CurrSens_Flt: 0=Cx00_Diagnostic_pending (Diagnostic pending), 1=Cx01_Diagnostic_passed (Diagnostic passed), 2=Cx02_0x2_0x1F_Reserve (0x2~0x1F, Reserve)
  compu method CM_HVCH_defectHeaterCircuits: 0=Cx0_No_defect (No defect), 1=Cx1_Leg_1_defect (Leg 1 defect), 2=Cx2_Leg_2_defect (Leg 2 defect), 3=Cx3_Leg_1_2_defect (Leg 1 + 2 defect), 4=Cx4_Leg_3_defect (Leg 3 defect), 5=Cx5_Leg_1_3_defect (Leg 1 + 3 defect), 6=Cx6_Leg_2_3_defect (Leg 2 + 3 defect), 7=Cx7_Leg_1_2_3_defect (Leg 1 + 2 + 3 defect)
  compu method CM_HVCH_DutyCycle: 0=Cx00_0x00_0x96_Valid_value (0x00~0x96, Valid value), 255=CxFF_invalid, phys=raw-50 for raw 1..150; unit percent  # Source signal range: [0,150]
  compu method CM_HVCH_ExtPwrSup_Flt: 0=Cx0_Battery_voltage_okay (Battery voltage okay), 1=Cx1_Battery_voltage_off (Battery voltage off)
  compu method CM_HVCH_HV_DC_curr: 0=Cx00_0x00_0xFE_Valid_value (0x00~0xFE, Valid value), 255=CxFF_invalid, phys=raw*0.25 for raw 1..254; unit A  # Source signal range: [0,254]
  compu method CM_HVCH_HV_voltage: 0=Cx00_0x00_0xFE_Valid_value (0x00~0xFE, Valid value), 255=CxFF_invalid, phys=raw*2 for raw 1..254; unit V  # Source signal range: [0,254]
  compu method CM_HVCH_HV_Voltage_Valid: 0=Cx0_NO_HV_detected (NO HV detected), 1=Cx1_HV_valid (HV valid), 2=Cx2_Under_Voltage (Under Voltage), 3=Cx3_Over_Voltage (Over Voltage)
  compu method CM_HVCH_IntelTemp: 0=Cx00_0x00_0xFE_Valid_value (0x00~0xFE, Valid value), 255=CxFF_invalid, phys=raw-50 for raw 1..254; unit celsius  # Source signal range: [0,254]
  compu method CM_HVCH_InternalPCBTemp: 0=Cx00_0x00_0xFE_Valid_value (0x00~0xFE, Valid value), 255=CxFF_invalid, phys=raw-50 for raw 1..254  # Source signal range: [0,254]
  compu method CM_HVCH_LIN_Flt: 0=Cx0_No_LIN_timeout_detected (No LIN timeout detected), 1=Cx1_LIN_timeout_active (LIN timeout active)
  compu method CM_HVCH_MediumTemp: 0=Cx00_0x00_0xFE_Valid_value (0x00~0xFE, Valid value), 255=CxFF_invalid, phys=raw-50 for raw 1..254; unit celsius  # Source signal range: [0,254]
  compu method CM_HVCH_Off_ShrtCurr: 0=Cx0_No_short_detected (No short detected), 1=Cx1_Short_detected (Short detected)
  compu method CM_HVCH_RsErr: 0=Cx0_No_LIN_response_error_detected (No LIN response error detected), 1=Cx1_LIN_response_error_active (LIN response error active)
  compu method CM_HVCH_Status: 0=Cx0_HV_PTC_off_HVCH_OFF (HV PTC off / HVCH_OFF), 1=Cx1_HV_PTC_on_HVCH_ON (HV PTC on / HVCH_ON), 2=Cx2_0x2_0x7_SNA (0x2~0x7, SNA)
  compu method CM_HVCH_TempLim: 0=Cx0_No_over_temperature_detected (No over temperature detected), 1=Cx1_Over_temp_situation_active (Over temp. situation active)
  compu method CM_HVCH_TempSens_Flt: 0=Cx0_No_fault (No fault), 1=Cx1_fault
  compu method CM_LIN_Resp_Error_sta: 0=Cx0_False, 1=Cx1_True
  compu method CM_PMP2_PumpDryRunningSta: 0=Cx0_Normal, 1=Cx1_DryRun
  compu method CM_PMP2_PumpInputVolt: phys=raw*0.1 for raw 0..30; unit V
  compu method CM_PMP2_PumpMotorSta: 0=Cx0_Normal, 1=Cx1_ShortCircuit, 2=Cx2_OpenCircuit, 3=Cx3_Stall
  compu method CM_PMP2_PumpPowerSta: 0=Cx0_Normal, 1=Cx1_OverVol, 2=Cx2_BelowVol, 3=Cx3_Reserved
  compu method CM_PMP2_PumpTempSta: 0=Cx0_Normal, 1=Cx1_OverTempReduction, 2=Cx2_OverTempShutDown, 3=Cx3_Reserved
  compu method CM_PMP2_RealRPM: phys=raw*0.4 for raw 0..100; unit %
  compu method CM_PMP2_RESP_ERROR: 0=Cx0_Normal, 1=Cx1_Error
  compu method CM_PMP3_PumpDryRunningSta: 0=Cx0_Normal, 1=Cx1_DryRun
  compu method CM_PMP3_PumpInputVolt: phys=raw*0.1 for raw 0..30; unit V
  compu method CM_PMP3_PumpMotorSta: 0=Cx0_Normal, 1=Cx1_ShortCircuit, 2=Cx2_OpenCircuit, 3=Cx3_Stall
  compu method CM_PMP3_PumpPowerSta: 0=Cx0_Normal, 1=Cx1_OverVol, 2=Cx2_BelowVol, 3=Cx3_Reserved
  compu method CM_PMP3_PumpTempSta: 0=Cx0_Normal, 1=Cx1_OverTempReduction, 2=Cx2_OverTempShutDown, 3=Cx3_Reserved
  compu method CM_PMP3_RealRPM: phys=raw*0.4 for raw 0..100; unit %
  compu method CM_PMP3_RESP_ERROR: 0=Cx0_Normal, 1=Cx1_Error
  compu method CM_RsErr_EXV2: 0=Cx0_NO_COMM_ERROR (NO COMM ERROR), 1=Cx1_COMM_ERROR_DETECTED (COMM ERROR DETECTED)
  compu method CM_Target_Pos_cmd: phys=raw*0.1-5 for raw 0..3600; unit Degree
  compu method CM_TCU_HVCH_heating_rq: 0=Cx00_Level0, 1=Cx01_Level1, 2=Cx02_Level2, 3=Cx03_Level3, 4=Cx04_Level4, 5=Cx05_Level5, 6=Cx06_Level6, 7=Cx07_Reserve; unit percent
  compu method CM_TCU_HVCH_On_Rq: 0=Cx0_PTC_OFF, 1=Cx1_PTC_ON, 2=Cx2_reserved_RES (reserved / RES), 3=Cx3_SNA
  compu method CM_TCU_HVCH_TmaxLim_output: 0=Cx00_0x00_0xFE_Valid_value (0x00~0xFE, Valid value), 255=CxFF_invalid, phys=raw-50 for raw 1..254; unit celsius  # Source signal range: [0,254]
  compu method CM_TCU_HVCHMaxPowerLimit: 0=Cx00_0x00_0xFE_Valid_value (0x00~0xFE, Valid value), 255=CxFF_invalid, phys=raw*0.04 for raw 1..254; unit KW  # Source signal range: [0,254]
  compu method CM_TMM_EXV1_EnableRequest: 0=Cx0_EXVNotEnable, 1=Cx1_EXVEnable
  compu method CM_TMM_EXV1_initRequest: 0=Cx0_NO_RQ, 1=Cx1_InitializationReq_, 2=Cx2_waiting_for_Sequence_to_finish (waiting for Sequence to finish)
  compu method CM_TMM_EXV1_PositionRequest: identical
  compu method CM_TMM_EXV2_EnableRequest: 0=Cx0_EXVNotEnable, 1=Cx1_EXVEnable
  compu method CM_TMM_EXV2_initRequest: 0=Cx0_NO_RQ, 1=Cx1_InitializationReq_, 2=Cx2_waiting_for_Sequence_to_finish (waiting for Sequence to finish)
  compu method CM_TMM_EXV2_PositionRequest: identical
  compu method CM_A_I_Actuator_With_F_B_request: 0=Cx0_Stop, 1=Cx1_Request_corotation, 2=Cx2_Request_revrsal
  compu method CM_A_I_F_B: phys=raw*0.1 for raw 0..50; unit V
  compu method CM_COMP_Pdis: phys=raw*0.1 for raw 0..50; unit V
  compu method CM_COMP_Psuc: phys=raw*0.1 for raw 0..50; unit V
  compu method CM_COMP_Tdis: phys=raw*0.1 for raw 0..50; unit V
  compu method CM_COMP_Tsuc: phys=raw*0.1 for raw 0..50; unit V
  compu method CM_COOLING_FAN_request: identical
  compu method CM_HVAC_Blower_request: identical
  compu method CM_Mode_Actuator_request: 0=Cx0_Stop, 1=Cx1_Request_corotation, 2=Cx2_Request_revrsal
  compu method CM_MODE_F_B: phys=raw*0.1 for raw 0..50; unit V
  compu method CM_SV{1..3}_request: 0=Cx0_OFF, 1=Cx1_ON
  compu method CM_Tamb: phys=raw*0.1 for raw 0..50; unit V
  compu method CM_Tevap_Tchiller_out: phys=raw*0.1 for raw 0..50; unit V
  compu method CM_Tincar: phys=raw*0.1 for raw 0..50; unit V
  compu method CM_Tohx_in: phys=raw*0.1 for raw 0..50; unit V
  compu method CM_Tohx_out: phys=raw*0.1 for raw 0..50; unit V
  compu method CM_VCU_Tx_51Ch_NM_PNCData: identical
  compu method CM_VCU_Tx_51Ch_NM_UserData: identical
  compu method CM_Checksum_0BC: identical
  compu method CM_Checksum_0D1: identical
  compu method CM_IBS_AVHSts: identical
  compu method CM_IBS_BrakeFluidWarning: identical
  compu method CM_IBS_EPBFailureStatus: identical
  compu method CM_IBS_ESClampdisplay: identical
  compu method CM_IBS_ESCOffSts: identical
  compu method CM_IBS_FactoryMode: identical
  compu method CM_IBS_HBAActive: identical
  compu method CM_IBS_HDCSts: identical
  compu method CM_IBS_MaintenaceMode: identical
  compu method CM_IBS_RollerbenchMode: identical
  compu method CM_IBS_RWUActive: identical
  compu method CM_IBS_RWUAvailable: identical
  compu method CM_IBS_TireMonSysSts: identical
  compu method CM_IBS_TireWarnFrntLe: identical
  compu method CM_IBS_TireWarnFrntRi: identical
  compu method CM_IBS_TireWarnReLe: identical
  compu method CM_IBS_TireWarnReRi: identical
  compu method CM_IBS_TPMS_ResetSts: identical
  compu method CM_MessageCounter_0BC: identical
  compu method CM_MessageCounter_0D1: identical
  compu method CM_VCU_ActDriveMode: identical
  compu method CM_VCU_ActiveEnergyProfile: identical
  compu method CM_VCU_ActiveRgnBrkProfile: identical
  compu method CM_VCU_BMS_Control_of_NegRelay: identical
  compu method CM_VCU_BMSTargetThermLevel: identical
  compu method CM_VCU_Chargestatus: identical
  compu method CM_VCU_DrvModSwitchWarn: identical
  compu method CM_VCU_HVStatus: identical
  compu method CM_VCU_IsomeasurmentSwitch: identical
  compu method CM_VCU_LimitLevel: identical
  compu method CM_VCU_RegenBrakeLightRequest: identical
  compu method CM_VCU_RegenBrakeLightReqVld: identical
  compu method CM_VCU_RequestedModeBMS: identical
package /DataType/Unit
  8 x unit, all with factor-si-to-unit=1, offset-si-to-unit=0:
    U_C: display-name=¡ãC
    U_A: display-name=A
    U_celsius: display-name=celsius
    U_Degree: display-name=Degree
    U_KW: display-name=KW
    U_p: display-name=%
    U_percent: display-name=percent
    U_V: display-name=V
package /DataTypes
  91 x impl type:
    VcuRxMsg1_Sig0: category=VALUE, base-type=sint16, range raw -32768..32767
    VcuRxMsg1_Sig2: category=VALUE, base-type=sint16, range raw -32768..32767
    VcuRxMsg1_Sig1: category=VALUE, base-type=sint16, range raw -32768..32767
    VcuRxMsg2_Sig3: category=VALUE, base-type=sint16, range raw -32768..32767
    VcuRxMsg1_Sig3: category=VALUE, base-type=sint16, range raw -32768..32767
    VcuRxMsg2_Sig0: category=VALUE, base-type=sint16, range raw -32768..32767
    VcuRxMsg2_Sig2: category=VALUE, base-type=sint16, range raw -32768..32767
    VcuRxMsg2_Sig1: category=VALUE, base-type=sint16, range raw -32768..32767
    VcuTxMsg1_Sig1: category=VALUE, base-type=sint16, range raw -32768..32767
    VcuTxMsg2_Sig1: category=VALUE, base-type=sint16, range raw -32768..32767
    VcuTxMsg2_Sig2: category=VALUE, base-type=sint16, range raw -32768..32767
    VcuTxMsg1_Sig3: category=VALUE, base-type=sint16, range raw -32768..32767
    VcuTxMsg2_Sig0: category=VALUE, base-type=sint16, range raw -32768..32767
    VcuTxMsg2_Sig3: category=VALUE, base-type=sint16, range raw -32768..32767
    VcuTxMsg1_Sig2: category=VALUE, base-type=sint16, range raw -32768..32767
    VcuTxMsg1_Sig0: category=VALUE, base-type=sint16, range raw -32768..32767
    NvM_Array10Bytes: category=ARRAY, sw-calibration-access=READ-ONLY, type-emitter=RTE
      element Element: array-size=10, implementation-data-type=uint8
    NvM_Array32Bytes: category=ARRAY, sw-calibration-access=READ-ONLY, type-emitter=RTE
      element Element: array-size=32, implementation-data-type=uint8
    NvM_Arry4Bytes: category=ARRAY, sw-calibration-access=READ-ONLY, type-emitter=RTE
      element Element: array-size=4, implementation-data-type=uint8
    EXT1_Valid: category=VALUE, base-type=uint16, range raw 0..1
    EXT3_Valid: category=VALUE, base-type=uint16, range raw 0..1
    EXT_A_IN4: category=VALUE, base-type=sint16, range raw -32768..32767
    EXT2_Valid: category=VALUE, base-type=uint16, range raw 0..1
    EXT4_Valid: category=VALUE, base-type=uint16, range raw 0..1
    EXT_A_IN1: category=VALUE, base-type=sint16, range raw -256..255
    EXT_A_IN2: category=VALUE, base-type=sint16, range raw -32768..32767
    EXT_A_IN3: category=VALUE, base-type=sint16, range raw -256..255
    EXT10_Valid: category=VALUE, base-type=uint16, range raw 0..1
    EXT12_Valid: category=VALUE, base-type=uint16, range raw 0..1
    EXT15_Valid: category=VALUE, base-type=uint16, range raw 0..1
    EXT5_Valid: category=VALUE, base-type=uint16, range raw 0..1
    EXT_A_IN15: category=VALUE, base-type=sint16, range raw -256..255
    EXT7_Valid: category=VALUE, base-type=uint16, range raw 0..1
    EXT_A_IN13: category=VALUE, base-type=sint16, range raw -256..255
    EXT_A_IN5: category=VALUE, base-type=sint16, range raw -256..255
    EXT6_Valid: category=VALUE, base-type=uint16, range raw 0..1
    EXT_A_IN12: category=VALUE, base-type=sint16, range raw -32768..32767
    EXT_A_IN7: category=VALUE, base-type=sint16, range raw -256..255
    EXT13_Valid: category=VALUE, base-type=uint16, range raw 0..1
    EXT_A_IN9: category=VALUE, base-type=sint16, range raw -256..255
    EXT9_Valid: category=VALUE, base-type=uint16, range raw 0..1
    EXT8_Valid: category=VALUE, base-type=uint16, range raw 0..1
    EXT11_Valid: category=VALUE, base-type=uint16, range raw 0..1
    EXT_A_IN6: category=VALUE, base-type=sint16, range raw -32768..32767
    EXT16_Valid: category=VALUE, base-type=uint16, range raw 0..1
    EXT14_Valid: category=VALUE, base-type=uint16, range raw 0..1
    EXT_A_IN16: category=VALUE, base-type=sint16, range raw -32768..32767
    EXT_A_IN11: category=VALUE, base-type=sint16, range raw -256..255
    EXT_A_IN8: category=VALUE, base-type=sint16, range raw -32768..32767
    EXT_A_IN14: category=VALUE, base-type=sint16, range raw -32768..32767
    EXT_A_IN10: category=VALUE, base-type=sint16, range raw -32768..32767
    ECC_PMP2_SpdSet: category=VALUE, base-type=uint8, range raw 0..100
    ECC_PMP3_SpdSet: category=VALUE, base-type=uint8, range raw 0..100
    IDT_Arry8Bytes: category=ARRAY, sw-calibration-access=READ-ONLY, type-emitter=RTE
      element Element: array-size=8, implementation-data-type=uint8
    SG_IBS_Status_06_Signal_Group: category=STRUCTURE
      20 x element, all with category=TYPE_REFERENCE:
        Checksum_0BC: range raw 0..255, implementation-data-type=Checksum_0BC
        IBS_AVHSts: range raw 0..2, implementation-data-type=IBS_AVHSts
        IBS_BrakeFluidWarning: range raw 0..3, implementation-data-type=IBS_BrakeFluidWarning
        IBS_EPBFailureStatus: range raw 0..3, implementation-data-type=IBS_EPBFailureStatus
        IBS_ESClampdisplay: range raw 0..2, implementation-data-type=IBS_ESClampdisplay
        IBS_ESCOffSts: range raw 0..1, implementation-data-type=IBS_ESCOffSts
        IBS_FactoryMode: range raw 0..1, implementation-data-type=IBS_FactoryMode
        IBS_HBAActive: range raw 0..1, implementation-data-type=IBS_HBAActive
        IBS_HDCSts: range raw 0..2, implementation-data-type=IBS_HDCSts
        IBS_MaintenaceMode: range raw 0..1, implementation-data-type=IBS_MaintenaceMode
        IBS_RollerbenchMode: range raw 0..1, implementation-data-type=IBS_RollerbenchMode
        IBS_RWUActive: range raw 0..1, implementation-data-type=IBS_RWUActive
        IBS_RWUAvailable: range raw 0..1, implementation-data-type=IBS_RWUAvailable
        IBS_TireMonSysSts: range raw 0..1, implementation-data-type=IBS_TireMonSysSts
        IBS_TireWarnFrntLe: range raw 0..1, implementation-data-type=IBS_TireWarnFrntLe
        IBS_TireWarnFrntRi: range raw 0..1, implementation-data-type=IBS_TireWarnFrntRi
        IBS_TireWarnReLe: range raw 0..1, implementation-data-type=IBS_TireWarnReLe
        IBS_TireWarnReRi: range raw 0..1, implementation-data-type=IBS_TireWarnReRi
        IBS_TPMS_ResetSts: range raw 0..1, implementation-data-type=IBS_TPMS_ResetSts
        MessageCounter_0BC: range raw 0..15, implementation-data-type=MessageCounter_0BC
    Checksum_0BC: category=VALUE, base-type=uint8
    IBS_AVHSts: category=VALUE, base-type=uint8
    IBS_BrakeFluidWarning: category=VALUE, base-type=uint8
    IBS_EPBFailureStatus: category=VALUE, base-type=uint8
    IBS_ESClampdisplay: category=VALUE, base-type=uint8
    IBS_ESCOffSts: category=VALUE, base-type=boolean
    IBS_FactoryMode: category=VALUE, base-type=boolean
    IBS_HBAActive: category=VALUE, base-type=boolean
    IBS_HDCSts: category=VALUE, base-type=uint8
    IBS_MaintenaceMode: category=VALUE, base-type=boolean
    IBS_RollerbenchMode: category=VALUE, base-type=boolean
    IBS_RWUActive: category=VALUE, base-type=boolean
    IBS_RWUAvailable: category=VALUE, base-type=boolean
    IBS_TireMonSysSts: category=VALUE, base-type=boolean
    IBS_TireWarnFrntLe: category=VALUE, base-type=boolean
    IBS_TireWarnFrntRi: category=VALUE, base-type=boolean
    IBS_TireWarnReLe: category=VALUE, base-type=boolean
    IBS_TireWarnReRi: category=VALUE, base-type=boolean
    IBS_TPMS_ResetSts: category=VALUE, base-type=boolean
    MessageCounter_0BC: category=VALUE, base-type=uint8
    SG_VCU_BMS_Signal_Group: category=STRUCTURE
      15 x element, all with category=TYPE_REFERENCE:
        Checksum_0D1: range raw 0..255, implementation-data-type=Checksum_0D1
        MessageCounter_0D1: range raw 0..15, implementation-data-type=MessageCounter_0D1
        VCU_ActDriveMode: range raw 0..4, implementation-data-type=VCU_ActDriveMode
        VCU_ActiveEnergyProfile: range raw 0..7, implementation-data-type=VCU_ActiveEnergyProfile
        VCU_ActiveRgnBrkProfile: range raw 0..7, implementation-data-type=VCU_ActiveRgnBrkProfile
        VCU_BMS_Control_of_NegRelay: range raw 0..2, implementation-data-type=VCU_BMS_Control_of_NegRelay
        VCU_BMSTargetThermLevel: range raw 0..3, implementation-data-type=VCU_BMSTargetThermLevel
        VCU_Chargestatus: range raw 0..14, implementation-data-type=VCU_Chargestatus
        VCU_DrvModSwitchWarn: range raw 0..7, implementation-data-type=VCU_DrvModSwitchWarn
        VCU_HVStatus: range raw 0..5, implementation-data-type=VCU_HVStatus
        VCU_IsomeasurmentSwitch: range raw 0..1, implementation-data-type=VCU_IsomeasurmentSwitch
        VCU_LimitLevel: range raw 0..3, implementation-data-type=VCU_LimitLevel
        VCU_RegenBrakeLightRequest: range raw 0..1, implementation-data-type=VCU_RegenBrakeLightRequest
        VCU_RegenBrakeLightReqVld: range raw 0..1, implementation-data-type=VCU_RegenBrakeLightReqVld
        VCU_RequestedModeBMS: range raw 0..7, implementation-data-type=VCU_RequestedModeBMS
    Checksum_0D1: category=VALUE, base-type=uint8
    MessageCounter_0D1: category=VALUE, base-type=uint8
    VCU_ActDriveMode: category=VALUE, base-type=uint8
    VCU_ActiveEnergyProfile: category=VALUE, base-type=uint8
    VCU_ActiveRgnBrkProfile: category=VALUE, base-type=uint8
    VCU_BMS_Control_of_NegRelay: category=VALUE, base-type=uint8
    VCU_BMSTargetThermLevel: category=VALUE, base-type=uint8
    VCU_Chargestatus: category=VALUE, base-type=uint8
    VCU_DrvModSwitchWarn: category=VALUE, base-type=uint8
    VCU_HVStatus: category=VALUE, base-type=uint8
    VCU_IsomeasurmentSwitch: category=VALUE, base-type=boolean
    VCU_LimitLevel: category=VALUE, base-type=uint8
    VCU_RegenBrakeLightRequest: category=VALUE, base-type=boolean
    VCU_RegenBrakeLightReqVld: category=VALUE, base-type=boolean
    VCU_RequestedModeBMS: category=VALUE, base-type=uint8
