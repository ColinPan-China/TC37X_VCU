AUTOSAR XML (schema 00046)
standard types defined: sint16, uint8, uint16, boolean, sint8, uint32, sint32
package /Predefined_DEV/ImplementationDataTypes
  impl type NvM_RequestResultType: compu {0=NVM_REQ_OK, 1=NVM_REQ_NOT_OK, 2=NVM_REQ_PENDING, 3=NVM_REQ_INTEGRITY_FAILED, 4=NVM_REQ_BLOCK_SKIPPED, 5=NVM_REQ_NV_INVALIDATED, 6=NVM_REQ_CANCELED, 7=NVM_REQ_REDUNDANCY_FAILED, 8=NVM_REQ_RESTORED_FROM_ROM}, implementation-data-type=uint8
  impl type NvM_ServiceIdType: compu {6=NVM_READ_BLOCK, 7=NVM_WRITE_BLOCK, 8=NVM_RESTORE_BLOCK_DEFAULTS, 9=NVM_ERASE_BLOCK, 11=NVM_INVALIDATE_NV_BLOCK, 12=NVM_READ_ALL}, implementation-data-type=uint8
  impl type Dem_UdsStatusByteType: compu {mask 1: 1=DEM_UDS_STATUS_TF, mask 2: 2=DEM_UDS_STATUS_TFTOC, mask 4: 4=DEM_UDS_STATUS_PDTC, mask 8: 8=DEM_UDS_STATUS_CDTC, mask 16: 16=DEM_UDS_STATUS_TNCSLC, mask 32: 32=DEM_UDS_STATUS_TFSLC, mask 64: 64=DEM_UDS_STATUS_TNCTOC, mask 128: 128=DEM_UDS_STATUS_WIR}, range raw 0..255, implementation-data-type=uint8
package /DataType
  base type uint8_6_none: category=FIXED_LENGTH, base-type-size=8, base-type-encoding=NONE
  base type uint8_8_none: category=FIXED_LENGTH, base-type-size=8, base-type-encoding=NONE
package /DataType/Constraint
  range DC_VcuRxMsg1_Sig{0..3}: raw -32768..32767
  range DC_VcuRxMsg2_Sig{0..3}: raw -32768..32767
  range DC_VcuTxMsg1_Sig{0..3}: raw -32768..32767
  range DC_VcuTxMsg2_Sig{0..3}: raw -32768..32767
  range DC_VcuAdcTxMsg1_Sig{0..3}: raw -32768..32767
  range DC_VcuAdcTxMsg2_Sig{0..3}: raw -32768..32767
  range DC_VcuRxMsg3_Sig{0..3}: raw -32768..32767
  range DC_VcuRxMsg4_Sig{0..3}: raw -32768..32767
  range DC_Vcu_Lin0_RxMsg1_Sig0: raw 0..255
  range DC_Vcu_Lin0_RxMsg1_Sig1: raw 0..255
  range DC_Vcu_Lin0_RxMsg2_Sig{0..3}: raw 0..255
  range DC_Vcu_Lin0_TxMsg1_Sig{0..3}: raw 0..255
  range DC_Vcu_Lin0_TxMsg2_Sig{0..3}: raw 0..255
  range DC_EXT_A_IN1: raw -256..255
  range DC_EXT_A_IN2: raw -32768..32767
  range DC_EXT_A_IN3: raw -256..255
  range DC_EXT_A_IN4: raw -32768..32767
  range DC_EXT{1..4}_Valid: raw 0..1
  range DC_EXT_A_IN10: raw -32768..32767
  range DC_EXT_A_IN11: raw -256..255
  range DC_EXT_A_IN12: raw -32768..32767
  range DC_EXT_A_IN13: raw -256..255
  range DC_EXT_A_IN14: raw -32768..32767
  range DC_EXT_A_IN15: raw -256..255
  range DC_EXT_A_IN16: raw -32768..32767
  range DC_EXT_A_IN5: raw -256..255
  range DC_EXT_A_IN6: raw -32768..32767
  range DC_EXT_A_IN7: raw -256..255
  range DC_EXT_A_IN8: raw -32768..32767
  range DC_EXT_A_IN9: raw -256..255
  range DC_EXT{10..16}_Valid: raw 0..1
  range DC_EXT{5..9}_Valid: raw 0..1
  range DC_Act_Pos_sta: raw 0..3600
  range DC_Blockage_Fault_STA: raw 0..1
  range DC_Breakage_Fault_STA: raw 0..1
  range DC_Calibration_cmd: raw 0..1
  range DC_Calibration_sta: raw 0..3
  range DC_EDCU_EXV2_Cmd_Init_Rq: raw 0..7
  range DC_EDCU_EXV2_Cmd_Move_Enbl: raw 0..1
  range DC_EDCU_EXV2_Cmd_Set_Rq: raw 0..576
  range DC_EXV1_CurrentInitState: raw 0..3
  range DC_EXV1_CurrentPosition: raw 0..500
  range DC_EXV1_FaultState: raw 0..4
  range DC_EXV1_ResponseError: raw 0..1
  range DC_EXV1_RunState: raw 0..1
  range DC_EXV1_TemperatureWarn: raw 0..1
  range DC_EXV1_VoltageState: raw 0..2
  range DC_EXV2_curInit_Stat: raw 0..3
  range DC_EXV2_CurrentInitState: raw 0..3
  range DC_EXV2_CurrentPosition: raw 0..500
  range DC_EXV2_Fault_Stat: raw 0..5
  range DC_EXV2_FaultState: raw 0..4
  range DC_EXV2_OvrTemp_Warn: raw 0..3
  range DC_EXV2_Pos: raw 0..576
  range DC_EXV2_ResponseError: raw 0..1
  range DC_EXV2_Run_Stat: raw 0..1
  range DC_EXV2_RunState: raw 0..1
  range DC_EXV2_TemperatureWarn: raw 0..1
  range DC_EXV2_Volt_Stat: raw 0..3
  range DC_EXV2_VoltageState: raw 0..2
  range DC_HVCH_CurrSens_Flt: raw 0..31
  range DC_HVCH_defectHeaterCircuits: raw 0..7
  range DC_HVCH_DutyCycle: raw 0..255
  range DC_HVCH_ExtPwrSup_Flt: raw 0..1
  range DC_HVCH_HV_DC_curr: raw 0..255
  range DC_HVCH_HV_voltage: raw 0..255
  range DC_HVCH_HV_Voltage_Valid: raw 0..3
  range DC_HVCH_IntelTemp: raw 0..255
  range DC_HVCH_InternalPCBTemp: raw 0..255
  range DC_HVCH_LIN_Flt: raw 0..1
  range DC_HVCH_MediumTemp: raw 0..255
  range DC_HVCH_Off_ShrtCurr: raw 0..1
  range DC_HVCH_RsErr: raw 0..1
  range DC_HVCH_Status: raw 0..7
  range DC_HVCH_TempLim: raw 0..1
  range DC_HVCH_TempSens_Flt: raw 0..1
  range DC_LIN_Resp_Error_sta: raw 0..1
  range DC_PMP2_PumpDryRunningSta: raw 0..1
  range DC_PMP2_PumpInputVolt: raw 0..30
  range DC_PMP2_PumpMotorSta: raw 0..3
  range DC_PMP2_PumpPowerSta: raw 0..3
  range DC_PMP2_PumpTempSta: raw 0..3
  range DC_PMP2_RealRPM: raw 0..100
  range DC_PMP2_RESP_ERROR: raw 0..1
  range DC_PMP3_PumpDryRunningSta: raw 0..1
  range DC_PMP3_PumpInputVolt: raw 0..30
  range DC_PMP3_PumpMotorSta: raw 0..3
  range DC_PMP3_PumpPowerSta: raw 0..3
  range DC_PMP3_PumpTempSta: raw 0..3
  range DC_PMP3_RealRPM: raw 0..100
  range DC_PMP3_RESP_ERROR: raw 0..1
  range DC_RsErr_EXV2: raw 0..1
  range DC_Target_Pos_cmd: raw 0..3600
  range DC_TCU_HVCH_heating_rq: raw 0..100
  range DC_TCU_HVCH_On_Rq: raw 0..3
  range DC_TCU_HVCH_TmaxLim_output: raw 0..255
  range DC_TCU_HVCHMaxPowerLimit: raw 0..255
  range DC_TMM_EXV1_EnableRequest: raw 0..1
  range DC_TMM_EXV1_initRequest: raw 0..7
  range DC_TMM_EXV1_PositionRequest: raw 0..500
  range DC_TMM_EXV2_EnableRequest: raw 0..1
  range DC_TMM_EXV2_initRequest: raw 0..7
  range DC_TMM_EXV2_PositionRequest: raw 0..500
  range DC_A_I_Actuator_With_F_B_request: raw 0..2
  range DC_A_I_F_B: raw 0..50
  range DC_COMP_Pdis: raw 0..50
  range DC_COMP_Psuc: raw 0..50
  range DC_COMP_Tdis: raw 0..50
  range DC_COMP_Tsuc: raw 0..50
  range DC_COOLING_FAN_request: raw 0..100
  range DC_HVAC_Blower_request: raw 0..100
  range DC_Mode_Actuator_request: raw 0..2
  range DC_MODE_F_B: raw 0..50
  range DC_SV{1..3}_request: raw 0..1
  range DC_Tamb: raw 0..50
  range DC_Tevap_Tchiller_out: raw 0..50
  range DC_Tincar: raw 0..50
  range DC_Tohx_in: raw 0..50
  range DC_Tohx_out: raw 0..50
  range DC_VcuCan12RxMsg3_Sig{0..3}: raw -32768..32767
  range DC_VcuCan12RxMsg4_Sig{0..3}: raw -32768..32767
  range DC_VcuCan12TxMsg1_Sig{0..3}: raw -32768..32767
  range DC_VcuCan12TxMsg2_Sig{0..3}: raw -32768..32767
  range DC_VCU_Tx_51Ch_NM_UserData: raw 0..281474976710655
  range DC_ACU_CrashOutputSts: raw 0..31
  range DC_ACU_CrashOutputStsValid: raw 0..1
  range DC_ACU_DriverSeatBeltSts: raw 0..1
  range DC_ACU_DriverSeatBeltStsValid: raw 0..1
  range DC_ACU_DriverWarningLampSts: raw 0..2
  range DC_ACU_LatA: raw 0..16383
  range DC_ACU_LatAStatus: raw 0..3
  range DC_ACU_LgtA: raw 0..16383
  range DC_ACU_LgtAStatus: raw 0..3
  range DC_ACU_PassengerAirbagSts: raw 0..3
  range DC_ACU_PassengerSeatBeltSts: raw 0..1
  range DC_ACU_PassengerSeatBeltStsValid: raw 0..1
  range DC_ACU_PassengerSts: raw 0..1
  range DC_ACU_PassengerWarningLampSts: raw 0..2
  range DC_ACU_RLSeatBeltStatusValid: raw 0..1
  range DC_ACU_RRSeatBeltStatusValid: raw 0..1
  range DC_ACU_SecondLeftSeatBeltSts: raw 0..1
  range DC_ACU_SecondLeftSts: raw 0..1
  range DC_ACU_SecondRightSeatBeltSts: raw 0..1
  range DC_ACU_SecondRightSts: raw 0..1
  range DC_ACU_WarningLampSts: raw 0..2
  range DC_ACU_YawRate: raw 0..65535
  range DC_ACU_YawRateStatus: raw 0..3
  range DC_ADCU_ACC_Mode: raw 0..7
  range DC_ADCU_ACCDA_HandsOFF_Warning: raw 0..7
  range DC_ADCU_ACCDA_SYS_Failure: raw 0..3
  range DC_ADCU_AEB_AWB_Level: raw 0..5
  range DC_ADCU_AEB_AWB_Req: raw 0..1
  range DC_ADCU_AEB_Decel_Cmd: raw 0..511
  range DC_ADCU_AEB_Prefill_CMD: raw 0..1
  range DC_ADCU_AEB_State: raw 0..3
  range DC_ADCU_AEB_Stop_Req: raw 0..1
  range DC_ADCU_AEBReq: raw 0..1
  range DC_ADCU_AEBWarningSts: raw 0..7
  range DC_ADCU_APS_Stop_Req: raw 0..2
  range DC_ADCU_APSComfBrkReq: raw 0..2
  range DC_ADCU_APSCrlModeReq: raw 0..3
  range DC_ADCU_APSCrlReq: raw 0..2
  range DC_ADCU_APSCrlTypReq: raw 0..3
  range DC_ADCU_APSDistanceStop: raw 0..4095
  range DC_ADCU_APSMaxSpeedReq: raw 0..31
  range DC_ADCU_DA_Mode: raw 0..7
  range DC_ADCU_FCW_State: raw 0..3
  range DC_ADCU_Parking_CtrlSts: raw 0..3
  range DC_ADCU_Parking_Mode: raw 0..15
  range DC_ADCU_RemoteParkingMode: raw 0..15
  range DC_ADCU_TargetGear: raw 0..4
  range DC_Checksum_090: raw 0..255
  range DC_Checksum_094: raw 0..255
  range DC_Checksum_095: raw 0..255
  range DC_Checksum_097: raw 0..255
  range DC_Checksum_0B{0..4}: raw 0..255
  range DC_Checksum_0B{7..9}: raw 0..255
  range DC_Checksum_0BA: raw 0..255
  range DC_Checksum_0BC: raw 0..255
  range DC_Checksum_0D{1..3}: raw 0..255
  range DC_Checksum_0E0: raw 0..255
  range DC_Checksum_0E2: raw 0..255
  range DC_Checksum_0E4: raw 0..255
  range DC_Checksum_0E6: raw 0..255
  range DC_Checksum_0F5: raw 0..255
  range DC_Checksum_0F6: raw 0..255
  range DC_Checksum_317: raw 0..255
  range DC_Checksum_318: raw 0..255
  range DC_IBS_ABPActive: raw 0..1
  range DC_IBS_ABPAvailable: raw 0..1
  range DC_IBS_ABSActive: raw 0..1
  range DC_IBS_ABSFault: raw 0..1
  range DC_IBS_AEBActive: raw 0..1
  range DC_IBS_AEBAvailable: raw 0..1
  range DC_IBS_APS_Avl: raw 0..3
  range DC_IBS_APSComfortAvl: raw 0..3
  range DC_IBS_APSCrlReqEcho: raw 0..3
  range DC_IBS_APSEmergenyAvl: raw 0..3
  range DC_IBS_APSModeEcho: raw 0..3
  range DC_IBS_APSTrqReqActive: raw 0..1
  range DC_IBS_AVHAvailable: raw 0..1
  range DC_IBS_AVHSts: raw 0..2
  range DC_IBS_AWBActive: raw 0..1
  range DC_IBS_AWBAvailable: raw 0..1
  range DC_IBS_BrakeFluidWarning: raw 0..3
  range DC_IBS_BrakeLightRequest: raw 0..3
  range DC_IBS_BrakePedalStatus: raw 0..3
  range DC_IBS_BrakePedalStatusValid: raw 0..1
  range DC_IBS_BrakePushrodStroke: raw 0..2047
  range DC_IBS_BrakeTypEcho: raw 0..3
  range DC_IBS_CddActive: raw 0..1
  range DC_IBS_CddAvailable: raw 0..1
  range DC_IBS_CddError: raw 0..1
  range DC_IBS_CDPActive: raw 0..1
  range DC_IBS_CDPAvailable: raw 0..1
  range DC_IBS_DTCActive: raw 0..1
  range DC_IBS_DTCFault: raw 0..1
  range DC_IBS_EBDActive: raw 0..1
  range DC_IBS_EBDFault: raw 0..1
  range DC_IBS_EPBControllerSts: raw 0..1
  range DC_IBS_EPBFailureLamp: raw 0..1
  range DC_IBS_EPBFailureStatus: raw 0..3
  range DC_IBS_EPBFunctionLamp: raw 0..3
  range DC_IBS_EPBTextdisplay: raw 0..4
  range DC_IBS_EPBworkingSts: raw 0..7
  range DC_IBS_ESClampdisplay: raw 0..2
  range DC_IBS_ESCOffSts: raw 0..1
  range DC_IBS_FactoryMode: raw 0..1
  range DC_IBS_FLMovingDirection: raw 0..2
  range DC_IBS_FLWheelPulseCounter: raw 0..255
  range DC_IBS_FLWheelSpeed: raw 0..6400
  range DC_IBS_FLWheelSpeed_Fault: raw 0..1
  range DC_IBS_FRMovingDirection: raw 0..2
  range DC_IBS_FRWheelPulseCounter: raw 0..255
  range DC_IBS_FRWheelSpeed: raw 0..6400
  range DC_IBS_FRWheelSpeed_Fault: raw 0..1
  range DC_IBS_HazWarnReq: raw 0..2
  range DC_IBS_HBAActive: raw 0..1
  range DC_IBS_HDCAvailable: raw 0..1
  range DC_IBS_HDCSts: raw 0..2
  range DC_IBS_HHCActive: raw 0..1
  range DC_IBS_HHCAvailable: raw 0..1
  range DC_IBS_MaintenaceMode: raw 0..1
  range DC_IBS_MasterCylinderPressure: raw 0..2500
  range DC_IBS_PlungerPressure: raw 0..2047
  range DC_IBS_RBSStatus: raw 0..1
  range DC_IBS_RLMovingDirection: raw 0..2
  range DC_IBS_RLWheelPulseCounter: raw 0..255
  range DC_IBS_RLWheelSpeed: raw 0..6400
  range DC_IBS_RLWheelSpeed_Fault: raw 0..1
  range DC_IBS_RollerbenchMode: raw 0..1
  range DC_IBS_RRMovingDirection: raw 0..2
  range DC_IBS_RRWheelPulseCounter: raw 0..255
  range DC_IBS_RRWheelSpeed: raw 0..6400
  range DC_IBS_RRWheelSpeed_Fault: raw 0..1
  range DC_IBS_RWUActive: raw 0..1
  range DC_IBS_RWUAvailable: raw 0..1
  range DC_IBS_SystemStatus: raw 0..7
  range DC_IBS_TargetGearReq: raw 0..4
  range DC_IBS_TCSActive: raw 0..1
  range DC_IBS_TCSFault: raw 0..1
  range DC_IBS_TireMonSysSts: raw 0..1
  range DC_IBS_TireWarnFrntLe: raw 0..1
  range DC_IBS_TireWarnFrntRi: raw 0..1
  range DC_IBS_TireWarnReLe: raw 0..1
  range DC_IBS_TireWarnReRi: raw 0..1
  range DC_IBS_TPMS_ResetSts: raw 0..1
  range DC_IBS_VCU_DecelerationReqActive: raw 0..1
  range DC_IBS_VCU_DecelerationRequest_Available: raw 0..3
  range DC_IBS_VDCActive: raw 0..1
  range DC_IBS_VDCFault: raw 0..1
  range DC_IBS_VehicleSpeed: raw 0..6400
  range DC_IBS_VehicleSpeedValid: raw 0..1
  range DC_IBS_VehicleStandstill: raw 0..2
  range DC_IBS_VehicleStandstill_Valid: raw 0..1
  range DC_IBS_VlcActive: raw 0..1
  range DC_IBS_VlcAvalible: raw 0..1
  range DC_IBS_VlcError: raw 0..1
  range DC_IBS_WLTorqueAPSReq: raw 0..40000
  range DC_IBS_WLTorqueAPSReqValid: raw 0..2
  range DC_IBS_WLTorqueIncrReq: raw 0..40000
  range DC_IBS_WLTorqueIncrReqSts: raw 0..1
  range DC_IBS_WLTorqueRBSReq: raw 0..40000
  range DC_IBS_WLTorqueRBSReqValid: raw 0..2
  range DC_IBS_WLTorqueRedReq: raw 0..40000
  range DC_IBS_WLTorqueRedReqSts: raw 0..1
  range DC_IBS_WLTorqueVLCReq: raw 0..32767
  range DC_IBS_WLTorqueVLCReqValid: raw 0..2
  range DC_MessageCounter_090: raw 0..15
  range DC_MessageCounter_094: raw 0..15
  range DC_MessageCounter_095: raw 0..15
  range DC_MessageCounter_097: raw 0..15
  range DC_MessageCounter_0B{0..4}: raw 0..15
  range DC_MessageCounter_0B{7..9}: raw 0..15
  range DC_MessageCounter_0BA: raw 0..15
  range DC_MessageCounter_0BC: raw 0..15
  range DC_MessageCounter_0D{1..3}: raw 0..15
  range DC_MessageCounter_0E0: raw 0..15
  range DC_MessageCounter_0E2: raw 0..15
  range DC_MessageCounter_0E4: raw 0..15
  range DC_MessageCounter_0E6: raw 0..15
  range DC_MessageCounter_0F5: raw 0..15
  range DC_MessageCounter_0F6: raw 0..15
  range DC_MessageCounter_317: raw 0..15
  range DC_MessageCounter_318: raw 0..15
  range DC_SGW_BLEChrgFlaplockCtrlReq: raw 0..3
  range DC_SGW_BLEPowerModeReq: raw 0..3
  range DC_SGW_BLESystemReadyReq: raw 0..3
  range DC_SGW_BLETailgateCtrlReq: raw 0..3
  range DC_SGW_KeyLowBatWarning: raw 0..1
  range DC_VCU_AccelerationPedal: raw 0..1000
  range DC_VCU_AccelerationPedalValid: raw 0..1
  range DC_VCU_ActDriveMode: raw 0..4
  range DC_VCU_ActualGear: raw 0..4
  range DC_VCU_ADASOverride: raw 0..1
  range DC_VCU_APSTorqueRequestActive: raw 0..1
  range DC_VCU_APSTorqueRequestAvailable: raw 0..1
  range DC_VCU_BMS_Control_of_PosRelay: raw 0..2
  range DC_VCU_BMSTargetThermLevel: raw 0..3
  range DC_VCU_BrakeCompensateStatus: raw 0..3
  range DC_VCU_BrakeCompensateWarn: raw 0..3
  range DC_VCU_BrakepedalStatus: raw 0..2
  range DC_VCU_BS_Current: raw 0..16383
  range DC_VCU_BS_IBSBatSOC: raw 0..255
  range DC_VCU_BS_IndicatorSts: raw 0..1
  range DC_VCU_BS_LV_Batt: raw 0..32767
  range DC_VCU_ChargeEndReason: raw 0..3
  range DC_VCU_ChargeProcessComment: raw 0..3
  range DC_VCU_ChargeStatus: raw 0..14
  range DC_VCU_CriSysFailure: raw 0..3
  range DC_VCU_DCDCFail: raw 0..1
  range DC_VCU_DCFCCurrent: raw 0..1023
  range DC_VCU_DecelerationReq: raw 0..255
  range DC_VCU_DecelerationReqactive: raw 0..1
  range DC_VCU_DischargeEndReason: raw 0..3
  range DC_VCU_DischargeEndSoc: raw 0..255
  range DC_VCU_Display_Cur: raw 0..1023
  range DC_VCU_Display_Power: raw 0..4095
  range DC_VCU_DriveMotOvrTemp: raw 0..1
  range DC_VCU_DriverTorqueRequest: raw 0..2045
  range DC_VCU_DrvModSwitchWarn: raw 0..7
  range DC_VCU_EnergyManagementWarn: raw 0..3
  range DC_VCU_EnergyV2L: raw 0..1023
  range DC_VCU_EPBReq: raw 0..3
  range DC_VCU_ForwardVmaxAllowed: raw 0..255
  range DC_VCU_ForwardVmaxlimitStatus: raw 0..1
  range DC_VCU_HVBatCriFail: raw 0..3
  range DC_VCU_HVBatOvrTemp: raw 0..1
  range DC_VCU_HVConnectFault: raw 0..1
  range DC_VCU_HVILError: raw 0..1
  range DC_VCU_HVInsulResFault: raw 0..1
  range DC_VCU_HVStatus: raw 0..5
  range DC_VCU_InvldGearSel: raw 0..15
  range DC_VCU_IsoMeasurementSwitch: raw 0..1
  range DC_VCU_Kickdown: raw 0..1
  range DC_VCU_KL15eOn: raw 0..1
  range DC_VCU_LimitLevel: raw 0..3
  range DC_VCU_LimpHome: raw 0..1
  range DC_VCU_ManuallyUnlockComment: raw 0..1
  range DC_VCU_maxChargeSOC: raw 0..255
  range DC_VCU_MCU_FaultLampReq: raw 0..3
  range DC_VCU_MCUDesiredTorque: raw 0..2047
  range DC_VCU_MCUSurgeDamperState: raw 0..2
  range DC_VCU_MemoryChargeFault: raw 0..1
  range DC_VCU_MileagelowRemind: raw 0..1
  range DC_VCU_MotorActualTorque: raw 0..2047
  range DC_VCU_MotorActualTorqueValid: raw 0..1
  range DC_VCU_OPStandstillReq: raw 0..3
  range DC_VCU_PlugStatus: raw 0..7
  range DC_VCU_PWTErrorLevel: raw 0..15
  range DC_VCU_ReachLimitStd: raw 0..1
  range DC_VCU_RegenBrakeLightRequest: raw 0..1
  range DC_VCU_RegenBrakeLightReqVld: raw 0..1
  range DC_VCU_RegenTorqueCap: raw 0..40000
  range DC_VCU_RegenTorqueCapValid: raw 0..1
  range DC_VCU_RegStatus: raw 0..7
  range DC_VCU_RemainChrgTime: raw 0..3600
  range DC_VCU_RequestedModeBMS: raw 0..7
  range DC_VCU_RequestedModeMCU: raw 0..4
  range DC_VCU_SystemReady: raw 0..1
  range DC_VCU_TargetGear: raw 0..4
  range DC_VCU_TCSActive: raw 0..1
  range DC_VCU_TorqueRequestActive: raw 0..1
  range DC_VCU_TorqueRequestAvailable: raw 0..1
  range DC_VCU_TrqThresholdDampgCtl: raw 0..255
  range DC_VCU_VehicleSpeed: raw 0..6400
  range DC_VCU_VehicleSpeedValid: raw 0..1
  range DC_VCU_VirtualACPedal: raw 0..1000
  range DC_VCU_VirtualACPedalValid: raw 0..1
  range DC_VCU_VLCTorqueRequestActive: raw 0..1
  range DC_VCU_VLCTorqueRequestAvailable: raw 0..1
  range DC_VCU_WakeUpStatus: raw 0..255
  range DC_VCU_WheelTrqACT: raw 0..40000
  range DC_VCU_WheelTrqACTValid: raw 0..1
  range DC_Vcu_Lin3_RxMsg1_Sig0: raw 0..255
  range DC_Vcu_Lin3_RxMsg1_Sig1: raw 0..255
  range DC_Vcu_Lin3_RxMsg2_Sig{0..3}: raw 0..255
  range DC_Vcu_Lin3_TxMsg1_Sig{0..3}: raw 0..255
  range DC_Vcu_Lin3_TxMsg2_Sig{0..3}: raw 0..255
  range DC_APTC_Core1TempSensorFaltStatus: raw 0..3
  range DC_APTC_Core2TempSensorFaltStatus: raw 0..3
  range DC_APTC_DriveFaltStatus: raw 0..1
  range DC_APTC_HeatingFaltStatus: raw 0..1
  range DC_APTC_HighVoltageStatus: raw 0..3
  range DC_APTC_HVBusVoltage: raw 0..2040
  range DC_APTC_HVPowerUpReq: raw 0..1
  range DC_APTC_IGBTFaltStatus: raw 0..3
  range DC_APTC_IGBTTempSensorStatus: raw 0..3
  range DC_APTC_LeftCoreTemp: raw 0..255
  range DC_APTC_LostCommuFaltStatus: raw 0..1
  range DC_APTC_LowVoltageStatus: raw 0..3
  range DC_APTC_OverCurrentFault: raw 0..1
  range DC_APTC_OverLoadStatus: raw 0..3
  range DC_APTC_PCBTempSensorStatus: raw 0..3
  range DC_APTC_PowerConsumption: raw 0..255
  range DC_APTC_RightCoreTemp: raw 0..255
  range DC_BCM_AlarmedRemind: raw 0..1
  range DC_BCM_AntiTheftSts: raw 0..3
  range DC_BCM_AutoCloseWinFunSts: raw 0..1
  range DC_BCM_ChrgFlapLockSts: raw 0..1
  range DC_BCM_DomeLampAutoSts: raw 0..2
  range DC_BCM_DomeLampBrightSts: raw 0..1
  range DC_BCM_FLSeatBeltRemindReq: raw 0..3
  range DC_BCM_FrontWiperModeSts: raw 0..5
  range DC_BCM_FRSeatBeltRemindReq: raw 0..3
  range DC_BCM_GearTimesSts: raw 0..5
  range DC_BCM_Immo_State: raw 0..1
  range DC_BCM_ImmobilizingRemind: raw 0..3
  range DC_BCM_KeyNotInCarRemind: raw 0..1
  range DC_BCM_PepsPowerMode: raw 0..7
  range DC_BCM_PowerOffDisplayReq: raw 0..1
  range DC_BCM_PuddleLiReq: raw 0..2
  range DC_BCM_RLSeatBeltRemindReq: raw 0..3
  range DC_BCM_RRSeatBeltRemindReq: raw 0..3
  range DC_BCM_SecOCFV_272: raw 0..65535
  range DC_BCM_SecOCFV_334: raw 0..65535
  range DC_BCM_SecOCMAC_272: raw 0..4294967295
  range DC_BCM_SecOCMAC_334: raw 0..4294967295
  range DC_BCM_WelLightshowOnOffSts: raw 0..2
  range DC_BCM_WiperServiceSts: raw 0..1
  range DC_BCM_WiperWorkingSts: raw 0..2
  range DC_BMS_AbortAchivesetValue: raw 0..2
  range DC_BMS_AbortAchiveSingleVolt: raw 0..2
  range DC_BMS_AbortAchiveTotalVolt: raw 0..2
  range DC_BMS_AbortErrorCurrent: raw 0..2
  range DC_BMS_AbortErrorVoltage: raw 0..2
  range DC_BMS_AbortFaultBatteryTemp: raw 0..2
  range DC_BMS_AbortFaultBMSTemp: raw 0..2
  range DC_BMS_AllowCellTemperature: raw 0..255
  range DC_BMS_AllowChagCurrent: raw 0..20000
  range DC_BMS_AverageCellTemp: raw 0..255
  range DC_BMS_BalanceCommand: raw 0..1
  range DC_BMS_BalancingStatus: raw 0..1
  range DC_BMS_BatChagSum: raw 0..3000
  range DC_BMS_BatProDatDay: raw 0..1
  range DC_BMS_BatProDatMonth: raw 0..1
  range DC_BMS_BatProDatYear: raw 0..1
  range DC_BMS_BatProRights: raw 0..1
  range DC_BMS_BatSupName: raw 0..4294967295
  range DC_BMS_BattCurr: raw 0..20470
  range DC_BMS_BattVolt: raw 0..10000
  range DC_BMS_BatType: raw 0..255
  range DC_BMS_CellNumbers: raw 0..255
  range DC_BMS_ChagComplete: raw 0..3
  range DC_BMS_ChargeRequest: raw 0..4
  range DC_BMS_ChargeStatus: raw 0..7
  range DC_BMS_ComVersion: raw 0..65535
  range DC_BMS_CoolCommand: raw 0..7
  range DC_BMS_DCChgMode: raw 0..2
  range DC_BMS_DisChgCurr: raw 0..20000
  range DC_BMS_DisplaySOC: raw 0..10000
  range DC_BMS_DTC: raw 0..255
  range DC_BMS_ErrorBattOverVolt: raw 0..3
  range DC_BMS_ErrorBattUnderVolt: raw 0..3
  range DC_BMS_ErrorBatVolt: raw 0..3
  range DC_BMS_ErrorBSUBalance: raw 0..1
  range DC_BMS_ErrorBSUOffline: raw 0..1
  range DC_BMS_ErrorCellHighTemp: raw 0..3
  range DC_BMS_ErrorCellLowTemp: raw 0..3
  range DC_BMS_ErrorCellOverVolt: raw 0..3
  range DC_BMS_ErrorCellTempDiff: raw 0..3
  range DC_BMS_ErrorCellTempOffline: raw 0..1
  range DC_BMS_ErrorCellUnderVolt: raw 0..3
  range DC_BMS_ErrorCellVoltDiff: raw 0..3
  range DC_BMS_ErrorCellVoltOffline: raw 0..1
  range DC_BMS_ErrorChaCurrentOver: raw 0..3
  range DC_BMS_ErrorDisChaCurrentOver: raw 0..3
  range DC_BMS_ErrorEmergencyOffCrash: raw 0..1
  range DC_BMS_ErrorHallOffline: raw 0..1
  range DC_BMS_ErrorHighSoc: raw 0..1
  range DC_BMS_ErrorHVIL: raw 0..1
  range DC_BMS_ErrorIsolationSingleLow: raw 0..3
  range DC_BMS_ErrorLeakCurrent: raw 0..3
  range DC_BMS_ErrorLeakDet: raw 0..1
  range DC_BMS_ErrorLevel: raw 0..4
  range DC_BMS_ErrorLowSoc: raw 0..3
  range DC_BMS_ErrorPreChaFailed: raw 0..1
  range DC_BMS_ErrorRelay: raw 0..1
  range DC_BMS_ErrorSmoke: raw 0..1
  range DC_BMS_ErrorSoCJump_RM: raw 0..1
  range DC_BMS_ErrorSystemsMatch: raw 0..1
  range DC_BMS_FeedbackCurr: raw 0..20000
  range DC_BMS_FlowRate: raw 0..255
  range DC_BMS_HardVsesion: raw 0..1
  range DC_BMS_HeatCommand: raw 0..7
  range DC_BMS_Heatcurrent: raw 0..20470
  range DC_BMS_HVinterlockState: raw 0..1
  range DC_BMS_InsulationDetectionStatus: raw 0..1
  range DC_BMS_KeepWarmRequest: raw 0..1
  range DC_BMS_KeepWarmStatus: raw 0..2
  range DC_BMS_Life: raw 0..255
  range DC_BMS_LinkVoltage: raw 0..65535
  range DC_BMS_MaxCellTemp: raw 0..255
  range DC_BMS_MaxCellTempModuleNO: raw 0..255
  range DC_BMS_MaxCellTempNO: raw 0..255
  range DC_BMS_MaxCellVoltage: raw 0..65535
  range DC_BMS_MaxCellVoltageModuleNO: raw 0..15
  range DC_BMS_MaxCellVoltageNO: raw 0..255
  range DC_BMS_MaxChagVoltage: raw 0..65535
  range DC_BMS_MinCellTemp: raw 0..255
  range DC_BMS_MinCellTempModuleNO: raw 0..255
  range DC_BMS_MinCellTempNO: raw 0..255
  range DC_BMS_MinCellVoltage: raw 0..65535
  range DC_BMS_MinCellVoltageModlueNO: raw 0..15
  range DC_BMS_MinCellVoltageNO: raw 0..255
  range DC_BMS_NegRelayStatus: raw 0..3
  range DC_BMS_PackVoltage: raw 0..65535
  range DC_BMS_PosRelayStatus: raw 0..3
  range DC_BMS_PreCharge: raw 0..3
  range DC_BMS_PreRelayStatus: raw 0..3
  range DC_BMS_PTC_VoltageValue: raw 0..1023
  range DC_BMS_PTC_WorkStatus: raw 0..2
  range DC_BMS_PTC_WorkTime: raw 0..255
  range DC_BMS_PTCRelayStatus: raw 0..3
  range DC_BMS_RatBatVoltage: raw 0..65535
  range DC_BMS_RatCapacity: raw 0..65535
  range DC_BMS_RatEnergy: raw 0..65535
  range DC_BMS_RemainCapacity: raw 0..65535
  range DC_BMS_RemChagTime: raw 0..3600
  range DC_BMS_RTC_Request: raw 0..1
  range DC_BMS_RunHeatStatus: raw 0..4
  range DC_BMS_SingChgkwh: raw 0..255
  range DC_BMS_SOC: raw 0..10000
  range DC_BMS_SoftVsesion: raw 0..1
  range DC_BMS_SOH: raw 0..200
  range DC_BMS_SumChgkwh: raw 0..16777216
  range DC_BMS_SysRegInsulationValue: raw 0..60000
  range DC_BMS_TargetBatteryMaxCellTemp: raw 0..255
  range DC_BMS_TempInlet: raw 0..255
  range DC_BMS_Tempoutlet: raw 0..255
  range DC_BMS_ThermalRunawayFault: raw 0..1
  range DC_BMS_ThermometerProbes: raw 0..255
  range DC_BMS_ThrmlRunawayFault: raw 0..1
  range DC_BMS_WorkMode: raw 0..7
  range DC_CGW_ADCUSts: raw 0..1
  range DC_CGW_BCMSts: raw 0..1
  range DC_CGW_BMSSts: raw 0..1
  range DC_CGW_CBMSts: raw 0..1
  range DC_CGW_CGWSts: raw 0..1
  range DC_CGW_DCM_FLSts: raw 0..1
  range DC_CGW_DCM_FRSts: raw 0..1
  range DC_CGW_DCM_RLSts: raw 0..1
  range DC_CGW_DCM_RRSts: raw 0..1
  range DC_CGW_HLLSts: raw 0..1
  range DC_CGW_HLRSts: raw 0..1
  range DC_CGW_HOD_HeatingSts: raw 0..1
  range DC_CGW_IVISts: raw 0..1
  range DC_CGW_MFP_FCSts: raw 0..1
  range DC_CGW_MFP_RCSts: raw 0..1
  range DC_CGW_PRNDSts: raw 0..1
  range DC_CGW_SCU_LSts: raw 0..1
  range DC_CGW_SCU_RSts: raw 0..1
  range DC_CGW_SGWSts: raw 0..1
  range DC_CGW_SwichesSts: raw 0..1
  range DC_CGW_SWPSts: raw 0..1
  range DC_CGW_VCUSts: raw 0..1
  range DC_CGW_VehicleState: raw 0..8
  range DC_CGW_VERSION1: raw 0..5
  range DC_CGW_VERSION2: raw 0..255
  range DC_CGW_VIN0: raw 0..255
  range DC_CGW_VIN1: raw 0..255
  range DC_CGW_VIN{10..16}: raw 0..255
  range DC_CGW_VIN{2..9}: raw 0..255
  range DC_Checksum_098: raw 0..255
  range DC_Checksum_0BB: raw 0..255
  range DC_Checksum_0C1: raw 0..255
  range DC_Checksum_0F9: raw 0..255
  range DC_Checksum_248: raw 0..255
  range DC_Checksum_253: raw 0..255
  range DC_checksum_271: raw 0..255
  range DC_Checksum_278: raw 0..255
  range DC_Checksum_28A: raw 0..255
  range DC_Checksum_33A: raw 0..255
  range DC_DCM_FL_DoorFLSts: raw 0..1
  range DC_DCM_FL_FRWndSwA: raw 0..5
  range DC_DCM_FL_LeftMirrorHorizontalPos: raw 0..255
  range DC_DCM_FL_LeftMirrorVerticalPos: raw 0..255
  range DC_DCM_FL_MirrorAutoFoldUnfoldSts: raw 0..1
  range DC_DCM_FL_MirrorAutoTurnDownSts: raw 0..1
  range DC_DCM_FL_MirrorFold_UnfoldSts: raw 0..1
  range DC_DCM_FL_RearmirrorHeatingSts: raw 0..1
  range DC_DCM_FL_RLWndSwA: raw 0..5
  range DC_DCM_FL_RRWndSwA: raw 0..5
  range DC_DCM_FR_AmbientTemperature: raw 0..255
  range DC_DCM_FR_AmbientTemperatureValid: raw 0..1
  range DC_DCM_FR_DoorAntiPinchSts: raw 0..1
  range DC_DCM_FR_DoorFRAngle: raw 0..100
  range DC_DCM_FR_DoorFRLockSts: raw 0..1
  range DC_DCM_FR_DoorFRSts: raw 0..1
  range DC_DCM_FR_DoorObstacleSts: raw 0..1
  range DC_DCM_FR_ElectricDoorMovementSts: raw 0..7
  range DC_DCM_FR_FrontDoorAngleFeedback: raw 0..1
  range DC_DCM_FR_FRPESwitchReq: raw 0..1
  range DC_DCM_FR_FRWindowLockSts: raw 0..1
  range DC_DCM_FR_GLASS_LOCATION: raw 0..20
  range DC_DCM_FR_InsideSwitchReq: raw 0..1
  range DC_DCM_FR_LinkageAvoidanceReq: raw 0..3
  range DC_DCM_FR_MirrorAutoFoldUnfoldSts: raw 0..1
  range DC_DCM_FR_MirrorAutoTurnDownSts: raw 0..1
  range DC_DCM_FR_MirrorFold_UnfoldSts: raw 0..1
  range DC_DCM_FR_PWM_POS_STS: raw 0..4
  range DC_DCM_FR_RearmirrorHeatingSts: raw 0..1
  range DC_DCM_FR_RightMirrorHorizontalPos: raw 0..255
  range DC_DCM_FR_RightMirrorVerticalPos: raw 0..255
  range DC_DCM_FR_WindowSts: raw 0..5
  range DC_DCM_RL_DoorAntiPinchSts: raw 0..1
  range DC_DCM_RL_DoorObstacleSts: raw 0..1
  range DC_DCM_RL_DoorRLAngle: raw 0..100
  range DC_DCM_RL_DoorRLLockSts: raw 0..1
  range DC_DCM_RL_DoorRLSts: raw 0..1
  range DC_DCM_RL_ElectricDoorMovementSts: raw 0..7
  range DC_DCM_RL_GLASS_LOCATION: raw 0..20
  range DC_DCM_RL_InsideSwitchReq: raw 0..1
  range DC_DCM_RL_LinkageAvoidanceReq: raw 0..3
  range DC_DCM_RL_PWM_POS_STS: raw 0..4
  range DC_DCM_RL_RearDoorAngleFeedback: raw 0..1
  range DC_DCM_RL_RLPESwitchReq: raw 0..1
  range DC_DCM_RL_RLWindowLockSts: raw 0..1
  range DC_DCM_RL_WindowSts: raw 0..5
  range DC_DCM_RR_DoorAntiPinchSts: raw 0..1
  range DC_DCM_RR_DoorObstacleSts: raw 0..1
  range DC_DCM_RR_DoorRRAngle: raw 0..100
  range DC_DCM_RR_DoorRRLockSts: raw 0..1
  range DC_DCM_RR_DoorRRSts: raw 0..1
  range DC_DCM_RR_ElectricDoorMovementSts: raw 0..7
  range DC_DCM_RR_GLASS_LOCATION: raw 0..20
  range DC_DCM_RR_InsideSwitchReq: raw 0..1
  range DC_DCM_RR_LinkageAvoidanceReq: raw 0..3
  range DC_DCM_RR_PWM_POS_STS: raw 0..4
  range DC_DCM_RR_RearDoorAngleFeedback: raw 0..1
  range DC_DCM_RR_RRPESwitchReq: raw 0..1
  range DC_DCM_RR_RRWindowLockSts: raw 0..1
  range DC_DCM_RR_WindowSts: raw 0..5
  range DC_EVCOM_ActlOprtMode: raw 0..7
  range DC_EVCOM_CommunicationError: raw 0..1
  range DC_EVCOM_CompActlCnsmpCur: raw 0..255
  range DC_EVCOM_CompActlPwrCnsmp: raw 0..255
  range DC_EVCOM_CompActlSpd: raw 0..9200
  range DC_EVCOM_CompDeviceInternTemp: raw 0..255
  range DC_EVCOM_OverCurDropFreqError: raw 0..1
  range DC_EVCOM_OverCurrentError: raw 0..1
  range DC_EVCOM_OverPwrDropFreqError: raw 0..1
  range DC_EVCOM_OverVoltageError: raw 0..1
  range DC_EVCOM_StandByOverVolError: raw 0..1
  range DC_EVCOM_StandByUnderVolError: raw 0..1
  range DC_EVCOM_UnderVoltageError: raw 0..1
  range DC_IBS_SUBEPBControllerSts: raw 0..1
  range DC_IBS_SUBEPBFailureStatus: raw 0..3
  range DC_IBS_SUBEPBworkingSts: raw 0..7
  range DC_IVI_AppointChargeCmd: raw 0..2
  range DC_IVI_AVHSet: raw 0..3
  range DC_IVI_BrakeCompensateCmd: raw 0..3
  range DC_IVI_BulbCheckSts: raw 0..1
  range DC_IVI_CRLevelSet: raw 0..7
  range DC_IVI_DriveModeSet: raw 0..4
  range DC_IVI_DschrgOnOffSet: raw 0..3
  range DC_IVI_ESCOffSet: raw 0..3
  range DC_IVI_ForwardVmaxAllowed: raw 0..175
  range DC_IVI_ForwardVmaxlimitSw: raw 0..3
  range DC_IVI_GearRequest: raw 0..5
  range DC_IVI_HDCOffSet: raw 0..3
  range DC_IVI_KeepWarmRequest: raw 0..2
  range DC_IVI_LockACPlug: raw 0..2
  range DC_IVI_LV_LimitPop: raw 0..2
  range DC_IVI_MaxChrgSocSet: raw 0..255
  range DC_IVI_MirrorInterfaceMode: raw 0..1
  range DC_IVI_OdometerInfor: raw 0..9999999
  range DC_IVI_OdometerInforValid: raw 0..1
  range DC_IVI_SFIabnormalSts: raw 0..1
  range DC_IVI_SFIDippedBeamSet: raw 0..3
  range DC_IVI_SteeringModeSet: raw 0..3
  range DC_IVI_TPMS_Reset: raw 0..1
  range DC_IVI_V2LidisSet: raw 0..255
  range DC_IVI_VrState: raw 0..1
  range DC_IVI_WCBSReminderSet: raw 0..2
  range DC_MCU_ActTrqValid: raw 0..1
  range DC_MCU_ActualSpeed: raw 0..65535
  range DC_MCU_ActualSpeedValid: raw 0..1
  range DC_MCU_ActualTorque: raw 0..2047
  range DC_MCU_ActUnfilteredRotSpd: raw 0..65534
  range DC_MCU_BDmpCActv: raw 0..1
  range DC_MCU_DmpCTrqCurr: raw 0..250
  range DC_MCU_FaultLevel: raw 0..7
  range DC_MCU_IGBTTempMax: raw 0..255
  range DC_MCU_IGBTTempRiseMax: raw 0..255
  range DC_MCU_IGBTTempRiseU: raw 0..255
  range DC_MCU_IGBTTempRiseV: raw 0..255
  range DC_MCU_IGBTTempRiseW: raw 0..255
  range DC_MCU_IGBTTempU: raw 0..255
  range DC_MCU_IGBTTempV: raw 0..255
  range DC_MCU_IGBTTempW: raw 0..255
  range DC_MCU_IsCurr: raw 0..2047
  range DC_MCU_Isd: raw 0..4093
  range DC_MCU_Isq: raw 0..4093
  range DC_MCU_OfsAl: raw 0..4092
  range DC_MCU_SpdMaxLimit: raw 0..65534
  range DC_MCU_StDischg: raw 0..3
  range DC_MCU_StGateDrv: raw 0..3
  range DC_MCU_TempCurrCool: raw 0..255
  range DC_MCU_TempCurrStr1: raw 0..255
  range DC_MCU_TempCurrStr2: raw 0..255
  range DC_MCU_TempCurrStrMax: raw 0..255
  range DC_MCU_TempRiseCurrStr: raw 0..255
  range DC_MCU_TempStatus: raw 0..3
  range DC_MCU_TrqAbsMax: raw 0..2046
  range DC_MCU_TrqAbsMin: raw 0..2046
  range DC_MCU_UdcCurr: raw 0..1023
  range DC_MCU_UT15State: raw 0..1
  range DC_MCU_UT30Curr: raw 0..62
  range DC_MCU_VCUWorkMode: raw 0..8
  range DC_MessageCounter_098: raw 0..15
  range DC_MessageCounter_0BB: raw 0..15
  range DC_MessageCounter_0C1: raw 0..15
  range DC_MessageCounter_0F9: raw 0..15
  range DC_MessageCounter_248: raw 0..15
  range DC_MessageCounter_253: raw 0..15
  range DC_MessageCounter_271: raw 0..15
  range DC_MessageCounter_278: raw 0..15
  range DC_MessageCounter_28A: raw 0..15
  range DC_MessageCounter_33A: raw 0..15
  range DC_OBC_OutputIsolatedFault: raw 0..1
  range DC_POD_CANBusoff: raw 0..1
  range DC_POD_DCDC_CommunFault: raw 0..1
  range DC_POD_DCDC_FaultLevel: raw 0..3
  range DC_POD_DCDC_HVInputCurrent: raw 0..255
  range DC_POD_DCDC_HVinputshortcircuit: raw 0..1
  range DC_POD_DCDC_HVInputVoltage: raw 0..8000
  range DC_POD_DCDC_InputVoltHighFault: raw 0..1
  range DC_POD_DCDC_InputVoltLowFault: raw 0..1
  range DC_POD_DCDC_InternalFault: raw 0..1
  range DC_POD_DCDC_LVOutputCurrent: raw 0..4000
  range DC_POD_DCDC_LVoutputshortcircuit: raw 0..1
  range DC_POD_DCDC_LVOutputVoltage: raw 0..255
  range DC_POD_DCDC_Maxoutputpower: raw 0..255
  range DC_POD_DCDC_OutCurSensorFault: raw 0..1
  range DC_POD_DCDC_OutputCurrentHighFault: raw 0..1
  range DC_POD_DCDC_Outputopencircuiterror: raw 0..1
  range DC_POD_DCDC_OutputTempSensorFault: raw 0..1
  range DC_POD_DCDC_OutputVoltHighFault: raw 0..1
  range DC_POD_DCDC_OutputVoltLowFault: raw 0..1
  range DC_POD_DCDC_SecondarySideTemp: raw 0..255
  range DC_POD_DCDC_Side2Overtempfault: raw 0..1
  range DC_POD_DCDC_WorkMode: raw 0..4
  range DC_POD_DCFCVoltage: raw 0..8190
  range DC_POD_DCInletTempA: raw 0..255
  range DC_POD_DCInletTempB: raw 0..255
  range DC_POD_DCPortInletTempAValid: raw 0..2
  range DC_POD_DCPortInletTempBValid: raw 0..2
  range DC_POD_DCPosRelayState: raw 0..2
  range DC_POD_KL30Error: raw 0..1
  range DC_POD_OBC_ACFrequencyStatus: raw 0..255
  range DC_POD_OBC_ACPortTempA: raw 0..255
  range DC_POD_OBC_ACPortTempAerror: raw 0..1
  range DC_POD_OBC_ACPortTempASensValid: raw 0..2
  range DC_POD_OBC_ACPortTempB: raw 0..255
  range DC_POD_OBC_ACPortTempBerror: raw 0..1
  range DC_POD_OBC_ACPortTempBSensValid: raw 0..2
  range DC_POD_OBC_ACVoltHighFault: raw 0..1
  range DC_POD_OBC_ACVoltLowFault: raw 0..1
  range DC_POD_OBC_CCCurrentLimit: raw 0..255
  range DC_POD_OBC_CCStatus: raw 0..10
  range DC_POD_OBC_ChargCapacibility: raw 0..2
  range DC_POD_OBC_ChrgOutpPwrAvl: raw 0..200
  range DC_POD_OBC_CommunFault: raw 0..1
  range DC_POD_OBC_CPCurrentLimit: raw 0..255
  range DC_POD_OBC_CPDuty: raw 0..255
  range DC_POD_OBC_CPFrequency: raw 0..2000
  range DC_POD_OBC_CPStatus: raw 0..7
  range DC_POD_OBC_DCCurHighFault: raw 0..1
  range DC_POD_OBC_DCVoltHighFault: raw 0..1
  range DC_POD_OBC_DCVoltLowFault: raw 0..1
  range DC_POD_OBC_EMLockState: raw 0..2
  range DC_POD_OBC_FaultLevel: raw 0..3
  range DC_POD_OBC_InputACCurrent_R: raw 0..1000
  range DC_POD_OBC_InputACCurrent_S: raw 0..500
  range DC_POD_OBC_InputACCurrent_T: raw 0..500
  range DC_POD_OBC_InputACVoltage_R: raw 0..4000
  range DC_POD_OBC_InputACVoltage_S: raw 0..4000
  range DC_POD_OBC_InputACVoltage_T: raw 0..4000
  range DC_POD_OBC_InputFrequencyStatus: raw 0..1
  range DC_POD_OBC_InputOverCurrentstatus_R: raw 0..1
  range DC_POD_OBC_InputOverCurrentstatus_S: raw 0..1
  range DC_POD_OBC_InputOverCurrentstatus_T: raw 0..1
  range DC_POD_OBC_InputPhaseStatus: raw 0..1
  range DC_POD_OBC_InputShortError: raw 0..1
  range DC_POD_OBC_InternalFault: raw 0..1
  range DC_POD_OBC_NlineStatus: raw 0..1
  range DC_POD_OBC_OBCMaxPermOutpCrrt: raw 0..400
  range DC_POD_OBC_OutputDCChargeCurrent: raw 0..5000
  range DC_POD_OBC_OutputDCChargeVoltage: raw 0..16000
  range DC_POD_OBC_OutputoverloadFault: raw 0..1
  range DC_POD_OBC_OutputShortError: raw 0..1
  range DC_POD_OBC_PFCOverVoltageError: raw 0..1
  range DC_POD_OBC_PFCUnderVoltageError: raw 0..1
  range DC_POD_OBC_PrimarySideTemp: raw 0..250
  range DC_POD_OBC_S2State: raw 0..2
  range DC_POD_OBC_SecondarySideTemp: raw 0..250
  range DC_POD_OBC_Side1Overtempfault: raw 0..1
  range DC_POD_OBC_Side2Overtempfault: raw 0..1
  range DC_POD_OBC_StartUpAllowed: raw 0..1
  range DC_POD_OBC_WorkMode: raw 0..7
  range DC_POD_T15e_fault: raw 0..1
  range DC_POD_Temperature: raw 0..255
  range DC_POD_TempHighFault: raw 0..1
  range DC_POD_TempSensor1Fault: raw 0..1
  range DC_PRND_Pbutton: raw 0..3
  range DC_PRND_Pbutton_FaultSts: raw 0..1
  range DC_PRND_RNDbutton: raw 0..7
  range DC_PRND_RNDbutton_FaultSts: raw 0..1
  range DC_SGW_AlarmEnableSet: raw 0..2
  range DC_SGW_ALM_MusicFrequencySet: raw 0..3
  range DC_SGW_AppointChargeCmd: raw 0..2
  range DC_SGW_BookingCarReq: raw 0..2
  range DC_SGW_ChargeFormSet: raw 0..2
  range DC_SGW_DomeLampBrightSet: raw 0..2
  range DC_SGW_DschrgOnOffSet: raw 0..3
  range DC_SGW_FL_BackrestMotorReq: raw 0..2
  range DC_SGW_FL_FrontRearReq: raw 0..2
  range DC_SGW_FL_HeightMotorReq: raw 0..2
  range DC_SGW_FollowMeHomeSet: raw 0..3
  range DC_SGW_FollowMeHomeTimeSet: raw 0..35
  range DC_SGW_HazardWarnReq: raw 0..2
  range DC_SGW_HoodlockSet: raw 0..1
  range DC_SGW_LockACPlug: raw 0..2
  range DC_SGW_RelockSet: raw 0..5
  range DC_SGW_RemoteActiveHorn: raw 0..1
  range DC_SGW_RemoteChrgFlapLockCtrlReq: raw 0..3
  range DC_SGW_RemoteHVCtrlReq: raw 0..2
  range DC_SGW_ResetCounter: raw 0..65535
  range DC_SGW_SynMsgAuthenticator: raw 0..16777215
  range DC_SGW_TaxiArrIllReq: raw 0..3
  range DC_SGW_TaxiArriveSts: raw 0..2
  range DC_SGW_TimeInfoDay: raw 1..31
  range DC_SGW_TimeInfoHour: raw 0..23
  range DC_SGW_TimeInfoMinute: raw 0..59
  range DC_SGW_TimeInfoMonth: raw 1..12
  range DC_SGW_TimeInfoSecond: raw 0..59
  range DC_SGW_TimeInfoYear: raw 0..59
  range DC_SGW_TimeValid: raw 0..1
  range DC_SGW_TimingChargefrquency: raw 0..2
  range DC_SGW_TimingChargeSwitchStatus: raw 0..2
  range DC_SGW_TripCounter: raw 0..16777215
  range DC_SGW_WelLightshowOnOffSet: raw 0..3
  range DC_SGW_WelLightshowTimeSet: raw 0..35
  range DC_TCU_APTC1Enable: raw 0..1
  range DC_TCU_APTCLeftCmd: raw 0..100
  range DC_TCU_APTCLeftMaxPowerLimit: raw 0..255
  range DC_TCU_APTCRightCmd: raw 0..100
  range DC_TCU_APTCRightMaxPowerLimit: raw 0..255
  range DC_TCU_APTCState: raw 0..3
  range DC_TCU_BattTMState: raw 0..7
  range DC_TCU_CompEnable: raw 0..1
  range DC_TCU_CompMaxAllowPwrCmsp: raw 0..254
  range DC_TCU_CompTargetSpeed: raw 0..9200
  range DC_TCU_EVCompState: raw 0..7
  range DC_TCU_HVACACState: raw 0..3
  range DC_TCU_HVCHHighVoltage: raw 0..508
  range DC_TCU_HVCHHVDCCurrent: raw 0..254
  range DC_TCU_HVCHState: raw 0..3
  range DC_TCU_HvOnReq: raw 0..1
  range DC_TCU_HVPwrState: raw 0..3
  range DC_TCU_TMSFaultLevel: raw 0..7
  range DC_TCU_TMSState: raw 0..2
  range DC_TCU_TMSTotalPwrCnsmp: raw 0..200
  range DC_TCU_TMSTotoalPwrReq: raw 0..200
  range DC_UDS_EPT_BootCmd{1..3}: raw 0..255
  range DC_Uds_EPT_bootResponse_Byte{0..7}: raw 0..255
  range DC_VCU_BS_HCurrent: raw 8768..32767
  range DC_VCU_BS_QuiescentCurrent: raw 0..255
  range DC_VCU_ChargeEnergy: raw 0..1023
  range DC_VCU_ChargeTime: raw 0..4095
  range DC_VCU_CreepTorque: raw 0..2047
  range DC_VCU_DCDCPowerLimit: raw 0..63
  range DC_VCU_DisChgPowerLimit: raw 0..255
  range DC_VCU_Display_voltage: raw 0..1023
  range DC_VCU_DisplayMileage: raw 0..1023
  range DC_VCU_DTC_Number: raw 0..255
  range DC_VCU_Enable_DC_Relay: raw 0..1
  range DC_VCU_EnableOBC: raw 0..3
  range DC_VCU_MaximumOutputCurrent: raw 0..4000
  range DC_VCU_MaximumOutputVoltage: raw 0..7500
  range DC_VCU_MaxSpdLimit: raw 0..65534
  range DC_VCU_MaxTorqueGradient: raw 0..16383
  range DC_VCU_MaxTorqueLimit: raw 0..2047
  range DC_VCU_MCUActHeatPwr: raw 0..255
  range DC_VCU_MCUPower: raw 0..1023
  range DC_VCU_MinimumOutputCurrent: raw 0..4000
  range DC_VCU_MinimumOutputVoltage: raw 0..7500
  range DC_VCU_MinTorqueLimit: raw 0..2047
  range DC_VCU_MotorSpdReq: raw 0..65534
  range DC_VCU_OBC_ChargeCurrentCommand: raw 0..5000
  range DC_VCU_OBC_Control_of_em_lock: raw 0..1
  range DC_VCU_OBC_Control_of_S2_SW: raw 0..1
  range DC_VCU_PermitPackPTC: raw 0..1
  range DC_VCU_RequestedModeDCDC: raw 0..2
  range DC_VCU_RequestedModeTCU: raw 0..3
  range DC_VCU_SpdLimitActTorque: raw 0..2047
  range DC_VCU_SynRequest: raw 0..16777215
  range DC_VCU_TCUPowerAllowed: raw 0..1600
  range DC_VCU_VoltageDemandLV: raw 0..511
  range DC_BCL_ChargeMode: raw 0..2
  range DC_BCL_CurrentRequire: raw 0..4000
  range DC_BCL_VolltageRequire: raw 0..7500
  range DC_BCP_AllowChargeVoltageMax: raw 0..7500
  range DC_BCP_AllowTempMax: raw 0..255
  range DC_BCP_BatteryChargeVoltageMax: raw 0..2400
  range DC_BCP_BatteryNominalEnergy: raw 0..10000
  range DC_BCP_BatteryTotalVoltage: raw 0..7500
  range DC_BCP_ChargeCurrentMax: raw 0..4000
  range DC_BCP_SOC: raw 0..1000
  range DC_BCS_BatteryVoltMax: raw 0..2400
  range DC_BCS_BatteryVoltMaxGroup: raw 0..15
  range DC_BCS_ChargeCurrentMeasure: raw 0..11500
  range DC_BCS_ChargeVoltageMeasure: raw 0..8000
  range DC_BCS_EstimatedTimeRemaining: raw 0..600
  range DC_BCS_SOC: raw 0..100
  range DC_BEM_ChargeAbortTimeout: raw 0..3
  range DC_BEM_ChargeFinishTimeout: raw 0..3
  range DC_BEM_ChargerIdTimeout0: raw 0..3
  range DC_BEM_ChargerIdTimeout1: raw 0..3
  range DC_BEM_ChargeStateTimeout: raw 0..3
  range DC_BEM_ChargeStatisticsTimeout: raw 0..3
  range DC_BEM_TimesyncOrPowerTimeout: raw 0..3
  range DC_BHM_AllowChargeVoltageMax: raw 0..7500
  range DC_BMT_BatteryTemp0: raw 0..250
  range DC_BMT_BatteryTemp1: raw 0..250
  range DC_BMT_BatteryTemp{10..15}: raw 0..250
  range DC_BMT_BatteryTemp{2..9}: raw 0..250
  range DC_BMV_BatteryGroupID0: raw 0..15
  range DC_BMV_BatteryGroupID1: raw 0..15
  range DC_BMV_BatteryGroupID10: raw 0..15
  range DC_BMV_BatteryGroupID{100..109}: raw 0..15
  range DC_BMV_BatteryGroupID11: raw 0..15
  range DC_BMV_BatteryGroupID{110..119}: raw 0..15
  range DC_BMV_BatteryGroupID12: raw 0..15
  range DC_BMV_BatteryGroupID{120..129}: raw 0..15
  range DC_BMV_BatteryGroupID13: raw 0..15
  range DC_BMV_BatteryGroupID{130..139}: raw 0..15
  range DC_BMV_BatteryGroupID14: raw 0..15
  range DC_BMV_BatteryGroupID{140..149}: raw 0..15
  range DC_BMV_BatteryGroupID15: raw 0..15
  range DC_BMV_BatteryGroupID{150..159}: raw 0..15
  range DC_BMV_BatteryGroupID16: raw 0..15
  range DC_BMV_BatteryGroupID{160..169}: raw 0..15
  range DC_BMV_BatteryGroupID17: raw 0..15
  range DC_BMV_BatteryGroupID{170..179}: raw 0..15
  range DC_BMV_BatteryGroupID18: raw 0..15
  range DC_BMV_BatteryGroupID{180..189}: raw 0..15
  range DC_BMV_BatteryGroupID19: raw 0..15
  range DC_BMV_BatteryGroupID{190..199}: raw 0..15
  range DC_BMV_BatteryGroupID2: raw 0..15
  range DC_BMV_BatteryGroupID20: raw 0..15
  range DC_BMV_BatteryGroupID{200..209}: raw 0..15
  range DC_BMV_BatteryGroupID21: raw 0..15
  range DC_BMV_BatteryGroupID{210..219}: raw 0..15
  range DC_BMV_BatteryGroupID22: raw 0..15
  range DC_BMV_BatteryGroupID{220..229}: raw 0..15
  range DC_BMV_BatteryGroupID23: raw 0..15
  range DC_BMV_BatteryGroupID{230..239}: raw 0..15
  range DC_BMV_BatteryGroupID24: raw 0..15
  range DC_BMV_BatteryGroupID{240..249}: raw 0..15
  range DC_BMV_BatteryGroupID25: raw 0..15
  range DC_BMV_BatteryGroupID{250..255}: raw 0..15
  range DC_BMV_BatteryGroupID{26..29}: raw 0..15
  range DC_BMV_BatteryGroupID3: raw 0..15
  range DC_BMV_BatteryGroupID{30..39}: raw 0..15
  range DC_BMV_BatteryGroupID4: raw 0..15
  range DC_BMV_BatteryGroupID{40..49}: raw 0..15
  range DC_BMV_BatteryGroupID5: raw 0..15
  range DC_BMV_BatteryGroupID{50..59}: raw 0..15
  range DC_BMV_BatteryGroupID6: raw 0..15
  range DC_BMV_BatteryGroupID{60..69}: raw 0..15
  range DC_BMV_BatteryGroupID7: raw 0..15
  range DC_BMV_BatteryGroupID{70..79}: raw 0..15
  range DC_BMV_BatteryGroupID8: raw 0..15
  range DC_BMV_BatteryGroupID{80..89}: raw 0..15
  range DC_BMV_BatteryGroupID9: raw 0..15
  range DC_BMV_BatteryGroupID{90..99}: raw 0..15
  range DC_BMV_BatteryVoltageMin0: raw 0..4095
  range DC_BMV_BatteryVoltageMin1: raw 0..4095
  range DC_BMV_BatteryVoltageMin10: raw 0..4095
  range DC_BMV_BatteryVoltageMin{100..109}: raw 0..4095
  range DC_BMV_BatteryVoltageMin11: raw 0..4095
  range DC_BMV_BatteryVoltageMin{110..119}: raw 0..4095
  range DC_BMV_BatteryVoltageMin12: raw 0..4095
  range DC_BMV_BatteryVoltageMin{120..129}: raw 0..4095
  range DC_BMV_BatteryVoltageMin13: raw 0..4095
  range DC_BMV_BatteryVoltageMin{130..139}: raw 0..4095
  range DC_BMV_BatteryVoltageMin14: raw 0..4095
  range DC_BMV_BatteryVoltageMin{140..149}: raw 0..4095
  range DC_BMV_BatteryVoltageMin15: raw 0..4095
  range DC_BMV_BatteryVoltageMin{150..159}: raw 0..4095
  range DC_BMV_BatteryVoltageMin16: raw 0..4095
  range DC_BMV_BatteryVoltageMin{160..169}: raw 0..4095
  range DC_BMV_BatteryVoltageMin17: raw 0..4095
  range DC_BMV_BatteryVoltageMin{170..179}: raw 0..4095
  range DC_BMV_BatteryVoltageMin18: raw 0..4095
  range DC_BMV_BatteryVoltageMin{180..189}: raw 0..4095
  range DC_BMV_BatteryVoltageMin19: raw 0..4095
  range DC_BMV_BatteryVoltageMin{190..199}: raw 0..4095
  range DC_BMV_BatteryVoltageMin2: raw 0..4095
  range DC_BMV_BatteryVoltageMin20: raw 0..4095
  range DC_BMV_BatteryVoltageMin{200..209}: raw 0..4095
  range DC_BMV_BatteryVoltageMin21: raw 0..4095
  range DC_BMV_BatteryVoltageMin{210..219}: raw 0..4095
  range DC_BMV_BatteryVoltageMin22: raw 0..4095
  range DC_BMV_BatteryVoltageMin{220..229}: raw 0..4095
  range DC_BMV_BatteryVoltageMin23: raw 0..4095
  range DC_BMV_BatteryVoltageMin{230..239}: raw 0..4095
  range DC_BMV_BatteryVoltageMin24: raw 0..4095
  range DC_BMV_BatteryVoltageMin{240..249}: raw 0..4095
  range DC_BMV_BatteryVoltageMin25: raw 0..4095
  range DC_BMV_BatteryVoltageMin{250..255}: raw 0..4095
  range DC_BMV_BatteryVoltageMin{26..29}: raw 0..4095
  range DC_BMV_BatteryVoltageMin3: raw 0..4095
  range DC_BMV_BatteryVoltageMin{30..39}: raw 0..4095
  range DC_BMV_BatteryVoltageMin4: raw 0..4095
  range DC_BMV_BatteryVoltageMin{40..49}: raw 0..4095
  range DC_BMV_BatteryVoltageMin5: raw 0..4095
  range DC_BMV_BatteryVoltageMin{50..59}: raw 0..4095
  range DC_BMV_BatteryVoltageMin6: raw 0..4095
  range DC_BMV_BatteryVoltageMin{60..69}: raw 0..4095
  range DC_BMV_BatteryVoltageMin7: raw 0..4095
  range DC_BMV_BatteryVoltageMin{70..79}: raw 0..4095
  range DC_BMV_BatteryVoltageMin8: raw 0..4095
  range DC_BMV_BatteryVoltageMin{80..89}: raw 0..4095
  range DC_BMV_BatteryVoltageMin9: raw 0..4095
  range DC_BMV_BatteryVoltageMin{90..99}: raw 0..4095
  range DC_BRM_BatteryChargeTimes: raw -8388608..8388607
  range DC_BRM_BatteryProductDay: raw 0..31
  range DC_BRM_BatteryProductMonth: raw 0..12
  range DC_BRM_BatteryProductYear: raw -128..127
  range DC_BRM_BatteryProperty: raw -128..127
  range DC_BRM_BatterySN: raw -2147483648..2147483647
  range DC_BRM_BatterySystemRatedCapacity: raw 0..10000
  range DC_BRM_BatterySystemRatedVoltage: raw 0..7500
  range DC_BRM_BatteryType: raw -1..8
  range DC_BRM_Manufacturer: raw -2147483648..2147483647
  range DC_BRM_ProtocolVersion: raw -8388608..8388607
  range DC_BRM_VehicleIdByte1_8: raw -9223372036854775808..9223372036854775807
  range DC_BRM_VehicleIdByte17: raw -128..127
  range DC_BRM_VehicleIdByte9_16: raw -9223372036854775808..9223372036854775807
  range DC_BRO_BMSChargeReady: raw 0..255
  range DC_BSD_AbortSOC: raw 0..100
  range DC_BSD_BatteryTempMax: raw 0..250
  range DC_BSD_BatteryTempMin: raw 0..250
  range DC_BSD_BatteryVoltageMax: raw 0..2400
  range DC_BSD_BatteryVoltageMin: raw 0..2400
  range DC_BSM_BatteryCurrentState: raw 0..3
  range DC_BSM_BatteryOutpuConnectorState: raw 0..3
  range DC_BSM_BatteryTempMax: raw 0..255
  range DC_BSM_BatteryTempMaxNo: raw 0..128
  range DC_BSM_BatteryTempMin: raw 0..255
  range DC_BSM_BatteryTempMinNo: raw 0..128
  range DC_BSM_BatteryTempState: raw 0..3
  range DC_BSM_BatteryVoltageMaxNo: raw 0..128
  range DC_BSM_BatteryVoltageState: raw 0..3
  range DC_BSM_ChargeEnable: raw 0..3
  range DC_BSM_InsulationState: raw 0..3
  range DC_BSM_SOC: raw 0..3
  range DC_BSOC_0: raw 0..100
  range DC_BSOC_1: raw 0..100
  range DC_BSOC_{10..15}: raw 0..100
  range DC_BSOC_{2..9}: raw 0..100
  range DC_BST_AbortAchiveSingleVolt: raw 0..3
  range DC_BST_AbortAchiveSOC: raw 0..3
  range DC_BST_AbortAchiveTotalVolt: raw 0..3
  range DC_BST_AbortChargparameter: raw 0..3
  range DC_BST_Abortdet2Voltexception: raw 0..3
  range DC_BST_AbortErrorCurrent: raw 0..3
  range DC_BST_AbortErrorVoltage: raw 0..3
  range DC_BST_AbortFaultBatteryTemp: raw 0..3
  range DC_BST_AbortFaultBMSTemp: raw 0..3
  range DC_BST_AbortFaultConnector: raw 0..3
  range DC_BST_AbortFaultConnectorTemp: raw 0..3
  range DC_BST_AbortFaultInsulation: raw 0..3
  range DC_BST_AbortFaultOther: raw 0..3
  range DC_BST_AbortHVrelayfault: raw 0..2
  range DC_BST_Abortmanoperate: raw 0..2
  range DC_CCS_ChargeAllow: raw 0..1
  range DC_CCS_ChargeTotalTime: raw 0..600
  range DC_CCS_OutputCurrent: raw 0..4000
  range DC_CCS_OutputVoltage: raw 0..7500
  range DC_CEM_BatteryChargeRequireTimeout: raw 0..3
  range DC_CEM_BatteryParameterTimout: raw 0..3
  range DC_CEM_BatteryStateTimeout: raw 0..3
  range DC_CEM_BMSAbortChargeTimeout: raw 0..3
  range DC_CEM_BMSChargeStatisticsTimeout: raw 0..3
  range DC_CEM_BMSFinishChargeTimeout: raw 0..3
  range DC_CEM_BMSIdentifyTimout: raw 0..3
  range DC_CHM_ProtocolVersion: raw 0..16777215
  range DC_CML_OutputCurrentMax: raw 0..4000
  range DC_CML_OutputCurrentMin: raw 0..4000
  range DC_CML_OutputVoltageMin: raw 0..7500
  range DC_CML_OutpuVoltageMax: raw 0..7500
  range DC_CRM_ChargerNo: raw 0..4294967295
  range DC_CRM_RecognitionResult: raw 0..255
  range DC_CRM_RegionCode: raw 0..16777215
  range DC_CRO_ChargerReady: raw 0..255
  range DC_CSD_ChargerNo: raw 0..4294967295
  range DC_CSD_OutputEnerge: raw 0..10000
  range DC_CSD_TotalChargeTime: raw 0..600
  range DC_CST_AbortAchiveCondition: raw 0..3
  range DC_CST_AbortByFault: raw 0..3
  range DC_CST_AbortByUser: raw 0..3
  range DC_CST_AbortErrorCurrent: raw 0..3
  range DC_CST_AbortErrorVoltage: raw 0..3
  range DC_CST_AbortFaultChargerInnerTemp: raw 0..3
  range DC_CST_AbortFaultChargerStop: raw 0..3
  range DC_CST_AbortFaultChargerTemp: raw 0..3
  range DC_CST_AbortFaultConnetor: raw 0..3
  range DC_CST_AbortFaultEnergeTransmit: raw 0..3
  range DC_CST_AbortFaultOther: raw 0..3
  range DC_CTS_Day: raw 0..255
  range DC_CTS_Hour: raw 0..255
  range DC_CTS_Minute: raw 0..255
  range DC_CTS_Month: raw 0..255
  range DC_CTS_Second: raw 0..255
  range DC_CTS_Year: raw 0..65535
  range DC_ChargeCurrWU: raw 0..1
  range DC_ChargeCurrWU_Ena: raw 0..1
  range DC_ChargeCurrWU_Sts: raw 0..1
  range DC_ChargeCurrWU_Treshold: raw 0..250
  range DC_DisChargeCurrWU: raw 0..1
  range DC_DisChargeCurrWU_Ena: raw 0..1
  range DC_DisChargeCurrWU_Sts: raw 0..1
  range DC_DisChargeCurrWU_Treshold: raw 0..250
  range DC_ERROR_Commom: raw 0..1
  range DC_ERROR_IDENT: raw 0..1
  range DC_FLAG_INCONSISTENCY: raw 0..1
  range DC_FRC_ComFtonNet: raw 0..1
  range DC_FRC_Vl_OV: raw 0..1
  range DC_FRC_Vl_UV: raw 0..1
  range DC_I_BATT: raw 0..65535
  range DC_I_RANGE: raw 0..3
  range DC_IBATT_QUIESCENT: raw 0..255
  range DC_Q_Charge: raw 0..65534
  range DC_Q_Discharge: raw 0..65534
  range DC_Resp_Error: raw 0..1
  range DC_SOC: raw 0..100
  range DC_SOC_STATE: raw 0..3
  range DC_SOCWU: raw 0..1
  range DC_SOCWU_Ena: raw 0..1
  range DC_SOCWU_Sts: raw 0..1
  range DC_SOCWU_Treshold: raw 0..80
  range DC_SOF_Q: raw 0..254
  range DC_SOF_Q_STATE: raw 0..3
  range DC_SOF_t_STATE: raw 0..3
  range DC_SOF_V1: raw 0..254
  range DC_SOF_V1_STATE: raw 0..3
  range DC_SOF_V2: raw 0..254
  range DC_SOF_V2_STATE: raw 0..3
  range DC_SOH: raw 0..100
  range DC_SOH_STATE: raw 0..3
  range DC_Status_Current: raw 0..3
  range DC_Status_Temp: raw 0..3
  range DC_Status_Voltage: raw 0..3
  range DC_T_BATT: raw 0..145
  range DC_U_BATT: raw 0..15360
  range DC_VCU_ACU_DriverWarningLampSts: raw 0..2
  range DC_VCU_ACU_PassengerAirbagSts: raw 0..3
  range DC_VCU_ACU_PassengerWarningLampSts: raw 0..2
  range DC_VCU_ACU_WarningLampSts: raw 0..2
  range DC_VCU_BCM_FLSeatBeltRemindReq: raw 0..3
  range DC_VCU_BCM_FRSeatBeltRemindReq: raw 0..3
  range DC_VCU_BCM_RLSeatBeltRemindReq: raw 0..3
  range DC_VCU_BCM_RRSeatBeltRemindReq: raw 0..3
  range DC_VCU_CGW_VehicleState: raw 0..8
  range DC_VCU_DCDCFail_LIN: raw 0..1
  range DC_VCU_DCM_FL_DoorFLSts: raw 0..1
  range DC_VCU_DCM_FR_DoorFRSts: raw 0..1
  range DC_VCU_DCM_RL_DoorRLSts: raw 0..1
  range DC_VCU_DCM_RR_DoorRRSts: raw 0..1
  range DC_VCU_DriveMotOvrTemp_LIN: raw 0..1
  range DC_VCU_HVBatCriFail_LIN: raw 0..3
  range DC_VCU_HVBatOvrTemp_LIN: raw 0..1
  range DC_VCU_IBS_BrakeFluidWarning: raw 0..3
  range DC_VCU_IBS_EBDFault: raw 0..1
  range DC_VCU_IBS_RollerbenchMode: raw 0..1
  range DC_VCU_IBS_SystemStatus: raw 0..7
  range DC_VCU_IVI_BulbCheckSts: raw 0..1
  range DC_VCU_IVI_VrState: raw 0..1
package /DataType/Semantics
  compu method CM_VcuRxMsg1_Sig{0..3}: identical
  compu method CM_VcuRxMsg2_Sig{0..3}: identical
  compu method CM_VcuTxMsg1_Sig{0..3}: identical
  compu method CM_VcuTxMsg2_Sig{0..3}: identical
  compu method CM_VcuAdcTxMsg1_Sig{0..3}: identical
  compu method CM_VcuAdcTxMsg2_Sig{0..3}: identical
  compu method CM_VcuRxMsg3_Sig{0..3}: identical
  compu method CM_VcuRxMsg4_Sig{0..3}: identical
  compu method CM_Vcu_Lin0_RxMsg1_Sig0: identical
  compu method CM_Vcu_Lin0_RxMsg1_Sig1: identical
  compu method CM_Vcu_Lin0_RxMsg2_Sig{0..3}: identical
  compu method CM_Vcu_Lin0_TxMsg1_Sig{0..3}: identical
  compu method CM_Vcu_Lin0_TxMsg2_Sig{0..3}: identical
  compu method CM_EXT_A_IN{1..4}: identical
  compu method CM_EXT{1..4}_Valid: identical
  compu method CM_EXT_A_IN{10..16}: identical
  compu method CM_EXT_A_IN{5..9}: identical
  compu method CM_EXT{10..16}_Valid: identical
  compu method CM_EXT{5..9}_Valid: identical
  compu method CM_Act_Pos_sta: phys=raw*0.1-5 for raw 0..3600; unit Degree
  compu method CM_Blockage_Fault_STA: 0=Cx0_False, 1=Cx1_True
  compu method CM_Breakage_Fault_STA: 0=Cx0_False, 1=Cx1_True
  compu method CM_Calibration_cmd: 0=Cx0_Normal, 1=Cx1_SVA_performs_calibration (SVA performs calibration)
  compu method CM_Calibration_sta: 0=Cx0_not_calibration (not calibration), 1=Cx1_calibration_ongoing (calibration ongoing), 2=Cx2_calibration_finished (calibration finished), 3=Cx3_calibration_failed (calibration failed)
  compu method CM_ECC_PMP2_SpdSet: phys=raw*0.4 for raw 0..100; unit %
  compu method CM_ECC_PMP3_SpdSet: phys=raw*0.4 for raw 0..100; unit %
  compu method CM_EDCU_EXV2_Cmd_Init_Rq: 0=Cx0_NO_RQ, 1=Cx1_START_INIT_SQC, 2=Cx2_WAIT_SQC_FINISH
  compu method CM_EDCU_EXV2_Cmd_Move_Enbl: 0=Cx0_DSABL, 1=Cx1_ENBL
  compu method CM_EDCU_EXV2_Cmd_Set_Rq: identical
  compu method CM_EXV1_CurrentInitState: 0=Cx0_NO_INIT, 1=Cx1_INIT_IN_PROCESS, 2=Cx2_Initialized
  compu method CM_EXV1_CurrentPosition: identical
  compu method CM_EXV1_FaultState: 0=Cx0_No_Fault (No Fault), 1=Cx1_COIL_SHRT, 2=Cx2_COIL_OPN, 3=Cx3_Over_temp_shut_down (Over temp shut down), 4=Cx4_Reserved
  compu method CM_EXV1_ResponseError: 0=Cx0_No_Comm_Error (No Comm Error), 1=Cx1_Comm_Error_Active (Comm Error Active)
  compu method CM_EXV1_RunState: 0=Cx0_NO_MOVEMENT, 1=Cx1_ACT_MOVING
  compu method CM_EXV1_TemperatureWarn: 0=Cx0_OK_, 1=Cx1_WARNING
  compu method CM_EXV1_VoltageState: 0=Cx0_Voltage_Range_OK_ (Voltage Range OK), 1=Cx1_Over_Voltage_ (Over Voltage), 2=Cx2_Under_Voltage (Under Voltage)
  compu method CM_EXV2_curInit_Stat: 0=Cx0_NO_INIT, 1=Cx1_INIT_IN_PROCESS, 2=Cx2_INIT_READY, 3=Cx3_Invalid
  compu method CM_EXV2_CurrentInitState: 0=Cx0_NO_INIT, 1=Cx1_INIT_IN_PROCESS, 2=Cx2_Initialized
  compu method CM_EXV2_CurrentPosition: identical
  compu method CM_EXV2_Fault_Stat: 0=Cx0_Actuator_Not_Faulted (Actuator Not Faulted), 1=Cx1_Motor_Coil_shorted (Motor-Coil shorted), 2=Cx2_Motor_Coil_open_load (Motor-Coil open load), 3=Cx3_Over_temperature_shutdown (Over temperature shutdown), 4=Cx4_not_defined (not defined), 5=Cx5_Motor_Stall_ (Motor_Stall?????????)  # Source signal range: [0,4]
  compu method CM_EXV2_FaultState: 0=Cx0_No_Fault (No Fault), 1=Cx1_COIL_SHRT, 2=Cx2_COIL_OPN, 3=Cx3_Over_temp_shut_down (Over temp shut down), 4=Cx4_Reserved
  compu method CM_EXV2_OvrTemp_Warn: 0=Cx0_Ok, 1=Cx1_High_Temperature_Warning (High Temperature Warning), 2=Cx2_not_defined (not defined), 3=Cx3_not_defined (not defined)  # Source signal range: [0,1]
  compu method CM_EXV2_Pos: identical
  compu method CM_EXV2_ResponseError: 0=Cx0_No_Comm_Error (No Comm Error), 1=Cx1_Comm_Error_Active (Comm Error Active)
  compu method CM_EXV2_Run_Stat: 0=Cx0_NO_MOVEMENT, 1=Cx1_ACT_MOVING
  compu method CM_EXV2_RunState: 0=Cx0_NO_MOVEMENT, 1=Cx1_ACT_MOVING
  compu method CM_EXV2_TemperatureWarn: 0=Cx0_OK_, 1=Cx1_WARNING
  compu method CM_EXV2_Volt_Stat: 0=Cx0_VOLT_RANGE_OK, 1=Cx1_OVERVOLTAGE, 2=Cx2_UNDERVOLTAGE, 3=Cx3_not_defined (not defined)  # Source signal range: [0,2]
  compu method CM_EXV2_VoltageState: 0=Cx0_Voltage_Range_OK_ (Voltage Range OK), 1=Cx1_Over_Voltage_ (Over Voltage), 2=Cx2_Under_Voltage (Under Voltage)
  compu method CM_HVCH_CurrSens_Flt: 0=Cx00_Diagnostic_pending (Diagnostic pending), 1=Cx01_Diagnostic_passed (Diagnostic passed), 2=Cx02_0x2_0x1F_Reserve (0x2~0x1F, Reserve)
  compu method CM_HVCH_defectHeaterCircuits: 0=Cx0_No_defect (No defect), 1=Cx1_Leg_1_defect (Leg 1 defect), 2=Cx2_Leg_2_defect (Leg 2 defect), 3=Cx3_Leg_1_2_defect (Leg 1 + 2 defect), 4=Cx4_Leg_3_defect (Leg 3 defect), 5=Cx5_Leg_1_3_defect (Leg 1 + 3 defect), 6=Cx6_Leg_2_3_defect (Leg 2 + 3 defect), 7=Cx7_Leg_1_2_3_defect (Leg 1 + 2 + 3 defect)
  compu method CM_HVCH_DutyCycle: 0=Cx00_0x00_0x96_Valid_value (0x00~0x96, Valid value), 255=CxFF_invalid, phys=raw-50 for raw 1..150; unit percent  # Source signal range: [0,150]
  compu method CM_HVCH_ExtPwrSup_Flt: 0=Cx0_Battery_voltage_okay (Battery voltage okay), 1=Cx1_Battery_voltage_off (Battery voltage off)
  compu method CM_HVCH_HV_DC_curr: 0=Cx00_0x00_0xFE_Valid_value (0x00~0xFE, Valid value), 255=CxFF_invalid, phys=raw*0.25 for raw 1..254; unit A  # Source signal range: [0,254]
  compu method CM_HVCH_HV_voltage: 0=Cx00_0x00_0xFE_Valid_value (0x00~0xFE, Valid value), 255=CxFF_invalid, phys=raw*2 for raw 1..254; unit V  # Source signal range: [0,254]
  compu method CM_HVCH_HV_Voltage_Valid: 0=Cx0_NO_HV_detected (NO HV detected), 1=Cx1_HV_valid (HV valid), 2=Cx2_Under_Voltage (Under Voltage), 3=Cx3_Over_Voltage (Over Voltage)
  compu method CM_HVCH_IntelTemp: 0=Cx00_0x00_0xFE_Valid_value (0x00~0xFE, Valid value), 255=CxFF_invalid, phys=raw-50 for raw 1..254; unit celsius  # Source signal range: [0,254]
  compu method CM_HVCH_InternalPCBTemp: 0=Cx00_0x00_0xFE_Valid_value (0x00~0xFE, Valid value), 255=CxFF_invalid, phys=raw-50 for raw 1..254  # Source signal range: [0,254]
  compu method CM_HVCH_LIN_Flt: 0=Cx0_No_LIN_timeout_detected (No LIN timeout detected), 1=Cx1_LIN_timeout_active (LIN timeout active)
  compu method CM_HVCH_MediumTemp: 0=Cx00_0x00_0xFE_Valid_value (0x00~0xFE, Valid value), 255=CxFF_invalid, phys=raw-50 for raw 1..254; unit celsius  # Source signal range: [0,254]
  compu method CM_HVCH_Off_ShrtCurr: 0=Cx0_No_short_detected (No short detected), 1=Cx1_Short_detected (Short detected)
  compu method CM_HVCH_RsErr: 0=Cx0_No_LIN_response_error_detected (No LIN response error detected), 1=Cx1_LIN_response_error_active (LIN response error active)
  compu method CM_HVCH_Status: 0=Cx0_HV_PTC_off_HVCH_OFF (HV PTC off / HVCH_OFF), 1=Cx1_HV_PTC_on_HVCH_ON (HV PTC on / HVCH_ON), 2=Cx2_0x2_0x7_SNA (0x2~0x7, SNA)
  compu method CM_HVCH_TempLim: 0=Cx0_No_over_temperature_detected (No over temperature detected), 1=Cx1_Over_temp_situation_active (Over temp. situation active)
  compu method CM_HVCH_TempSens_Flt: 0=Cx0_No_fault (No fault), 1=Cx1_fault
  compu method CM_LIN_Resp_Error_sta: 0=Cx0_False, 1=Cx1_True
  compu method CM_PMP2_PumpDryRunningSta: 0=Cx0_Normal, 1=Cx1_DryRun
  compu method CM_PMP2_PumpInputVolt: phys=raw*0.1 for raw 0..30; unit V
  compu method CM_PMP2_PumpMotorSta: 0=Cx0_Normal, 1=Cx1_ShortCircuit, 2=Cx2_OpenCircuit, 3=Cx3_Stall
  compu method CM_PMP2_PumpPowerSta: 0=Cx0_Normal, 1=Cx1_OverVol, 2=Cx2_BelowVol, 3=Cx3_Reserved
  compu method CM_PMP2_PumpTempSta: 0=Cx0_Normal, 1=Cx1_OverTempReduction, 2=Cx2_OverTempShutDown, 3=Cx3_Reserved
  compu method CM_PMP2_RealRPM: phys=raw*0.4 for raw 0..100; unit %
  compu method CM_PMP2_RESP_ERROR: 0=Cx0_Normal, 1=Cx1_Error
  compu method CM_PMP3_PumpDryRunningSta: 0=Cx0_Normal, 1=Cx1_DryRun
  compu method CM_PMP3_PumpInputVolt: phys=raw*0.1 for raw 0..30; unit V
  compu method CM_PMP3_PumpMotorSta: 0=Cx0_Normal, 1=Cx1_ShortCircuit, 2=Cx2_OpenCircuit, 3=Cx3_Stall
  compu method CM_PMP3_PumpPowerSta: 0=Cx0_Normal, 1=Cx1_OverVol, 2=Cx2_BelowVol, 3=Cx3_Reserved
  compu method CM_PMP3_PumpTempSta: 0=Cx0_Normal, 1=Cx1_OverTempReduction, 2=Cx2_OverTempShutDown, 3=Cx3_Reserved
  compu method CM_PMP3_RealRPM: phys=raw*0.4 for raw 0..100; unit %
  compu method CM_PMP3_RESP_ERROR: 0=Cx0_Normal, 1=Cx1_Error
  compu method CM_RsErr_EXV2: 0=Cx0_NO_COMM_ERROR (NO COMM ERROR), 1=Cx1_COMM_ERROR_DETECTED (COMM ERROR DETECTED)
  compu method CM_Target_Pos_cmd: phys=raw*0.1-5 for raw 0..3600; unit Degree
  compu method CM_TCU_HVCH_heating_rq: 0=Cx00_Level0, 1=Cx01_Level1, 2=Cx02_Level2, 3=Cx03_Level3, 4=Cx04_Level4, 5=Cx05_Level5, 6=Cx06_Level6, 7=Cx07_Reserve; unit percent
  compu method CM_TCU_HVCH_On_Rq: 0=Cx0_PTC_OFF, 1=Cx1_PTC_ON, 2=Cx2_reserved_RES (reserved / RES), 3=Cx3_SNA
  compu method CM_TCU_HVCH_TmaxLim_output: 0=Cx00_0x00_0xFE_Valid_value (0x00~0xFE, Valid value), 255=CxFF_invalid, phys=raw-50 for raw 1..254; unit celsius  # Source signal range: [0,254]
  compu method CM_TCU_HVCHMaxPowerLimit: 0=Cx00_0x00_0xFE_Valid_value (0x00~0xFE, Valid value), 255=CxFF_invalid, phys=raw*0.04 for raw 1..254; unit KW  # Source signal range: [0,254]
  compu method CM_TMM_EXV1_EnableRequest: 0=Cx0_EXVNotEnable, 1=Cx1_EXVEnable
  compu method CM_TMM_EXV1_initRequest: 0=Cx0_NO_RQ, 1=Cx1_InitializationReq_, 2=Cx2_waiting_for_Sequence_to_finish (waiting for Sequence to finish)
  compu method CM_TMM_EXV1_PositionRequest: identical
  compu method CM_TMM_EXV2_EnableRequest: 0=Cx0_EXVNotEnable, 1=Cx1_EXVEnable
  compu method CM_TMM_EXV2_initRequest: 0=Cx0_NO_RQ, 1=Cx1_InitializationReq_, 2=Cx2_waiting_for_Sequence_to_finish (waiting for Sequence to finish)
  compu method CM_TMM_EXV2_PositionRequest: identical
  compu method CM_A_I_Actuator_With_F_B_request: 0=Cx0_Stop, 1=Cx1_Request_corotation, 2=Cx2_Request_revrsal
  compu method CM_A_I_F_B: phys=raw*0.1 for raw 0..50; unit V
  compu method CM_COMP_Pdis: phys=raw*0.1 for raw 0..50; unit V
  compu method CM_COMP_Psuc: phys=raw*0.1 for raw 0..50; unit V
  compu method CM_COMP_Tdis: phys=raw*0.1 for raw 0..50; unit V
  compu method CM_COMP_Tsuc: phys=raw*0.1 for raw 0..50; unit V
  compu method CM_COOLING_FAN_request: identical
  compu method CM_HVAC_Blower_request: identical
  compu method CM_Mode_Actuator_request: 0=Cx0_Stop, 1=Cx1_Request_corotation, 2=Cx2_Request_revrsal
  compu method CM_MODE_F_B: phys=raw*0.1 for raw 0..50; unit V
  compu method CM_SV{1..3}_request: 0=Cx0_OFF, 1=Cx1_ON
  compu method CM_Tamb: phys=raw*0.1 for raw 0..50; unit V
  compu method CM_Tevap_Tchiller_out: phys=raw*0.1 for raw 0..50; unit V
  compu method CM_Tincar: phys=raw*0.1 for raw 0..50; unit V
  compu method CM_Tohx_in: phys=raw*0.1 for raw 0..50; unit V
  compu method CM_Tohx_out: phys=raw*0.1 for raw 0..50; unit V
  compu method CM_VcuCan12RxMsg3_Sig{0..3}: identical
  compu method CM_VcuCan12RxMsg4_Sig{0..3}: identical
  compu method CM_VcuCan12TxMsg1_Sig{0..3}: identical
  compu method CM_VcuCan12TxMsg2_Sig{0..3}: identical
  compu method CM_VCU_Tx_51Ch_NM_UserData: identical
  compu method CM_ACU_CrashOutputSts: 0=Cx00_No_Crash (No Crash), 1=Cx01_Rollover, 2=Cx02_BPT_Crash (BPT Crash), 3=Cx03_Rollover_BPT (Rollover + BPT), 4=Cx04_Front_Crash (Front Crash), 5=Cx05_Rollover_Front (Rollover + Front), 6=Cx06_BPT_Front (BPT+Front), 7=Cx07_Rollover_BPT_Front (Rollover+BPT+Front), 8=Cx08_Side_Crash (Side Crash), 9=Cx09_Rollover_Side (Rollover+Side), 10=Cx0A_BPT_Side (BPT+Side), 11=Cx0B_Rollover_BPT_Side (Rollover+BPT+Side), 12=Cx0C_Front_Side (Front+Side), 13=Cx0D_Rollover_Front_Side (Rollover+Front+Side), 14=Cx0E_BPT_Front_Side (BPT+Front+Side), 15=Cx0F_Rollover_BPT_Front_Side (Rollover+BPT+Front+Side), 16=Cx10_Rear_Crash (Rear Crash), 17=Cx11_Rollover_Rear (Rollover+Rear), 18=Cx12_BPT_Rear (BPT+Rear), 19=Cx13_Rollover_BPT_Rear (Rollover+BPT+Rear), 20=Cx14_Front_Rear (Front+Rear), 21=Cx15_Rollover_Front_Rear (Rollover+Front+Rear), 22=Cx16_BPT_Front_Rear (BPT+Front+Rear), 23=Cx17_Rollover_BPT_Front_Rear (Rollover+BPT+Front+Rear), 24=Cx18_Side_Rear (Side+Rear), 25=Cx19_Rollover_Side_Rear (Rollover+Side+Rear), 26=Cx1A_BPT_Side_Rear (BPT+Side+Rear), 27=Cx1B_Rollover_BPT_Side_Rear (Rollover+BPT+Side+Rear), 28=Cx1C_Front_Side_Rear (Front+Side+Rear), 29=Cx1D_Rollover_Front_Side_Rear (Rollover+Front+Side+Rear), 30=Cx1E_BPT_Front_Side_Rear (BPT+Front+Side+Rear), 31=Cx1F_Rollover_BPT_Front_Side_Rear (Rollover+BPT+Front+Side+Rear)
  compu method CM_ACU_CrashOutputStsValid: 0=Cx0_INVALID, 1=Cx1_VALID
  compu method CM_ACU_DriverSeatBeltSts: 0=Cx0_UNTIED, 1=Cx1_TIED
  compu method CM_ACU_DriverSeatBeltStsValid: 0=Cx0_INVALID, 1=Cx1_VALID
  compu method CM_ACU_DriverWarningLampSts: 0=Cx0_OFF, 1=Cx1_ON, 2=Cx2_FLASH
  compu method CM_ACU_LatA: 16383=Cx3FFF_Invalid, phys=raw*0.01-49.05 for raw 0..16382; unit m/s^2  # Source signal range: [0,16383]
  compu method CM_ACU_LatAStatus: 0=Cx0_Invalid, 1=Cx1_Valid, 2=Cx2_Reserved, 3=Cx3_Reserved
  compu method CM_ACU_LgtA: 16383=Cx3FFF_Invalid, phys=raw*0.01-49.05 for raw 0..16382; unit m/s^2  # Source signal range: [0,16383]
  compu method CM_ACU_LgtAStatus: 0=Cx0_Invalid, 1=Cx1_Valid, 2=Cx2_Reserved, 3=Cx3_Reserved
  compu method CM_ACU_PassengerAirbagSts: 0=Cx0_RESERVED, 1=Cx1_Disabled, 2=Cx2_Enabled, 3=Cx3_RESERVED
  compu method CM_ACU_PassengerSeatBeltSts: 0=Cx0_UNTIED, 1=Cx1_TIED
  compu method CM_ACU_PassengerSeatBeltStsValid: 0=Cx0_INVALID, 1=Cx1_VALID
  compu method CM_ACU_PassengerSts: 0=Cx0_UNOCCUPIED, 1=Cx1_OCCUPIED
  compu method CM_ACU_PassengerWarningLampSts: 0=Cx0_OFF, 1=Cx1_ON, 2=Cx2_FLASH
  compu method CM_ACU_RLSeatBeltStatusValid: 0=Cx0_INVALID, 1=Cx1_VALID
  compu method CM_ACU_RRSeatBeltStatusValid: 0=Cx0_INVALID, 1=Cx1_VALID
  compu method CM_ACU_SecondLeftSeatBeltSts: 0=Cx0_UNTIED, 1=Cx1_TIED
  compu method CM_ACU_SecondLeftSts: 0=Cx0_UNOCCUPIED, 1=Cx1_OCCUPIED
  compu method CM_ACU_SecondRightSeatBeltSts: 0=Cx0_UNTIED, 1=Cx1_TIED
  compu method CM_ACU_SecondRightSts: 0=Cx0_UNOCCUPIED, 1=Cx1_OCCUPIED
  compu method CM_ACU_WarningLampSts: 0=Cx0_OFF, 1=Cx1_ON, 2=Cx2_FLASH
  compu method CM_ACU_YawRate: 65535=CxFFFF_Invalid, phys=raw*0.01-300 for raw 0..65534; unit degrees/s
  compu method CM_ACU_YawRateStatus: 0=Cx0_Invalid, 1=Cx1_Valid, 2=Cx2_Reserved, 3=Cx3_Reserved
  compu method CM_ADCU_ACC_Mode: 0=Cx0_Off, 1=Cx1_Active_State (Active State), 2=Cx2_Override_State (Override State), 3=Cx3_Shut_off_State (Shut-off State), 4=Cx4_Standby_State (Standby State), 5=Cx5_Fail_State (Fail State), 6=Cx6_Reserved, 7=Cx7_Reserved
  compu method CM_ADCU_ACCDA_HandsOFF_Warning: 0=Cx0_No_Warning (No Warning), 1=Cx1_Hands_Off_1st_Warning (Hands Off 1st Warning), 2=Cx2_Hands_Off_2nd_Warning (Hands Off 2nd Warning), 3=Cx3_Function_Automatic_exit_Warning (Function Automatic exit Warning), 4=Cx4_Reserved, 5=Cx5_Reserved, 6=Cx6_Reserved, 7=Cx7_Reserved
  compu method CM_ADCU_ACCDA_SYS_Failure: 0=Cx0_No_Error (No Error), 1=Cx1_Error, 2=Cx2_Reserved, 3=Cx3_Reserved
  compu method CM_ADCU_AEB_AWB_Level: 0=Cx0_No_level (No level), 1=Cx1_Level_1 (Level 1), 2=Cx2_Level_2 (Level 2), 3=Cx3_Level_3 (Level 3), 4=Cx4_Level_4 (Level 4), 5=Cx5_Reserved
  compu method CM_ADCU_AEB_AWB_Req: 0=Cx0_No_Request (No Request), 1=Cx1_Request
  compu method CM_ADCU_AEB_Decel_Cmd: phys=raw*0.05-16 for raw 0..511; unit m/s^2
  compu method CM_ADCU_AEB_Prefill_CMD: 0=Cx0_No_pre_fill (No pre-fill), 1=Cx1_Pre_fill_act (Pre-fill act)
  compu method CM_ADCU_AEB_State: 0=Cx0_Off, 1=Cx1_Standby, 2=Cx2_Active, 3=Cx3_Failure
  compu method CM_ADCU_AEB_Stop_Req: 0=Cx0_No_request (No request), 1=Cx1_Stop_control_is_required (Stop control is required)
  compu method CM_ADCU_AEBReq: 0=Cx0_No_active (No active), 1=Cx1_active
  compu method CM_ADCU_AEBWarningSts: 0=Cx0_NO_WARNING, 1=Cx1_PreWarning_to_car (PreWarning to car), 2=Cx2_Latent_distance_Warning (Latent distance Warning), 3=Cx3_Braking_to_car (Braking to car), 4=Cx4_PreWarning_to_PED (PreWarning to PED), 5=Cx5_Braking_to_PED (Braking to PED), 6=Cx6_Reserved, 7=Cx7_Reserved
  compu method CM_ADCU_APS_Stop_Req: 0=Cx0_No_request (No request), 1=Cx1_Stop_control_is_required (Stop control is required), 2=Cx2_No_need_to_stop (No need to stop)
  compu method CM_ADCU_APSComfBrkReq: 0=Cx0_ComfBrakeReq_NoReq, 1=Cx1_ComfBrakeReq_Type1, 2=Cx2_ComfBrakeReq_Type2
  compu method CM_ADCU_APSCrlModeReq: 0=Cx0_None, 1=Cx1_APS, 2=Cx2_RC, 3=Cx3_Reserved
  compu method CM_ADCU_APSCrlReq: 0=Cx0_Req_None, 1=Cx1_Req_Drive, 2=Cx2_Req_LSM
  compu method CM_ADCU_APSCrlTypReq: 0=Cx0_None, 1=Cx1_Comfort, 2=Cx2_Emergency, 3=Cx3_Reserved
  compu method CM_ADCU_APSDistanceStop: 4095=CxFFF_Invalid; unit cm
  compu method CM_ADCU_APSMaxSpeedReq: 31=Cx1F_Invalid; unit km/h  # Source signal range: [0,30]
  compu method CM_ADCU_DA_Mode: 0=Cx0_Off, 1=Cx1_Standby_Inhibit (Standby-Inhibit), 2=Cx2_Standby_Available (Standby-Available), 3=Cx3_Active, 4=Cx4_Override_longitudinal (Override-longitudinal), 5=Cx5_Override_lateral (Override-lateral), 6=Cx6_Failure, 7=Cx7_Reserved
  compu method CM_ADCU_FCW_State: 0=Cx0_Off, 1=Cx1_Standby, 2=Cx2_Active, 3=Cx3_Failure
  compu method CM_ADCU_Parking_CtrlSts: 0=Cx0_OFF, 1=Cx1_ON, 2=Cx2_Failure, 3=Cx3_Reserved
  compu method CM_ADCU_Parking_Mode: 0=Cx0_Off, 1=Cx1_Standby, 2=Cx2_Background_searching (Background searching), 3=Cx3_Searching, 4=Cx4_Guidance_active (Guidance active), 5=Cx5_Recovery_interrupt (Recovery interrupt), 6=Cx6_Completed, 7=Cx7_Failure, 8=Cx8_Terminated, 9=Cx9_Reserved, 10=CxA_Reserved, 11=CxB_Reserved, 12=CxC_Reserved, 13=CxD_Reserved, 14=CxE_Reserved, 15=CxF_Reserved
  compu method CM_ADCU_RemoteParkingMode: 0=Cx0_Off, 1=Cx1_Prepare, 2=Cx2_Standby, 3=Cx3_Moving, 4=Cx4_Recovery_interrupt (Recovery interrupt), 5=Cx5_Voluntarily_Exit (Voluntarily Exit), 6=Cx6_Passive_Exit (Passive Exit), 7=Cx7_Failure, 8=Cx8_Reserved, 9=Cx9_Reserved, 10=CxA_Reserved, 11=CxB_Reserved, 12=CxC_Reserved, 13=CxD_Reserved, 14=CxE_Reserved, 15=CxF_Reserved
  compu method CM_ADCU_TargetGear: 0=Cx0_No_Request (No Request), 1=Cx1_P, 2=Cx2_N, 3=Cx3_R, 4=Cx4_D
  compu method CM_Checksum_090: identical
  compu method CM_Checksum_094: identical
  compu method CM_Checksum_095: identical
  compu method CM_Checksum_097: identical
  compu method CM_Checksum_0B{0..4}: identical
  compu method CM_Checksum_0B{7..9}: identical
  compu method CM_Checksum_0BA: identical
  compu method CM_Checksum_0BC: identical
  compu method CM_Checksum_0D{1..3}: identical
  compu method CM_Checksum_0E0: identical
  compu method CM_Checksum_0E2: identical
  compu method CM_Checksum_0E4: identical
  compu method CM_Checksum_0E6: identical
  compu method CM_Checksum_0F5: identical
  compu method CM_Checksum_0F6: identical
  compu method CM_Checksum_317: identical
  compu method CM_Checksum_318: identical
  compu method CM_IBS_ABPActive: 0=Cx0_INACTIVE, 1=Cx1_ACTIVE
  compu method CM_IBS_ABPAvailable: 0=Cx0_NOT_AVAILABLE, 1=Cx1_AVAILABLE
  compu method CM_IBS_ABSActive: 0=Cx0_Not_Active (Not Active), 1=Cx1_Active
  compu method CM_IBS_ABSFault: 0=Cx0_Noerror, 1=Cx1_Error
  compu method CM_IBS_AEBActive: 0=Cx0_notactive, 1=Cx1_active
  compu method CM_IBS_AEBAvailable: 0=Cx0_NOT_AVAILABLE, 1=Cx1_AVAILABLE
  compu method CM_IBS_APS_Avl: 0=Cx0_AxCapbl_Full, 1=Cx1_reversed, 2=Cx2_AxCapbl_VehBlocked, 3=Cx3_reversed
  compu method CM_IBS_APSComfortAvl: 0=Cx0_NotAvailable, 1=Cx1_Brake_failure (Brake failure), 2=Cx2_Excessive_slope (Excessive slope), 3=Cx3_Available
  compu method CM_IBS_APSCrlReqEcho: 0=Cx0_None, 1=Cx1_Drive, 2=Cx2_LSM, 3=Cx3_reserved
  compu method CM_IBS_APSEmergenyAvl: 0=Cx0_NotAvailable, 1=Cx1_Brake_failure (Brake failure), 2=Cx2_Excessive_slope (Excessive slope), 3=Cx3_Available
  compu method CM_IBS_APSModeEcho: 0=Cx0_None, 1=Cx1_APS, 2=Cx2_RC, 3=Cx3_Reserved
  compu method CM_IBS_APSTrqReqActive: 0=Cx0_INACTIVE, 1=Cx1_ACTIVE
  compu method CM_IBS_AVHAvailable: 0=Cx0_NOT_AVAILABLE, 1=Cx1_AVAILABLE
  compu method CM_IBS_AVHSts: 0=Cx0_OFF, 1=Cx1_STANDBY, 2=Cx2_ACTIVE
  compu method CM_IBS_AWBActive: 0=Cx0_NotActive, 1=Cx1_Active
  compu method CM_IBS_AWBAvailable: 0=Cx0_NOT_AVAILABLE, 1=Cx1_AVAILABLE
  compu method CM_IBS_BrakeFluidWarning: 0=Cx0_BRAKEFLUID_NORMAL_INIT_DEFAULT, 1=Cx1_BRAKEFLUID_EMPTY, 2=Cx2_RESERVED, 3=Cx3_RESERVED
  compu method CM_IBS_BrakeLightRequest: 0=Cx0_brakelightOFF, 1=Cx1_brakelightON, 2=Cx2_notused, 3=Cx3_signalnotavailable
  compu method CM_IBS_BrakePedalStatus: 0=Cx0_NOT_PRESSED_INIT_DEFAULT, 1=Cx1_PRESSED, 2=Cx2_RESERVED, 3=Cx3_ERROR
  compu method CM_IBS_BrakePedalStatusValid: 0=Cx0_Invalid, 1=Cx1_Valid
  compu method CM_IBS_BrakePushrodStroke: phys=raw/64-5 for raw 0..2047; unit mm
  compu method CM_IBS_BrakeTypEcho: 0=Cx0_None, 1=Cx1_Comfort, 2=Cx2_Emergency, 3=Cx3_Reserved
  compu method CM_IBS_CddActive: 0=Cx0_INACTIVE, 1=Cx1_ACTIVE
  compu method CM_IBS_CddAvailable: 0=Cx0_NOT_AVAILABLE, 1=Cx1_AVAILABLE
  compu method CM_IBS_CddError: 0=Cx0_NOT_ERROR, 1=Cx1_ERROR
  compu method CM_IBS_CDPActive: 0=Cx0_Not_Active (Not Active), 1=Cx1_Active
  compu method CM_IBS_CDPAvailable: 0=Cx0_NOT_AVAILABLE, 1=Cx1_AVAILABLE
  compu method CM_IBS_DTCActive: 0=Cx0_Not_Active (Not Active), 1=Cx1_Active
  compu method CM_IBS_DTCFault: 0=Cx0_Noerror, 1=Cx1_Error
  compu method CM_IBS_EBDActive: 0=Cx0_Not_Active (Not Active), 1=Cx1_Active
  compu method CM_IBS_EBDFault: 0=Cx0_Noerror, 1=Cx1_Error
  compu method CM_IBS_EPBControllerSts: 0=Cx0_MasterMode, 1=Cx1_SlaveMode
  compu method CM_IBS_EPBFailureLamp: 0=Cx0_LampOFF, 1=Cx1_LampON
  compu method CM_IBS_EPBFailureStatus: 0=Cx0_No_error (No error), 1=Cx1_error, 2=Cx2_Reserve, 3=Cx3_Reserve
  compu method CM_IBS_EPBFunctionLamp: 0=Cx0_LampOFF, 1=Cx1_LampON, 2=Cx2_flash, 3=Cx3_Invalid
  compu method CM_IBS_EPBTextdisplay: 0=Cx0_Off, 1=Cx1_Park_Brake_Applied (Park Brake Applied), 2=Cx2_Park_Brake_Released (Park Brake Released), 3=Cx3_Parking_brake_malfunction_Visit_service_center_to_fix_the_issue (Parking brake malfunction.Visit service center to fix the issue), 4=Cx4_Reserve
  compu method CM_IBS_EPBworkingSts: 0=Cx0_UNKNOWN, 1=Cx1_APPLIED, 2=Cx2_RELEASED, 3=Cx3_APPLY_IN_PROGRESS (APPLY IN PROGRESS), 4=Cx4_RELEASE_IN_PROGRESS (RELEASE IN PROGRESS), 5=Cx5_COMPLETELY_RELEASED (COMPLETELY RELEASED), 6=Cx6_DYNAMIC_APPLY (DYNAMIC APPLY), 7=Cx7_RESERVED
  compu method CM_IBS_ESClampdisplay: 0=Cx0_ESC_lamp_ON (ESC lamp ON), 1=Cx1_ESC_lamp_OFF (ESC lamp OFF), 2=Cx2_ESC_lamp_FLASH (ESC lamp FLASH)
  compu method CM_IBS_ESCOffSts: 0=Cx0_ESC_OFF (ESC OFF), 1=Cx1_ESC_ON (ESC ON)
  compu method CM_IBS_FactoryMode: 0=Cx0_Not_Active (Not Active), 1=Cx1_Active
  compu method CM_IBS_FLMovingDirection: 0=Cx0_Standstill, 1=Cx1_Forward, 2=Cx2_Backward
  compu method CM_IBS_FLWheelPulseCounter: identical
  compu method CM_IBS_FLWheelSpeed: phys=raw*0.05625 for raw 0..6400; unit km/h
  compu method CM_IBS_FLWheelSpeed_Fault: 0=Cx0_No_error (No error), 1=Cx1_Error
  compu method CM_IBS_FRMovingDirection: 0=Cx0_Standstill, 1=Cx1_Forward, 2=Cx2_Backward
  compu method CM_IBS_FRWheelPulseCounter: identical
  compu method CM_IBS_FRWheelSpeed: phys=raw*0.05625 for raw 0..6400; unit km/h
  compu method CM_IBS_FRWheelSpeed_Fault: 0=Cx0_No_error (No error), 1=Cx1_Error
  compu method CM_IBS_HazWarnReq: 0=Cx0_OFF, 1=Cx1_ON, 2=Cx2_Signalnotavailable
  compu method CM_IBS_HBAActive: 0=Cx0_Not_Active (Not Active), 1=Cx1_Active
  compu method CM_IBS_HDCAvailable: 0=Cx0_NOT_AVAILABLE, 1=Cx1_AVAILABLE
  compu method CM_IBS_HDCSts: 0=Cx0_OFF, 1=Cx1_STANDBY, 2=Cx2_ACTIVE
  compu method CM_IBS_HHCActive: 0=Cx0_notactive, 1=Cx1_active
  compu method CM_IBS_HHCAvailable: 0=Cx0_NOT_AVAILABLE, 1=Cx1_AVAILABLE
  compu method CM_IBS_MaintenaceMode: 0=Cx0_Not_Active (Not Active), 1=Cx1_Active
  compu method CM_IBS_MasterCylinderPressure: phys=raw*0.1 for raw 0..2500; unit BAR
  compu method CM_IBS_PlungerPressure: phys=raw*0.1-5 for raw 0..2047; unit BAR
  compu method CM_IBS_RBSStatus: 0=Cx0_NotActive, 1=Cx1_Active
  compu method CM_IBS_RLMovingDirection: 0=Cx0_Standstill, 1=Cx1_Forward, 2=Cx2_Backward
  compu method CM_IBS_RLWheelPulseCounter: identical
  compu method CM_IBS_RLWheelSpeed: phys=raw*0.05625 for raw 0..6400; unit km/h
  compu method CM_IBS_RLWheelSpeed_Fault: 0=Cx0_No_error (No error), 1=Cx1_Error
  compu method CM_IBS_RollerbenchMode: 0=Cx0_Not_Active (Not Active), 1=Cx1_Active
  compu method CM_IBS_RRMovingDirection: 0=Cx0_Standstill, 1=Cx1_Forward, 2=Cx2_Backward
  compu method CM_IBS_RRWheelPulseCounter: identical
  compu method CM_IBS_RRWheelSpeed: phys=raw*0.05625 for raw 0..6400; unit km/h
  compu method CM_IBS_RRWheelSpeed_Fault: 0=Cx0_No_error (No error), 1=Cx1_Error
  compu method CM_IBS_RWUActive: 0=Cx0_Not_Active (Not Active), 1=Cx1_Active
  compu method CM_IBS_RWUAvailable: 0=Cx0_NOT_AVAILABLE, 1=Cx1_AVAILABLE
  compu method CM_IBS_SystemStatus: 0=Cx0_Normal, 1=Cx1_Degrade, 2=Cx2_Partial, 3=Cx3_Inhibit, 4=Cx4_Reserved, 5=Cx5_Reserved, 6=Cx6_Reserved, 7=Cx7_Reserved
  compu method CM_IBS_TargetGearReq: 0=Cx0_No_Request (No Request), 1=Cx1_P, 2=Cx2_N, 3=Cx3_R, 4=Cx4_D
  compu method CM_IBS_TCSActive: 0=Cx0_NotActive, 1=Cx1_Active
  compu method CM_IBS_TCSFault: 0=Cx0_Noerror, 1=Cx1_Error
  compu method CM_IBS_TireMonSysSts: 0=Cx0_System_not_OK (System not OK), 1=Cx1_System_OK (System OK)
  compu method CM_IBS_TireWarnFrntLe: 0=Cx0_Normal, 1=Cx1_Abnormal
  compu method CM_IBS_TireWarnFrntRi: 0=Cx0_Normal, 1=Cx1_Abnormal
  compu method CM_IBS_TireWarnReLe: 0=Cx0_Normal, 1=Cx1_Abnormal
  compu method CM_IBS_TireWarnReRi: 0=Cx0_Normal, 1=Cx1_Abnormal
  compu method CM_IBS_TPMS_ResetSts: 0=Cx0_OFF, 1=Cx1_ON
  compu method CM_IBS_VCU_DecelerationReqActive: 0=Cx0_NotActive, 1=Cx1_Active
  compu method CM_IBS_VCU_DecelerationRequest_Available: 0=Cx0_Available, 1=Cx1_Not_Available (Not Available), 2=Cx2_Reserved, 3=Cx3_Reserved
  compu method CM_IBS_VDCActive: 0=Cx0_NotActive, 1=Cx1_Active
  compu method CM_IBS_VDCFault: 0=Cx0_Noerror, 1=Cx1_Error
  compu method CM_IBS_VehicleSpeed: phys=raw*0.05625 for raw 0..6400; unit km/h
  compu method CM_IBS_VehicleSpeedValid: 0=Cx0_Invalid, 1=Cx1_Valid
  compu method CM_IBS_VehicleStandstill: 0=Cx0_NOT_STANDSTILL, 1=Cx1_STANDSTILL, 2=Cx2_RESERVED
  compu method CM_IBS_VehicleStandstill_Valid: 0=Cx0_Invalid, 1=Cx1_Valid
  compu method CM_IBS_VlcActive: 0=Cx0_INACTIVE, 1=Cx1_ACTIVE
  compu method CM_IBS_VlcAvalible: 0=Cx0_NOT_AVAILABLE, 1=Cx1_AVAILABLE
  compu method CM_IBS_VlcError: 0=Cx0_NOT_ERROR, 1=Cx1_ERROR
  compu method CM_IBS_WLTorqueAPSReq: phys=raw-20000 for raw 0..40000; unit Nm
  compu method CM_IBS_WLTorqueAPSReqValid: 0=Cx0_NotIntialized, 1=Cx1_Normal, 2=Cx2_Faulty
  compu method CM_IBS_WLTorqueIncrReq: phys=raw-20000 for raw 0..40000; unit Nm
  compu method CM_IBS_WLTorqueIncrReqSts: 0=Cx0_INACTIVE, 1=Cx1_ACTIVE
  compu method CM_IBS_WLTorqueRBSReq: phys=raw-20000 for raw 0..40000; unit Nm
  compu method CM_IBS_WLTorqueRBSReqValid: 0=Cx0_NotIntialized, 1=Cx1_Normal, 2=Cx2_Faulty
  compu method CM_IBS_WLTorqueRedReq: phys=raw-20000 for raw 0..40000; unit Nm
  compu method CM_IBS_WLTorqueRedReqSts: 0=Cx0_INACTIVE, 1=Cx1_ACTIVE
  compu method CM_IBS_WLTorqueVLCReq: phys=raw-20000 for raw 0..32767; unit Nm
  compu method CM_IBS_WLTorqueVLCReqValid: 0=Cx0_NotIntialized, 1=Cx1_Normal, 2=Cx2_Faulty
  compu method CM_MessageCounter_090: 15=CxF_Invalid
  compu method CM_MessageCounter_094: 15=CxF_Invalid
  compu method CM_MessageCounter_095: 15=CxF_Invalid
  compu method CM_MessageCounter_097: 15=CxF_Invalid
  compu method CM_MessageCounter_0B{0..4}: 15=CxF_Invalid
  compu method CM_MessageCounter_0B{7..9}: 15=CxF_Invalid
  compu method CM_MessageCounter_0BA: 15=CxF_Invalid
  compu method CM_MessageCounter_0BC: 15=CxF_Invalid
  compu method CM_MessageCounter_0D{1..3}: 15=CxF_Invalid
  compu method CM_MessageCounter_0E0: 15=CxF_Invalid
  compu method CM_MessageCounter_0E2: 15=CxF_Invalid
  compu method CM_MessageCounter_0E4: 15=CxF_Invalid
  compu method CM_MessageCounter_0E6: 15=CxF_Invalid
  compu method CM_MessageCounter_0F5: 15=CxF_Invalid
  compu method CM_MessageCounter_0F6: 15=CxF_Invalid
  compu method CM_MessageCounter_317: 15=CxF_Invalid
  compu method CM_MessageCounter_318: 15=CxF_Invalid
  compu method CM_SGW_BLEChrgFlaplockCtrlReq: 0=Cx0_No_Request (No Request), 1=Cx1_Unlock, 2=Cx2_Lock, 3=Cx3_Reserved
  compu method CM_SGW_BLEPowerModeReq: 0=Cx0_No_Request (No Request), 1=Cx1_Request_Power_OFF (Request Power OFF), 2=Cx2_Request_Power_ON (Request Power ON), 3=Cx3_Reserve
  compu method CM_SGW_BLESystemReadyReq: 0=Cx0_No_Request (No Request), 1=Cx1_Request_Ready_Remote (Request Ready_Remote), 2=Cx2_Reserve, 3=Cx3_Reserve
  compu method CM_SGW_BLETailgateCtrlReq: 0=Cx0_No_Request (No Request), 1=Cx1_Unlock, 2=Cx2_Lock, 3=Cx3_Reserved
  compu method CM_SGW_KeyLowBatWarning: 0=Cx0_NO_WARNING, 1=Cx1_WARNING
  compu method CM_VCU_AccelerationPedal: phys=raw*0.1 for raw 0..1000; unit percent
  compu method CM_VCU_AccelerationPedalValid: 0=Cx0_Invalid, 1=Cx1_Valid
  compu method CM_VCU_ActDriveMode: 0=Cx0_INVALID, 1=Cx1_ECO, 2=Cx2_NORMAL, 3=Cx3_SPORT, 4=Cx4_OnePedal
  compu method CM_VCU_ActualGear: 0=Cx0_Reserve, 1=Cx1_P, 2=Cx2_N, 3=Cx3_R, 4=Cx4_D
  compu method CM_VCU_ADASOverride: 0=Cx0_off, 1=Cx1_on
  compu method CM_VCU_APSTorqueRequestActive: 0=Cx0_Not_Active (Not Active), 1=Cx1_Active
  compu method CM_VCU_APSTorqueRequestAvailable: 0=Cx0_Not_Available (Not Available), 1=Cx1_Available
  compu method CM_VCU_BMS_Control_of_PosRelay: 0=Cx0_Invaild, 1=Cx1_Open, 2=Cx2_Close
  compu method CM_VCU_BMSTargetThermLevel: 0=Cx0_Level_1_low_ (Level 1(low)), 1=Cx1_Level_2_medium_ (Level 2(medium)), 2=Cx2_Level_3_high_ (Level 3(high)), 3=Cx3_Reserved
  compu method CM_VCU_BrakeCompensateStatus: 0=Cx0_Invalid, 1=Cx1_OFF, 2=Cx2_ON, 3=Cx3_Reserved
  compu method CM_VCU_BrakeCompensateWarn: 0=Cx0_No_display (No display), 1=Cx1_Vehicle_failure_brake_compensation_failed_to_open_ (Vehicle failure, brake compensation failed to open.), 2=Cx2_Reserved, 3=Cx3_Reserved
  compu method CM_VCU_BrakepedalStatus: 0=Cx0_No_pressed (No pressed), 1=Cx1_pressed, 2=Cx2_Invalid
  compu method CM_VCU_BS_Current: phys=raw*0.001-8.192 for raw 0..16383
  compu method CM_VCU_BS_IBSBatSOC: 255=CxFF_Invalid; unit percent  # Source signal range: [0,100]
  compu method CM_VCU_BS_IndicatorSts: 0=Cx0_No_request (No request), 1=Cx1_Low_SOH (Low SOH)
  compu method CM_VCU_BS_LV_Batt: phys=raw*0.001 for raw 0..32767; unit V
  compu method CM_VCU_ChargeEndReason: 0=Cx0_No_Display (No Display), 1=Cx1_Reach_the_charge_cut_off_SOC (Reach the charge cut-off SOC), 2=Cx2_reserved, 3=Cx3_reserved
  compu method CM_VCU_ChargeProcessComment: 0=Cx0_No_comment (No comment), 1=Cx1_Charge_Fault_and_slow (Charge Fault and slow), 2=Cx2_Reserved, 3=Cx3_Reserved
  compu method CM_VCU_ChargeStatus: 0=Cx0_Init, 1=Cx1_Off_Plug (Off Plug), 2=Cx2_AC_Plug_Detected (AC Plug Detected), 3=Cx3_DC_Plug_Detected (DC Plug Detected), 4=Cx4_V2L_Plug_Detected (V2L Plug Detected), 5=Cx5_AC_Charging (AC Charging), 6=Cx6_DC_Charging (DC Charging), 7=Cx7_V2L_Discharging (V2L Discharging), 8=Cx8_Charging_Completed (Charging Completed), 9=Cx9_Charging_Fault (Charging Fault), 10=CxA_AC_Preheating (AC Preheating), 11=CxB_DC_Preheating (DC Preheating), 12=CxC_V2L_completed (V2L completed), 13=CxD_KeepWarming, 14=CxE_V2L_Fault (V2L Fault)
  compu method CM_VCU_CriSysFailure: 0=Cx0_No_Warning, 1=Cx1_Leve1_lighting_prompt_only_ (Leve1 (lighting prompt only)), 2=Cx2_Leve2_power_loss_ (Leve2 (power loss)), 3=Cx3_Leve3_emergency_power_off_ (Leve3 (emergency power off))
  compu method CM_VCU_DCDCFail: 0=Cx0_False, 1=Cx1_True
  compu method CM_VCU_DCFCCurrent: identical
  compu method CM_VCU_DecelerationReq: phys=raw*0.05-5 for raw 0..255; unit m/s^2
  compu method CM_VCU_DecelerationReqactive: 0=Cx0_Inactive_ (Inactive;), 1=Cx1_Active
  compu method CM_VCU_DischargeEndReason: 0=Cx0_No_Display (No Display), 1=Cx1_Reach_the_discharge_cut_off_SOC (Reach the discharge cut-off SOC), 2=Cx2_reserved, 3=Cx3_reserved
  compu method CM_VCU_DischargeEndSoc: identical
  compu method CM_VCU_Display_Cur: identical
  compu method CM_VCU_Display_Power: phys=raw*0.1 for raw 0..4095; unit kW
  compu method CM_VCU_DriveMotOvrTemp: 0=Cx0_False, 1=Cx1_True
  compu method CM_VCU_DriverTorqueRequest: phys=raw-1023 for raw 0..2045
  compu method CM_VCU_DrvModSwitchWarn: 0=Cx0_RESERVE, 1=Cx1_unrecommed_Sport_Low_SOC (unrecommed Sport-Low SOC), 2=Cx2_Vehicle_not_in_P_gear_single_pedal_unavailable (Vehicle not in P gear,single pedal unavailable), 3=Cx3_Vehicle_failure_single_pedal_unavailable_ (Vehicle failure, single pedal unavailable.), 4=Cx4_Reserved, 5=Cx5_Reserved, 6=Cx6_Reserved, 7=Cx7_Reserved
  compu method CM_VCU_EnergyManagementWarn: 0=Cx0_OFF, 1=Cx1_Battery_is_discharging_recommended_to_turn_off_the_air_conditioner_or_other_loads_ (Battery is discharging, recommended to turn off the air conditioner or other loads.), 2=Cx2_Insufficient_vehicle_power_recommended_to_turn_off_the_air_conditioner_or_other_loads_ (Insufficient vehicle power,recommended to turn off the air conditioner or other loads.), 3=Cx3_Reserved
  compu method CM_VCU_EnergyV2L: phys=raw*0.1 for raw 0..1023; unit kWh
  compu method CM_VCU_EPBReq: 0=Cx0_Not_Request (Not Request), 1=Cx1_Apply_Request (Apply Request), 2=Cx2_Release_Request (Release Request), 3=Cx3_Reserved
  compu method CM_VCU_ForwardVmaxAllowed: 0=Cx00_No_request (No request), 1=Cx01_1_170 (1-170), 2=Cx02_1_170 (1-170), 3=Cx03_1_170 (1-170), 4=Cx04_1_170 (1-170), 5=Cx05_1_170 (1-170), 6=Cx06_1_170 (1-170), 7=Cx07_1_170 (1-170), 8=Cx08_1_170 (1-170), 9=Cx09_1_170 (1-170), 10=Cx0A_1_170 (1-170), 11=Cx0B_1_170 (1-170), 12=Cx0C_1_170 (1-170), 13=Cx0D_1_170 (1-170), 14=Cx0E_1_170 (1-170), 15=Cx0F_1_170 (1-170), 16=Cx10_1_170 (1-170), 17=Cx11_1_170 (1-170), 18=Cx12_1_170 (1-170), 19=Cx13_1_170 (1-170), 20=Cx14_1_170 (1-170), 21=Cx15_1_170 (1-170), 22=Cx16_1_170 (1-170), 23=Cx17_1_170 (1-170), 24=Cx18_1_170 (1-170), 25=Cx19_1_170 (1-170), 26=Cx1A_1_170 (1-170), 27=Cx1B_1_170 (1-170), 28=Cx1C_1_170 (1-170), 29=Cx1D_1_170 (1-170), 30=Cx1E_1_170 (1-170), 31=Cx1F_1_170 (1-170), 32=Cx20_1_170 (1-170), 33=Cx21_1_170 (1-170), 34=Cx22_1_170 (1-170), 35=Cx23_1_170 (1-170), 36=Cx24_1_170 (1-170), 37=Cx25_1_170 (1-170), 38=Cx26_1_170 (1-170), 39=Cx27_1_170 (1-170), 40=Cx28_1_170 (1-170), 41=Cx29_1_170 (1-170), 42=Cx2A_1_170 (1-170), 43=Cx2B_1_170 (1-170), 44=Cx2C_1_170 (1-170), 45=Cx2D_1_170 (1-170), 46=Cx2E_1_170 (1-170), 47=Cx2F_1_170 (1-170), 48=Cx30_1_170 (1-170), 49=Cx31_1_170 (1-170), 50=Cx32_1_170 (1-170), 51=Cx33_1_170 (1-170), 52=Cx34_1_170 (1-170), 53=Cx35_1_170 (1-170), 54=Cx36_1_170 (1-170), 55=Cx37_1_170 (1-170), 56=Cx38_1_170 (1-170), 57=Cx39_1_170 (1-170), 58=Cx3A_1_170 (1-170), 59=Cx3B_1_170 (1-170), 60=Cx3C_1_170 (1-170), 61=Cx3D_1_170 (1-170), 62=Cx3E_1_170 (1-170), 63=Cx3F_1_170 (1-170), 64=Cx40_1_170 (1-170), 65=Cx41_1_170 (1-170), 66=Cx42_1_170 (1-170), 67=Cx43_1_170 (1-170), 68=Cx44_1_170 (1-170), 69=Cx45_1_170 (1-170), 70=Cx46_1_170 (1-170), 71=Cx47_1_170 (1-170), 72=Cx48_1_170 (1-170), 73=Cx49_1_170 (1-170), 74=Cx4A_1_170 (1-170), 75=Cx4B_1_170 (1-170), 76=Cx4C_1_170 (1-170), 77=Cx4D_1_170 (1-170), 78=Cx4E_1_170 (1-170), 79=Cx4F_1_170 (1-170), 80=Cx50_1_170 (1-170), 81=Cx51_1_170 (1-170), 82=Cx52_1_170 (1-170), 83=Cx53_1_170 (1-170), 84=Cx54_1_170 (1-170), 85=Cx55_1_170 (1-170), 86=Cx56_1_170 (1-170), 87=Cx57_1_170 (1-170), 88=Cx58_1_170 (1-170), 89=Cx59_1_170 (1-170), 90=Cx5A_1_170 (1-170), 91=Cx5B_1_170 (1-170), 92=Cx5C_1_170 (1-170), 93=Cx5D_1_170 (1-170), 94=Cx5E_1_170 (1-170), 95=Cx5F_1_170 (1-170), 96=Cx60_1_170 (1-170), 97=Cx61_1_170 (1-170), 98=Cx62_1_170 (1-170), 99=Cx63_1_170 (1-170), 100=Cx64_1_170 (1-170), 101=Cx65_1_170 (1-170), 102=Cx66_1_170 (1-170), 103=Cx67_1_170 (1-170), 104=Cx68_1_170 (1-170), 105=Cx69_1_170 (1-170), 106=Cx6A_1_170 (1-170), 107=Cx6B_1_170 (1-170), 108=Cx6C_1_170 (1-170), 109=Cx6D_1_170 (1-170), 110=Cx6E_1_170 (1-170), 111=Cx6F_1_170 (1-170), 112=Cx70_1_170 (1-170), 113=Cx71_1_170 (1-170), 114=Cx72_1_170 (1-170), 115=Cx73_1_170 (1-170), 116=Cx74_1_170 (1-170), 117=Cx75_1_170 (1-170), 118=Cx76_1_170 (1-170), 119=Cx77_1_170 (1-170), 120=Cx78_1_170 (1-170), 121=Cx79_1_170 (1-170), 122=Cx7A_1_170 (1-170), 123=Cx7B_1_170 (1-170), 124=Cx7C_1_170 (1-170), 125=Cx7D_1_170 (1-170), 126=Cx7E_1_170 (1-170), 127=Cx7F_1_170 (1-170), 128=Cx80_1_170 (1-170), 129=Cx81_1_170 (1-170), 130=Cx82_1_170 (1-170), 131=Cx83_1_170 (1-170), 132=Cx84_1_170 (1-170), 133=Cx85_1_170 (1-170), 134=Cx86_1_170 (1-170), 135=Cx87_1_170 (1-170), 136=Cx88_1_170 (1-170), 137=Cx89_1_170 (1-170), 138=Cx8A_1_170 (1-170), 139=Cx8B_1_170 (1-170), 140=Cx8C_1_170 (1-170), 141=Cx8D_1_170 (1-170), 142=Cx8E_1_170 (1-170), 143=Cx8F_1_170 (1-170), 144=Cx90_1_170 (1-170), 145=Cx91_1_170 (1-170), 146=Cx92_1_170 (1-170), 147=Cx93_1_170 (1-170), 148=Cx94_1_170 (1-170), 149=Cx95_1_170 (1-170), 150=Cx96_1_170 (1-170), 151=Cx97_1_170 (1-170), 152=Cx98_1_170 (1-170), 153=Cx99_1_170 (1-170), 154=Cx9A_1_170 (1-170), 155=Cx9B_1_170 (1-170), 156=Cx9C_1_170 (1-170), 157=Cx9D_1_170 (1-170), 158=Cx9E_1_170 (1-170), 159=Cx9F_1_170 (1-170), 160=CxA0_1_170 (1-170), 161=CxA1_1_170 (1-170), 162=CxA2_1_170 (1-170), 163=CxA3_1_170 (1-170), 164=CxA4_1_170 (1-170), 165=CxA5_1_170 (1-170), 166=CxA6_1_170 (1-170), 167=CxA7_1_170 (1-170), 168=CxA8_1_170 (1-170), 169=CxA9_1_170 (1-170), 170=CxAA_1_170 (1-170), 171=CxAB_Reserved, 172=CxAC_Reserved, 173=CxAD_Reserved, 174=CxAE_Reserved, 175=CxAF_Reserved, 176=CxB0_Reserved, 177=CxB1_Reserved, 178=CxB2_Reserved, 179=CxB3_Reserved, 180=CxB4_Reserved, 181=CxB5_Reserved, 182=CxB6_Reserved, 183=CxB7_Reserved, 184=CxB8_Reserved, 185=CxB9_Reserved, 186=CxBA_Reserved, 187=CxBB_Reserved, 188=CxBC_Reserved, 189=CxBD_Reserved, 190=CxBE_Reserved, 191=CxBF_Reserved, 192=CxC0_Reserved, 193=CxC1_Reserved, 194=CxC2_Reserved, 195=CxC3_Reserved, 196=CxC4_Reserved, 197=CxC5_Reserved, 198=CxC6_Reserved, 199=CxC7_Reserved, 200=CxC8_Reserved, 201=CxC9_Reserved, 202=CxCA_Reserved, 203=CxCB_Reserved, 204=CxCC_Reserved, 205=CxCD_Reserved, 206=CxCE_Reserved, 207=CxCF_Reserved, 208=CxD0_Reserved, 209=CxD1_Reserved, 210=CxD2_Reserved, 211=CxD3_Reserved, 212=CxD4_Reserved, 213=CxD5_Reserved, 214=CxD6_Reserved, 215=CxD7_Reserved, 216=CxD8_Reserved, 217=CxD9_Reserved, 218=CxDA_Reserved, 219=CxDB_Reserved, 220=CxDC_Reserved, 221=CxDD_Reserved, 222=CxDE_Reserved, 223=CxDF_Reserved, 224=CxE0_Reserved, 225=CxE1_Reserved, 226=CxE2_Reserved, 227=CxE3_Reserved, 228=CxE4_Reserved, 229=CxE5_Reserved, 230=CxE6_Reserved, 231=CxE7_Reserved, 232=CxE8_Reserved, 233=CxE9_Reserved, 234=CxEA_Reserved, 235=CxEB_Reserved, 236=CxEC_Reserved, 237=CxED_Reserved, 238=CxEE_Reserved, 239=CxEF_Reserved, 240=CxF0_Reserved, 241=CxF1_Reserved, 242=CxF2_Reserved, 243=CxF3_Reserved, 244=CxF4_Reserved, 245=CxF5_Reserved, 246=CxF6_Reserved, 247=CxF7_Reserved, 248=CxF8_Reserved, 249=CxF9_Reserved, 250=CxFA_Reserved, 251=CxFB_Reserved, 252=CxFC_Reserved, 253=CxFD_Reserved, 254=CxFE_Reserved, 255=CxFF_Reserved
  compu method CM_VCU_ForwardVmaxlimitStatus: 0=Cx0_Inactive, 1=Cx1_Active
  compu method CM_VCU_HVBatCriFail: 0=Cx0_False, 1=Cx1_Yellow, 2=Cx2_Red, 3=Cx3_Reserve
  compu method CM_VCU_HVBatOvrTemp: 0=Cx0_False, 1=Cx1_True
  compu method CM_VCU_HVConnectFault: 0=Cx0_Normal, 1=Cx1_Fault
  compu method CM_VCU_HVILError: 0=Cx0_False, 1=Cx1_True
  compu method CM_VCU_HVInsulResFault: 0=Cx0_False, 1=Cx1_True
  compu method CM_VCU_HVStatus: 0=Cx0_Init, 1=Cx1_Standby, 2=Cx2_HV_Ready (HV Ready), 3=Cx3_Drive_ready (Drive ready), 4=Cx4_Preheating, 5=Cx5_Sleep
  compu method CM_VCU_InvldGearSel: 0=Cx0_Normal, 1=Cx1_Shifting_fails_please_brake (Shifting fails, please brake), 2=Cx2_Danger_Too_high_speed_do_not_switch_D_gear (Danger _ Too high speed _ do not switch D gear), 3=Cx3_Danger_Too_high_speed_do_not_switch_R_gear (Danger _ Too high speed _ do not switch R gear), 4=Cx4_Danger_Too_high_speed_do_not_switch_P_gear (Danger _ Too high speed _ do not switch P gear), 5=Cx5_Danger_The_accelerator_pedal_is_too_large_it_is_forbidden_to_switch_driving_gear (Danger _ The accelerator pedal is too large _ it is forbidden to switch driving gear), 6=Cx6_Charging_gun_connected_do_not_switch_gear (Charging gun connected, do not switch gear), 7=Cx7_The_shift_button_is_faulty_Screen_shift_is_recommended (The shift button is faulty _ Screen shift is recommended), 8=Cx8_The_vehicle_is_not_ready_it_is_forbidden_to_switch_driving_gears (The vehicle is not ready_it is forbidden to switch driving gears), 9=Cx9_EPB_unresponsive_unable_to_engage_in_P_gear (EPB unresponsive_unable to engage in P gear), 10=CxA_EPB_unresponsive_unable_to_exit_in_P_gear (EPB unresponsive_unable to exit in P gear), 11=CxB_SWP_is_faulty_PRND_button_is_recommended (SWP is faulty _ PRND button is recommended), 12=CxC_Fault_detected_shift_failed_please_restart_the_vehicle_or_contact_customer_service (Fault detected, shift failed, please restart the vehicle or contact customer service), 13=CxD_Danger_Too_high_speed_do_not_switch_N_gear (Danger _ Too high speed _ do not switch N gear), 14=CxE_Gun_insertion_detected_execute_automatic_P_gear (Gun insertion detected. execute automatic P-gear), 15=CxF_Immo_state_enable_forbid_gear_shifting (Immo state enable,forbid gear shifting)
  compu method CM_VCU_IsoMeasurementSwitch: 0=Cx0_OFF, 1=Cx1_ON
  compu method CM_VCU_Kickdown: 0=Cx0_Invalid, 1=Cx1_Valid
  compu method CM_VCU_KL15eOn: 0=Cx0_Off, 1=Cx1_On
  compu method CM_VCU_LimitLevel: 0=Cx0_level_0_No_limit (level 0-No limit), 1=Cx1_level_1 (level 1), 2=Cx2_level_2 (level 2), 3=Cx3_level_3 (level 3)
  compu method CM_VCU_LimpHome: 0=Cx0_False, 1=Cx1_True
  compu method CM_VCU_ManuallyUnlockComment: 0=Cx0_False, 1=Cx1_True
  compu method CM_VCU_maxChargeSOC: 254=CxFE_No_Request (No Request), 255=CxFF_Invalid
  compu method CM_VCU_MCU_FaultLampReq: 0=Cx0_No_Request (No Request), 1=Cx1_Yellow_LED_request (Yellow-LED request), 2=Cx2_Red_LED_request (Red-LED request), 3=Cx3_Reserve
  compu method CM_VCU_MCUDesiredTorque: 2046=Cx7FE_Init, 2047=Cx7FF_Error, phys=raw-1023 for raw 0..2045; unit Nm  # Source signal range: [0,2045]
  compu method CM_VCU_MCUSurgeDamperState: 0=Cx0_DstC_off, 1=Cx1_DstC_ext, 2=Cx2_DstC_int_ext; unit SED
  compu method CM_VCU_MemoryChargeFault: 0=Cx0_Normal, 1=Cx1_Charge_Fault (Charge Fault)
  compu method CM_VCU_MileagelowRemind: 0=Cx0_No_comment (No comment), 1=Cx1_The_mileage_is_too_low_please_charge (The mileage is too low, please charge)
  compu method CM_VCU_MotorActualTorque: phys=raw-1024 for raw 0..2047
  compu method CM_VCU_MotorActualTorqueValid: 0=Cx0_Invalid, 1=Cx1_Valid
  compu method CM_VCU_OPStandstillReq: 0=Cx0_NO_DEMAND, 1=Cx1_DEMAND, 2=Cx2_Reserve, 3=Cx3_Reserve
  compu method CM_VCU_PlugStatus: 0=Cx0_Init, 1=Cx1_No_Plug_connected, 2=Cx2_AC_Plug_connected_Unlock, 3=Cx3_AC_Plug_connected_Locked, 4=Cx4_DC_Plug_connected, 5=Cx5_V2L_Plug_connected, 6=Cx6_AC_Plug_DC_Plug_Connected (AC Plug&DC Plug Connected), 7=Cx7_Fault
  compu method CM_VCU_PWTErrorLevel: 0=Cx0_Fault_Level0 (Fault Level0), 1=Cx1_Fault_Level1 (Fault Level1), 2=Cx2_Fault_Level2 (Fault Level2), 3=Cx3_Fault_Level3 (Fault Level3), 4=Cx4_Fault_Level4 (Fault Level4), 5=Cx5_Fault_Level5 (Fault Level5), 6=Cx6_Fault_Level6 (Fault Level6), 7=Cx7_Fault_Level7 (Fault Level7), 8=Cx8_Fault_Level8 (Fault Level8), 9=Cx9_Fault_Level9 (Fault Level9), 10=CxA_Fault_Level10 (Fault Level10), 11=CxB_Fault_Level11 (Fault Level11), 12=CxC_Fault_Level12 (Fault Level12), 13=CxD_Fault_Level13 (Fault Level13), 14=CxE_Fault_Level14 (Fault Level14), 15=CxF_Fault_Level15 (Fault Level15)
  compu method CM_VCU_ReachLimitStd: 0=Cx0_No_request (No request), 1=Cx1_Request
  compu method CM_VCU_RegenBrakeLightRequest: 0=Cx0_Brake_lights_Off (Brake lights Off), 1=Cx1_Brake_lights_On (Brake lights On)
  compu method CM_VCU_RegenBrakeLightReqVld: 0=Cx0_INVALID, 1=Cx1_VALID
  compu method CM_VCU_RegenTorqueCap: phys=raw-20000 for raw 0..40000
  compu method CM_VCU_RegenTorqueCapValid: 0=Cx0_invalid, 1=Cx1_valid
  compu method CM_VCU_RegStatus: 0=Cx0_Reserve, 1=Cx1_OFF, 2=Cx2_Primary_energy_recovery_weak_ (Primary energy recovery (weak)), 3=Cx3_Secondary_energy_recovery_medium_ (Secondary energy recovery(medium)), 4=Cx4_Tertiary_energy_recovery_strong_ (Tertiary energy recovery (strong)), 5=Cx5_Reserved, 6=Cx6_Reserved, 7=Cx7_Reserved
  compu method CM_VCU_RemainChrgTime: 1022=Cx3FE_Init, 1023=Cx3FF_Error; unit min
  compu method CM_VCU_RequestedModeBMS: 0=Cx0_InActive, 1=Cx1_HVActive, 2=Cx2_Reserved, 3=Cx3_Reserved, 4=Cx4_Reserved, 5=Cx5_EmergencyOff, 6=Cx6_Reserved, 7=Cx7_Invalid
  compu method CM_VCU_RequestedModeMCU: 0=Cx0_Ready, 1=Cx1_TrqCtrl, 2=Cx2_Active_Hearting (Active Hearting), 3=Cx3_Discharge, 4=Cx4_SpeedCtrl
  compu method CM_VCU_SystemReady: 0=Cx0_Not_Ready (Not Ready), 1=Cx1_Ready
  compu method CM_VCU_TargetGear: 0=Cx0_Reserve, 1=Cx1_P, 2=Cx2_N, 3=Cx3_R, 4=Cx4_D
  compu method CM_VCU_TCSActive: 0=Cx0_NotActive, 1=Cx1_Active
  compu method CM_VCU_TorqueRequestActive: 0=Cx0_Not_Active (Not Active), 1=Cx1_Active
  compu method CM_VCU_TorqueRequestAvailable: 0=Cx0_Not_Available (Not Available), 1=Cx1_Available
  compu method CM_VCU_TrqThresholdDampgCtl: 254=CxFE_Init, 255=CxFF_Error, phys=raw*0.1 for raw 0..250; unit Nm  # Source signal range: [0,250]
  compu method CM_VCU_VehicleSpeed: phys=raw*0.05625 for raw 0..6400; unit km/h
  compu method CM_VCU_VehicleSpeedValid: 0=Cx0_invalid, 1=Cx1_valid
  compu method CM_VCU_VirtualACPedal: phys=raw*0.1 for raw 0..1000; unit percent
  compu method CM_VCU_VirtualACPedalValid: 0=Cx0_Invalid, 1=Cx1_Valid
  compu method CM_VCU_VLCTorqueRequestActive: 0=Cx0_Not_Active (Not Active), 1=Cx1_Active
  compu method CM_VCU_VLCTorqueRequestAvailable: 0=Cx0_Not_Available (Not Available), 1=Cx1_Available
  compu method CM_VCU_WakeUpStatus: identical
  compu method CM_VCU_WheelTrqACT: phys=raw-20000 for raw 0..40000; unit Nm
  compu method CM_VCU_WheelTrqACTValid: 0=Cx0_invalid, 1=Cx1_valid
  compu method CM_AN0: identical
  compu method CM_AN1: identical
  compu method CM_AN{10..19}: identical
  compu method CM_AN2: identical
  compu method CM_AN{20..29}: identical
  compu method CM_AN3: identical
  compu method CM_AN{30..39}: identical
  compu method CM_AN4: identical
  compu method CM_AN{40..47}: identical
  compu method CM_AN{5..9}: identical
  compu method CM_Bts7xx_HS{1..4}_En: identical
  compu method CM_Tle888qk_Out{21..24}_En: identical
  compu method CM_Tle4252d_en: identical
  compu method CM_Tle888qk_Out{21..24}BriCfg: identical
  compu method CM_Tle9201_Dir: identical
  compu method CM_Tle9201_Dis: identical
  compu method CM_Tle9201_Pwm: identical
  compu method CM_Ext_IN2: identical
  compu method CM_EXT_PWM_IN1_Duty: identical
  compu method CM_EXT_PWM_IN1_Period: identical
  compu method CM_EXT_PWM_IN2_Duty: identical
  compu method CM_EXT_PWM_IN2_Period: identical
  compu method CM_Tle888qk_Lout1_En: identical
  compu method CM_Tle888qk_Lout14_En: identical
  compu method CM_Tle888qk_Lout16_En: identical
  compu method CM_Tle888qk_Lout8_En: identical
  compu method CM_Vcu_Lin3_RxMsg1_Sig0: identical
  compu method CM_Vcu_Lin3_RxMsg1_Sig1: identical
  compu method CM_Vcu_Lin3_RxMsg2_Sig{0..3}: identical
  compu method CM_Vcu_Lin3_TxMsg1_Sig{0..3}: identical
  compu method CM_Vcu_Lin3_TxMsg2_Sig{0..3}: identical
  compu method CM_APTC_Core1TempSensorFaltStatus: 0=Cx0_no_error (no error), 1=Cx1_L_sensor_open (L sensor open), 2=Cx2_sensor_short (sensor short), 3=Cx3_overheating
  compu method CM_APTC_Core2TempSensorFaltStatus: 0=Cx0_no_error (no error), 1=Cx1_R_sensor_open (R sensor open), 2=Cx2_sensor_short (sensor short), 3=Cx3_overheating
  compu method CM_APTC_DriveFaltStatus: 0=Cx0_no_error (no error), 1=Cx1_error
  compu method CM_APTC_HeatingFaltStatus: 0=Cx0_no_error (no error), 1=Cx1_error
  compu method CM_APTC_HighVoltageStatus: 0=Cx0_High_Voltage_Normal (High Voltage Normal), 1=Cx1_High_Voltage_Under (High Voltage Under), 2=Cx2_High_Voltage_Over (High Voltage Over)
  compu method CM_APTC_HVBusVoltage: phys=raw*0.5 for raw 0..2040; unit V
  compu method CM_APTC_HVPowerUpReq: 0=Cx0_APTC_OK (APTC OK), 1=Cx1_APTC_failure (APTC failure)
  compu method CM_APTC_IGBTFaltStatus: 0=Cx0_no_error (no error), 1=Cx1_IGBT1_SHORT (IGBT1 SHORT), 2=Cx2_IGBT2_SHORT (IGBT2 SHORT), 3=Cx3_BOTH_SHORT (BOTH SHORT)
  compu method CM_APTC_IGBTTempSensorStatus: 0=Cx0_No_Error (No Error), 1=Cx1_IGBT_Temp_Sensor_Short (IGBT Temp Sensor Short), 2=Cx2_IGBT_Temp_Sensor_OverTemp (IGBT Temp Sensor OverTemp), 3=Cx3_IGBT_Temp_Sensor_Open (IGBT Temp Sensor Open)
  compu method CM_APTC_LeftCoreTemp: phys=raw-40 for raw 0..255; unit degrees
  compu method CM_APTC_LostCommuFaltStatus: 0=Cx0_no_error (no error), 1=Cx1_TCU_signal_losted (TCU signal losted)
  compu method CM_APTC_LowVoltageStatus: 0=Cx0_Low_Voltage_Normal (Low Voltage Normal), 1=Cx1_Low_Voltage_Under (Low Voltage Under), 2=Cx2_Low_Voltage_Over (Low Voltage Over), 3=Cx3_Reserve
  compu method CM_APTC_OverCurrentFault: 0=Cx0_No_Error (No Error), 1=Cx1_Error
  compu method CM_APTC_OverLoadStatus: 0=Cx0_No_Error (No Error), 1=Cx1_Left_APTC_OverLoad (Left APTC OverLoad), 2=Cx2_Right_APTC_Overload (Right APTC Overload), 3=Cx3_Both_APTC_Overload (Both APTC Overload)
  compu method CM_APTC_PCBTempSensorStatus: 0=Cx0_No_Error (No Error), 1=Cx1_PCB_Temp_Sensor_Short (PCB Temp Sensor Short), 2=Cx2_PCB_Temp_Sensor_OverTemp (PCB Temp Sensor OverTemp), 3=Cx3_PCB_Temp_Sensor_Open (PCB Temp Sensor Open)
  compu method CM_APTC_PowerConsumption: phys=raw*0.04 for raw 0..255; unit KW
  compu method CM_APTC_RightCoreTemp: phys=raw-40 for raw 0..255; unit degrees
  compu method CM_BCM_AlarmedRemind: 0=Cx0_No_Warning (No Warning), 1=Cx1_Warning
  compu method CM_BCM_AntiTheftSts: 0=Cx0_DISARMED, 1=Cx1_ARMED, 2=Cx2_ALARM, 3=Cx3_HALF_ARMED
  compu method CM_BCM_AutoCloseWinFunSts: 0=Cx0_No_Active (No Active), 1=Cx1_Active
  compu method CM_BCM_ChrgFlapLockSts: 0=Cx0_Locked, 1=Cx1_Unlocked
  compu method CM_BCM_DomeLampAutoSts: 0=Cx0_Non_auto_set (Non-auto set), 1=Cx1_Door_open_auto_set (Door open auto set), 2=Cx2_Door_close_auto_set (Door close auto set)
  compu method CM_BCM_DomeLampBrightSts: 0=Cx0_100_ (100%), 1=Cx1_50_ (50%)
  compu method CM_BCM_FLSeatBeltRemindReq: 0=Cx0_No_request (No request), 1=Cx1_First_level_reminder (First level reminder), 2=Cx2_Second_level_reminder (Second level reminder), 3=Cx3_Reserved
  compu method CM_BCM_FrontWiperModeSts: 0=Cx0_OFF, 1=Cx1_AUTO, 2=Cx2_Low_speed (Low speed), 3=Cx3_High_speed (High speed), 4=Cx4_Intermittent, 5=Cx5_Reserved
  compu method CM_BCM_FRSeatBeltRemindReq: 0=Cx0_No_request (No request), 1=Cx1_First_level_reminder (First level reminder), 2=Cx2_Second_level_reminder (Second level reminder), 3=Cx3_Reserved
  compu method CM_BCM_GearTimesSts: 0=Cx0_0, 1=Cx1_1, 2=Cx2_2, 3=Cx3_3, 4=Cx4_4, 5=Cx5_5
  compu method CM_BCM_Immo_State: 0=Cx0_Disable_immo (Disable immo), 1=Cx1_Enable_immo (Enable immo)
  compu method CM_BCM_ImmobilizingRemind: 0=Cx0_No_worning (No worning), 1=Cx1_Please_stop (Please stop), 2=Cx2_Immobilizing, 3=Cx3_Reserved
  compu method CM_BCM_KeyNotInCarRemind: 0=Cx0_No_Warning (No Warning), 1=Cx1_Warning
  compu method CM_BCM_PepsPowerMode: 0=Cx0_Default, 1=Cx1_OFF, 2=Cx2_Local_ON (Local ON), 3=Cx3_Reserve, 4=Cx4_Reserve, 5=Cx5_Reserve, 6=Cx6_Reserve, 7=Cx7_Invalid
  compu method CM_BCM_PowerOffDisplayReq: 0=Cx0_No_Request (No Request), 1=Cx1_Req_Power_off (Req_Power off)
  compu method CM_BCM_PuddleLiReq: 0=Cx0_Reserved, 1=Cx1_Off, 2=Cx2_On
  compu method CM_BCM_RLSeatBeltRemindReq: 0=Cx0_No_request (No request), 1=Cx1_First_level_reminder (First level reminder), 2=Cx2_Second_level_reminder (Second level reminder), 3=Cx3_Reserved
  compu method CM_BCM_RRSeatBeltRemindReq: 0=Cx0_No_request (No request), 1=Cx1_First_level_reminder (First level reminder), 2=Cx2_Second_level_reminder (Second level reminder), 3=Cx3_Reserved
  compu method CM_BCM_SecOCFV_272: identical
  compu method CM_BCM_SecOCFV_334: identical
  compu method CM_BCM_SecOCMAC_272: identical
  compu method CM_BCM_SecOCMAC_334: identical
  compu method CM_BCM_WelLightshowOnOffSts: 0=Cx0_Reserved, 1=Cx1_OFF, 2=Cx2_ON
  compu method CM_BCM_WiperServiceSts: 0=Cx0_OFF, 1=Cx1_ON
  compu method CM_BCM_WiperWorkingSts: 0=Cx0_OFF, 1=Cx1_Low_speed (Low speed), 2=Cx2_High_speed (High speed)
  compu method CM_BMS_AbortAchivesetValue: 0=Cx0_Not_reached (Not reached), 1=Cx1_Reached, 2=Cx2_Untrustable
  compu method CM_BMS_AbortAchiveSingleVolt: 0=Cx0_Not_reached (Not reached), 1=Cx1_Reached, 2=Cx2_Untrustable
  compu method CM_BMS_AbortAchiveTotalVolt: 0=Cx0_Not_reached (Not reached), 1=Cx1_Reached, 2=Cx2_Untrustable
  compu method CM_BMS_AbortErrorCurrent: 0=Cx0_Normal, 1=Cx1_Over_current (Over current), 2=Cx2_Untrustable
  compu method CM_BMS_AbortErrorVoltage: 0=Cx0_Normal, 1=Cx1_Abnormal, 2=Cx2_Untrustable
  compu method CM_BMS_AbortFaultBatteryTemp: 0=Cx0_Normal, 1=Cx1_Over_temp (Over temp), 2=Cx2_Untrustable
  compu method CM_BMS_AbortFaultBMSTemp: 0=Cx0_Normal, 1=Cx1_Over_temp (Over temp), 2=Cx2_Untrustable
  compu method CM_BMS_AllowCellTemperature: phys=raw-40 for raw 0..255; unit celsius
  compu method CM_BMS_AllowChagCurrent: phys=raw*0.1-1000 for raw 0..20000; unit A
  compu method CM_BMS_AverageCellTemp: phys=raw-40 for raw 0..255; unit celsius
  compu method CM_BMS_BalanceCommand: 0=Cx0_No_request (No request), 1=Cx1_Request
  compu method CM_BMS_BalancingStatus: 0=Cx0_stop, 1=Cx1_active
  compu method CM_BMS_BatChagSum: identical
  compu method CM_BMS_BatProDatDay: identical
  compu method CM_BMS_BatProDatMonth: identical
  compu method CM_BMS_BatProDatYear: identical
  compu method CM_BMS_BatProRights: 0=Cx0_lease, 1=Cx1_Buy
  compu method CM_BMS_BatSupName: identical
  compu method CM_BMS_BattCurr: phys=raw*0.1-1024 for raw 0..20470; unit A
  compu method CM_BMS_BattVolt: phys=raw*0.1 for raw 0..10000; unit V
  compu method CM_BMS_BatType: 1=Cx01_lead_acid_battery (lead-acid battery), 2=Cx02_Ni_MH_battery (Ni-MH battery), 3=Cx03_Lithium_iron_phosphate_battery (Lithium iron phosphate battery), 4=Cx04_Lithium_manganate_battery (Lithium manganate battery), 5=Cx05_Lithium_cobalt_oxide_battery (Lithium cobalt oxide battery), 6=Cx06_Ternary_material_battery (Ternary material battery), 7=Cx07_Polymer_lithium_ion_battery (Polymer lithium ion battery), 8=Cx08_Lithium_titanate_battery (Lithium titanate battery), 9=Cx09_Reserved, 10=Cx0A_Reserved, 11=Cx0B_Reserved, 12=Cx0C_Reserved, 13=Cx0D_Reserved, 14=Cx0E_Reserved, 15=Cx0F_Reserved, 16=Cx10_Reserved, 17=Cx11_Reserved, 18=Cx12_Reserved, 19=Cx13_Reserved, 20=Cx14_Reserved, 21=Cx15_Reserved, 22=Cx16_Reserved, 23=Cx17_Reserved, 24=Cx18_Reserved, 25=Cx19_Reserved, 26=Cx1A_Reserved, 27=Cx1B_Reserved, 28=Cx1C_Reserved, 29=Cx1D_Reserved, 30=Cx1E_Reserved, 31=Cx1F_Reserved, 32=Cx20_Reserved, 33=Cx21_Reserved, 34=Cx22_Reserved, 35=Cx23_Reserved, 36=Cx24_Reserved, 37=Cx25_Reserved, 38=Cx26_Reserved, 39=Cx27_Reserved, 40=Cx28_Reserved, 41=Cx29_Reserved, 42=Cx2A_Reserved, 43=Cx2B_Reserved, 44=Cx2C_Reserved, 45=Cx2D_Reserved, 46=Cx2E_Reserved, 47=Cx2F_Reserved, 48=Cx30_Reserved, 49=Cx31_Reserved, 50=Cx32_Reserved, 51=Cx33_Reserved, 52=Cx34_Reserved, 53=Cx35_Reserved, 54=Cx36_Reserved, 55=Cx37_Reserved, 56=Cx38_Reserved, 57=Cx39_Reserved, 58=Cx3A_Reserved, 59=Cx3B_Reserved, 60=Cx3C_Reserved, 61=Cx3D_Reserved, 62=Cx3E_Reserved, 63=Cx3F_Reserved, 64=Cx40_Reserved, 65=Cx41_Reserved, 66=Cx42_Reserved, 67=Cx43_Reserved, 68=Cx44_Reserved, 69=Cx45_Reserved, 70=Cx46_Reserved, 71=Cx47_Reserved, 72=Cx48_Reserved, 73=Cx49_Reserved, 74=Cx4A_Reserved, 75=Cx4B_Reserved, 76=Cx4C_Reserved, 77=Cx4D_Reserved, 78=Cx4E_Reserved, 79=Cx4F_Reserved, 80=Cx50_Reserved, 81=Cx51_Reserved, 82=Cx52_Reserved, 83=Cx53_Reserved, 84=Cx54_Reserved, 85=Cx55_Reserved, 86=Cx56_Reserved, 87=Cx57_Reserved, 88=Cx58_Reserved, 89=Cx59_Reserved, 90=Cx5A_Reserved, 91=Cx5B_Reserved, 92=Cx5C_Reserved, 93=Cx5D_Reserved, 94=Cx5E_Reserved, 95=Cx5F_Reserved, 96=Cx60_Reserved, 97=Cx61_Reserved, 98=Cx62_Reserved, 99=Cx63_Reserved, 100=Cx64_Reserved, 101=Cx65_Reserved, 102=Cx66_Reserved, 103=Cx67_Reserved, 104=Cx68_Reserved, 105=Cx69_Reserved, 106=Cx6A_Reserved, 107=Cx6B_Reserved, 108=Cx6C_Reserved, 109=Cx6D_Reserved, 110=Cx6E_Reserved, 111=Cx6F_Reserved, 112=Cx70_Reserved, 113=Cx71_Reserved, 114=Cx72_Reserved, 115=Cx73_Reserved, 116=Cx74_Reserved, 117=Cx75_Reserved, 118=Cx76_Reserved, 119=Cx77_Reserved, 120=Cx78_Reserved, 121=Cx79_Reserved, 122=Cx7A_Reserved, 123=Cx7B_Reserved, 124=Cx7C_Reserved, 125=Cx7D_Reserved, 126=Cx7E_Reserved, 127=Cx7F_Reserved, 128=Cx80_Reserved, 129=Cx81_Reserved, 130=Cx82_Reserved, 131=Cx83_Reserved, 132=Cx84_Reserved, 133=Cx85_Reserved, 134=Cx86_Reserved, 135=Cx87_Reserved, 136=Cx88_Reserved, 137=Cx89_Reserved, 138=Cx8A_Reserved, 139=Cx8B_Reserved, 140=Cx8C_Reserved, 141=Cx8D_Reserved, 142=Cx8E_Reserved, 143=Cx8F_Reserved, 144=Cx90_Reserved, 145=Cx91_Reserved, 146=Cx92_Reserved, 147=Cx93_Reserved, 148=Cx94_Reserved, 149=Cx95_Reserved, 150=Cx96_Reserved, 151=Cx97_Reserved, 152=Cx98_Reserved, 153=Cx99_Reserved, 154=Cx9A_Reserved, 155=Cx9B_Reserved, 156=Cx9C_Reserved, 157=Cx9D_Reserved, 158=Cx9E_Reserved, 159=Cx9F_Reserved, 160=CxA0_Reserved, 161=CxA1_Reserved, 162=CxA2_Reserved, 163=CxA3_Reserved, 164=CxA4_Reserved, 165=CxA5_Reserved, 166=CxA6_Reserved, 167=CxA7_Reserved, 168=CxA8_Reserved, 169=CxA9_Reserved, 170=CxAA_Reserved, 171=CxAB_Reserved, 172=CxAC_Reserved, 173=CxAD_Reserved, 174=CxAE_Reserved, 175=CxAF_Reserved, 176=CxB0_Reserved, 177=CxB1_Reserved, 178=CxB2_Reserved, 179=CxB3_Reserved, 180=CxB4_Reserved, 181=CxB5_Reserved, 182=CxB6_Reserved, 183=CxB7_Reserved, 184=CxB8_Reserved, 185=CxB9_Reserved, 186=CxBA_Reserved, 187=CxBB_Reserved, 188=CxBC_Reserved, 189=CxBD_Reserved, 190=CxBE_Reserved, 191=CxBF_Reserved, 192=CxC0_Reserved, 193=CxC1_Reserved, 194=CxC2_Reserved, 195=CxC3_Reserved, 196=CxC4_Reserved, 197=CxC5_Reserved, 198=CxC6_Reserved, 199=CxC7_Reserved, 200=CxC8_Reserved, 201=CxC9_Reserved, 202=CxCA_Reserved, 203=CxCB_Reserved, 204=CxCC_Reserved, 205=CxCD_Reserved, 206=CxCE_Reserved, 207=CxCF_Reserved, 208=CxD0_Reserved, 209=CxD1_Reserved, 210=CxD2_Reserved, 211=CxD3_Reserved, 212=CxD4_Reserved, 213=CxD5_Reserved, 214=CxD6_Reserved, 215=CxD7_Reserved, 216=CxD8_Reserved, 217=CxD9_Reserved, 218=CxDA_Reserved, 219=CxDB_Reserved, 220=CxDC_Reserved, 221=CxDD_Reserved, 222=CxDE_Reserved, 223=CxDF_Reserved, 224=CxE0_Reserved, 225=CxE1_Reserved, 226=CxE2_Reserved, 227=CxE3_Reserved, 228=CxE4_Reserved, 229=CxE5_Reserved, 230=CxE6_Reserved, 231=CxE7_Reserved, 232=CxE8_Reserved, 233=CxE9_Reserved, 234=CxEA_Reserved, 235=CxEB_Reserved, 236=CxEC_Reserved, 237=CxED_Reserved, 238=CxEE_Reserved, 239=CxEF_Reserved, 240=CxF0_Reserved, 241=CxF1_Reserved, 242=CxF2_Reserved, 243=CxF3_Reserved, 244=CxF4_Reserved, 245=CxF5_Reserved, 246=CxF6_Reserved, 247=CxF7_Reserved, 248=CxF8_Reserved, 249=CxF9_Reserved, 250=CxFA_Reserved, 251=CxFB_Reserved, 252=CxFC_Reserved, 253=CxFD_Reserved, 254=CxFE_Reserved, 255=CxFF_Reserved
  compu method CM_BMS_CellNumbers: identical
  compu method CM_BMS_ChagComplete: 0=Cx0_Normal_Completion (Normal Completion), 1=Cx1_Abnormal_completion (Abnormal completion), 2=Cx2_Untrustable, 3=Cx3_During_Charging (During Charging)
  compu method CM_BMS_ChargeRequest: 0=Cx0_Invalid, 1=Cx1_Heat_Request_only (Heat Request only), 2=Cx2_Heat_And_Charge_Request (Heat And Charge Request), 3=Cx3_Charge_Only (Charge Only), 4=Cx4_Cool_And_Charge_Request (Cool And Charge Request)
  compu method CM_BMS_ChargeStatus: 0=Cx0_Not_charging (Not charging), 1=Cx1_Heat_only (Heat only), 2=Cx2_Charge_and_heat_DC_ (Charge and heat(DC)), 3=Cx3_Charge_and_heat_AC_ (Charge and heat(AC)), 4=Cx4_Charge_only_DC_ (Charge only(DC)), 5=Cx5_Charge_only_AC_ (Charge only(AC)), 6=Cx6_Charge_hold (Charge hold), 7=Cx7_Charge_stop (Charge stop)
  compu method CM_BMS_ComVersion: identical
  compu method CM_BMS_CoolCommand: 0=Cx0_Not_cooling (Not cooling), 1=Cx1_Reserved, 2=Cx2_Charge_and_cool_DC_ (Charge and cool(DC)), 3=Cx3_Charge_and_cool_AC_ (Charge and cool(AC)), 4=Cx4_Running_cool (Running cool), 5=Cx5_Keep_cool (Keep cool), 6=Cx6_Reserved, 7=Cx7_Target_cool (Target cool)
  compu method CM_BMS_DCChgMode: 0=Cx0_Ready, 1=Cx1_Constant_voltage (Constant voltage), 2=Cx2_Constant_current (Constant current)
  compu method CM_BMS_DisChgCurr: phys=raw*0.1-1000 for raw 0..20000; unit A
  compu method CM_BMS_DisplaySOC: phys=raw*0.01 for raw 0..10000; unit percent
  compu method CM_BMS_DTC: identical
  compu method CM_BMS_ErrorBattOverVolt: 0=Cx0_Normal, 1=Cx1_Fault_Level1 (Fault Level1), 2=Cx2_Fault_Level2 (Fault Level2), 3=Cx3_Fault_Level3 (Fault Level3)
  compu method CM_BMS_ErrorBattUnderVolt: 0=Cx0_Normal, 1=Cx1_Fault_Level1 (Fault Level1), 2=Cx2_Fault_Level2 (Fault Level2), 3=Cx3_Fault_Level3 (Fault Level3)
  compu method CM_BMS_ErrorBatVolt: 0=Cx0_Normal, 1=Cx1_Fault_Level1 (Fault Level1), 2=Cx2_Fault_Level2 (Fault Level2), 3=Cx3_Fault_Level3 (Fault Level3)
  compu method CM_BMS_ErrorBSUBalance: 0=Cx0_Normal, 1=Cx1_Fault
  compu method CM_BMS_ErrorBSUOffline: 0=Cx0_Normal, 1=Cx1_Fault
  compu method CM_BMS_ErrorCellHighTemp: 0=Cx0_Normal, 1=Cx1_Fault_Level1 (Fault Level1), 2=Cx2_Fault_Level2 (Fault Level2), 3=Cx3_Fault_Level3 (Fault Level3)
  compu method CM_BMS_ErrorCellLowTemp: 0=Cx0_Normal, 1=Cx1_Fault_Level1 (Fault Level1), 2=Cx2_Fault_Level2 (Fault Level2), 3=Cx3_Fault_Level3 (Fault Level3)
  compu method CM_BMS_ErrorCellOverVolt: 0=Cx0_Normal, 1=Cx1_Fault_Level1 (Fault Level1), 2=Cx2_Fault_Level2 (Fault Level2), 3=Cx3_Fault_Level3 (Fault Level3)
  compu method CM_BMS_ErrorCellTempDiff: 0=Cx0_Normal, 1=Cx1_Fault_Level1 (Fault Level1), 2=Cx2_Fault_Level2 (Fault Level2), 3=Cx3_Fault_Level3 (Fault Level3)
  compu method CM_BMS_ErrorCellTempOffline: 0=Cx0_Normal, 1=Cx1_Fault
  compu method CM_BMS_ErrorCellUnderVolt: 0=Cx0_Normal, 1=Cx1_Fault_Level1 (Fault Level1), 2=Cx2_Fault_Level2 (Fault Level2), 3=Cx3_Fault_Level3 (Fault Level3)
  compu method CM_BMS_ErrorCellVoltDiff: 0=Cx0_Normal, 1=Cx1_Fault_Level1 (Fault Level1), 2=Cx2_Fault_Level2 (Fault Level2), 3=Cx3_Fault_Level3 (Fault Level3)
  compu method CM_BMS_ErrorCellVoltOffline: 0=Cx0_Normal, 1=Cx1_Fault
  compu method CM_BMS_ErrorChaCurrentOver: 0=Cx0_Normal, 1=Cx1_Fault_Level1 (Fault Level1), 2=Cx2_Fault_Level2 (Fault Level2), 3=Cx3_Fault_Level3 (Fault Level3)
  compu method CM_BMS_ErrorDisChaCurrentOver: 0=Cx0_Normal, 1=Cx1_Fault_Level1 (Fault Level1), 2=Cx2_Fault_Level2 (Fault Level2), 3=Cx3_Fault_Level3 (Fault Level3)
  compu method CM_BMS_ErrorEmergencyOffCrash: 0=Cx0_Normal, 1=Cx1_Fault
  compu method CM_BMS_ErrorHallOffline: 0=Cx0_Normal, 1=Cx1_Fault
  compu method CM_BMS_ErrorHighSoc: 0=Cx0_Normal, 1=Cx1_Fault
  compu method CM_BMS_ErrorHVIL: 0=Cx0_Normal, 1=Cx1_Fault
  compu method CM_BMS_ErrorIsolationSingleLow: 0=Cx0_Normal, 1=Cx1_Fault_Level1 (Fault Level1), 2=Cx2_Fault_Level2 (Fault Level2), 3=Cx3_Fault_Level3 (Fault Level3)
  compu method CM_BMS_ErrorLeakCurrent: 0=Cx0_Normal, 1=Cx1_Fault_Level1 (Fault Level1), 2=Cx2_Fault_Level2 (Fault Level2), 3=Cx3_Fault_Level3 (Fault Level3)
  compu method CM_BMS_ErrorLeakDet: 0=Cx0_Normal, 1=Cx1_Fault
  compu method CM_BMS_ErrorLevel: 0=Cx0_Normal, 1=Cx1_level1, 2=Cx2_level2, 3=Cx3_level3, 4=Cx4_level4
  compu method CM_BMS_ErrorLowSoc: 0=Cx0_Normal, 1=Cx1_Fault_Level1 (Fault Level1), 2=Cx2_Fault_Level2 (Fault Level2), 3=Cx3_Fault_Level3 (Fault Level3)
  compu method CM_BMS_ErrorPreChaFailed: 0=Cx0_Normal, 1=Cx1_Fault
  compu method CM_BMS_ErrorRelay: 0=Cx0_Normal, 1=Cx1_Fault
  compu method CM_BMS_ErrorSmoke: 0=Cx0_Normal, 1=Cx1_Fault
  compu method CM_BMS_ErrorSoCJump_RM: 0=Cx0_Normal, 1=Cx1_Fault
  compu method CM_BMS_ErrorSystemsMatch: 0=Cx0_Normal, 1=Cx1_Fault
  compu method CM_BMS_FeedbackCurr: phys=raw*0.1-1000 for raw 0..20000; unit A
  compu method CM_BMS_FlowRate: identical
  compu method CM_BMS_HardVsesion: identical
  compu method CM_BMS_HeatCommand: 0=Cx0_Not_heat (Not heat), 1=Cx1_Preheating, 2=Cx2_Charge_and_heat_DC_ (Charge and heat(DC)), 3=Cx3_Charge_and_heat_AC_ (Charge and heat(AC)), 4=Cx4_Running_heat (Running heat), 5=Cx5_Keep_warm (Keep warm), 6=Cx6_Reserved, 7=Cx7_Target_heat (Target heat)
  compu method CM_BMS_Heatcurrent: phys=raw*0.1-1024 for raw 0..20470; unit A
  compu method CM_BMS_HVinterlockState: 0=Cx0_Normal, 1=Cx1_Fault
  compu method CM_BMS_InsulationDetectionStatus: 0=Cx0_stop_ (stop;), 1=Cx1_active_ (active;)
  compu method CM_BMS_KeepWarmRequest: 0=Cx0_Not_Request (Not Request), 1=Cx1_Request
  compu method CM_BMS_KeepWarmStatus: 0=Cx0_Init, 1=Cx1_OFF, 2=Cx2_ON
  compu method CM_BMS_Life: identical
  compu method CM_BMS_LinkVoltage: phys=raw*0.1 for raw 0..65535; unit V
  compu method CM_BMS_MaxCellTemp: phys=raw-40 for raw 0..255; unit celsius
  compu method CM_BMS_MaxCellTempModuleNO: identical
  compu method CM_BMS_MaxCellTempNO: identical
  compu method CM_BMS_MaxCellVoltage: phys=raw*0.001 for raw 0..65535; unit V
  compu method CM_BMS_MaxCellVoltageModuleNO: identical
  compu method CM_BMS_MaxCellVoltageNO: identical
  compu method CM_BMS_MaxChagVoltage: phys=raw*0.1 for raw 0..65535; unit V
  compu method CM_BMS_MinCellTemp: phys=raw-40 for raw 0..255; unit celsius
  compu method CM_BMS_MinCellTempModuleNO: identical
  compu method CM_BMS_MinCellTempNO: identical
  compu method CM_BMS_MinCellVoltage: phys=raw*0.001 for raw 0..65535; unit V
  compu method CM_BMS_MinCellVoltageModlueNO: identical
  compu method CM_BMS_MinCellVoltageNO: identical
  compu method CM_BMS_NegRelayStatus: 0=Cx0_Reserved, 1=Cx1_Closed, 2=Cx2_Opened, 3=Cx3_Signal_Invalid (Signal Invalid)
  compu method CM_BMS_PackVoltage: phys=raw*0.1 for raw 0..65535; unit V
  compu method CM_BMS_PosRelayStatus: 0=Cx0_Reserved, 1=Cx1_Closed, 2=Cx2_Opened, 3=Cx3_Signal_Invalid (Signal Invalid)
  compu method CM_BMS_PreCharge: 0=Cx0_Not_precharge (Not precharge), 1=Cx1_Precharging, 2=Cx2_Precharge_finished (Precharge finished), 3=Cx3_Precharge_failed (Precharge failed)
  compu method CM_BMS_PreRelayStatus: 0=Cx0_Reserved, 1=Cx1_Closed, 2=Cx2_Opened, 3=Cx3_Signal_Invalid (Signal Invalid)
  compu method CM_BMS_PTC_VoltageValue: identical
  compu method CM_BMS_PTC_WorkStatus: identical
  compu method CM_BMS_PTC_WorkTime: identical
  compu method CM_BMS_PTCRelayStatus: 0=Cx0_Reserved, 1=Cx1_Closed, 2=Cx2_Opened, 3=Cx3_Signal_Invalid (Signal Invalid)
  compu method CM_BMS_RatBatVoltage: phys=raw*0.1 for raw 0..65535; unit V
  compu method CM_BMS_RatCapacity: phys=raw*0.1 for raw 0..65535; unit Ah
  compu method CM_BMS_RatEnergy: phys=raw*0.1 for raw 0..65535; unit KWH
  compu method CM_BMS_RemainCapacity: phys=raw*0.1 for raw 0..65535; unit Ah
  compu method CM_BMS_RemChagTime: identical
  compu method CM_BMS_RTC_Request: 0=Cx0_No_request (No request), 1=Cx1_Request
  compu method CM_BMS_RunHeatStatus: 0=Cx0_Running_heat (Running heat), 1=Cx1_Target_heat (Target heat), 2=Cx2_App_heat (App heat), 3=Cx3_Running_cool (Running cool), 4=Cx4_not_heat_not_cool (not heat not cool)
  compu method CM_BMS_SingChgkwh: identical
  compu method CM_BMS_SOC: phys=raw*0.01 for raw 0..10000; unit percent
  compu method CM_BMS_SoftVsesion: identical
  compu method CM_BMS_SOH: phys=raw*0.5 for raw 0..200; unit percent
  compu method CM_BMS_SumChgkwh: identical
  compu method CM_BMS_SysRegInsulationValue: identical
  compu method CM_BMS_TargetBatteryMaxCellTemp: phys=raw-40 for raw 0..255; unit celsius
  compu method CM_BMS_TempInlet: phys=raw-40 for raw 0..255; unit celsius
  compu method CM_BMS_Tempoutlet: phys=raw-40 for raw 0..255; unit celsius
  compu method CM_BMS_ThermalRunawayFault: 0=Cx0_Normal, 1=Cx1_Fault
  compu method CM_BMS_ThermometerProbes: identical
  compu method CM_BMS_ThrmlRunawayFault: 0=Cx0_Normal, 1=Cx1_Fault
  compu method CM_BMS_WorkMode: 0=Cx0_Initialize, 1=Cx1_Standby, 2=Cx2_Running, 3=Cx3_DC_charge (DC charge), 4=Cx4_AC_charge (AC charge), 5=Cx5_Discharge, 6=Cx6_Error, 7=Cx7_Invalid
  compu method CM_CGW_ADCUSts: 0=Cx0_Sleep, 1=Cx1_Wake_up (Wake up)
  compu method CM_CGW_BCMSts: 0=Cx0_Sleep, 1=Cx1_Wake_up (Wake up)
  compu method CM_CGW_BMSSts: 0=Cx0_Sleep, 1=Cx1_Wake_up (Wake up)
  compu method CM_CGW_CBMSts: 0=Cx0_Sleep, 1=Cx1_Wake_up (Wake up)
  compu method CM_CGW_CGWSts: 0=Cx0_Sleep, 1=Cx1_Wake_up (Wake up)
  compu method CM_CGW_DCM_FLSts: 0=Cx0_Sleep, 1=Cx1_Wake_up (Wake up)
  compu method CM_CGW_DCM_FRSts: 0=Cx0_Sleep, 1=Cx1_Wake_up (Wake up)
  compu method CM_CGW_DCM_RLSts: 0=Cx0_Sleep, 1=Cx1_Wake_up (Wake up)
  compu method CM_CGW_DCM_RRSts: 0=Cx0_Sleep, 1=Cx1_Wake_up (Wake up)
  compu method CM_CGW_HLLSts: 0=Cx0_Sleep, 1=Cx1_Wake_up (Wake up)
  compu method CM_CGW_HLRSts: 0=Cx0_Sleep, 1=Cx1_Wake_up (Wake up)
  compu method CM_CGW_HOD_HeatingSts: 0=Cx0_Sleep, 1=Cx1_Wake_up (Wake up)
  compu method CM_CGW_IVISts: 0=Cx0_Sleep, 1=Cx1_Wake_up (Wake up)
  compu method CM_CGW_MFP_FCSts: 0=Cx0_Sleep, 1=Cx1_Wake_up (Wake up)
  compu method CM_CGW_MFP_RCSts: 0=Cx0_Sleep, 1=Cx1_Wake_up (Wake up)
  compu method CM_CGW_PRNDSts: 0=Cx0_Sleep, 1=Cx1_Wake_up (Wake up)
  compu method CM_CGW_SCU_LSts: 0=Cx0_Sleep, 1=Cx1_Wake_up (Wake up)
  compu method CM_CGW_SCU_RSts: 0=Cx0_Sleep, 1=Cx1_Wake_up (Wake up)
  compu method CM_CGW_SGWSts: 0=Cx0_Sleep, 1=Cx1_Wake_up (Wake up)
  compu method CM_CGW_SwichesSts: 0=Cx0_Sleep, 1=Cx1_Wake_up (Wake up)
  compu method CM_CGW_SWPSts: 0=Cx0_Sleep, 1=Cx1_Wake_up (Wake up)
  compu method CM_CGW_VCUSts: 0=Cx0_Sleep, 1=Cx1_Wake_up (Wake up)
  compu method CM_CGW_VehicleState: 0=Cx0_Fully_sleep (Fully sleep), 1=Cx1_Invisible_awake_CANwakeup (Invisible awake-CANwakeup), 2=Cx2_Reserve, 3=Cx3_Reserve, 4=Cx4_Invisible_awake_OnlyHVon (Invisible awake-OnlyHVon), 5=Cx5_Standby_Normal (Standby-Normal), 6=Cx6_Standby_OnlyLVon (Standby-OnlyLVon), 7=Cx7_Drive_Normal (Drive-Normal), 8=Cx8_Drive_LVFault (Drive-LVFault)
  compu method CM_CGW_VERSION1: 0=Cx00_concept, 1=Cx01_Sample_A (Sample A), 2=Cx02_Sample_B (Sample B), 3=Cx03_Sample_C (Sample C), 4=Cx04_Sample_D (Sample D), 5=Cx05_Sample_SW (Sample SW)
  compu method CM_CGW_VERSION2: identical
  compu method CM_CGW_VIN0: identical
  compu method CM_CGW_VIN1: identical
  compu method CM_CGW_VIN{10..16}: identical
  compu method CM_CGW_VIN{2..9}: identical
  compu method CM_Checksum_098: identical
  compu method CM_Checksum_0BB: identical
  compu method CM_Checksum_0C1: identical
  compu method CM_Checksum_0F9: identical
  compu method CM_Checksum_248: identical
  compu method CM_Checksum_253: identical
  compu method CM_checksum_271: identical
  compu method CM_Checksum_278: identical
  compu method CM_Checksum_28A: identical
  compu method CM_Checksum_33A: identical
  compu method CM_DCM_FL_DoorFLSts: 0=Cx0_Closed, 1=Cx1_Opened
  compu method CM_DCM_FL_FRWndSwA: 0=Cx0_Off_switch (Off switch), 1=Cx1_manually_press_the_window_lift_switch (manually press the window lift switch), 2=Cx2_automatically_press_the_window_lift_switch (automatically press the window lift switch), 3=Cx3_manually_press_the_window_drop_switch (manually press the window drop switch), 4=Cx4_automatically_press_the_window_drop_switch (automatically press the window drop switch), 5=Cx5_Invalid
  compu method CM_DCM_FL_LeftMirrorHorizontalPos: 255=CxFF_Invalid; unit percent  # Source signal range: [0,100]
  compu method CM_DCM_FL_LeftMirrorVerticalPos: 255=CxFF_Invalid; unit percent  # Source signal range: [0,100]
  compu method CM_DCM_FL_MirrorAutoFoldUnfoldSts: 0=Cx0_Disable, 1=Cx1_Enable
  compu method CM_DCM_FL_MirrorAutoTurnDownSts: 0=Cx0_Disable, 1=Cx1_Enable
  compu method CM_DCM_FL_MirrorFold_UnfoldSts: 0=Cx0_Unfold, 1=Cx1_Fold
  compu method CM_DCM_FL_RearmirrorHeatingSts: 0=Cx0_OFF, 1=Cx1_ON
  compu method CM_DCM_FL_RLWndSwA: 0=Cx0_Off_switch (Off switch), 1=Cx1_manually_press_the_window_lift_switch (manually press the window lift switch), 2=Cx2_automatically_press_the_window_lift_switch (automatically press the window lift switch), 3=Cx3_manually_press_the_window_drop_switch (manually press the window drop switch), 4=Cx4_automatically_press_the_window_drop_switch (automatically press the window drop switch), 5=Cx5_Invalid
  compu method CM_DCM_FL_RRWndSwA: 0=Cx0_Off_switch (Off switch), 1=Cx1_manually_press_the_window_lift_switch (manually press the window lift switch), 2=Cx2_automatically_press_the_window_lift_switch (automatically press the window lift switch), 3=Cx3_manually_press_the_window_drop_switch (manually press the window drop switch), 4=Cx4_automatically_press_the_window_drop_switch (automatically press the window drop switch), 5=Cx5_Invalid
  compu method CM_DCM_FR_AmbientTemperature: phys=raw-50 for raw 0..255; unit celsius
  compu method CM_DCM_FR_AmbientTemperatureValid: 0=Cx0_Invalid, 1=Cx1_Valid
  compu method CM_DCM_FR_DoorAntiPinchSts: 0=Cx0_Normal, 1=Cx1_Anti_pinch (Anti pinch)
  compu method CM_DCM_FR_DoorFRAngle: identical
  compu method CM_DCM_FR_DoorFRLockSts: 0=Cx0_Locked, 1=Cx1_Unlocked
  compu method CM_DCM_FR_DoorFRSts: 0=Cx0_Closed, 1=Cx1_Opened
  compu method CM_DCM_FR_DoorObstacleSts: 0=Cx0_Normal, 1=Cx1_Outer_obstacle (Outer obstacle)
  compu method CM_DCM_FR_ElectricDoorMovementSts: 0=Cx0_FullyClosed, 1=Cx1_FullyOpened, 2=Cx2_Opening, 3=Cx3_Closing, 4=Cx4_Stoped, 5=Cx5_Revserved, 6=Cx6_Revserved, 7=Cx7_Revserved
  compu method CM_DCM_FR_FrontDoorAngleFeedback: 0=Cx0_75_ (75Â°), 1=Cx1_35_ (35Â°)
  compu method CM_DCM_FR_FRPESwitchReq: 0=Cx0_Not_pressed (Not pressed), 1=Cx1_Pressed
  compu method CM_DCM_FR_FRWindowLockSts: 0=Cx0_LOCK, 1=Cx1_UNLOCK
  compu method CM_DCM_FR_GLASS_LOCATION: 0=Cx00_0_ (0%), 1=Cx01_5_ (5%), 2=Cx02_10_ (10%), 3=Cx03_15_ (15%), 4=Cx04_20_ (20%), 5=Cx05_25_ (25%), 6=Cx06_30_ (30%), 7=Cx07_35_ (35%), 8=Cx08_40_ (40%), 9=Cx09_45_ (45%), 10=Cx0A_50_ (50%), 11=Cx0B_55_ (55%), 12=Cx0C_60_ (60%), 13=Cx0D_65_ (65%), 14=Cx0E_70_ (70%), 15=Cx0F_75_ (75%), 16=Cx10_80_ (80%), 17=Cx11_85_ (85%), 18=Cx12_90_ (90%), 19=Cx13_95_ (95%), 20=Cx14_100_ (100%)
  compu method CM_DCM_FR_InsideSwitchReq: 0=Cx0_Not_pressed (Not pressed), 1=Cx1_Pressed
  compu method CM_DCM_FR_LinkageAvoidanceReq: 0=Cx0_NO_Request (NO Request), 1=Cx1_Close, 2=Cx2_Open, 3=Cx3_Stop
  compu method CM_DCM_FR_MirrorAutoFoldUnfoldSts: 0=Cx0_Disable, 1=Cx1_Enable
  compu method CM_DCM_FR_MirrorAutoTurnDownSts: 0=Cx0_Disable, 1=Cx1_Enable
  compu method CM_DCM_FR_MirrorFold_UnfoldSts: 0=Cx0_Unfold, 1=Cx1_Fold
  compu method CM_DCM_FR_PWM_POS_STS: 0=Cx0_Bottom_stall (Bottom stall), 1=Cx1_No_stall (No stall), 2=Cx2_Top_stall (Top stall), 3=Cx3_Top_soft_stop (Top soft stop), 4=Cx4_Bottom_soft_stop (Bottom soft stop)
  compu method CM_DCM_FR_RearmirrorHeatingSts: 0=Cx0_OFF, 1=Cx1_ON
  compu method CM_DCM_FR_RightMirrorHorizontalPos: 255=CxFF_Invalid; unit percent  # Source signal range: [0,100]
  compu method CM_DCM_FR_RightMirrorVerticalPos: 255=CxFF_Invalid; unit percent  # Source signal range: [0,100]
  compu method CM_DCM_FR_WindowSts: 0=Cx0_Stopped, 1=Cx1_Auto_Up_moving (Auto Up moving), 2=Cx2_Manual_Up_moving (Manual Up moving), 3=Cx3_Auto_Down_moving (Auto Down moving), 4=Cx4_Manual_Down_moving (Manual Down moving), 5=Cx5_Pinch_Reversing (Pinch Reversing)
  compu method CM_DCM_RL_DoorAntiPinchSts: 0=Cx0_Normal, 1=Cx1_Anti_pinch (Anti pinch)
  compu method CM_DCM_RL_DoorObstacleSts: 0=Cx0_Normal, 1=Cx1_Outer_obstacle (Outer obstacle)
  compu method CM_DCM_RL_DoorRLAngle: identical
  compu method CM_DCM_RL_DoorRLLockSts: 0=Cx0_Locked, 1=Cx1_Unlocked
  compu method CM_DCM_RL_DoorRLSts: 0=Cx0_Closed, 1=Cx1_Opened
  compu method CM_DCM_RL_ElectricDoorMovementSts: 0=Cx0_FullyClosed, 1=Cx1_FullyOpened, 2=Cx2_Opening, 3=Cx3_Closing, 4=Cx4_Stoped, 5=Cx5_Revserved, 6=Cx6_Revserved, 7=Cx7_Revserved
  compu method CM_DCM_RL_GLASS_LOCATION: 0=Cx00_0_ (0%), 1=Cx01_5_ (5%), 2=Cx02_10_ (10%), 3=Cx03_15_ (15%), 4=Cx04_20_ (20%), 5=Cx05_25_ (25%), 6=Cx06_30_ (30%), 7=Cx07_35_ (35%), 8=Cx08_40_ (40%), 9=Cx09_45_ (45%), 10=Cx0A_50_ (50%), 11=Cx0B_55_ (55%), 12=Cx0C_60_ (60%), 13=Cx0D_65_ (65%), 14=Cx0E_70_ (70%), 15=Cx0F_75_ (75%), 16=Cx10_80_ (80%), 17=Cx11_85_ (85%), 18=Cx12_90_ (90%), 19=Cx13_95_ (95%), 20=Cx14_100_ (100%)
  compu method CM_DCM_RL_InsideSwitchReq: 0=Cx0_Not_pressed (Not pressed), 1=Cx1_Pressed
  compu method CM_DCM_RL_LinkageAvoidanceReq: 0=Cx0_NO_Request (NO Request), 1=Cx1_Close, 2=Cx2_Open, 3=Cx3_Stop
  compu method CM_DCM_RL_PWM_POS_STS: 0=Cx0_Bottom_stall (Bottom stall), 1=Cx1_No_stall (No stall), 2=Cx2_Top_stall (Top stall), 3=Cx3_Top_soft_stop (Top soft stop), 4=Cx4_Bottom_soft_stop (Bottom soft stop)
  compu method CM_DCM_RL_RearDoorAngleFeedback: 0=Cx0_75_ (75Â°), 1=Cx1_35_ (35Â°)
  compu method CM_DCM_RL_RLPESwitchReq: 0=Cx0_Not_pressed (Not pressed), 1=Cx1_Pressed
  compu method CM_DCM_RL_RLWindowLockSts: 0=Cx0_LOCK, 1=Cx1_UNLOCK
  compu method CM_DCM_RL_WindowSts: 0=Cx0_stopped, 1=Cx1_Auto_Up_moving (Auto Up moving), 2=Cx2_Manual_Up_moving (Manual Up moving), 3=Cx3_Auto_Down_moving (Auto Down moving), 4=Cx4_Manual_Down_moving (Manual Down moving), 5=Cx5_Pinch_Reversing (Pinch Reversing)
  compu method CM_DCM_RR_DoorAntiPinchSts: 0=Cx0_Normal, 1=Cx1_Anti_pinch (Anti pinch)
  compu method CM_DCM_RR_DoorObstacleSts: 0=Cx0_Normal, 1=Cx1_Outer_obstacle (Outer obstacle)
  compu method CM_DCM_RR_DoorRRAngle: identical
  compu method CM_DCM_RR_DoorRRLockSts: 0=Cx0_Locked, 1=Cx1_Unlocked
  compu method CM_DCM_RR_DoorRRSts: 0=Cx0_Closed, 1=Cx1_Opened
  compu method CM_DCM_RR_ElectricDoorMovementSts: 0=Cx0_FullyClosed, 1=Cx1_FullyOpened, 2=Cx2_Opening, 3=Cx3_Closing, 4=Cx4_Stoped, 5=Cx5_Revserved, 6=Cx6_Revserved, 7=Cx7_Revserved
  compu method CM_DCM_RR_GLASS_LOCATION: 0=Cx00_0_ (0%), 1=Cx01_5_ (5%), 2=Cx02_10_ (10%), 3=Cx03_15_ (15%), 4=Cx04_20_ (20%), 5=Cx05_25_ (25%), 6=Cx06_30_ (30%), 7=Cx07_35_ (35%), 8=Cx08_40_ (40%), 9=Cx09_45_ (45%), 10=Cx0A_50_ (50%), 11=Cx0B_55_ (55%), 12=Cx0C_60_ (60%), 13=Cx0D_65_ (65%), 14=Cx0E_70_ (70%), 15=Cx0F_75_ (75%), 16=Cx10_80_ (80%), 17=Cx11_85_ (85%), 18=Cx12_90_ (90%), 19=Cx13_95_ (95%), 20=Cx14_100_ (100%)
  compu method CM_DCM_RR_InsideSwitchReq: 0=Cx0_Not_pressed (Not pressed), 1=Cx1_Pressed
  compu method CM_DCM_RR_LinkageAvoidanceReq: 0=Cx0_NO_Request (NO Request), 1=Cx1_Close, 2=Cx2_Open, 3=Cx3_Stop
  compu method CM_DCM_RR_PWM_POS_STS: 0=Cx0_Bottom_stall (Bottom stall), 1=Cx1_No_stall (No stall), 2=Cx2_Top_stall (Top stall), 3=Cx3_Top_soft_stop (Top soft stop), 4=Cx4_Bottom_soft_stop (Bottom soft stop)
  compu method CM_DCM_RR_RearDoorAngleFeedback: 0=Cx0_75_ (75Â°), 1=Cx1_35_ (35Â°)
  compu method CM_DCM_RR_RRPESwitchReq: 0=Cx0_Not_pressed (Not pressed), 1=Cx1_Pressed
  compu method CM_DCM_RR_RRWindowLockSts: 0=Cx0_LOCK, 1=Cx1_UNLOCK
  compu method CM_DCM_RR_WindowSts: 0=Cx0_stopped, 1=Cx1_Auto_Up_moving (Auto Up moving), 2=Cx2_Manual_Up_moving (Manual Up moving), 3=Cx3_Auto_Down_moving (Auto Down moving), 4=Cx4_Manual_Down_moving (Manual Down moving), 5=Cx5_Pinch_Reversing (Pinch Reversing)
  compu method CM_EVCOM_ActlOprtMode: 0=Cx0_off, 1=Cx1_running, 2=Cx2_limit, 3=Cx3_pre_heat, 4=Cx4_fault, 5=Cx5_reserved, 6=Cx6_reserved, 7=Cx7_reserved
  compu method CM_EVCOM_CommunicationError: 0=Cx0_No_Error (No Error), 1=Cx1_Error
  compu method CM_EVCOM_CompActlCnsmpCur: phys=raw*0.2 for raw 0..255; unit A
  compu method CM_EVCOM_CompActlPwrCnsmp: phys=raw*0.04 for raw 0..255; unit KW
  compu method CM_EVCOM_CompActlSpd: identical
  compu method CM_EVCOM_CompDeviceInternTemp: phys=raw-40 for raw 0..255; unit celsius
  compu method CM_EVCOM_OverCurDropFreqError: 0=Cx0_No_Error (No Error), 1=Cx1_Error
  compu method CM_EVCOM_OverCurrentError: 0=Cx0_No_Error (No Error), 1=Cx1_Error
  compu method CM_EVCOM_OverPwrDropFreqError: 0=Cx0_No_Error (No Error), 1=Cx1_Error
  compu method CM_EVCOM_OverVoltageError: 0=Cx0_No_Error (No Error), 1=Cx1_Error
  compu method CM_EVCOM_StandByOverVolError: 0=Cx0_No_Error (No Error), 1=Cx1_Error
  compu method CM_EVCOM_StandByUnderVolError: 0=Cx0_No_Error (No Error), 1=Cx1_Error
  compu method CM_EVCOM_UnderVoltageError: 0=Cx0_No_Error (No Error), 1=Cx1_Error
  compu method CM_IBS_SUBEPBControllerSts: 0=Cx0_MasterMode, 1=Cx1_SlaveMode
  compu method CM_IBS_SUBEPBFailureStatus: 0=Cx0_No_error (No error), 1=Cx1_error, 2=Cx2_Reserve, 3=Cx3_Reserve
  compu method CM_IBS_SUBEPBworkingSts: 0=Cx0_UNKNOWN, 1=Cx1_APPLIED, 2=Cx2_RELEASED, 3=Cx3_APPLY_IN_PROGRESS (APPLY IN PROGRESS), 4=Cx4_RELEASE_IN_PROGRESS (RELEASE IN PROGRESS), 5=Cx5_COMPLETELY_RELEASED (COMPLETELY RELEASED), 6=Cx6_DYNAMIC_APPLY (DYNAMIC APPLY), 7=Cx7_RESERVED
  compu method CM_IVI_AppointChargeCmd: 0=Cx0_No_Request (No Request), 1=Cx1_Charge_ON (Charge ON), 2=Cx2_Charge_OFF (Charge OFF)
  compu method CM_IVI_AVHSet: 0=Cx0_No_Request (No Request), 1=Cx1_OFF, 2=Cx2_ON, 3=Cx3_RESERVED
  compu method CM_IVI_BrakeCompensateCmd: 0=Cx0_NO_Request (NO Request), 1=Cx1_OFF, 2=Cx2_ON, 3=Cx3_Reserved
  compu method CM_IVI_BulbCheckSts: 0=Cx0_Not_BulbCheck (Not BulbCheck), 1=Cx1_BulbCheck
  compu method CM_IVI_CRLevelSet: 0=Cx0_No_request (No request), 1=Cx1_OFF, 2=Cx2_Primary_energy_recovery_weak_ (Primary energy recovery (weak)), 3=Cx3_Secondary_energy_recovery_medium_ (Secondary energy recovery(medium)), 4=Cx4_Tertiary_energy_recovery_strong_ (Tertiary energy recovery (strong)), 5=Cx5_Reserved, 6=Cx6_Reserved, 7=Cx7_Reserved
  compu method CM_IVI_DriveModeSet: 0=Cx0_No_Request (No Request), 1=Cx1_ECO, 2=Cx2_NORMAL, 3=Cx3_SPORT, 4=Cx4_OnePedal
  compu method CM_IVI_DschrgOnOffSet: 0=Cx0_No_Request (No Request), 1=Cx1_OFF, 2=Cx2_ON, 3=Cx3_Reserved
  compu method CM_IVI_ESCOffSet: 0=Cx0_NO_Request (NO Request), 1=Cx1_OFF, 2=Cx2_ON, 3=Cx3_Reserved
  compu method CM_IVI_ForwardVmaxAllowed: 0=Cx00_No_request (No request), 1=Cx01_1_170 (1- 170), 2=Cx02_1_170 (1- 170), 3=Cx03_1_170 (1- 170), 4=Cx04_1_170 (1- 170), 5=Cx05_1_170 (1- 170), 6=Cx06_1_170 (1- 170), 7=Cx07_1_170 (1- 170), 8=Cx08_1_170 (1- 170), 9=Cx09_1_170 (1- 170), 10=Cx0A_1_170 (1- 170), 11=Cx0B_1_170 (1- 170), 12=Cx0C_1_170 (1- 170), 13=Cx0D_1_170 (1- 170), 14=Cx0E_1_170 (1- 170), 15=Cx0F_1_170 (1- 170), 16=Cx10_1_170 (1- 170), 17=Cx11_1_170 (1- 170), 18=Cx12_1_170 (1- 170), 19=Cx13_1_170 (1- 170), 20=Cx14_1_170 (1- 170), 21=Cx15_1_170 (1- 170), 22=Cx16_1_170 (1- 170), 23=Cx17_1_170 (1- 170), 24=Cx18_1_170 (1- 170), 25=Cx19_1_170 (1- 170), 26=Cx1A_1_170 (1- 170), 27=Cx1B_1_170 (1- 170), 28=Cx1C_1_170 (1- 170), 29=Cx1D_1_170 (1- 170), 30=Cx1E_1_170 (1- 170), 31=Cx1F_1_170 (1- 170), 32=Cx20_1_170 (1- 170), 33=Cx21_1_170 (1- 170), 34=Cx22_1_170 (1- 170), 35=Cx23_1_170 (1- 170), 36=Cx24_1_170 (1- 170), 37=Cx25_1_170 (1- 170), 38=Cx26_1_170 (1- 170), 39=Cx27_1_170 (1- 170), 40=Cx28_1_170 (1- 170), 41=Cx29_1_170 (1- 170), 42=Cx2A_1_170 (1- 170), 43=Cx2B_1_170 (1- 170), 44=Cx2C_1_170 (1- 170), 45=Cx2D_1_170 (1- 170), 46=Cx2E_1_170 (1- 170), 47=Cx2F_1_170 (1- 170), 48=Cx30_1_170 (1- 170), 49=Cx31_1_170 (1- 170), 50=Cx32_1_170 (1- 170), 51=Cx33_1_170 (1- 170), 52=Cx34_1_170 (1- 170), 53=Cx35_1_170 (1- 170), 54=Cx36_1_170 (1- 170), 55=Cx37_1_170 (1- 170), 56=Cx38_1_170 (1- 170), 57=Cx39_1_170 (1- 170), 58=Cx3A_1_170 (1- 170), 59=Cx3B_1_170 (1- 170), 60=Cx3C_1_170 (1- 170), 61=Cx3D_1_170 (1- 170), 62=Cx3E_1_170 (1- 170), 63=Cx3F_1_170 (1- 170), 64=Cx40_1_170 (1- 170), 65=Cx41_1_170 (1- 170), 66=Cx42_1_170 (1- 170), 67=Cx43_1_170 (1- 170), 68=Cx44_1_170 (1- 170), 69=Cx45_1_170 (1- 170), 70=Cx46_1_170 (1- 170), 71=Cx47_1_170 (1- 170), 72=Cx48_1_170 (1- 170), 73=Cx49_1_170 (1- 170), 74=Cx4A_1_170 (1- 170), 75=Cx4B_1_170 (1- 170), 76=Cx4C_1_170 (1- 170), 77=Cx4D_1_170 (1- 170), 78=Cx4E_1_170 (1- 170), 79=Cx4F_1_170 (1- 170), 80=Cx50_1_170 (1- 170), 81=Cx51_1_170 (1- 170), 82=Cx52_1_170 (1- 170), 83=Cx53_1_170 (1- 170), 84=Cx54_1_170 (1- 170), 85=Cx55_1_170 (1- 170), 86=Cx56_1_170 (1- 170), 87=Cx57_1_170 (1- 170), 88=Cx58_1_170 (1- 170), 89=Cx59_1_170 (1- 170), 90=Cx5A_1_170 (1- 170), 91=Cx5B_1_170 (1- 170), 92=Cx5C_1_170 (1- 170), 93=Cx5D_1_170 (1- 170), 94=Cx5E_1_170 (1- 170), 95=Cx5F_1_170 (1- 170), 96=Cx60_1_170 (1- 170), 97=Cx61_1_170 (1- 170), 98=Cx62_1_170 (1- 170), 99=Cx63_1_170 (1- 170), 100=Cx64_1_170 (1- 170), 101=Cx65_1_170 (1- 170), 102=Cx66_1_170 (1- 170), 103=Cx67_1_170 (1- 170), 104=Cx68_1_170 (1- 170), 105=Cx69_1_170 (1- 170), 106=Cx6A_1_170 (1- 170), 107=Cx6B_1_170 (1- 170), 108=Cx6C_1_170 (1- 170), 109=Cx6D_1_170 (1- 170), 110=Cx6E_1_170 (1- 170), 111=Cx6F_1_170 (1- 170), 112=Cx70_1_170 (1- 170), 113=Cx71_1_170 (1- 170), 114=Cx72_1_170 (1- 170), 115=Cx73_1_170 (1- 170), 116=Cx74_1_170 (1- 170), 117=Cx75_1_170 (1- 170), 118=Cx76_1_170 (1- 170), 119=Cx77_1_170 (1- 170), 120=Cx78_1_170 (1- 170), 121=Cx79_1_170 (1- 170), 122=Cx7A_1_170 (1- 170), 123=Cx7B_1_170 (1- 170), 124=Cx7C_1_170 (1- 170), 125=Cx7D_1_170 (1- 170), 126=Cx7E_1_170 (1- 170), 127=Cx7F_1_170 (1- 170), 128=Cx80_1_170 (1- 170), 129=Cx81_1_170 (1- 170), 130=Cx82_1_170 (1- 170), 131=Cx83_1_170 (1- 170), 132=Cx84_1_170 (1- 170), 133=Cx85_1_170 (1- 170), 134=Cx86_1_170 (1- 170), 135=Cx87_1_170 (1- 170), 136=Cx88_1_170 (1- 170), 137=Cx89_1_170 (1- 170), 138=Cx8A_1_170 (1- 170), 139=Cx8B_1_170 (1- 170), 140=Cx8C_1_170 (1- 170), 141=Cx8D_1_170 (1- 170), 142=Cx8E_1_170 (1- 170), 143=Cx8F_1_170 (1- 170), 144=Cx90_1_170 (1- 170), 145=Cx91_1_170 (1- 170), 146=Cx92_1_170 (1- 170), 147=Cx93_1_170 (1- 170), 148=Cx94_1_170 (1- 170), 149=Cx95_1_170 (1- 170), 150=Cx96_1_170 (1- 170), 151=Cx97_1_170 (1- 170), 152=Cx98_1_170 (1- 170), 153=Cx99_1_170 (1- 170), 154=Cx9A_1_170 (1- 170), 155=Cx9B_1_170 (1- 170), 156=Cx9C_1_170 (1- 170), 157=Cx9D_1_170 (1- 170), 158=Cx9E_1_170 (1- 170), 159=Cx9F_1_170 (1- 170), 160=CxA0_1_170 (1- 170), 161=CxA1_1_170 (1- 170), 162=CxA2_1_170 (1- 170), 163=CxA3_1_170 (1- 170), 164=CxA4_1_170 (1- 170), 165=CxA5_1_170 (1- 170), 166=CxA6_1_170 (1- 170), 167=CxA7_1_170 (1- 170), 168=CxA8_1_170 (1- 170), 169=CxA9_1_170 (1- 170), 170=CxAA_1_170 (1- 170)
  compu method CM_IVI_ForwardVmaxlimitSw: 0=Cx0_No_Request (No Request), 1=Cx1_OFF, 2=Cx2_ON, 3=Cx3_Reserved
  compu method CM_IVI_GearRequest: 0=Cx0_NO_request (NO request), 1=Cx1_P, 2=Cx2_N, 3=Cx3_R, 4=Cx4_D, 5=Cx5_Invaild
  compu method CM_IVI_HDCOffSet: 0=Cx0_No_Request (No Request), 1=Cx1_OFF, 2=Cx2_ON, 3=Cx3_RESERVED
  compu method CM_IVI_KeepWarmRequest: 0=Cx0_No_request (No request), 1=Cx1_OFF, 2=Cx2_ON
  compu method CM_IVI_LockACPlug: 0=Cx0_No_request (No request), 1=Cx1_UnLock, 2=Cx2_Lock
  compu method CM_IVI_LV_LimitPop: 0=Cx0_No_request (No request), 1=Cx1_Cancel, 2=Cx2_Open
  compu method CM_IVI_MaxChrgSocSet: 254=CxFE_No_Request (No Request), 255=CxFF_Invalid; unit percent  # Source signal range: [0,100]
  compu method CM_IVI_MirrorInterfaceMode: 0=Cx0_Normal, 1=Cx1_Tilt
  compu method CM_IVI_OdometerInfor: phys=raw*0.1 for raw 0..9999999; unit km
  compu method CM_IVI_OdometerInforValid: 0=Cx0_Invalid, 1=Cx1_Valid
  compu method CM_IVI_SFIabnormalSts: 0=Cx0_Normal, 1=Cx1_Abnormal
  compu method CM_IVI_SFIDippedBeamSet: 0=Cx0_NO_Request (NO Request), 1=Cx1_On, 2=Cx2_Reserved, 3=Cx3_Reserved
  compu method CM_IVI_SteeringModeSet: 0=Cx0_No_Request (No Request), 1=Cx1_Normal, 2=Cx2_Sport, 3=Cx3_Comfort
  compu method CM_IVI_TPMS_Reset: 0=Cx0_No_request (No request), 1=Cx1_Active
  compu method CM_IVI_V2LidisSet: 254=CxFE_No_Request (No Request), 255=CxFF_Invalid; unit percent  # Source signal range: [0,100]
  compu method CM_IVI_VrState: 0=Cx0_Inactive, 1=Cx1_Active
  compu method CM_IVI_WCBSReminderSet: 0=Cx0_Forbidden_State (Forbidden State), 1=Cx1_Enabled_State (Enabled State)
  compu method CM_MCU_ActTrqValid: 0=Cx0_Invalid, 1=Cx1_Valid
  compu method CM_MCU_ActualSpeed: 65535=CxFFFF_Invalid, phys=raw-32767 for raw 0..65534  # Source signal range: [0,65534]
  compu method CM_MCU_ActualSpeedValid: 0=Cx0_Invalid, 1=Cx1_Valid
  compu method CM_MCU_ActualTorque: 2047=Cx7FF_Invalid, phys=raw-1023 for raw 0..2046  # Source signal range: [0,2046]
  compu method CM_MCU_ActUnfilteredRotSpd: phys=raw-32767 for raw 0..65534
  compu method CM_MCU_BDmpCActv: 0=Cx0_Damping_Off (Damping Off), 1=Cx1_Damping_On (Damping On)
  compu method CM_MCU_DmpCTrqCurr: phys=raw*0.2-25 for raw 0..250
  compu method CM_MCU_FaultLevel: 0=Cx0_Normal, 1=Cx1_LV1_Minor_fault (LV1 Minor fault), 2=Cx2_LV2_Limited_power_by_a_small_margin (LV2 Limited power by a small margin), 3=Cx3_LV3_Greatly_limited_power (LV3 Greatly limited power), 4=Cx4_LV4_Stop_the_output_Fault_enable_recovery_ (LV4 Stop the output(Fault enable recovery)), 5=Cx5_LV5_Stop_the_output_Fault_disable_recovery_ (LV5 Stop the output(Fault disable recovery))
  compu method CM_MCU_IGBTTempMax: 254=CxFE_Abnormal, 255=CxFF_Invalid, phys=raw-50 for raw 0..250  # Source signal range: [0,250]
  compu method CM_MCU_IGBTTempRiseMax: 254=CxFE_Abnormal, 255=CxFF_Invalid  # Source signal range: [0,200]
  compu method CM_MCU_IGBTTempRiseU: 254=CxFE_Abnormal, 255=CxFF_Invalid  # Source signal range: [0,200]
  compu method CM_MCU_IGBTTempRiseV: 254=CxFE_Abnormal, 255=CxFF_Invalid  # Source signal range: [0,200]
  compu method CM_MCU_IGBTTempRiseW: 254=CxFE_Abnormal, 255=CxFF_Invalid  # Source signal range: [0,200]
  compu method CM_MCU_IGBTTempU: 254=CxFE_Abnormal, 255=CxFF_Invalid, phys=raw-50 for raw 0..250  # Source signal range: [0,250]
  compu method CM_MCU_IGBTTempV: 254=CxFE_Abnormal, 255=CxFF_Invalid, phys=raw-50 for raw 0..250  # Source signal range: [0,250]
  compu method CM_MCU_IGBTTempW: 254=CxFE_Abnormal, 255=CxFF_Invalid, phys=raw-50 for raw 0..250  # Source signal range: [0,250]
  compu method CM_MCU_IsCurr: 2047=Cx7FF_Invalid, phys=raw-1023 for raw 0..2046  # Source signal range: [0,2046]
  compu method CM_MCU_Isd: phys=raw*0.5-1023.5 for raw 0..4093
  compu method CM_MCU_Isq: phys=raw*0.5-1023.5 for raw 0..4093
  compu method CM_MCU_OfsAl: phys=raw*0.0878906 for raw 0..4092
  compu method CM_MCU_SpdMaxLimit: phys=raw-32767 for raw 0..65534
  compu method CM_MCU_StDischg: 0=Cx0_Standby, 1=Cx1_Active, 2=Cx2_Finished, 3=Cx3_Failed
  compu method CM_MCU_StGateDrv: 0=Cx0_ShortCircuit, 1=Cx1_FreeWheel, 2=Cx2_PWMrun, 3=Cx3_Invalid
  compu method CM_MCU_TempCurrCool: 254=CxFE_Abnormal, 255=CxFF_Invalid, phys=raw-50 for raw 0..250  # Source signal range: [0,250]
  compu method CM_MCU_TempCurrStr1: 254=CxFE_Abnormal, 255=CxFF_Invalid, phys=raw-50 for raw 0..250  # Source signal range: [0,250]
  compu method CM_MCU_TempCurrStr2: 254=CxFE_Abnormal, 255=CxFF_Invalid, phys=raw-50 for raw 0..250  # Source signal range: [0,250]
  compu method CM_MCU_TempCurrStrMax: 254=CxFE_Abnormal, 255=CxFF_Invalid, phys=raw-50 for raw 0..250  # Source signal range: [0,250]
  compu method CM_MCU_TempRiseCurrStr: 254=CxFE_Abnormal, 255=CxFF_Invalid  # Source signal range: [0,250]
  compu method CM_MCU_TempStatus: 0=Cx0_Normal_Temperature (Normal Temperature), 1=Cx1_Heating_alarm_1 (Heating alarm 1), 2=Cx2_Heating_alarm_2 (Heating alarm 2), 3=Cx3_Over_Heating (Over Heating)
  compu method CM_MCU_TrqAbsMax: phys=raw-1023 for raw 0..2046
  compu method CM_MCU_TrqAbsMin: phys=raw-1023 for raw 0..2046
  compu method CM_MCU_UdcCurr: 1022=Cx3FE_Abnormal, 1023=Cx3FF_Invalid  # Source signal range: [0,1021]
  compu method CM_MCU_UT15State: 0=Cx0_No_active (No active), 1=Cx1_Active
  compu method CM_MCU_UT30Curr: phys=raw*0.5 for raw 0..62; unit V
  compu method CM_MCU_VCUWorkMode: 0=Cx0_Initialization_ (Initialization;), 1=Cx1_Standby_ (Standby;), 2=Cx2_Ready_ (Ready;), 3=Cx3_Torque_Control_ (Torque Control;), 4=Cx4_Fault, 5=Cx5_ActiveDischarge_ (ActiveDischarge;), 6=Cx6_Afterrun_ (Afterrun;), 7=Cx7_Motor_Active_Hearting_ (Motor Active Hearting;), 8=Cx8_Speed_Control (Speed Control)
  compu method CM_MessageCounter_098: 15=CxF_Invalid
  compu method CM_MessageCounter_0BB: 15=CxF_Invalid
  compu method CM_MessageCounter_0C1: 15=CxF_Invalid
  compu method CM_MessageCounter_0F9: identical
  compu method CM_MessageCounter_248: 15=CxF_Invalid
  compu method CM_MessageCounter_253: 15=CxF_Invalid
  compu method CM_MessageCounter_271: 15=CxF_Invalid
  compu method CM_MessageCounter_278: 15=CxF_Invalid
  compu method CM_MessageCounter_28A: 15=CxF_Invalid
  compu method CM_MessageCounter_33A: 15=CxF_Invalid
  compu method CM_OBC_OutputIsolatedFault: 0=Cx0_No_Fault (No Fault), 1=Cx1_Fault
  compu method CM_POD_CANBusoff: 0=Cx0_No_Fault (No Fault), 1=Cx1_Fault
  compu method CM_POD_DCDC_CommunFault: 0=Cx0_No_Fault (No Fault), 1=Cx1_Fault
  compu method CM_POD_DCDC_FaultLevel: 0=Cx0_No_Fault (No Fault), 1=Cx1_Fault_Level1 (Fault Level1), 2=Cx2_Fault_Level2 (Fault Level2), 3=Cx3_Fault_Level3 (Fault Level3)
  compu method CM_POD_DCDC_HVInputCurrent: phys=raw*0.1 for raw 0..255; unit A
  compu method CM_POD_DCDC_HVinputshortcircuit: 0=Cx0_No_Fault (No Fault), 1=Cx1_Fault
  compu method CM_POD_DCDC_HVInputVoltage: phys=raw*0.1 for raw 0..8000; unit V
  compu method CM_POD_DCDC_InputVoltHighFault: 0=Cx0_No_Fault (No Fault), 1=Cx1_Fault
  compu method CM_POD_DCDC_InputVoltLowFault: 0=Cx0_No_Fault (No Fault), 1=Cx1_Fault
  compu method CM_POD_DCDC_InternalFault: 0=Cx0_No_Fault (No Fault), 1=Cx1_Fault
  compu method CM_POD_DCDC_LVOutputCurrent: phys=raw*0.1 for raw 0..4000; unit A
  compu method CM_POD_DCDC_LVoutputshortcircuit: 0=Cx0_No_Fault (No Fault), 1=Cx1_Fault
  compu method CM_POD_DCDC_LVOutputVoltage: phys=raw*0.1 for raw 0..255; unit V
  compu method CM_POD_DCDC_Maxoutputpower: phys=raw*0.02 for raw 0..255; unit kW
  compu method CM_POD_DCDC_OutCurSensorFault: 0=Cx0_No_Fault (No Fault), 1=Cx1_Fault
  compu method CM_POD_DCDC_OutputCurrentHighFault: 0=Cx0_No_Fault (No Fault), 1=Cx1_Fault
  compu method CM_POD_DCDC_Outputopencircuiterror: 0=Cx0_No_Fault (No Fault), 1=Cx1_Fault
  compu method CM_POD_DCDC_OutputTempSensorFault: 0=Cx0_No_Fault (No Fault), 1=Cx1_Fault
  compu method CM_POD_DCDC_OutputVoltHighFault: 0=Cx0_No_Fault (No Fault), 1=Cx1_Fault
  compu method CM_POD_DCDC_OutputVoltLowFault: 0=Cx0_No_Fault (No Fault), 1=Cx1_Fault
  compu method CM_POD_DCDC_SecondarySideTemp: phys=raw-40 for raw 0..255; unit celsius
  compu method CM_POD_DCDC_Side2Overtempfault: 0=Cx0_No_Fault (No Fault), 1=Cx1_Fault
  compu method CM_POD_DCDC_WorkMode: 0=Cx0_Init, 1=Cx1_Standby, 2=Cx2_Buck, 3=Cx3_Fault, 4=Cx4_sleep
  compu method CM_POD_DCFCVoltage: phys=raw*0.1 for raw 0..8190; unit V
  compu method CM_POD_DCInletTempA: phys=raw-40 for raw 0..255; unit celsius
  compu method CM_POD_DCInletTempB: phys=raw-40 for raw 0..255; unit celsius
  compu method CM_POD_DCPortInletTempAValid: 0=Cx0_Damage, 1=Cx1_Short_Circuit (Short Circuit), 2=Cx2_normal
  compu method CM_POD_DCPortInletTempBValid: 0=Cx0_Damage, 1=Cx1_Short_Circuit (Short Circuit), 2=Cx2_normal
  compu method CM_POD_DCPosRelayState: 0=Cx0_Close, 1=Cx1_Open, 2=Cx2_Error
  compu method CM_POD_KL30Error: 0=Cx0_No_Fault (No Fault), 1=Cx1_Fault
  compu method CM_POD_OBC_ACFrequencyStatus: identical
  compu method CM_POD_OBC_ACPortTempA: phys=raw-40 for raw 0..255; unit celsius
  compu method CM_POD_OBC_ACPortTempAerror: 0=Cx0_No_Fault (No Fault), 1=Cx1_Fault
  compu method CM_POD_OBC_ACPortTempASensValid: 0=Cx0_Damage, 1=Cx1_Short_Circuit (Short Circuit), 2=Cx2_Normal
  compu method CM_POD_OBC_ACPortTempB: phys=raw-40 for raw 0..255; unit celsius
  compu method CM_POD_OBC_ACPortTempBerror: 0=Cx0_No_Fault (No Fault), 1=Cx1_Fault
  compu method CM_POD_OBC_ACPortTempBSensValid: 0=Cx0_Damage, 1=Cx1_Short_Circuit (Short Circuit), 2=Cx2_Normal
  compu method CM_POD_OBC_ACVoltHighFault: 0=Cx0_No_Fault (No Fault), 1=Cx1_Fault
  compu method CM_POD_OBC_ACVoltLowFault: 0=Cx0_No_Fault (No Fault), 1=Cx1_Fault
  compu method CM_POD_OBC_CCCurrentLimit: phys=raw*0.126 for raw 0..255; unit A
  compu method CM_POD_OBC_CCStatus: 0=Cx0_Unconnected, 1=Cx1_Half_connected (Half-connected), 2=Cx2_1500_Ohm (1500 Ohm), 3=Cx3_680_Ohm (680 Ohm), 4=Cx4_220_Ohm (220 Ohm), 5=Cx5_100_Ohm (100 Ohm), 6=Cx6_2000_Ohm (2000 Ohm), 7=Cx7_2700_Ohm (2700 Ohm), 8=Cx8_1000_Ohm (1000 Ohm), 9=Cx9_470_Ohm (470 Ohm), 10=CxA_invalid
  compu method CM_POD_OBC_ChargCapacibility: 0=Cx0_single_phase (single-phase), 1=Cx1_Three_phase (Three-phase), 2=Cx2_Error
  compu method CM_POD_OBC_ChrgOutpPwrAvl: phys=raw*0.1-7 for raw 0..200; unit kW
  compu method CM_POD_OBC_CommunFault: 0=Cx0_No_Fault (No Fault), 1=Cx1_Fault
  compu method CM_POD_OBC_CPCurrentLimit: phys=raw*0.126 for raw 0..255; unit A
  compu method CM_POD_OBC_CPDuty: identical
  compu method CM_POD_OBC_CPFrequency: identical
  compu method CM_POD_OBC_CPStatus: 0=Cx0_Unconnected, 1=Cx1_9V, 2=Cx2_9V_PWM (9V PWM), 3=Cx3_6V, 4=Cx4_6V_PWM (6V PWM), 5=Cx5_Fault, 6=Cx6_Reserve, 7=Cx7_Reserve
  compu method CM_POD_OBC_DCCurHighFault: 0=Cx0_No_Fault (No Fault), 1=Cx1_Fault
  compu method CM_POD_OBC_DCVoltHighFault: 0=Cx0_No_Fault (No Fault), 1=Cx1_Fault
  compu method CM_POD_OBC_DCVoltLowFault: 0=Cx0_No_Fault (No Fault), 1=Cx1_Fault
  compu method CM_POD_OBC_EMLockState: 0=Cx0_Close, 1=Cx1_Open, 2=Cx2_Error
  compu method CM_POD_OBC_FaultLevel: 0=Cx0_No_Fault (No Fault), 1=Cx1_Level1, 2=Cx2_Level2, 3=Cx3_Level3
  compu method CM_POD_OBC_InputACCurrent_R: phys=raw*0.1-50 for raw 0..1000
  compu method CM_POD_OBC_InputACCurrent_S: phys=raw*0.1 for raw 0..500
  compu method CM_POD_OBC_InputACCurrent_T: phys=raw*0.1 for raw 0..500
  compu method CM_POD_OBC_InputACVoltage_R: phys=raw*0.1 for raw 0..4000
  compu method CM_POD_OBC_InputACVoltage_S: phys=raw*0.1 for raw 0..4000; unit V
  compu method CM_POD_OBC_InputACVoltage_T: phys=raw*0.1 for raw 0..4000; unit V
  compu method CM_POD_OBC_InputFrequencyStatus: 0=Cx0_No_Fault (No Fault), 1=Cx1_Fault
  compu method CM_POD_OBC_InputOverCurrentstatus_R: 0=Cx0_No_Fault (No Fault), 1=Cx1_Fault
  compu method CM_POD_OBC_InputOverCurrentstatus_S: 0=Cx0_No_Fault (No Fault), 1=Cx1_Fault
  compu method CM_POD_OBC_InputOverCurrentstatus_T: 0=Cx0_No_Fault (No Fault), 1=Cx1_Fault
  compu method CM_POD_OBC_InputPhaseStatus: 0=Cx0_No_Fault (No Fault), 1=Cx1_Fault
  compu method CM_POD_OBC_InputShortError: 0=Cx0_No_Fault (No Fault), 1=Cx1_Fault
  compu method CM_POD_OBC_InternalFault: 0=Cx0_No_Fault (No Fault), 1=Cx1_Fault
  compu method CM_POD_OBC_NlineStatus: 0=Cx0_No_Fault (No Fault), 1=Cx1_Fault
  compu method CM_POD_OBC_OBCMaxPermOutpCrrt: phys=raw*0.1 for raw 0..400; unit A
  compu method CM_POD_OBC_OutputDCChargeCurrent: phys=raw*0.1-250 for raw 0..5000; unit A
  compu method CM_POD_OBC_OutputDCChargeVoltage: phys=raw*0.1-800 for raw 0..16000; unit V
  compu method CM_POD_OBC_OutputoverloadFault: 0=Cx0_No_Fault (No Fault), 1=Cx1_Fault
  compu method CM_POD_OBC_OutputShortError: 0=Cx0_No_Fault (No Fault), 1=Cx1_Fault
  compu method CM_POD_OBC_PFCOverVoltageError: 0=Cx0_No_Fault (No Fault), 1=Cx1_Fault
  compu method CM_POD_OBC_PFCUnderVoltageError: 0=Cx0_No_Fault (No Fault), 1=Cx1_Fault
  compu method CM_POD_OBC_PrimarySideTemp: phys=raw-40 for raw 0..250; unit celsius
  compu method CM_POD_OBC_S2State: 0=Cx0_Close, 1=Cx1_Open, 2=Cx2_Error
  compu method CM_POD_OBC_SecondarySideTemp: phys=raw-40 for raw 0..250; unit celsius
  compu method CM_POD_OBC_Side1Overtempfault: 0=Cx0_No_Fault (No Fault), 1=Cx1_Fault
  compu method CM_POD_OBC_Side2Overtempfault: 0=Cx0_No_Fault (No Fault), 1=Cx1_Fault
  compu method CM_POD_OBC_StartUpAllowed: 0=Cx0_No_Fault (No Fault), 1=Cx1_Fault
  compu method CM_POD_OBC_WorkMode: 0=Cx0_Init, 1=Cx1_Standby, 2=Cx2_Reserve, 3=Cx3_Charging_Mode (Charging Mode), 4=Cx4_Pre_heating_Mode (Pre-heating Mode), 5=Cx5_V2L_Mode (V2L Mode), 6=Cx6_Sleep, 7=Cx7_Fault
  compu method CM_POD_T15e_fault: 0=Cx0_No_Fault (No Fault), 1=Cx1_Fault
  compu method CM_POD_Temperature: phys=raw-40 for raw 0..255; unit celsius
  compu method CM_POD_TempHighFault: 0=Cx0_No_Fault (No Fault), 1=Cx1_Fault
  compu method CM_POD_TempSensor1Fault: 0=Cx0_No_Fault (No Fault), 1=Cx1_Fault
  compu method CM_PRND_Pbutton: 0=Cx0_Not_Pressed (Not Pressed), 1=Cx1_Pressed, 2=Cx2_Held, 3=Cx3_reserved
  compu method CM_PRND_Pbutton_FaultSts: 0=Cx0_No_Fault (No Fault), 1=Cx1_Fault
  compu method CM_PRND_RNDbutton: 0=Cx0_NO_TARGET, 1=Cx1_R, 2=Cx2_N, 3=Cx3_D, 4=Cx4_RESERVE, 5=Cx5_RESERVE, 6=Cx6_RESERVE, 7=Cx7_RESERVE
  compu method CM_PRND_RNDbutton_FaultSts: 0=Cx0_No_Fault (No Fault), 1=Cx1_Fault
  compu method CM_SGW_AlarmEnableSet: 0=Cx0_No_request (No request), 1=Cx1_Disable, 2=Cx2_Enable
  compu method CM_SGW_ALM_MusicFrequencySet: 0=Cx0_NO_Request (NO Request), 1=Cx1_OFF, 2=Cx2_ON, 3=Cx3_Reserved
  compu method CM_SGW_AppointChargeCmd: 0=Cx0_Init, 1=Cx1_Charge_ON (Charge ON), 2=Cx2_Charge_OFF (Charge OFF)
  compu method CM_SGW_BookingCarReq: 0=Cx0_Booking, 1=Cx1_Cancel, 2=Cx2_No_request (No request)
  compu method CM_SGW_ChargeFormSet: 0=Cx0_Init, 1=Cx1_ChargeImmediately, 2=Cx2_Appointment_charging (Appointment charging)
  compu method CM_SGW_DomeLampBrightSet: 0=Cx0_No_request (No request), 1=Cx1_50_ (50%), 2=Cx2_100_ (100%)
  compu method CM_SGW_DschrgOnOffSet: 0=Cx0_NO_COMMAND, 1=Cx1_OFF, 2=Cx2_ON, 3=Cx3_INVALID
  compu method CM_SGW_FL_BackrestMotorReq: 0=Cx0_Noactive, 1=Cx1_Front, 2=Cx2_Rear
  compu method CM_SGW_FL_FrontRearReq: 0=Cx0_Noactive, 1=Cx1_Front, 2=Cx2_Rear
  compu method CM_SGW_FL_HeightMotorReq: 0=Cx0_Noactive, 1=Cx1_Up, 2=Cx2_Down
  compu method CM_SGW_FollowMeHomeSet: 0=Cx0_No_request (No request), 1=Cx1_OFF, 2=Cx2_ON, 3=Cx3_Reserved
  compu method CM_SGW_FollowMeHomeTimeSet: phys=raw*5+5 for raw 0..35; unit s
  compu method CM_SGW_HazardWarnReq: 0=Cx0_No_Request (No Request), 1=Cx1_Off, 2=Cx2_On
  compu method CM_SGW_HoodlockSet: 0=Cx0_No_Request (No Request), 1=Cx1_Unlock
  compu method CM_SGW_LockACPlug: 0=Cx0_Init, 1=Cx1_Lock, 2=Cx2_Unlock
  compu method CM_SGW_RelockSet: 0=Cx0_NO_COMMAND, 1=Cx1_INACTIVE, 2=Cx2_30s, 3=Cx3_60s, 4=Cx4_Reserved, 5=Cx5_Reserved
  compu method CM_SGW_RemoteActiveHorn: 0=Cx0_No_Request (No Request), 1=Cx1_Active
  compu method CM_SGW_RemoteChrgFlapLockCtrlReq: 0=Cx0_NO_REQUEST, 1=Cx1_UNLOCK, 2=Cx2_LOCK, 3=Cx3_Reserved
  compu method CM_SGW_RemoteHVCtrlReq: 0=Cx0_NO_REQUEST, 1=Cx1_HV_ON, 2=Cx2_HV_OFF
  compu method CM_SGW_ResetCounter: identical
  compu method CM_SGW_SynMsgAuthenticator: identical
  compu method CM_SGW_TaxiArrIllReq: 0=Cx0_NO_Request (NO Request), 1=Cx1_OFF, 2=Cx2_ON, 3=Cx3_AUTO
  compu method CM_SGW_TaxiArriveSts: 0=Cx0_No_request (No request), 1=Cx1_Not_arrived (Not arrived), 2=Cx2_Arrived
  compu method CM_SGW_TimeInfoDay: identical
  compu method CM_SGW_TimeInfoHour: identical
  compu method CM_SGW_TimeInfoMinute: identical
  compu method CM_SGW_TimeInfoMonth: identical
  compu method CM_SGW_TimeInfoSecond: identical
  compu method CM_SGW_TimeInfoYear: phys=raw+2000 for raw 0..59
  compu method CM_SGW_TimeValid: 0=Cx0_INVALID, 1=Cx1_VALID
  compu method CM_SGW_TimingChargefrquency: 0=Cx0_Init, 1=Cx1_once, 2=Cx2_everyday
  compu method CM_SGW_TimingChargeSwitchStatus: 0=Cx0_Init, 1=Cx1_ON, 2=Cx2_OFF
  compu method CM_SGW_TripCounter: identical
  compu method CM_SGW_WelLightshowOnOffSet: 0=Cx0_NO_Request (NO Request), 1=Cx1_OFF, 2=Cx2_ON, 3=Cx3_Reserved
  compu method CM_SGW_WelLightshowTimeSet: phys=raw*5+5 for raw 0..35; unit s
  compu method CM_TCU_APTC1Enable: 0=Cx0_Not_Allowed (Not Allowed), 1=Cx1_Allowed
  compu method CM_TCU_APTCLeftCmd: identical
  compu method CM_TCU_APTCLeftMaxPowerLimit: phys=raw*0.04 for raw 0..255; unit KW
  compu method CM_TCU_APTCRightCmd: identical
  compu method CM_TCU_APTCRightMaxPowerLimit: phys=raw*0.04 for raw 0..255; unit KW
  compu method CM_TCU_APTCState: 0=Cx0_Default, 1=Cx1_OFF, 2=Cx2_ON, 3=Cx3_Reserved
  compu method CM_TCU_BattTMState: 0=Cx0_sleep_mode_and_no_coolant_flow (sleep mode and no coolant flow), 1=Cx1_cooling_mode (cooling mode), 2=Cx2_heating_mode (heating mode), 3=Cx3_pump_only_mode (pump only mode), 4=Cx4_exception_mode (exception mode), 5=Cx5_Reserved, 6=Cx6_Reserved, 7=Cx7_Reserved
  compu method CM_TCU_CompEnable: 0=Cx0_Disabled, 1=Cx1_Enabled
  compu method CM_TCU_CompMaxAllowPwrCmsp: phys=raw*0.04 for raw 0..254; unit KW
  compu method CM_TCU_CompTargetSpeed: identical
  compu method CM_TCU_EVCompState: 0=Cx0_off, 1=Cx1_running, 2=Cx2_limit, 3=Cx3_pre_heat, 4=Cx4_fault, 5=Cx5_reserved, 6=Cx6_reserved, 7=Cx7_reserved
  compu method CM_TCU_HVACACState: 0=Cx0_Default, 1=Cx1_Auto, 2=Cx2_Manual, 3=Cx3_Reserved
  compu method CM_TCU_HVCHHighVoltage: identical
  compu method CM_TCU_HVCHHVDCCurrent: phys=raw*0.25 for raw 0..254; unit A
  compu method CM_TCU_HVCHState: 0=Cx0_Default, 1=Cx1_OFF, 2=Cx2_ON, 3=Cx3_Reserved
  compu method CM_TCU_HvOnReq: 0=Cx0_No_Request (No Request), 1=Cx1_Request
  compu method CM_TCU_HVPwrState: 0=Cx0_Default, 1=Cx1_OFF, 2=Cx2_ON, 3=Cx3_Reserved
  compu method CM_TCU_TMSFaultLevel: 0=Cx0_No_Fault (No Fault), 1=Cx1_Fault_Level_1 (Fault Level 1), 2=Cx2_Fault_Level_2 (Fault Level 2), 3=Cx3_Fault_Level_3 (Fault Level 3), 4=Cx4_Fault_Level_4 (Fault Level 4), 5=Cx5_Reserved, 6=Cx6_Reserved, 7=Cx7_Reserved
  compu method CM_TCU_TMSState: 0=Cx0_NotActive, 1=Cx1_Active, 2=Cx2_reserved
  compu method CM_TCU_TMSTotalPwrCnsmp: phys=raw*200 for raw 0..200; unit w
  compu method CM_TCU_TMSTotoalPwrReq: phys=raw*200 for raw 0..200; unit w
  compu method CM_UDS_EPT_BootCmd{1..3}: identical
  compu method CM_Uds_EPT_bootResponse_Byte{0..7}: identical
  compu method CM_VCU_BS_HCurrent: phys=raw*0.0625-2048 for raw 8768..32767; unit A
  compu method CM_VCU_BS_QuiescentCurrent: 253=CxFD_Overflow, 254=CxFE_Out_of_bounds (Out of bounds), 255=CxFF_Invalid, phys=raw/256 for raw 0..252; unit A  # Source signal range: [0,252]
  compu method CM_VCU_ChargeEnergy: phys=raw*0.1 for raw 0..1023; unit km/h
  compu method CM_VCU_ChargeTime: identical
  compu method CM_VCU_CreepTorque: phys=raw-1024 for raw 0..2047
  compu method CM_VCU_DCDCPowerLimit: phys=raw*0.1 for raw 0..63; unit kW
  compu method CM_VCU_DisChgPowerLimit: phys=raw*0.1 for raw 0..255; unit kW
  compu method CM_VCU_Display_voltage: identical
  compu method CM_VCU_DisplayMileage: identical
  compu method CM_VCU_DTC_Number: identical
  compu method CM_VCU_Enable_DC_Relay: 0=Cx0_Close_Request (Close Request), 1=Cx1_Open_Request (Open Request)
  compu method CM_VCU_EnableOBC: 0=Cx0_Reserve, 1=Cx1_Reserve, 2=Cx2_Enable, 3=Cx3_Disable
  compu method CM_VCU_MaximumOutputCurrent: phys=raw*0.1-400 for raw 0..4000; unit A
  compu method CM_VCU_MaximumOutputVoltage: phys=raw*0.1 for raw 0..7500; unit V
  compu method CM_VCU_MaxSpdLimit: phys=raw-32767 for raw 0..65534
  compu method CM_VCU_MaxTorqueGradient: 16382=Cx3FFE_Init, 16383=Cx3FFF_Error, phys=raw*32 for raw 0..16381; unit Nm/s  # Source signal range: [0,16381]
  compu method CM_VCU_MaxTorqueLimit: 2046=Cx7FE_Init, 2047=Cx7FF_Error, phys=raw-1023 for raw 0..2045; unit Nm  # Source signal range: [0,2045]
  compu method CM_VCU_MCUActHeatPwr: 254=CxFE_Init, 255=CxFF_Error, phys=raw*0.1 for raw 0..100; unit kW  # Source signal range: [0,100]
  compu method CM_VCU_MCUPower: phys=raw-400 for raw 0..1023; unit kW
  compu method CM_VCU_MinimumOutputCurrent: phys=raw*0.1-400 for raw 0..4000; unit A
  compu method CM_VCU_MinimumOutputVoltage: phys=raw*0.1 for raw 0..7500; unit V
  compu method CM_VCU_MinTorqueLimit: 2046=Cx7FE_Init, 2047=Cx7FF_Error, phys=raw-1023 for raw 0..2045; unit Nm  # Source signal range: [0,2045]
  compu method CM_VCU_MotorSpdReq: phys=raw-32767 for raw 0..65534
  compu method CM_VCU_OBC_ChargeCurrentCommand: phys=raw*0.1 for raw 0..5000; unit A
  compu method CM_VCU_OBC_Control_of_em_lock: 0=Cx0_Close, 1=Cx1_Open
  compu method CM_VCU_OBC_Control_of_S2_SW: 0=Cx0_Close, 1=Cx1_Open
  compu method CM_VCU_PermitPackPTC: 0=Cx0_not_permit (not permit), 1=Cx1_permit
  compu method CM_VCU_RequestedModeDCDC: 0=Cx0_OFF, 1=Cx1_Buck, 2=Cx2_Disable
  compu method CM_VCU_RequestedModeTCU: 0=Cx0_Init, 1=Cx1_Standby, 2=Cx2_Disable, 3=Cx3_Enable
  compu method CM_VCU_SpdLimitActTorque: phys=raw-1024 for raw 0..2047
  compu method CM_VCU_SynRequest: identical
  compu method CM_VCU_TCUPowerAllowed: phys=raw*40 for raw 0..1600; unit W
  compu method CM_VCU_VoltageDemandLV: 510=Cx1FE_Init, 511=Cx1FF_Error, phys=raw*0.125 for raw 0..509; unit V  # Source signal range: [0,509]
  compu method CM_BCL_ChargeMode: 1=Cx01_ae_ (ºãÑ¹³äµç), 2=Cx02_ae_ (ºãÁ÷³äµç)
  compu method CM_BCL_CurrentRequire: phys=raw*0.1-400 for raw 0..4000; unit A
  compu method CM_BCL_VolltageRequire: phys=raw*0.1 for raw 0..7500; unit V
  compu method CM_BCP_AllowChargeVoltageMax: phys=raw*0.1 for raw 0..7500; unit V
  compu method CM_BCP_AllowTempMax: phys=raw-50 for raw 0..255
  compu method CM_BCP_BatteryChargeVoltageMax: phys=raw*0.01 for raw 0..2400; unit V
  compu method CM_BCP_BatteryNominalEnergy: phys=raw*0.1 for raw 0..10000; unit kWh
  compu method CM_BCP_BatteryTotalVoltage: phys=raw*0.1 for raw 0..7500; unit V
  compu method CM_BCP_ChargeCurrentMax: phys=raw*0.1-400 for raw 0..4000; unit A
  compu method CM_BCP_SOC: phys=raw*0.1 for raw 0..1000; unit %
  compu method CM_BCS_BatteryVoltMax: phys=raw*0.01 for raw 0..2400; unit V
  compu method CM_BCS_BatteryVoltMaxGroup: identical
  compu method CM_BCS_ChargeCurrentMeasure: phys=raw*0.1-400 for raw 0..11500; unit A
  compu method CM_BCS_ChargeVoltageMeasure: phys=raw*0.1 for raw 0..8000; unit V
  compu method CM_BCS_EstimatedTimeRemaining: identical
  compu method CM_BCS_SOC: identical
  compu method CM_BEM_ChargeAbortTimeout: 0=Cx0_ (Õý³£), 1=Cx1_ (³¬Ê±), 2=Cx2_ (²»¿ÉÐÅ)
  compu method CM_BEM_ChargeFinishTimeout: 0=Cx0_ (Õý³£), 1=Cx1_ (³¬Ê±), 2=Cx2_ (²»¿ÉÐÅ)
  compu method CM_BEM_ChargerIdTimeout0: 0=Cx0_ (Õý³£), 1=Cx1_ (³¬Ê±), 2=Cx2_ (²»¿ÉÐÅ)
  compu method CM_BEM_ChargerIdTimeout1: 0=Cx0_ (Õý³£), 1=Cx1_ (³¬Ê±), 2=Cx2_ (²»¿ÉÐÅ)
  compu method CM_BEM_ChargeStateTimeout: 0=Cx0_ (Õý³£), 1=Cx1_ (³¬Ê±), 2=Cx2_ (²»¿ÉÐÅ)
  compu method CM_BEM_ChargeStatisticsTimeout: 0=Cx0_ (Õý³£), 1=Cx1_ (³¬Ê±), 2=Cx2_ (²»¿ÉÐÅ)
  compu method CM_BEM_TimesyncOrPowerTimeout: 0=Cx0_ (Õý³£), 1=Cx1_ (³¬Ê±), 2=Cx2_ (²»¿ÉÐÅ)
  compu method CM_BHM_AllowChargeVoltageMax: phys=raw*0.1 for raw 0..7500; unit V
  compu method CM_BMT_BatteryTemp0: phys=raw-50 for raw 0..250
  compu method CM_BMT_BatteryTemp1: phys=raw-50 for raw 0..250
  compu method CM_BMT_BatteryTemp{10..15}: phys=raw-50 for raw 0..250
  compu method CM_BMT_BatteryTemp{2..9}: phys=raw-50 for raw 0..250
  compu method CM_BMV_BatteryGroupID0: identical
  compu method CM_BMV_BatteryGroupID1: identical
  compu method CM_BMV_BatteryGroupID10: identical
  compu method CM_BMV_BatteryGroupID{100..109}: identical
  compu method CM_BMV_BatteryGroupID11: identical
  compu method CM_BMV_BatteryGroupID{110..119}: identical
  compu method CM_BMV_BatteryGroupID12: identical
  compu method CM_BMV_BatteryGroupID{120..129}: identical
  compu method CM_BMV_BatteryGroupID13: identical
  compu method CM_BMV_BatteryGroupID{130..139}: identical
  compu method CM_BMV_BatteryGroupID14: identical
  compu method CM_BMV_BatteryGroupID{140..149}: identical
  compu method CM_BMV_BatteryGroupID15: identical
  compu method CM_BMV_BatteryGroupID{150..159}: identical
  compu method CM_BMV_BatteryGroupID16: identical
  compu method CM_BMV_BatteryGroupID{160..169}: identical
  compu method CM_BMV_BatteryGroupID17: identical
  compu method CM_BMV_BatteryGroupID{170..179}: identical
  compu method CM_BMV_BatteryGroupID18: identical
  compu method CM_BMV_BatteryGroupID{180..189}: identical
  compu method CM_BMV_BatteryGroupID19: identical
  compu method CM_BMV_BatteryGroupID{190..199}: identical
  compu method CM_BMV_BatteryGroupID2: identical
  compu method CM_BMV_BatteryGroupID20: identical
  compu method CM_BMV_BatteryGroupID{200..209}: identical
  compu method CM_BMV_BatteryGroupID21: identical
  compu method CM_BMV_BatteryGroupID{210..219}: identical
  compu method CM_BMV_BatteryGroupID22: identical
  compu method CM_BMV_BatteryGroupID{220..229}: identical
  compu method CM_BMV_BatteryGroupID23: identical
  compu method CM_BMV_BatteryGroupID{230..239}: identical
  compu method CM_BMV_BatteryGroupID24: identical
  compu method CM_BMV_BatteryGroupID{240..249}: identical
  compu method CM_BMV_BatteryGroupID25: identical
  compu method CM_BMV_BatteryGroupID{250..255}: identical
  compu method CM_BMV_BatteryGroupID{26..29}: identical
  compu method CM_BMV_BatteryGroupID3: identical
  compu method CM_BMV_BatteryGroupID{30..39}: identical
  compu method CM_BMV_BatteryGroupID4: identical
  compu method CM_BMV_BatteryGroupID{40..49}: identical
  compu method CM_BMV_BatteryGroupID5: identical
  compu method CM_BMV_BatteryGroupID{50..59}: identical
  compu method CM_BMV_BatteryGroupID6: identical
  compu method CM_BMV_BatteryGroupID{60..69}: identical
  compu method CM_BMV_BatteryGroupID7: identical
  compu method CM_BMV_BatteryGroupID{70..79}: identical
  compu method CM_BMV_BatteryGroupID8: identical
  compu method CM_BMV_BatteryGroupID{80..89}: identical
  compu method CM_BMV_BatteryGroupID9: identical
  compu method CM_BMV_BatteryGroupID{90..99}: identical
  compu method CM_BMV_BatteryVoltageMin0: phys=raw*0.01 for raw 0..4095
  compu method CM_BMV_BatteryVoltageMin1: phys=raw*0.01 for raw 0..4095
  compu method CM_BMV_BatteryVoltageMin10: phys=raw*0.01 for raw 0..4095
  compu method CM_BMV_BatteryVoltageMin{100..109}: phys=raw*0.01 for raw 0..4095
  compu method CM_BMV_BatteryVoltageMin11: phys=raw*0.01 for raw 0..4095
  compu method CM_BMV_BatteryVoltageMin{110..119}: phys=raw*0.01 for raw 0..4095
  compu method CM_BMV_BatteryVoltageMin12: phys=raw*0.01 for raw 0..4095
  compu method CM_BMV_BatteryVoltageMin{120..129}: phys=raw*0.01 for raw 0..4095
  compu method CM_BMV_BatteryVoltageMin13: phys=raw*0.01 for raw 0..4095
  compu method CM_BMV_BatteryVoltageMin{130..139}: phys=raw*0.01 for raw 0..4095
  compu method CM_BMV_BatteryVoltageMin14: phys=raw*0.01 for raw 0..4095
  compu method CM_BMV_BatteryVoltageMin{140..149}: phys=raw*0.01 for raw 0..4095
  compu method CM_BMV_BatteryVoltageMin15: phys=raw*0.01 for raw 0..4095
  compu method CM_BMV_BatteryVoltageMin{150..159}: phys=raw*0.01 for raw 0..4095
  compu method CM_BMV_BatteryVoltageMin16: phys=raw*0.01 for raw 0..4095
  compu method CM_BMV_BatteryVoltageMin{160..169}: phys=raw*0.01 for raw 0..4095
  compu method CM_BMV_BatteryVoltageMin17: phys=raw*0.01 for raw 0..4095
  compu method CM_BMV_BatteryVoltageMin{170..179}: phys=raw*0.01 for raw 0..4095
  compu method CM_BMV_BatteryVoltageMin18: phys=raw*0.01 for raw 0..4095
  compu method CM_BMV_BatteryVoltageMin{180..189}: phys=raw*0.01 for raw 0..4095
  compu method CM_BMV_BatteryVoltageMin19: phys=raw*0.01 for raw 0..4095
  compu method CM_BMV_BatteryVoltageMin{190..199}: phys=raw*0.01 for raw 0..4095
  compu method CM_BMV_BatteryVoltageMin2: phys=raw*0.01 for raw 0..4095
  compu method CM_BMV_BatteryVoltageMin20: phys=raw*0.01 for raw 0..4095
  compu method CM_BMV_BatteryVoltageMin{200..209}: phys=raw*0.01 for raw 0..4095
  compu method CM_BMV_BatteryVoltageMin21: phys=raw*0.01 for raw 0..4095
  compu method CM_BMV_BatteryVoltageMin{210..219}: phys=raw*0.01 for raw 0..4095
  compu method CM_BMV_BatteryVoltageMin22: phys=raw*0.01 for raw 0..4095
  compu method CM_BMV_BatteryVoltageMin{220..229}: phys=raw*0.01 for raw 0..4095
  compu method CM_BMV_BatteryVoltageMin23: phys=raw*0.01 for raw 0..4095
  compu method CM_BMV_BatteryVoltageMin{230..239}: phys=raw*0.01 for raw 0..4095
  compu method CM_BMV_BatteryVoltageMin24: phys=raw*0.01 for raw 0..4095
  compu method CM_BMV_BatteryVoltageMin{240..249}: phys=raw*0.01 for raw 0..4095
  compu method CM_BMV_BatteryVoltageMin25: phys=raw*0.01 for raw 0..4095
  compu method CM_BMV_BatteryVoltageMin{250..255}: phys=raw*0.01 for raw 0..4095
  compu method CM_BMV_BatteryVoltageMin{26..29}: phys=raw*0.01 for raw 0..4095
  compu method CM_BMV_BatteryVoltageMin3: phys=raw*0.01 for raw 0..4095
  compu method CM_BMV_BatteryVoltageMin{30..39}: phys=raw*0.01 for raw 0..4095
  compu method CM_BMV_BatteryVoltageMin4: phys=raw*0.01 for raw 0..4095
  compu method CM_BMV_BatteryVoltageMin{40..49}: phys=raw*0.01 for raw 0..4095
  compu method CM_BMV_BatteryVoltageMin5: phys=raw*0.01 for raw 0..4095
  compu method CM_BMV_BatteryVoltageMin{50..59}: phys=raw*0.01 for raw 0..4095
  compu method CM_BMV_BatteryVoltageMin6: phys=raw*0.01 for raw 0..4095
  compu method CM_BMV_BatteryVoltageMin{60..69}: phys=raw*0.01 for raw 0..4095
  compu method CM_BMV_BatteryVoltageMin7: phys=raw*0.01 for raw 0..4095
  compu method CM_BMV_BatteryVoltageMin{70..79}: phys=raw*0.01 for raw 0..4095
  compu method CM_BMV_BatteryVoltageMin8: phys=raw*0.01 for raw 0..4095
  compu method CM_BMV_BatteryVoltageMin{80..89}: phys=raw*0.01 for raw 0..4095
  compu method CM_BMV_BatteryVoltageMin9: phys=raw*0.01 for raw 0..4095
  compu method CM_BMV_BatteryVoltageMin{90..99}: phys=raw*0.01 for raw 0..4095
  compu method CM_BRM_BatteryChargeTimes: identical
  compu method CM_BRM_BatteryProductDay: identical
  compu method CM_BRM_BatteryProductMonth: identical
  compu method CM_BRM_BatteryProductYear: phys=raw+1985 for raw -128..127
  compu method CM_BRM_BatteryProperty: identical
  compu method CM_BRM_BatterySN: identical
  compu method CM_BRM_BatterySystemRatedCapacity: phys=raw*0.1 for raw 0..10000; unit Ah
  compu method CM_BRM_BatterySystemRatedVoltage: phys=raw*0.1 for raw 0..7500
  compu method CM_BRM_BatteryType: -1=CxFF_ae_ (ÆäËûµç³Ø), 1=Cx01_ (Ç¦Ëáµç³Ø), 2=Cx02_Ae_ (ÄøÇâµç³Ø), 3=Cx03_ (Á×ËáÌúï®µç³Ø), 4=Cx04_ (ÃÌËáï®µç³Ø), 5=Cx05_ (¹ÅËáï®µç³Ø), 6=Cx06_Ae_ (ÈýÔª²ÄÁÏµç³Ø), 7=Cx07_ (¾ÛºÏÎïï®Àë×Óµç³Ø), 8=Cx08_ (îÑËáï®µç³Ø)
  compu method CM_BRM_Manufacturer: identical
  compu method CM_BRM_ProtocolVersion: identical
  compu method CM_BRM_VehicleIdByte1_8: identical
  compu method CM_BRM_VehicleIdByte17: identical
  compu method CM_BRM_VehicleIdByte9_16: identical
  compu method CM_BRO_BMSChargeReady: 0=Cx00_BMS_oe_ae_ (BMSÎ´×öºÃ³äµç×¼±¸), 170=CxAA_BMS_ae_ (BMSÍê³É³äµç×¼±¸), 255=CxFF_ (ÎÞÐ§)
  compu method CM_BSD_AbortSOC: identical
  compu method CM_BSD_BatteryTempMax: phys=raw-50 for raw 0..250
  compu method CM_BSD_BatteryTempMin: phys=raw-50 for raw 0..250
  compu method CM_BSD_BatteryVoltageMax: phys=raw*0.01 for raw 0..2400; unit V
  compu method CM_BSD_BatteryVoltageMin: phys=raw*0.01 for raw 0..2400; unit V
  compu method CM_BSM_BatteryCurrentState: 0=Cx0_ (Õý³£), 1=Cx1_ (¹ýÁ÷), 2=Cx2_ (²»¿ÉÐÅ)
  compu method CM_BSM_BatteryOutpuConnectorState: 0=Cx0_ (Õý³£), 1=Cx1_ (²»Õý³£), 2=Cx2_ (²»¿ÉÐÅ)
  compu method CM_BSM_BatteryTempMax: phys=raw-50 for raw 0..255
  compu method CM_BSM_BatteryTempMaxNo: identical
  compu method CM_BSM_BatteryTempMin: phys=raw-50 for raw 0..255
  compu method CM_BSM_BatteryTempMinNo: identical
  compu method CM_BSM_BatteryTempState: 0=Cx0_ (Õý³£), 1=Cx1_ss (¹ý¸ß), 2=Cx2_ (²»¿ÉÐÅ)
  compu method CM_BSM_BatteryVoltageMaxNo: identical
  compu method CM_BSM_BatteryVoltageState: 0=Cx0_ (Õý³£), 1=Cx1_ss (¹ý¸ß), 2=Cx2_ (¹ýµÍ)
  compu method CM_BSM_ChargeEnable: 0=Cx0_Oe_ (½ûÖ¹), 1=Cx1_ (ÔÊÐí)
  compu method CM_BSM_InsulationState: 0=Cx0_ (Õý³£), 1=Cx1_ (²»Õý³£), 2=Cx2_ (²»¿ÉÐÅ)
  compu method CM_BSM_SOC: 0=Cx0_ (Õý³£), 1=Cx1_ss (¹ý¸ß), 2=Cx2_ (¹ýµÍ)
  compu method CM_BSOC_0: identical
  compu method CM_BSOC_1: identical
  compu method CM_BSOC_{10..15}: identical
  compu method CM_BSOC_{2..9}: identical
  compu method CM_BST_AbortAchiveSingleVolt: 0=Cx0_ (Î´µ½´ï), 1=Cx1_ (µ½´ï), 2=Cx2_ (²»¿ÉÐÅ)
  compu method CM_BST_AbortAchiveSOC: 0=Cx0_ (Î´µ½´ï), 1=Cx1_ (µ½´ï), 2=Cx2_ (²»¿ÉÐÅ)
  compu method CM_BST_AbortAchiveTotalVolt: 0=Cx0_ (Î´µ½´ï), 1=Cx1_ (µ½´ï), 2=Cx2_ (²»¿ÉÐÅ)
  compu method CM_BST_AbortChargparameter: 0=Cx0_ae (²ÎÊýÆ¥Åä), 1=Cx1_ae (²ÎÊý²»Æ¥Åä), 2=Cx2_ (²»¿ÉÐÅ×´Ì¬)
  compu method CM_BST_Abortdet2Voltexception: 0=Cx0_Nolmal, 1=Cx1_Fault, 2=Cx2_Untrustable
  compu method CM_BST_AbortErrorCurrent: 0=Cx0_ (µçÁ÷Õý³£), 1=Cx1_Oe_ (µçÁ÷³¬¹ýÐèÇóÖµ), 2=Cx2_ (²»¿ÉÐÅ)
  compu method CM_BST_AbortErrorVoltage: 0=Cx0_ (Õý³£), 1=Cx1_ (µçÑ¹Òì³£), 2=Cx2_ (²»¿ÉÐÅ)
  compu method CM_BST_AbortFaultBatteryTemp: 0=Cx0_ (Õý³£), 1=Cx1_ss (¹ý¸ß), 2=Cx2_ (²»¿ÉÐÅ)
  compu method CM_BST_AbortFaultBMSTemp: 0=Cx0_ (Õý³£), 1=Cx1_ss (¹ý¸ß), 2=Cx2_ (²»¿ÉÐÅ)
  compu method CM_BST_AbortFaultConnector: 0=Cx0_ (Õý³£), 1=Cx1_ (¹ÊÕÏ), 2=Cx2_ (²»¿ÉÐÅ)
  compu method CM_BST_AbortFaultConnectorTemp: 0=Cx0_ (Õý³£), 1=Cx1_ (¹ÊÕÏ), 2=Cx2_ (²»¿ÉÐÅ)
  compu method CM_BST_AbortFaultInsulation: 0=Cx0_ (Õý³£), 1=Cx1_ (¹ÊÕÏ), 2=Cx2_ (²»¿ÉÐÅ)
  compu method CM_BST_AbortFaultOther: 0=Cx0_ (Õý³£), 1=Cx1_ (¹ÊÕÏ), 2=Cx2_ (²»¿ÉÐÅ)
  compu method CM_BST_AbortHVrelayfault: 0=Cx0_Nomal, 1=Cx1_Fault, 2=Cx2_Untrustable
  compu method CM_BST_Abortmanoperate: 0=Cx0_Normal, 1=Cx1_Abort_by_charger (Abort by charger), 2=Cx2_untrustable
  compu method CM_CCS_ChargeAllow: 0=Cx0_ (ÔÝÍ£), 1=Cx1_ (ÔÊÐí)
  compu method CM_CCS_ChargeTotalTime: identical
  compu method CM_CCS_OutputCurrent: phys=raw*0.1-400 for raw 0..4000; unit A
  compu method CM_CCS_OutputVoltage: phys=raw*0.1 for raw 0..7500; unit V
  compu method CM_CEM_BatteryChargeRequireTimeout: 0=Cx0_ (Õý³£), 1=Cx1_ (³¬Ê±), 2=Cx2_ (²»¿ÉÐÅ)
  compu method CM_CEM_BatteryParameterTimout: 0=Cx0_ (Õý³£), 1=Cx1_ (³¬Ê±), 2=Cx2_ (²»¿ÉÐÅ)
  compu method CM_CEM_BatteryStateTimeout: 0=Cx0_ (Õý³£), 1=Cx1_ (³¬Ê±), 2=Cx2_ (²»¿ÉÐÅ)
  compu method CM_CEM_BMSAbortChargeTimeout: 0=Cx0_ (Õý³£), 1=Cx1_ (³¬Ê±), 2=Cx2_ (²»¿ÉÐÅ)
  compu method CM_CEM_BMSChargeStatisticsTimeout: 0=Cx0_ (Õý³£), 1=Cx1_ (³¬Ê±), 2=Cx2_ (²»¿ÉÐÅ)
  compu method CM_CEM_BMSFinishChargeTimeout: 0=Cx0_ (Õý³£), 1=Cx1_ (³¬Ê±), 2=Cx2_ (²»¿ÉÐÅ)
  compu method CM_CEM_BMSIdentifyTimout: 0=Cx0_ (Õý³£), 1=Cx1_ (³¬Ê±), 2=Cx2_ (²»¿ÉÐÅ)
  compu method CM_CHM_ProtocolVersion: identical
  compu method CM_CML_OutputCurrentMax: phys=raw*0.1-400 for raw 0..4000; unit A
  compu method CM_CML_OutputCurrentMin: phys=raw*0.1-400 for raw 0..4000; unit A
  compu method CM_CML_OutputVoltageMin: phys=raw*0.1 for raw 0..7500; unit V
  compu method CM_CML_OutpuVoltageMax: phys=raw*0.1 for raw 0..7500; unit V
  compu method CM_CRM_ChargerNo: identical
  compu method CM_CRM_RecognitionResult: 0=Cx00_BMS_AeUe_ (BMS²»ÄÜ±æÊ¶), 170=CxAA_BMSAeUe_ (BMSÄÜ±æÊ¶), phys=raw+1 for raw 1..255
  compu method CM_CRM_RegionCode: identical
  compu method CM_CRO_ChargerReady: 0=Cx00_ae_oe_ae_ (³äµç»úÎ´×öºÃ³äµç×¼±¸), 170=CxAA_ae_ae_ (³äµç»úÍê³É³äµç×¼±¸), 255=CxFF_ (ÎÞÐ§)
  compu method CM_CSD_ChargerNo: phys=raw+1 for raw 0..4294967295
  compu method CM_CSD_OutputEnerge: phys=raw*0.1 for raw 0..10000; unit kWh
  compu method CM_CSD_TotalChargeTime: identical
  compu method CM_CST_AbortAchiveCondition: 0=Cx0_ (Î´µ½´ï), 1=Cx1_ (µ½´ï), 2=Cx2_ (²»¿ÉÐÅ)
  compu method CM_CST_AbortByFault: 0=Cx0_ (Õý³£), 1=Cx1_Oe_Oe_ (ÖÐÖ¹), 2=Cx2_ (²»¿ÉÐÅ)
  compu method CM_CST_AbortByUser: 0=Cx0_ (Õý³£), 1=Cx1_Oe_Oe_ (ÖÐÖ¹), 2=Cx2_ (²»¿ÉÐÅ)
  compu method CM_CST_AbortErrorCurrent: 0=Cx0_ (Õý³£), 1=Cx1_Oe_Oe_ (ÖÐÖ¹), 2=Cx2_ (²»¿ÉÐÅ)
  compu method CM_CST_AbortErrorVoltage: 0=Cx0_ (Õý³£), 1=Cx1_Oe_Oe_ (ÖÐÖ¹), 2=Cx2_ (²»¿ÉÐÅ)
  compu method CM_CST_AbortFaultChargerInnerTemp: 0=Cx0_ (Õý³£), 1=Cx1_ (¹ÊÕÏ), 2=Cx2_ (²»¿ÉÐÅ)
  compu method CM_CST_AbortFaultChargerStop: 0=Cx0_ (Õý³£), 1=Cx1_ (¹ÊÕÏ), 2=Cx2_ (²»¿ÉÐÅ)
  compu method CM_CST_AbortFaultChargerTemp: 0=Cx0_ (Õý³£), 1=Cx1_ (¹ÊÕÏ), 2=Cx2_ (²»¿ÉÐÅ)
  compu method CM_CST_AbortFaultConnetor: 0=Cx0_ (Õý³£), 1=Cx1_ (¹ÊÕÏ), 2=Cx2_ (²»¿ÉÐÅ)
  compu method CM_CST_AbortFaultEnergeTransmit: 0=Cx0_ (Õý³£), 1=Cx1_ (¹ÊÕÏ), 2=Cx2_ (²»¿ÉÐÅ)
  compu method CM_CST_AbortFaultOther: 0=Cx0_ (Õý³£), 1=Cx1_ (¹ÊÕÏ), 2=Cx2_ (²»¿ÉÐÅ)
  compu method CM_CTS_Day: identical
  compu method CM_CTS_Hour: identical
  compu method CM_CTS_Minute: identical
  compu method CM_CTS_Month: identical
  compu method CM_CTS_Second: identical
  compu method CM_CTS_Year: identical
  compu method CM_ChargeCurrWU: 0=Cx0_No_Wake_Up_with_charge_current (No Wake Up with charge current), 1=Cx1_Wake_Up_with_charge_current (Wake Up with charge current)
  compu method CM_ChargeCurrWU_Ena: 0=Cx0_Disabled, 1=Cx1_Enabled
  compu method CM_ChargeCurrWU_Sts: 0=Cx0_Disabled, 1=Cx1_Enabled
  compu method CM_ChargeCurrWU_Treshold: phys=raw*10 for raw 0..250; unit mA
  compu method CM_DisChargeCurrWU: 0=Cx0_No_Wake_Up_with_discharge_current (No Wake Up with discharge current), 1=Cx1_Wake_Up_with_discharge_current (Wake Up with discharge current)
  compu method CM_DisChargeCurrWU_Ena: 0=Cx0_Disabled, 1=Cx1_Enabled
  compu method CM_DisChargeCurrWU_Sts: 0=Cx0_Disabled, 1=Cx1_Enabled
  compu method CM_DisChargeCurrWU_Treshold: phys=raw*2+10 for raw 0..250; unit mA
  compu method CM_ERROR_Commom: 0=Cx0_No_error (No error), 1=Cx1_Error
  compu method CM_ERROR_IDENT: 0=Cx0_No_error (No error), 1=Cx1_Error
  compu method CM_FLAG_INCONSISTENCY: 0=Cx0_No_error (No error), 1=Cx1_Error
  compu method CM_FRC_ComFtonNet: 0=Cx0_No_error (No error), 1=Cx1_Error
  compu method CM_FRC_Vl_OV: 0=Cx0_No_error (No error), 1=Cx1_Error
  compu method CM_FRC_Vl_UV: 0=Cx0_No_error (No error), 1=Cx1_Error
  compu method CM_I_BATT: phys=raw/1024-32 for raw 0..65535
  compu method CM_I_RANGE: 0=Cx0_1_1A (-1,1A), 1=Cx1_200_200A (-200,200A), 2=Cx2_1500_1500A (-1500,1500A), 3=Cx3_Invalid
  compu method CM_IBATT_QUIESCENT: 253=CxFD_Overflow, 254=CxFE_Out_of_bounds (Out of bounds), 255=CxFF_Invalid, phys=raw/256 for raw 0..252; unit 2^(-8) A  # Source signal range: [0,252]
  compu method CM_Q_Charge: phys=raw*0.125 for raw 0..65534; unit 0.125 Ah
  compu method CM_Q_Discharge: phys=raw*0.125 for raw 0..65534; unit 0.125 Ah
  compu method CM_Resp_Error: 0=Cx0_No_error (No error), 1=Cx1_Error
  compu method CM_SOC: identical
  compu method CM_SOC_STATE: 0=Cx0_deviation_higher_15_ (deviation higher 15%), 1=Cx1_deviation_lower_15_ (deviation lower 15%), 2=Cx2_deviation_lower_10_ (deviation lower 10%), 3=Cx3_invalid
  compu method CM_SOCWU: 0=Cx0_No_Wake_Up_with_Low_SOC (No Wake Up with Low SOC), 1=Cx1_Wake_Up_with_Low_SOC (Wake Up with Low SOC)
  compu method CM_SOCWU_Ena: 0=Cx0_Disabled, 1=Cx1_Enabled
  compu method CM_SOCWU_Sts: 0=Cx0_Disabled, 1=Cx1_Enabled
  compu method CM_SOCWU_Treshold: identical
  compu method CM_SOF_Q: phys=raw*0.5 for raw 0..254; unit 0.5 Ah
  compu method CM_SOF_Q_STATE: 0=Cx0_deviation_higher_15_ (deviation higher 15%), 1=Cx1_deviation_lower_15_ (deviation lower 15%), 2=Cx2_deviation_lower_10_ (deviation lower 10%), 3=Cx3_invalid
  compu method CM_SOF_t_STATE: 0=Cx0_deviation_higher_15_ (deviation higher 15%), 1=Cx1_deviation_lower_15_ (deviation lower 15%), 2=Cx2_deviation_lower_10_ (deviation lower 10%), 3=Cx3_invalid
  compu method CM_SOF_V1: phys=raw*0.0625 for raw 0..254; unit 0.0625V
  compu method CM_SOF_V1_STATE: 0=Cx0_deviation_higher_15_ (deviation higher 15%), 1=Cx1_deviation_lower_15_ (deviation lower 15%), 2=Cx2_deviation_lower_10_ (deviation lower 10%), 3=Cx3_invalid
  compu method CM_SOF_V2: phys=raw*0.0625 for raw 0..254; unit 0.0625V
  compu method CM_SOF_V2_STATE: 0=Cx0_deviation_higher_15_ (deviation higher 15%), 1=Cx1_deviation_lower_15_ (deviation lower 15%), 2=Cx2_deviation_lower_10_ (deviation lower 10%), 3=Cx3_invalid
  compu method CM_SOH: identical
  compu method CM_SOH_STATE: 0=Cx0_deviation_higher_15_ (deviation higher 15%), 1=Cx1_deviation_lower_15_ (deviation lower 15%), 2=Cx2_deviation_lower_10_ (deviation lower 10%), 3=Cx3_invalid
  compu method CM_Status_Current: 0=Cx0_No_Error (No Error), 1=Cx1_Error_Open_circuit (Error Open circuit), 2=Cx2_HW_defect_out_of_ranger_or_ADC_defect_ (HW defect(out of ranger or ADC defect)), 3=Cx3_LIN_saturation_no_HW_defect_ (LIN saturation(no HW defect))
  compu method CM_Status_Temp: 0=Cx0_No_Error (No Error), 1=Cx1_not_used (not used), 2=Cx2_HW_defect_ADC_defect_ (HW defect(ADC defect)), 3=Cx3_LIN_saturation_no_HW_defect_ (LIN saturation(no HW defect))
  compu method CM_Status_Voltage: 0=Cx0_No_Error (No Error), 1=Cx1_Error_Open_circuit (Error Open circuit), 2=Cx2_HW_defect_ADC_defect_ (HW defect(ADC defect)), 3=Cx3_LIN_saturation_no_HW_defect_ (LIN saturation(no HW defect))
  compu method CM_T_BATT: phys=raw-40 for raw 0..145; unit ?°C
  compu method CM_U_BATT: phys=raw/1024+3 for raw 0..15360; unit 2^(-10) V
  compu method CM_VCU_ACU_DriverWarningLampSts: 0=Cx0_OFF, 1=Cx1_ON, 2=Cx2_FLASH
  compu method CM_VCU_ACU_PassengerAirbagSts: 0=Cx0_RESERVED, 1=Cx1_Disabled, 2=Cx2_Enabled, 3=Cx3_RESERVED
  compu method CM_VCU_ACU_PassengerWarningLampSts: 0=Cx0_OFF, 1=Cx1_ON, 2=Cx2_FLASH
  compu method CM_VCU_ACU_WarningLampSts: 0=Cx0_OFF, 1=Cx1_ON, 2=Cx2_FLASH
  compu method CM_VCU_BCM_FLSeatBeltRemindReq: 0=Cx0_No_request (No request), 1=Cx1_First_level_reminder (First level reminder), 2=Cx2_Second_level_reminder (Second level reminder), 3=Cx3_Reserved
  compu method CM_VCU_BCM_FRSeatBeltRemindReq: 0=Cx0_No_request (No request), 1=Cx1_First_level_reminder (First level reminder), 2=Cx2_Second_level_reminder (Second level reminder), 3=Cx3_Reserved
  compu method CM_VCU_BCM_RLSeatBeltRemindReq: 0=Cx0_No_request (No request), 1=Cx1_First_level_reminder (First level reminder), 2=Cx2_Second_level_reminder (Second level reminder), 3=Cx3_Reserved
  compu method CM_VCU_BCM_RRSeatBeltRemindReq: 0=Cx0_No_request (No request), 1=Cx1_First_level_reminder (First level reminder), 2=Cx2_Second_level_reminder (Second level reminder), 3=Cx3_Reserved
  compu method CM_VCU_CGW_VehicleState: 0=Cx0_Fully_sleep (Fully sleep), 1=Cx1_Invisible_awake_CANwakeup (Invisible awake-CANwakeup), 2=Cx2_Reserve, 3=Cx3_Reserve, 4=Cx4_Invisible_awake_OnlyHVon (Invisible awake-OnlyHVon), 5=Cx5_Standby_Normal (Standby-Normal), 6=Cx6_Standby_OnlyLVon (Standby-OnlyLVon), 7=Cx7_Drive_Normal (Drive-Normal), 8=Cx8_Drive_LVFault (Drive-LVFault)
  compu method CM_VCU_DCDCFail_LIN: 0=Cx0_False, 1=Cx1_True
  compu method CM_VCU_DCM_FL_DoorFLSts: 0=Cx0_Closed, 1=Cx1_Opened
  compu method CM_VCU_DCM_FR_DoorFRSts: 0=Cx0_Closed, 1=Cx1_Opened
  compu method CM_VCU_DCM_RL_DoorRLSts: 0=Cx0_Closed, 1=Cx1_Opened
  compu method CM_VCU_DCM_RR_DoorRRSts: 0=Cx0_Closed, 1=Cx1_Opened
  compu method CM_VCU_DriveMotOvrTemp_LIN: 0=Cx0_False, 1=Cx1_True
  compu method CM_VCU_HVBatCriFail_LIN: 0=Cx0_False, 1=Cx1_Yellow, 2=Cx2_Red, 3=Cx3_Reserve
  compu method CM_VCU_HVBatOvrTemp_LIN: 0=Cx0_False, 1=Cx1_True
  compu method CM_VCU_IBS_BrakeFluidWarning: 0=Cx0_BRAKEFLUID_NORMAL_INIT_DEFAULT, 1=Cx1_BRAKEFLUID_EMPTY, 2=Cx2_RESERVED, 3=Cx3_RESERVED
  compu method CM_VCU_IBS_EBDFault: 0=Cx0_Noerror, 1=Cx1_Error
  compu method CM_VCU_IBS_RollerbenchMode: 0=Cx0_Not_Active (Not Active), 1=Cx1_Active
  compu method CM_VCU_IBS_SystemStatus: 0=Cx0_Normal_, 1=Cx1_Degrade_, 2=Cx2_Partial_, 3=Cx3_Inhibit_, 4=Cx4_0x4_0x7_Reserved (0x4~0x7, Reserved)
  compu method CM_VCU_IVI_BulbCheckSts: 0=Cx0_Not_BulbCheck (Not BulbCheck), 1=Cx1_BulbCheck
  compu method CM_VCU_IVI_VrState: 0=Cx0_Inactive, 1=Cx1_Active
package /DataType/Unit
  41 x unit:
    U_C: display-name=¡ãC, factor-si-to-unit=1, offset-si-to-unit=0
    U_A: display-name=A, factor-si-to-unit=1, offset-si-to-unit=0
    U_celsius: display-name=celsius, factor-si-to-unit=1, offset-si-to-unit=0
    U_Degree: display-name=Degree, factor-si-to-unit=1, offset-si-to-unit=0
    U_KW: display-name=KW, factor-si-to-unit=1, offset-si-to-unit=0
    U_p: display-name=%, factor-si-to-unit=1, offset-si-to-unit=0
    U_percent: display-name=percent, factor-si-to-unit=1, offset-si-to-unit=0
    U_V: display-name=V, factor-si-to-unit=1, offset-si-to-unit=0
    U_BAR: display-name=BAR, factor-si-to-unit=1, offset-si-to-unit=0
    U_cm: display-name=cm, factor-si-to-unit=1, offset-si-to-unit=0
    U_degreesYs: display-name=degrees/s, factor-si-to-unit=1, offset-si-to-unit=0
    U_kmYh: display-name=km/h, factor-si-to-unit=1, offset-si-to-unit=0
    U_kW: display-name=kW, factor-si-to-unit=1, offset-si-to-unit=0
    U_kWh: display-name=kWh, factor-si-to-unit=1, offset-si-to-unit=0
    U_min: display-name=min, factor-si-to-unit=1, offset-si-to-unit=0
    U_mm: display-name=mm, factor-si-to-unit=1, offset-si-to-unit=0
    U_mYsX2: display-name=m/s^2, factor-si-to-unit=1, offset-si-to-unit=0
    U_Nm: display-name=Nm, factor-si-to-unit=1, offset-si-to-unit=0
    U_SED: display-name=SED, factor-si-to-unit=1, offset-si-to-unit=0
    U_mV: display-name=mV, factor-si-to-unit=1, offset-si-to-unit=0
    U_ms: display-name=ms, factor-si-to-unit=1, offset-si-to-unit=0
    U_us: display-name=us, factor-si-to-unit=1, offset-si-to-unit=0
    U_Ah: display-name=Ah, factor-si-to-unit=1, offset-si-to-unit=0
    U_degrees: display-name=degrees, factor-si-to-unit=1, offset-si-to-unit=0
    U_Hz: display-name=Hz, factor-si-to-unit=1, offset-si-to-unit=0
    U_km: display-name=km, factor-si-to-unit=1, offset-si-to-unit=0
    U_kOhm: display-name=kOhm, factor-si-to-unit=1, offset-si-to-unit=0
    U_KWH: display-name=KWH, factor-si-to-unit=1, offset-si-to-unit=0
    U_LYmin: display-name=L/min, factor-si-to-unit=1, offset-si-to-unit=0
    U_NmYs: display-name=Nm/s, factor-si-to-unit=1, offset-si-to-unit=0
    U_rpm: display-name=rpm, factor-si-to-unit=1, offset-si-to-unit=0
    U_s: display-name=s, factor-si-to-unit=1, offset-si-to-unit=0
    U_w: display-name=w, factor-si-to-unit=1, offset-si-to-unit=0
    U_W: display-name=W, factor-si-to-unit=1, offset-si-to-unit=0
    U_0_0625V: display-name=0.0625V
    U_0_125_Ah: display-name=0.125 Ah
    U_0_5_Ah: display-name=0.5 Ah
    U_2X_10_V: display-name=2^(-10) V
    U_2X_8_A: display-name=2^(-8) A
    U_dC: display-name=?°C
    U_mA: display-name=mA
package /DataTypes
  78 x impl type:
    NvM_Array10Bytes: category=ARRAY, sw-calibration-access=READ-ONLY, type-emitter=RTE
      element Element: array-size=10, implementation-data-type=uint8
    NvM_Array32Bytes: category=ARRAY, sw-calibration-access=READ-ONLY, type-emitter=RTE
      element Element: array-size=32, implementation-data-type=uint8
    NvM_Arry4Bytes: category=ARRAY, sw-calibration-access=READ-ONLY, type-emitter=RTE
      element Element: array-size=4, implementation-data-type=uint8
    ECC_PMP2_SpdSet: category=VALUE, base-type=uint8, range raw 0..100
    ECC_PMP3_SpdSet: category=VALUE, base-type=uint8, range raw 0..100
    AN30: category=VALUE, base-type=sint16, range raw -32768..32767
    AN22: category=VALUE, base-type=sint16, range raw -32768..32767
    AN27: category=VALUE, base-type=sint16, range raw -32768..32767
    AN10: category=VALUE, base-type=sint16, range raw -32768..32767
    AN24: category=VALUE, base-type=sint16, range raw -32768..32767
    AN13: category=VALUE, base-type=sint16, range raw -32768..32767
    AN8: category=VALUE, base-type=sint16, range raw -32768..32767
    AN0: category=VALUE, base-type=sint16, range raw -32768..32767
    AN26: category=VALUE, base-type=sint16, range raw -32768..32767
    AN29: category=VALUE, base-type=sint16, range raw -32768..32767
    AN3: category=VALUE, base-type=sint16, range raw -32768..32767
    AN19: category=VALUE, base-type=sint16, range raw -32768..32767
    AN14: category=VALUE, base-type=sint16, range raw -32768..32767
    AN42: category=VALUE, base-type=sint16, range raw -32768..32767
    AN25: category=VALUE, base-type=sint16, range raw -32768..32767
    AN12: category=VALUE, base-type=sint16, range raw -32768..32767
    AN9: category=VALUE, base-type=sint16, range raw -32768..32767
    AN31: category=VALUE, base-type=sint16, range raw -32768..32767
    AN18: category=VALUE, base-type=sint16, range raw -32768..32767
    AN5: category=VALUE, base-type=sint16, range raw -32768..32767
    AN20: category=VALUE, base-type=sint16, range raw -32768..32767
    AN43: category=VALUE, base-type=sint16, range raw -32768..32767
    AN15: category=VALUE, base-type=sint16, range raw -32768..32767
    AN46: category=VALUE, base-type=sint16, range raw -32768..32767
    AN32: category=VALUE, base-type=sint16, range raw -32768..32767
    AN34: category=VALUE, base-type=sint16, range raw -32768..32767
    AN36: category=VALUE, base-type=sint16, range raw -32768..32767
    AN41: category=VALUE, base-type=sint16, range raw -32768..32767
    AN44: category=VALUE, base-type=sint16, range raw -32768..32767
    AN6: category=VALUE, base-type=sint16, range raw -32768..32767
    AN2: category=VALUE, base-type=sint16, range raw -32768..32767
    AN7: category=VALUE, base-type=sint16, range raw -32768..32767
    AN11: category=VALUE, base-type=sint16, range raw -32768..32767
    AN40: category=VALUE, base-type=sint16, range raw -32768..32767
    AN47: category=VALUE, base-type=sint16, range raw -32768..32767
    AN1: category=VALUE, base-type=sint16, range raw -32768..32767
    AN28: category=VALUE, base-type=sint16, range raw -32768..32767
    AN37: category=VALUE, base-type=sint16, range raw -32768..32767
    AN21: category=VALUE, base-type=sint16, range raw -32768..32767
    AN33: category=VALUE, base-type=sint16, range raw -32768..32767
    AN23: category=VALUE, base-type=sint16, range raw -32768..32767
    AN4: category=VALUE, base-type=sint16, range raw -32768..32767
    AN16: category=VALUE, base-type=sint16, range raw -32768..32767
    AN17: category=VALUE, base-type=sint16, range raw -32768..32767
    AN35: category=VALUE, base-type=sint16, range raw -32768..32767
    AN45: category=VALUE, base-type=sint16, range raw -32768..32767
    AN38: category=VALUE, base-type=sint16, range raw -32768..32767
    AN39: category=VALUE, base-type=sint16, range raw -32768..32767
    Tle888qk_Out23_En: category=VALUE, base-type=sint8, range raw -128..127
    Tle888qk_Out22_En: category=VALUE, base-type=sint8, range raw -128..127
    Tle888qk_Out21_En: category=VALUE, base-type=sint8, range raw -128..127
    Bts7xx_HS3_En: category=VALUE, base-type=sint8, range raw -128..127
    Bts7xx_HS1_En: category=VALUE, base-type=sint8, range raw -128..127
    Bts7xx_HS4_En: category=VALUE, base-type=sint8, range raw -128..127
    Bts7xx_HS2_En: category=VALUE, base-type=sint8, range raw -128..127
    Tle888qk_Out24_En: category=VALUE, base-type=sint8, range raw -128..127
    Tle9201_Dir: category=VALUE, base-type=sint8, range raw -128..127
    Tle9201_Pwm: category=VALUE, base-type=sint8, range raw -128..127
    Tle9201_Dis: category=VALUE, base-type=sint8, range raw -128..127
    Tle4252d_en: category=VALUE, base-type=sint8, range raw -128..127
    Tle888qk_Out22BriCfg: category=VALUE, base-type=sint8, range raw -128..127
    Tle888qk_Out23BriCfg: category=VALUE, base-type=sint8, range raw -128..127
    Tle888qk_Out21BriCfg: category=VALUE, base-type=sint8, range raw -128..127
    Tle888qk_Out24BriCfg: category=VALUE, base-type=sint8, range raw -128..127
    Ext_IN2: category=VALUE, base-type=sint8, range raw -128..127
    EXT_PWM_IN1_Duty: category=VALUE, base-type=sint8, range raw -128..127
    EXT_PWM_IN2_Duty: category=VALUE, base-type=sint8, range raw -128..127
    EXT_PWM_IN2_Period: category=VALUE, base-type=sint16, range raw -32768..32767
    EXT_PWM_IN1_Period: category=VALUE, base-type=sint16, range raw -32768..32767
    Tle888qk_Lout1_En: category=VALUE, base-type=sint8, range raw -128..127
    Tle888qk_Lout8_En: category=VALUE, base-type=sint8, range raw -128..127
    Tle888qk_Lout14_En: category=VALUE, base-type=sint8, range raw -128..127
    Tle888qk_Lout16_En: category=VALUE, base-type=sint8, range raw -128..127
