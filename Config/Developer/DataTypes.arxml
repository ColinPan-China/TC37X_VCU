AUTOSAR XML (schema 00046)
standard types defined: sint16, uint8, uint16
package /Predefined_DEV/ImplementationDataTypes
  impl type NvM_RequestResultType: compu {0=NVM_REQ_OK, 1=NVM_REQ_NOT_OK, 2=NVM_REQ_PENDING, 3=NVM_REQ_INTEGRITY_FAILED, 4=NVM_REQ_BLOCK_SKIPPED, 5=NVM_REQ_NV_INVALIDATED, 6=NVM_REQ_CANCELED, 7=NVM_REQ_REDUNDANCY_FAILED, 8=NVM_REQ_RESTORED_FROM_ROM}, implementation-data-type=uint8
  impl type NvM_ServiceIdType: compu {6=NVM_READ_BLOCK, 7=NVM_WRITE_BLOCK, 8=NVM_RESTORE_BLOCK_DEFAULTS, 9=NVM_ERASE_BLOCK, 11=NVM_INVALIDATE_NV_BLOCK, 12=NVM_READ_ALL}, implementation-data-type=uint8
  impl type Dem_UdsStatusByteType: compu {mask 1: 1=DEM_UDS_STATUS_TF, mask 2: 2=DEM_UDS_STATUS_TFTOC, mask 4: 4=DEM_UDS_STATUS_PDTC, mask 8: 8=DEM_UDS_STATUS_CDTC, mask 16: 16=DEM_UDS_STATUS_TNCSLC, mask 32: 32=DEM_UDS_STATUS_TFSLC, mask 64: 64=DEM_UDS_STATUS_TNCTOC, mask 128: 128=DEM_UDS_STATUS_WIR}, range raw 0..255, implementation-data-type=uint8
package /DataType/Constraint
  range DC_VcuAdcTxMsg1_Sig{0..3}: raw -32768..32767
  range DC_VcuAdcTxMsg2_Sig{0..3}: raw -32768..32767
  range DC_VcuRxMsg3_Sig{0..3}: raw -32768..32767
  range DC_VcuRxMsg4_Sig{0..3}: raw -32768..32767
  range DC_Vcu_Lin0_RxMsg1_Sig0: raw 0..255
  range DC_Vcu_Lin0_RxMsg1_Sig1: raw 0..255
  range DC_Vcu_Lin0_RxMsg2_Sig{0..3}: raw 0..255
  range DC_Vcu_Lin0_TxMsg1_Sig{0..3}: raw 0..255
  range DC_Vcu_Lin0_TxMsg2_Sig{0..3}: raw 0..255
package /DataType/Semantics
  compu method CM_VcuRxMsg1_Sig{0..3}: identical
  compu method CM_VcuRxMsg2_Sig{0..3}: identical
  compu method CM_VcuTxMsg1_Sig{0..3}: identical
  compu method CM_VcuTxMsg2_Sig{0..3}: identical
  compu method CM_VcuAdcTxMsg1_Sig{0..3}: identical
  compu method CM_VcuAdcTxMsg2_Sig{0..3}: identical
  compu method CM_VcuRxMsg3_Sig{0..3}: identical
  compu method CM_VcuRxMsg4_Sig{0..3}: identical
  compu method CM_Vcu_Lin0_RxMsg1_Sig0: identical
  compu method CM_Vcu_Lin0_RxMsg1_Sig1: identical
  compu method CM_Vcu_Lin0_RxMsg2_Sig{0..3}: identical
  compu method CM_Vcu_Lin0_TxMsg1_Sig{0..3}: identical
  compu method CM_Vcu_Lin0_TxMsg2_Sig{0..3}: identical
  compu method CM_EXT_A_IN{1..4}: identical
  compu method CM_EXT{1..4}_Valid: identical
  compu method CM_EXT_A_IN{10..16}: identical
  compu method CM_EXT_A_IN{5..9}: identical
  compu method CM_EXT{10..16}_Valid: identical
  compu method CM_EXT{5..9}_Valid: identical
package /DataType/Unit
  unit U_C: display-name=¡ãC, factor-si-to-unit=1, offset-si-to-unit=0
package /DataTypes
  51 x impl type:
    VcuRxMsg1_Sig0: category=VALUE, base-type=sint16, range raw -32768..32767
    VcuRxMsg1_Sig2: category=VALUE, base-type=sint16, range raw -32768..32767
    VcuRxMsg1_Sig1: category=VALUE, base-type=sint16, range raw -32768..32767
    VcuRxMsg2_Sig3: category=VALUE, base-type=sint16, range raw -32768..32767
    VcuRxMsg1_Sig3: category=VALUE, base-type=sint16, range raw -32768..32767
    VcuRxMsg2_Sig0: category=VALUE, base-type=sint16, range raw -32768..32767
    VcuRxMsg2_Sig2: category=VALUE, base-type=sint16, range raw -32768..32767
    VcuRxMsg2_Sig1: category=VALUE, base-type=sint16, range raw -32768..32767
    VcuTxMsg1_Sig1: category=VALUE, base-type=sint16, range raw -32768..32767
    VcuTxMsg2_Sig1: category=VALUE, base-type=sint16, range raw -32768..32767
    VcuTxMsg2_Sig2: category=VALUE, base-type=sint16, range raw -32768..32767
    VcuTxMsg1_Sig3: category=VALUE, base-type=sint16, range raw -32768..32767
    VcuTxMsg2_Sig0: category=VALUE, base-type=sint16, range raw -32768..32767
    VcuTxMsg2_Sig3: category=VALUE, base-type=sint16, range raw -32768..32767
    VcuTxMsg1_Sig2: category=VALUE, base-type=sint16, range raw -32768..32767
    VcuTxMsg1_Sig0: category=VALUE, base-type=sint16, range raw -32768..32767
    NvM_Array10Bytes: category=ARRAY, sw-calibration-access=READ-ONLY, type-emitter=RTE
      element Element: array-size=10, implementation-data-type=uint8
    NvM_Array32Bytes: category=ARRAY, sw-calibration-access=READ-ONLY, type-emitter=RTE
      element Element: array-size=32, implementation-data-type=uint8
    NvM_Arry4Bytes: category=ARRAY, sw-calibration-access=READ-ONLY, type-emitter=RTE
      element Element: array-size=4, implementation-data-type=uint8
    EXT1_Valid: category=VALUE, base-type=uint16, range raw 0..1
    EXT3_Valid: category=VALUE, base-type=uint16, range raw 0..1
    EXT_A_IN4: category=VALUE, base-type=sint16, range raw -32768..32767
    EXT2_Valid: category=VALUE, base-type=uint16, range raw 0..1
    EXT4_Valid: category=VALUE, base-type=uint16, range raw 0..1
    EXT_A_IN1: category=VALUE, base-type=sint16, range raw -256..255
    EXT_A_IN2: category=VALUE, base-type=sint16, range raw -32768..32767
    EXT_A_IN3: category=VALUE, base-type=sint16, range raw -256..255
    EXT10_Valid: category=VALUE, base-type=uint16, range raw 0..1
    EXT12_Valid: category=VALUE, base-type=uint16, range raw 0..1
    EXT15_Valid: category=VALUE, base-type=uint16, range raw 0..1
    EXT5_Valid: category=VALUE, base-type=uint16, range raw 0..1
    EXT_A_IN15: category=VALUE, base-type=sint16, range raw -256..255
    EXT7_Valid: category=VALUE, base-type=uint16, range raw 0..1
    EXT_A_IN13: category=VALUE, base-type=sint16, range raw -256..255
    EXT_A_IN5: category=VALUE, base-type=sint16, range raw -256..255
    EXT6_Valid: category=VALUE, base-type=uint16, range raw 0..1
    EXT_A_IN12: category=VALUE, base-type=sint16, range raw -32768..32767
    EXT_A_IN7: category=VALUE, base-type=sint16, range raw -256..255
    EXT13_Valid: category=VALUE, base-type=uint16, range raw 0..1
    EXT_A_IN9: category=VALUE, base-type=sint16, range raw -256..255
    EXT9_Valid: category=VALUE, base-type=uint16, range raw 0..1
    EXT8_Valid: category=VALUE, base-type=uint16, range raw 0..1
    EXT11_Valid: category=VALUE, base-type=uint16, range raw 0..1
    EXT_A_IN6: category=VALUE, base-type=sint16, range raw -32768..32767
    EXT16_Valid: category=VALUE, base-type=uint16, range raw 0..1
    EXT14_Valid: category=VALUE, base-type=uint16, range raw 0..1
    EXT_A_IN16: category=VALUE, base-type=sint16, range raw -32768..32767
    EXT_A_IN11: category=VALUE, base-type=sint16, range raw -256..255
    EXT_A_IN8: category=VALUE, base-type=sint16, range raw -32768..32767
    EXT_A_IN14: category=VALUE, base-type=sint16, range raw -32768..32767
    EXT_A_IN10: category=VALUE, base-type=sint16, range raw -32768..32767
