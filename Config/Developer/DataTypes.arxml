AUTOSAR XML (schema 00046)
standard types defined: sint16, uint8, uint16, boolean, sint8
package /Predefined_DEV/ImplementationDataTypes
  impl type NvM_RequestResultType: compu {0=NVM_REQ_OK, 1=NVM_REQ_NOT_OK, 2=NVM_REQ_PENDING, 3=NVM_REQ_INTEGRITY_FAILED, 4=NVM_REQ_BLOCK_SKIPPED, 5=NVM_REQ_NV_INVALIDATED, 6=NVM_REQ_CANCELED, 7=NVM_REQ_REDUNDANCY_FAILED, 8=NVM_REQ_RESTORED_FROM_ROM}, implementation-data-type=uint8
  impl type NvM_ServiceIdType: compu {6=NVM_READ_BLOCK, 7=NVM_WRITE_BLOCK, 8=NVM_RESTORE_BLOCK_DEFAULTS, 9=NVM_ERASE_BLOCK, 11=NVM_INVALIDATE_NV_BLOCK, 12=NVM_READ_ALL}, implementation-data-type=uint8
  impl type Dem_UdsStatusByteType: compu {mask 1: 1=DEM_UDS_STATUS_TF, mask 2: 2=DEM_UDS_STATUS_TFTOC, mask 4: 4=DEM_UDS_STATUS_PDTC, mask 8: 8=DEM_UDS_STATUS_CDTC, mask 16: 16=DEM_UDS_STATUS_TNCSLC, mask 32: 32=DEM_UDS_STATUS_TFSLC, mask 64: 64=DEM_UDS_STATUS_TNCTOC, mask 128: 128=DEM_UDS_STATUS_WIR}, range raw 0..255, implementation-data-type=uint8
package /DataType
  base type uint8_6_none: category=FIXED_LENGTH, base-type-size=8, base-type-encoding=NONE
package /DataType/Constraint
  range DC_VcuAdcTxMsg1_Sig{0..3}: raw -32768..32767
  range DC_VcuAdcTxMsg2_Sig{0..3}: raw -32768..32767
  range DC_VcuRxMsg3_Sig{0..3}: raw -32768..32767
  range DC_VcuRxMsg4_Sig{0..3}: raw -32768..32767
  range DC_Vcu_Lin0_RxMsg1_Sig0: raw 0..255
  range DC_Vcu_Lin0_RxMsg1_Sig1: raw 0..255
  range DC_Vcu_Lin0_RxMsg2_Sig{0..3}: raw 0..255
  range DC_Vcu_Lin0_TxMsg1_Sig{0..3}: raw 0..255
  range DC_Vcu_Lin0_TxMsg2_Sig{0..3}: raw 0..255
  range DC_Act_Pos_sta: raw 0..3600
  range DC_Blockage_Fault_STA: raw 0..1
  range DC_Breakage_Fault_STA: raw 0..1
  range DC_Calibration_cmd: raw 0..1
  range DC_Calibration_sta: raw 0..3
  range DC_EDCU_EXV2_Cmd_Init_Rq: raw 0..7
  range DC_EDCU_EXV2_Cmd_Move_Enbl: raw 0..1
  range DC_EDCU_EXV2_Cmd_Set_Rq: raw 0..576
  range DC_EXV1_CurrentInitState: raw 0..3
  range DC_EXV1_CurrentPosition: raw 0..500
  range DC_EXV1_FaultState: raw 0..4
  range DC_EXV1_ResponseError: raw 0..1
  range DC_EXV1_RunState: raw 0..1
  range DC_EXV1_TemperatureWarn: raw 0..1
  range DC_EXV1_VoltageState: raw 0..2
  range DC_EXV2_curInit_Stat: raw 0..3
  range DC_EXV2_CurrentInitState: raw 0..3
  range DC_EXV2_CurrentPosition: raw 0..500
  range DC_EXV2_Fault_Stat: raw 0..5
  range DC_EXV2_FaultState: raw 0..4
  range DC_EXV2_OvrTemp_Warn: raw 0..3
  range DC_EXV2_Pos: raw 0..576
  range DC_EXV2_ResponseError: raw 0..1
  range DC_EXV2_Run_Stat: raw 0..1
  range DC_EXV2_RunState: raw 0..1
  range DC_EXV2_TemperatureWarn: raw 0..1
  range DC_EXV2_Volt_Stat: raw 0..3
  range DC_EXV2_VoltageState: raw 0..2
  range DC_HVCH_CurrSens_Flt: raw 0..31
  range DC_HVCH_defectHeaterCircuits: raw 0..7
  range DC_HVCH_DutyCycle: raw 0..255
  range DC_HVCH_ExtPwrSup_Flt: raw 0..1
  range DC_HVCH_HV_DC_curr: raw 0..255
  range DC_HVCH_HV_voltage: raw 0..255
  range DC_HVCH_HV_Voltage_Valid: raw 0..3
  range DC_HVCH_IntelTemp: raw 0..255
  range DC_HVCH_InternalPCBTemp: raw 0..255
  range DC_HVCH_LIN_Flt: raw 0..1
  range DC_HVCH_MediumTemp: raw 0..255
  range DC_HVCH_Off_ShrtCurr: raw 0..1
  range DC_HVCH_RsErr: raw 0..1
  range DC_HVCH_Status: raw 0..7
  range DC_HVCH_TempLim: raw 0..1
  range DC_HVCH_TempSens_Flt: raw 0..1
  range DC_LIN_Resp_Error_sta: raw 0..1
  range DC_PMP2_PumpDryRunningSta: raw 0..1
  range DC_PMP2_PumpInputVolt: raw 0..30
  range DC_PMP2_PumpMotorSta: raw 0..3
  range DC_PMP2_PumpPowerSta: raw 0..3
  range DC_PMP2_PumpTempSta: raw 0..3
  range DC_PMP2_RealRPM: raw 0..100
  range DC_PMP2_RESP_ERROR: raw 0..1
  range DC_PMP3_PumpDryRunningSta: raw 0..1
  range DC_PMP3_PumpInputVolt: raw 0..30
  range DC_PMP3_PumpMotorSta: raw 0..3
  range DC_PMP3_PumpPowerSta: raw 0..3
  range DC_PMP3_PumpTempSta: raw 0..3
  range DC_PMP3_RealRPM: raw 0..100
  range DC_PMP3_RESP_ERROR: raw 0..1
  range DC_RsErr_EXV2: raw 0..1
  range DC_Target_Pos_cmd: raw 0..3600
  range DC_TCU_HVCH_heating_rq: raw 0..100
  range DC_TCU_HVCH_On_Rq: raw 0..3
  range DC_TCU_HVCH_TmaxLim_output: raw 0..255
  range DC_TCU_HVCHMaxPowerLimit: raw 0..255
  range DC_TMM_EXV1_EnableRequest: raw 0..1
  range DC_TMM_EXV1_initRequest: raw 0..7
  range DC_TMM_EXV1_PositionRequest: raw 0..500
  range DC_TMM_EXV2_EnableRequest: raw 0..1
  range DC_TMM_EXV2_initRequest: raw 0..7
  range DC_TMM_EXV2_PositionRequest: raw 0..500
  range DC_A_I_Actuator_With_F_B_request: raw 0..2
  range DC_A_I_F_B: raw 0..50
  range DC_COMP_Pdis: raw 0..50
  range DC_COMP_Psuc: raw 0..50
  range DC_COMP_Tdis: raw 0..50
  range DC_COMP_Tsuc: raw 0..50
  range DC_COOLING_FAN_request: raw 0..100
  range DC_HVAC_Blower_request: raw 0..100
  range DC_Mode_Actuator_request: raw 0..2
  range DC_MODE_F_B: raw 0..50
  range DC_SV{1..3}_request: raw 0..1
  range DC_Tamb: raw 0..50
  range DC_Tevap_Tchiller_out: raw 0..50
  range DC_Tincar: raw 0..50
  range DC_Tohx_in: raw 0..50
  range DC_Tohx_out: raw 0..50
  range DC_VcuCan12RxMsg3_Sig{0..3}: raw -32768..32767
  range DC_VcuCan12RxMsg4_Sig{0..3}: raw -32768..32767
  range DC_VcuCan12TxMsg1_Sig{0..3}: raw -32768..32767
  range DC_VcuCan12TxMsg2_Sig{0..3}: raw -32768..32767
  range DC_VCU_Tx_51Ch_NM_UserData: raw 0..281474976710655
  range DC_ACU_CrashOutputSts: raw 0..31
  range DC_ACU_CrashOutputStsValid: raw 0..1
  range DC_ACU_DriverSeatBeltSts: raw 0..1
  range DC_ACU_DriverSeatBeltStsValid: raw 0..1
  range DC_ACU_DriverWarningLampSts: raw 0..2
  range DC_ACU_LatA: raw 0..16383
  range DC_ACU_LatAStatus: raw 0..3
  range DC_ACU_LgtA: raw 0..16383
  range DC_ACU_LgtAStatus: raw 0..3
  range DC_ACU_PassengerAirbagSts: raw 0..3
  range DC_ACU_PassengerSeatBeltSts: raw 0..1
  range DC_ACU_PassengerSeatBeltStsValid: raw 0..1
  range DC_ACU_PassengerSts: raw 0..1
  range DC_ACU_PassengerWarningLampSts: raw 0..2
  range DC_ACU_RLSeatBeltStatusValid: raw 0..1
  range DC_ACU_RRSeatBeltStatusValid: raw 0..1
  range DC_ACU_SecondLeftSeatBeltSts: raw 0..1
  range DC_ACU_SecondLeftSts: raw 0..1
  range DC_ACU_SecondRightSeatBeltSts: raw 0..1
  range DC_ACU_SecondRightSts: raw 0..1
  range DC_ACU_WarningLampSts: raw 0..2
  range DC_ACU_YawRate: raw 0..65535
  range DC_ACU_YawRateStatus: raw 0..3
  range DC_ADCU_ACC_Mode: raw 0..7
  range DC_ADCU_ACCDA_HandsOFF_Warning: raw 0..7
  range DC_ADCU_ACCDA_SYS_Failure: raw 0..3
  range DC_ADCU_AEB_AWB_Level: raw 0..5
  range DC_ADCU_AEB_AWB_Req: raw 0..1
  range DC_ADCU_AEB_Decel_Cmd: raw 0..511
  range DC_ADCU_AEB_Prefill_CMD: raw 0..1
  range DC_ADCU_AEB_State: raw 0..3
  range DC_ADCU_AEB_Stop_Req: raw 0..1
  range DC_ADCU_AEBReq: raw 0..1
  range DC_ADCU_AEBWarningSts: raw 0..7
  range DC_ADCU_APS_Stop_Req: raw 0..2
  range DC_ADCU_APSComfBrkReq: raw 0..2
  range DC_ADCU_APSCrlModeReq: raw 0..3
  range DC_ADCU_APSCrlReq: raw 0..2
  range DC_ADCU_APSCrlTypReq: raw 0..3
  range DC_ADCU_APSDistanceStop: raw 0..4095
  range DC_ADCU_APSMaxSpeedReq: raw 0..31
  range DC_ADCU_DA_Mode: raw 0..7
  range DC_ADCU_FCW_State: raw 0..3
  range DC_ADCU_Parking_CtrlSts: raw 0..3
  range DC_ADCU_Parking_Mode: raw 0..15
  range DC_ADCU_RemoteParkingMode: raw 0..15
  range DC_ADCU_TargetGear: raw 0..4
  range DC_Checksum_090: raw 0..255
  range DC_Checksum_094: raw 0..255
  range DC_Checksum_095: raw 0..255
  range DC_Checksum_097: raw 0..255
  range DC_Checksum_0B{0..4}: raw 0..255
  range DC_Checksum_0B{7..9}: raw 0..255
  range DC_Checksum_0BA: raw 0..255
  range DC_Checksum_0BC: raw 0..255
  range DC_Checksum_0D{1..3}: raw 0..255
  range DC_Checksum_0E0: raw 0..255
  range DC_Checksum_0E2: raw 0..255
  range DC_Checksum_0E4: raw 0..255
  range DC_Checksum_0E6: raw 0..255
  range DC_Checksum_0F5: raw 0..255
  range DC_Checksum_0F6: raw 0..255
  range DC_Checksum_317: raw 0..255
  range DC_Checksum_318: raw 0..255
  range DC_IBS_ABPActive: raw 0..1
  range DC_IBS_ABPAvailable: raw 0..1
  range DC_IBS_ABSActive: raw 0..1
  range DC_IBS_ABSFault: raw 0..1
  range DC_IBS_AEBActive: raw 0..1
  range DC_IBS_AEBAvailable: raw 0..1
  range DC_IBS_APS_Avl: raw 0..3
  range DC_IBS_APSComfortAvl: raw 0..3
  range DC_IBS_APSCrlReqEcho: raw 0..3
  range DC_IBS_APSEmergenyAvl: raw 0..3
  range DC_IBS_APSModeEcho: raw 0..3
  range DC_IBS_APSTrqReqActive: raw 0..1
  range DC_IBS_AVHAvailable: raw 0..1
  range DC_IBS_AVHSts: raw 0..2
  range DC_IBS_AWBActive: raw 0..1
  range DC_IBS_AWBAvailable: raw 0..1
  range DC_IBS_BrakeFluidWarning: raw 0..3
  range DC_IBS_BrakeLightRequest: raw 0..3
  range DC_IBS_BrakePedalStatus: raw 0..3
  range DC_IBS_BrakePedalStatusValid: raw 0..1
  range DC_IBS_BrakePushrodStroke: raw 0..2047
  range DC_IBS_BrakeTypEcho: raw 0..3
  range DC_IBS_CddActive: raw 0..1
  range DC_IBS_CddAvailable: raw 0..1
  range DC_IBS_CddError: raw 0..1
  range DC_IBS_CDPActive: raw 0..1
  range DC_IBS_CDPAvailable: raw 0..1
  range DC_IBS_DTCActive: raw 0..1
  range DC_IBS_DTCFault: raw 0..1
  range DC_IBS_EBDActive: raw 0..1
  range DC_IBS_EBDFault: raw 0..1
  range DC_IBS_EPBControllerSts: raw 0..1
  range DC_IBS_EPBFailureLamp: raw 0..1
  range DC_IBS_EPBFailureStatus: raw 0..3
  range DC_IBS_EPBFunctionLamp: raw 0..3
  range DC_IBS_EPBTextdisplay: raw 0..4
  range DC_IBS_EPBworkingSts: raw 0..7
  range DC_IBS_ESClampdisplay: raw 0..2
  range DC_IBS_ESCOffSts: raw 0..1
  range DC_IBS_FactoryMode: raw 0..1
  range DC_IBS_FLMovingDirection: raw 0..2
  range DC_IBS_FLWheelPulseCounter: raw 0..255
  range DC_IBS_FLWheelSpeed: raw 0..6400
  range DC_IBS_FLWheelSpeed_Fault: raw 0..1
  range DC_IBS_FRMovingDirection: raw 0..2
  range DC_IBS_FRWheelPulseCounter: raw 0..255
  range DC_IBS_FRWheelSpeed: raw 0..6400
  range DC_IBS_FRWheelSpeed_Fault: raw 0..1
  range DC_IBS_HazWarnReq: raw 0..2
  range DC_IBS_HBAActive: raw 0..1
  range DC_IBS_HDCAvailable: raw 0..1
  range DC_IBS_HDCSts: raw 0..2
  range DC_IBS_HHCActive: raw 0..1
  range DC_IBS_HHCAvailable: raw 0..1
  range DC_IBS_MaintenaceMode: raw 0..1
  range DC_IBS_MasterCylinderPressure: raw 0..2500
  range DC_IBS_PlungerPressure: raw 0..2047
  range DC_IBS_RBSStatus: raw 0..1
  range DC_IBS_RLMovingDirection: raw 0..2
  range DC_IBS_RLWheelPulseCounter: raw 0..255
  range DC_IBS_RLWheelSpeed: raw 0..6400
  range DC_IBS_RLWheelSpeed_Fault: raw 0..1
  range DC_IBS_RollerbenchMode: raw 0..1
  range DC_IBS_RRMovingDirection: raw 0..2
  range DC_IBS_RRWheelPulseCounter: raw 0..255
  range DC_IBS_RRWheelSpeed: raw 0..6400
  range DC_IBS_RRWheelSpeed_Fault: raw 0..1
  range DC_IBS_RWUActive: raw 0..1
  range DC_IBS_RWUAvailable: raw 0..1
  range DC_IBS_SystemStatus: raw 0..7
  range DC_IBS_TargetGearReq: raw 0..4
  range DC_IBS_TCSActive: raw 0..1
  range DC_IBS_TCSFault: raw 0..1
  range DC_IBS_TireMonSysSts: raw 0..1
  range DC_IBS_TireWarnFrntLe: raw 0..1
  range DC_IBS_TireWarnFrntRi: raw 0..1
  range DC_IBS_TireWarnReLe: raw 0..1
  range DC_IBS_TireWarnReRi: raw 0..1
  range DC_IBS_TPMS_ResetSts: raw 0..1
  range DC_IBS_VCU_DecelerationReqActive: raw 0..1
  range DC_IBS_VCU_DecelerationRequest_Available: raw 0..3
  range DC_IBS_VDCActive: raw 0..1
  range DC_IBS_VDCFault: raw 0..1
  range DC_IBS_VehicleSpeed: raw 0..6400
  range DC_IBS_VehicleSpeedValid: raw 0..1
  range DC_IBS_VehicleStandstill: raw 0..2
  range DC_IBS_VehicleStandstill_Valid: raw 0..1
  range DC_IBS_VlcActive: raw 0..1
  range DC_IBS_VlcAvalible: raw 0..1
  range DC_IBS_VlcError: raw 0..1
  range DC_IBS_WLTorqueAPSReq: raw 0..40000
  range DC_IBS_WLTorqueAPSReqValid: raw 0..2
  range DC_IBS_WLTorqueIncrReq: raw 0..40000
  range DC_IBS_WLTorqueIncrReqSts: raw 0..1
  range DC_IBS_WLTorqueRBSReq: raw 0..40000
  range DC_IBS_WLTorqueRBSReqValid: raw 0..2
  range DC_IBS_WLTorqueRedReq: raw 0..40000
  range DC_IBS_WLTorqueRedReqSts: raw 0..1
  range DC_IBS_WLTorqueVLCReq: raw 0..32767
  range DC_IBS_WLTorqueVLCReqValid: raw 0..2
  range DC_MessageCounter_090: raw 0..15
  range DC_MessageCounter_094: raw 0..15
  range DC_MessageCounter_095: raw 0..15
  range DC_MessageCounter_097: raw 0..15
  range DC_MessageCounter_0B{0..4}: raw 0..15
  range DC_MessageCounter_0B{7..9}: raw 0..15
  range DC_MessageCounter_0BA: raw 0..15
  range DC_MessageCounter_0BC: raw 0..15
  range DC_MessageCounter_0D{1..3}: raw 0..15
  range DC_MessageCounter_0E0: raw 0..15
  range DC_MessageCounter_0E2: raw 0..15
  range DC_MessageCounter_0E4: raw 0..15
  range DC_MessageCounter_0E6: raw 0..15
  range DC_MessageCounter_0F5: raw 0..15
  range DC_MessageCounter_0F6: raw 0..15
  range DC_MessageCounter_317: raw 0..15
  range DC_MessageCounter_318: raw 0..15
  range DC_SGW_BLEChrgFlaplockCtrlReq: raw 0..3
  range DC_SGW_BLEPowerModeReq: raw 0..3
  range DC_SGW_BLESystemReadyReq: raw 0..3
  range DC_SGW_BLETailgateCtrlReq: raw 0..3
  range DC_SGW_KeyLowBatWarning: raw 0..1
  range DC_VCU_AccelerationPedal: raw 0..1000
  range DC_VCU_AccelerationPedalValid: raw 0..1
  range DC_VCU_ActDriveMode: raw 0..4
  range DC_VCU_ActualGear: raw 0..4
  range DC_VCU_ADASOverride: raw 0..1
  range DC_VCU_APSTorqueRequestActive: raw 0..1
  range DC_VCU_APSTorqueRequestAvailable: raw 0..1
  range DC_VCU_BMS_Control_of_PosRelay: raw 0..2
  range DC_VCU_BMSTargetThermLevel: raw 0..3
  range DC_VCU_BrakeCompensateStatus: raw 0..3
  range DC_VCU_BrakeCompensateWarn: raw 0..3
  range DC_VCU_BrakepedalStatus: raw 0..2
  range DC_VCU_BS_Current: raw 0..16383
  range DC_VCU_BS_IBSBatSOC: raw 0..255
  range DC_VCU_BS_IndicatorSts: raw 0..1
  range DC_VCU_BS_LV_Batt: raw 0..32767
  range DC_VCU_ChargeEndReason: raw 0..3
  range DC_VCU_ChargeProcessComment: raw 0..3
  range DC_VCU_ChargeStatus: raw 0..14
  range DC_VCU_CriSysFailure: raw 0..3
  range DC_VCU_DCDCFail: raw 0..1
  range DC_VCU_DCFCCurrent: raw 0..1023
  range DC_VCU_DecelerationReq: raw 0..255
  range DC_VCU_DecelerationReqactive: raw 0..1
  range DC_VCU_DischargeEndReason: raw 0..3
  range DC_VCU_DischargeEndSoc: raw 0..255
  range DC_VCU_Display_Cur: raw 0..1023
  range DC_VCU_Display_Power: raw 0..4095
  range DC_VCU_DriveMotOvrTemp: raw 0..1
  range DC_VCU_DriverTorqueRequest: raw 0..2045
  range DC_VCU_DrvModSwitchWarn: raw 0..7
  range DC_VCU_EnergyManagementWarn: raw 0..3
  range DC_VCU_EnergyV2L: raw 0..1023
  range DC_VCU_EPBReq: raw 0..3
  range DC_VCU_ForwardVmaxAllowed: raw 0..255
  range DC_VCU_ForwardVmaxlimitStatus: raw 0..1
  range DC_VCU_HVBatCriFail: raw 0..3
  range DC_VCU_HVBatOvrTemp: raw 0..1
  range DC_VCU_HVConnectFault: raw 0..1
  range DC_VCU_HVILError: raw 0..1
  range DC_VCU_HVInsulResFault: raw 0..1
  range DC_VCU_HVStatus: raw 0..5
  range DC_VCU_InvldGearSel: raw 0..15
  range DC_VCU_IsoMeasurementSwitch: raw 0..1
  range DC_VCU_Kickdown: raw 0..1
  range DC_VCU_KL15eOn: raw 0..1
  range DC_VCU_LimitLevel: raw 0..3
  range DC_VCU_LimpHome: raw 0..1
  range DC_VCU_ManuallyUnlockComment: raw 0..1
  range DC_VCU_maxChargeSOC: raw 0..255
  range DC_VCU_MCU_FaultLampReq: raw 0..3
  range DC_VCU_MCUDesiredTorque: raw 0..2047
  range DC_VCU_MCUSurgeDamperState: raw 0..2
  range DC_VCU_MemoryChargeFault: raw 0..1
  range DC_VCU_MileagelowRemind: raw 0..1
  range DC_VCU_MotorActualTorque: raw 0..2047
  range DC_VCU_MotorActualTorqueValid: raw 0..1
  range DC_VCU_OPStandstillReq: raw 0..3
  range DC_VCU_PlugStatus: raw 0..7
  range DC_VCU_PWTErrorLevel: raw 0..15
  range DC_VCU_ReachLimitStd: raw 0..1
  range DC_VCU_RegenBrakeLightRequest: raw 0..1
  range DC_VCU_RegenBrakeLightReqVld: raw 0..1
  range DC_VCU_RegenTorqueCap: raw 0..40000
  range DC_VCU_RegenTorqueCapValid: raw 0..1
  range DC_VCU_RegStatus: raw 0..7
  range DC_VCU_RemainChrgTime: raw 0..3600
  range DC_VCU_RequestedModeBMS: raw 0..7
  range DC_VCU_RequestedModeMCU: raw 0..4
  range DC_VCU_SystemReady: raw 0..1
  range DC_VCU_TargetGear: raw 0..4
  range DC_VCU_TCSActive: raw 0..1
  range DC_VCU_TorqueRequestActive: raw 0..1
  range DC_VCU_TorqueRequestAvailable: raw 0..1
  range DC_VCU_TrqThresholdDampgCtl: raw 0..255
  range DC_VCU_VehicleSpeed: raw 0..6400
  range DC_VCU_VehicleSpeedValid: raw 0..1
  range DC_VCU_VirtualACPedal: raw 0..1000
  range DC_VCU_VirtualACPedalValid: raw 0..1
  range DC_VCU_VLCTorqueRequestActive: raw 0..1
  range DC_VCU_VLCTorqueRequestAvailable: raw 0..1
  range DC_VCU_WakeUpStatus: raw 0..255
  range DC_VCU_WheelTrqACT: raw 0..40000
  range DC_VCU_WheelTrqACTValid: raw 0..1
  range DC_Vcu_Lin3_RxMsg1_Sig0: raw 0..255
  range DC_Vcu_Lin3_RxMsg1_Sig1: raw 0..255
  range DC_Vcu_Lin3_RxMsg2_Sig{0..3}: raw 0..255
  range DC_Vcu_Lin3_TxMsg1_Sig{0..3}: raw 0..255
  range DC_Vcu_Lin3_TxMsg2_Sig{0..3}: raw 0..255
package /DataType/Semantics
  compu method CM_VcuRxMsg1_Sig{0..3}: identical
  compu method CM_VcuRxMsg2_Sig{0..3}: identical
  compu method CM_VcuTxMsg1_Sig{0..3}: identical
  compu method CM_VcuTxMsg2_Sig{0..3}: identical
  compu method CM_VcuAdcTxMsg1_Sig{0..3}: identical
  compu method CM_VcuAdcTxMsg2_Sig{0..3}: identical
  compu method CM_VcuRxMsg3_Sig{0..3}: identical
  compu method CM_VcuRxMsg4_Sig{0..3}: identical
  compu method CM_Vcu_Lin0_RxMsg1_Sig0: identical
  compu method CM_Vcu_Lin0_RxMsg1_Sig1: identical
  compu method CM_Vcu_Lin0_RxMsg2_Sig{0..3}: identical
  compu method CM_Vcu_Lin0_TxMsg1_Sig{0..3}: identical
  compu method CM_Vcu_Lin0_TxMsg2_Sig{0..3}: identical
  compu method CM_EXT_A_IN{1..4}: identical
  compu method CM_EXT{1..4}_Valid: identical
  compu method CM_EXT_A_IN{10..16}: identical
  compu method CM_EXT_A_IN{5..9}: identical
  compu method CM_EXT{10..16}_Valid: identical
  compu method CM_EXT{5..9}_Valid: identical
  compu method CM_Act_Pos_sta: phys=raw*0.1-5 for raw 0..3600; unit Degree
  compu method CM_Blockage_Fault_STA: 0=Cx0_False, 1=Cx1_True
  compu method CM_Breakage_Fault_STA: 0=Cx0_False, 1=Cx1_True
  compu method CM_Calibration_cmd: 0=Cx0_Normal, 1=Cx1_SVA_performs_calibration (SVA performs calibration)
  compu method CM_Calibration_sta: 0=Cx0_not_calibration (not calibration), 1=Cx1_calibration_ongoing (calibration ongoing), 2=Cx2_calibration_finished (calibration finished), 3=Cx3_calibration_failed (calibration failed)
  compu method CM_ECC_PMP2_SpdSet: phys=raw*0.4 for raw 0..100; unit %
  compu method CM_ECC_PMP3_SpdSet: phys=raw*0.4 for raw 0..100; unit %
  compu method CM_EDCU_EXV2_Cmd_Init_Rq: 0=Cx0_NO_RQ, 1=Cx1_START_INIT_SQC, 2=Cx2_WAIT_SQC_FINISH
  compu method CM_EDCU_EXV2_Cmd_Move_Enbl: 0=Cx0_DSABL, 1=Cx1_ENBL
  compu method CM_EDCU_EXV2_Cmd_Set_Rq: identical
  compu method CM_EXV1_CurrentInitState: 0=Cx0_NO_INIT, 1=Cx1_INIT_IN_PROCESS, 2=Cx2_Initialized
  compu method CM_EXV1_CurrentPosition: identical
  compu method CM_EXV1_FaultState: 0=Cx0_No_Fault (No Fault), 1=Cx1_COIL_SHRT, 2=Cx2_COIL_OPN, 3=Cx3_Over_temp_shut_down (Over temp shut down), 4=Cx4_Reserved
  compu method CM_EXV1_ResponseError: 0=Cx0_No_Comm_Error (No Comm Error), 1=Cx1_Comm_Error_Active (Comm Error Active)
  compu method CM_EXV1_RunState: 0=Cx0_NO_MOVEMENT, 1=Cx1_ACT_MOVING
  compu method CM_EXV1_TemperatureWarn: 0=Cx0_OK_, 1=Cx1_WARNING
  compu method CM_EXV1_VoltageState: 0=Cx0_Voltage_Range_OK_ (Voltage Range OK), 1=Cx1_Over_Voltage_ (Over Voltage), 2=Cx2_Under_Voltage (Under Voltage)
  compu method CM_EXV2_curInit_Stat: 0=Cx0_NO_INIT, 1=Cx1_INIT_IN_PROCESS, 2=Cx2_INIT_READY, 3=Cx3_Invalid
  compu method CM_EXV2_CurrentInitState: 0=Cx0_NO_INIT, 1=Cx1_INIT_IN_PROCESS, 2=Cx2_Initialized
  compu method CM_EXV2_CurrentPosition: identical
  compu method CM_EXV2_Fault_Stat: 0=Cx0_Actuator_Not_Faulted (Actuator Not Faulted), 1=Cx1_Motor_Coil_shorted (Motor-Coil shorted), 2=Cx2_Motor_Coil_open_load (Motor-Coil open load), 3=Cx3_Over_temperature_shutdown (Over temperature shutdown), 4=Cx4_not_defined (not defined), 5=Cx5_Motor_Stall_ (Motor_Stall?????????)  # Source signal range: [0,4]
  compu method CM_EXV2_FaultState: 0=Cx0_No_Fault (No Fault), 1=Cx1_COIL_SHRT, 2=Cx2_COIL_OPN, 3=Cx3_Over_temp_shut_down (Over temp shut down), 4=Cx4_Reserved
  compu method CM_EXV2_OvrTemp_Warn: 0=Cx0_Ok, 1=Cx1_High_Temperature_Warning (High Temperature Warning), 2=Cx2_not_defined (not defined), 3=Cx3_not_defined (not defined)  # Source signal range: [0,1]
  compu method CM_EXV2_Pos: identical
  compu method CM_EXV2_ResponseError: 0=Cx0_No_Comm_Error (No Comm Error), 1=Cx1_Comm_Error_Active (Comm Error Active)
  compu method CM_EXV2_Run_Stat: 0=Cx0_NO_MOVEMENT, 1=Cx1_ACT_MOVING
  compu method CM_EXV2_RunState: 0=Cx0_NO_MOVEMENT, 1=Cx1_ACT_MOVING
  compu method CM_EXV2_TemperatureWarn: 0=Cx0_OK_, 1=Cx1_WARNING
  compu method CM_EXV2_Volt_Stat: 0=Cx0_VOLT_RANGE_OK, 1=Cx1_OVERVOLTAGE, 2=Cx2_UNDERVOLTAGE, 3=Cx3_not_defined (not defined)  # Source signal range: [0,2]
  compu method CM_EXV2_VoltageState: 0=Cx0_Voltage_Range_OK_ (Voltage Range OK), 1=Cx1_Over_Voltage_ (Over Voltage), 2=Cx2_Under_Voltage (Under Voltage)
  compu method CM_HVCH_CurrSens_Flt: 0=Cx00_Diagnostic_pending (Diagnostic pending), 1=Cx01_Diagnostic_passed (Diagnostic passed), 2=Cx02_0x2_0x1F_Reserve (0x2~0x1F, Reserve)
  compu method CM_HVCH_defectHeaterCircuits: 0=Cx0_No_defect (No defect), 1=Cx1_Leg_1_defect (Leg 1 defect), 2=Cx2_Leg_2_defect (Leg 2 defect), 3=Cx3_Leg_1_2_defect (Leg 1 + 2 defect), 4=Cx4_Leg_3_defect (Leg 3 defect), 5=Cx5_Leg_1_3_defect (Leg 1 + 3 defect), 6=Cx6_Leg_2_3_defect (Leg 2 + 3 defect), 7=Cx7_Leg_1_2_3_defect (Leg 1 + 2 + 3 defect)
  compu method CM_HVCH_DutyCycle: 0=Cx00_0x00_0x96_Valid_value (0x00~0x96, Valid value), 255=CxFF_invalid, phys=raw-50 for raw 1..150; unit percent  # Source signal range: [0,150]
  compu method CM_HVCH_ExtPwrSup_Flt: 0=Cx0_Battery_voltage_okay (Battery voltage okay), 1=Cx1_Battery_voltage_off (Battery voltage off)
  compu method CM_HVCH_HV_DC_curr: 0=Cx00_0x00_0xFE_Valid_value (0x00~0xFE, Valid value), 255=CxFF_invalid, phys=raw*0.25 for raw 1..254; unit A  # Source signal range: [0,254]
  compu method CM_HVCH_HV_voltage: 0=Cx00_0x00_0xFE_Valid_value (0x00~0xFE, Valid value), 255=CxFF_invalid, phys=raw*2 for raw 1..254; unit V  # Source signal range: [0,254]
  compu method CM_HVCH_HV_Voltage_Valid: 0=Cx0_NO_HV_detected (NO HV detected), 1=Cx1_HV_valid (HV valid), 2=Cx2_Under_Voltage (Under Voltage), 3=Cx3_Over_Voltage (Over Voltage)
  compu method CM_HVCH_IntelTemp: 0=Cx00_0x00_0xFE_Valid_value (0x00~0xFE, Valid value), 255=CxFF_invalid, phys=raw-50 for raw 1..254; unit celsius  # Source signal range: [0,254]
  compu method CM_HVCH_InternalPCBTemp: 0=Cx00_0x00_0xFE_Valid_value (0x00~0xFE, Valid value), 255=CxFF_invalid, phys=raw-50 for raw 1..254  # Source signal range: [0,254]
  compu method CM_HVCH_LIN_Flt: 0=Cx0_No_LIN_timeout_detected (No LIN timeout detected), 1=Cx1_LIN_timeout_active (LIN timeout active)
  compu method CM_HVCH_MediumTemp: 0=Cx00_0x00_0xFE_Valid_value (0x00~0xFE, Valid value), 255=CxFF_invalid, phys=raw-50 for raw 1..254; unit celsius  # Source signal range: [0,254]
  compu method CM_HVCH_Off_ShrtCurr: 0=Cx0_No_short_detected (No short detected), 1=Cx1_Short_detected (Short detected)
  compu method CM_HVCH_RsErr: 0=Cx0_No_LIN_response_error_detected (No LIN response error detected), 1=Cx1_LIN_response_error_active (LIN response error active)
  compu method CM_HVCH_Status: 0=Cx0_HV_PTC_off_HVCH_OFF (HV PTC off / HVCH_OFF), 1=Cx1_HV_PTC_on_HVCH_ON (HV PTC on / HVCH_ON), 2=Cx2_0x2_0x7_SNA (0x2~0x7, SNA)
  compu method CM_HVCH_TempLim: 0=Cx0_No_over_temperature_detected (No over temperature detected), 1=Cx1_Over_temp_situation_active (Over temp. situation active)
  compu method CM_HVCH_TempSens_Flt: 0=Cx0_No_fault (No fault), 1=Cx1_fault
  compu method CM_LIN_Resp_Error_sta: 0=Cx0_False, 1=Cx1_True
  compu method CM_PMP2_PumpDryRunningSta: 0=Cx0_Normal, 1=Cx1_DryRun
  compu method CM_PMP2_PumpInputVolt: phys=raw*0.1 for raw 0..30; unit V
  compu method CM_PMP2_PumpMotorSta: 0=Cx0_Normal, 1=Cx1_ShortCircuit, 2=Cx2_OpenCircuit, 3=Cx3_Stall
  compu method CM_PMP2_PumpPowerSta: 0=Cx0_Normal, 1=Cx1_OverVol, 2=Cx2_BelowVol, 3=Cx3_Reserved
  compu method CM_PMP2_PumpTempSta: 0=Cx0_Normal, 1=Cx1_OverTempReduction, 2=Cx2_OverTempShutDown, 3=Cx3_Reserved
  compu method CM_PMP2_RealRPM: phys=raw*0.4 for raw 0..100; unit %
  compu method CM_PMP2_RESP_ERROR: 0=Cx0_Normal, 1=Cx1_Error
  compu method CM_PMP3_PumpDryRunningSta: 0=Cx0_Normal, 1=Cx1_DryRun
  compu method CM_PMP3_PumpInputVolt: phys=raw*0.1 for raw 0..30; unit V
  compu method CM_PMP3_PumpMotorSta: 0=Cx0_Normal, 1=Cx1_ShortCircuit, 2=Cx2_OpenCircuit, 3=Cx3_Stall
  compu method CM_PMP3_PumpPowerSta: 0=Cx0_Normal, 1=Cx1_OverVol, 2=Cx2_BelowVol, 3=Cx3_Reserved
  compu method CM_PMP3_PumpTempSta: 0=Cx0_Normal, 1=Cx1_OverTempReduction, 2=Cx2_OverTempShutDown, 3=Cx3_Reserved
  compu method CM_PMP3_RealRPM: phys=raw*0.4 for raw 0..100; unit %
  compu method CM_PMP3_RESP_ERROR: 0=Cx0_Normal, 1=Cx1_Error
  compu method CM_RsErr_EXV2: 0=Cx0_NO_COMM_ERROR (NO COMM ERROR), 1=Cx1_COMM_ERROR_DETECTED (COMM ERROR DETECTED)
  compu method CM_Target_Pos_cmd: phys=raw*0.1-5 for raw 0..3600; unit Degree
  compu method CM_TCU_HVCH_heating_rq: 0=Cx00_Level0, 1=Cx01_Level1, 2=Cx02_Level2, 3=Cx03_Level3, 4=Cx04_Level4, 5=Cx05_Level5, 6=Cx06_Level6, 7=Cx07_Reserve; unit percent
  compu method CM_TCU_HVCH_On_Rq: 0=Cx0_PTC_OFF, 1=Cx1_PTC_ON, 2=Cx2_reserved_RES (reserved / RES), 3=Cx3_SNA
  compu method CM_TCU_HVCH_TmaxLim_output: 0=Cx00_0x00_0xFE_Valid_value (0x00~0xFE, Valid value), 255=CxFF_invalid, phys=raw-50 for raw 1..254; unit celsius  # Source signal range: [0,254]
  compu method CM_TCU_HVCHMaxPowerLimit: 0=Cx00_0x00_0xFE_Valid_value (0x00~0xFE, Valid value), 255=CxFF_invalid, phys=raw*0.04 for raw 1..254; unit KW  # Source signal range: [0,254]
  compu method CM_TMM_EXV1_EnableRequest: 0=Cx0_EXVNotEnable, 1=Cx1_EXVEnable
  compu method CM_TMM_EXV1_initRequest: 0=Cx0_NO_RQ, 1=Cx1_InitializationReq_, 2=Cx2_waiting_for_Sequence_to_finish (waiting for Sequence to finish)
  compu method CM_TMM_EXV1_PositionRequest: identical
  compu method CM_TMM_EXV2_EnableRequest: 0=Cx0_EXVNotEnable, 1=Cx1_EXVEnable
  compu method CM_TMM_EXV2_initRequest: 0=Cx0_NO_RQ, 1=Cx1_InitializationReq_, 2=Cx2_waiting_for_Sequence_to_finish (waiting for Sequence to finish)
  compu method CM_TMM_EXV2_PositionRequest: identical
  compu method CM_A_I_Actuator_With_F_B_request: 0=Cx0_Stop, 1=Cx1_Request_corotation, 2=Cx2_Request_revrsal
  compu method CM_A_I_F_B: phys=raw*0.1 for raw 0..50; unit V
  compu method CM_COMP_Pdis: phys=raw*0.1 for raw 0..50; unit V
  compu method CM_COMP_Psuc: phys=raw*0.1 for raw 0..50; unit V
  compu method CM_COMP_Tdis: phys=raw*0.1 for raw 0..50; unit V
  compu method CM_COMP_Tsuc: phys=raw*0.1 for raw 0..50; unit V
  compu method CM_COOLING_FAN_request: identical
  compu method CM_HVAC_Blower_request: identical
  compu method CM_Mode_Actuator_request: 0=Cx0_Stop, 1=Cx1_Request_corotation, 2=Cx2_Request_revrsal
  compu method CM_MODE_F_B: phys=raw*0.1 for raw 0..50; unit V
  compu method CM_SV{1..3}_request: 0=Cx0_OFF, 1=Cx1_ON
  compu method CM_Tamb: phys=raw*0.1 for raw 0..50; unit V
  compu method CM_Tevap_Tchiller_out: phys=raw*0.1 for raw 0..50; unit V
  compu method CM_Tincar: phys=raw*0.1 for raw 0..50; unit V
  compu method CM_Tohx_in: phys=raw*0.1 for raw 0..50; unit V
  compu method CM_Tohx_out: phys=raw*0.1 for raw 0..50; unit V
  compu method CM_VcuCan12RxMsg3_Sig{0..3}: identical
  compu method CM_VcuCan12RxMsg4_Sig{0..3}: identical
  compu method CM_VcuCan12TxMsg1_Sig{0..3}: identical
  compu method CM_VcuCan12TxMsg2_Sig{0..3}: identical
  compu method CM_VCU_Tx_51Ch_NM_UserData: identical
  compu method CM_ACU_CrashOutputSts: 0=Cx00_No_Crash (No Crash), 1=Cx01_Rollover, 2=Cx02_BPT_Crash (BPT Crash), 3=Cx03_Rollover_BPT (Rollover + BPT), 4=Cx04_Front_Crash (Front Crash), 5=Cx05_Rollover_Front (Rollover + Front), 6=Cx06_BPT_Front (BPT+Front), 7=Cx07_Rollover_BPT_Front (Rollover+BPT+Front), 8=Cx08_Side_Crash (Side Crash), 9=Cx09_Rollover_Side (Rollover+Side), 10=Cx0A_BPT_Side (BPT+Side), 11=Cx0B_Rollover_BPT_Side (Rollover+BPT+Side), 12=Cx0C_Front_Side (Front+Side), 13=Cx0D_Rollover_Front_Side (Rollover+Front+Side), 14=Cx0E_BPT_Front_Side (BPT+Front+Side), 15=Cx0F_Rollover_BPT_Front_Side (Rollover+BPT+Front+Side), 16=Cx10_Rear_Crash (Rear Crash), 17=Cx11_Rollover_Rear (Rollover+Rear), 18=Cx12_BPT_Rear (BPT+Rear), 19=Cx13_Rollover_BPT_Rear (Rollover+BPT+Rear), 20=Cx14_Front_Rear (Front+Rear), 21=Cx15_Rollover_Front_Rear (Rollover+Front+Rear), 22=Cx16_BPT_Front_Rear (BPT+Front+Rear), 23=Cx17_Rollover_BPT_Front_Rear (Rollover+BPT+Front+Rear), 24=Cx18_Side_Rear (Side+Rear), 25=Cx19_Rollover_Side_Rear (Rollover+Side+Rear), 26=Cx1A_BPT_Side_Rear (BPT+Side+Rear), 27=Cx1B_Rollover_BPT_Side_Rear (Rollover+BPT+Side+Rear), 28=Cx1C_Front_Side_Rear (Front+Side+Rear), 29=Cx1D_Rollover_Front_Side_Rear (Rollover+Front+Side+Rear), 30=Cx1E_BPT_Front_Side_Rear (BPT+Front+Side+Rear), 31=Cx1F_Rollover_BPT_Front_Side_Rear (Rollover+BPT+Front+Side+Rear)
  compu method CM_ACU_CrashOutputStsValid: 0=Cx0_INVALID, 1=Cx1_VALID
  compu method CM_ACU_DriverSeatBeltSts: 0=Cx0_UNTIED, 1=Cx1_TIED
  compu method CM_ACU_DriverSeatBeltStsValid: 0=Cx0_INVALID, 1=Cx1_VALID
  compu method CM_ACU_DriverWarningLampSts: 0=Cx0_OFF, 1=Cx1_ON, 2=Cx2_FLASH
  compu method CM_ACU_LatA: 16383=Cx3FFF_Invalid, phys=raw*0.01-49.05 for raw 0..16382; unit m/s^2  # Source signal range: [0,16383]
  compu method CM_ACU_LatAStatus: 0=Cx0_Invalid, 1=Cx1_Valid, 2=Cx2_Reserved, 3=Cx3_Reserved
  compu method CM_ACU_LgtA: 16383=Cx3FFF_Invalid, phys=raw*0.01-49.05 for raw 0..16382; unit m/s^2  # Source signal range: [0,16383]
  compu method CM_ACU_LgtAStatus: 0=Cx0_Invalid, 1=Cx1_Valid, 2=Cx2_Reserved, 3=Cx3_Reserved
  compu method CM_ACU_PassengerAirbagSts: 0=Cx0_RESERVED, 1=Cx1_Disabled, 2=Cx2_Enabled, 3=Cx3_RESERVED
  compu method CM_ACU_PassengerSeatBeltSts: 0=Cx0_UNTIED, 1=Cx1_TIED
  compu method CM_ACU_PassengerSeatBeltStsValid: 0=Cx0_INVALID, 1=Cx1_VALID
  compu method CM_ACU_PassengerSts: 0=Cx0_UNOCCUPIED, 1=Cx1_OCCUPIED
  compu method CM_ACU_PassengerWarningLampSts: 0=Cx0_OFF, 1=Cx1_ON, 2=Cx2_FLASH
  compu method CM_ACU_RLSeatBeltStatusValid: 0=Cx0_INVALID, 1=Cx1_VALID
  compu method CM_ACU_RRSeatBeltStatusValid: 0=Cx0_INVALID, 1=Cx1_VALID
  compu method CM_ACU_SecondLeftSeatBeltSts: 0=Cx0_UNTIED, 1=Cx1_TIED
  compu method CM_ACU_SecondLeftSts: 0=Cx0_UNOCCUPIED, 1=Cx1_OCCUPIED
  compu method CM_ACU_SecondRightSeatBeltSts: 0=Cx0_UNTIED, 1=Cx1_TIED
  compu method CM_ACU_SecondRightSts: 0=Cx0_UNOCCUPIED, 1=Cx1_OCCUPIED
  compu method CM_ACU_WarningLampSts: 0=Cx0_OFF, 1=Cx1_ON, 2=Cx2_FLASH
  compu method CM_ACU_YawRate: 65535=CxFFFF_Invalid, phys=raw*0.01-300 for raw 0..65534; unit degrees/s
  compu method CM_ACU_YawRateStatus: 0=Cx0_Invalid, 1=Cx1_Valid, 2=Cx2_Reserved, 3=Cx3_Reserved
  compu method CM_ADCU_ACC_Mode: 0=Cx0_Off, 1=Cx1_Active_State (Active State), 2=Cx2_Override_State (Override State), 3=Cx3_Shut_off_State (Shut-off State), 4=Cx4_Standby_State (Standby State), 5=Cx5_Fail_State (Fail State), 6=Cx6_Reserved, 7=Cx7_Reserved
  compu method CM_ADCU_ACCDA_HandsOFF_Warning: 0=Cx0_No_Warning (No Warning), 1=Cx1_Hands_Off_1st_Warning (Hands Off 1st Warning), 2=Cx2_Hands_Off_2nd_Warning (Hands Off 2nd Warning), 3=Cx3_Function_Automatic_exit_Warning (Function Automatic exit Warning), 4=Cx4_Reserved, 5=Cx5_Reserved, 6=Cx6_Reserved, 7=Cx7_Reserved
  compu method CM_ADCU_ACCDA_SYS_Failure: 0=Cx0_No_Error (No Error), 1=Cx1_Error, 2=Cx2_Reserved, 3=Cx3_Reserved
  compu method CM_ADCU_AEB_AWB_Level: 0=Cx0_No_level (No level), 1=Cx1_Level_1 (Level 1), 2=Cx2_Level_2 (Level 2), 3=Cx3_Level_3 (Level 3), 4=Cx4_Level_4 (Level 4), 5=Cx5_Reserved
  compu method CM_ADCU_AEB_AWB_Req: 0=Cx0_No_Request (No Request), 1=Cx1_Request
  compu method CM_ADCU_AEB_Decel_Cmd: phys=raw*0.05-16 for raw 0..511; unit m/s^2
  compu method CM_ADCU_AEB_Prefill_CMD: 0=Cx0_No_pre_fill (No pre-fill), 1=Cx1_Pre_fill_act (Pre-fill act)
  compu method CM_ADCU_AEB_State: 0=Cx0_Off, 1=Cx1_Standby, 2=Cx2_Active, 3=Cx3_Failure
  compu method CM_ADCU_AEB_Stop_Req: 0=Cx0_No_request (No request), 1=Cx1_Stop_control_is_required (Stop control is required)
  compu method CM_ADCU_AEBReq: 0=Cx0_No_active (No active), 1=Cx1_active
  compu method CM_ADCU_AEBWarningSts: 0=Cx0_NO_WARNING, 1=Cx1_PreWarning_to_car (PreWarning to car), 2=Cx2_Latent_distance_Warning (Latent distance Warning), 3=Cx3_Braking_to_car (Braking to car), 4=Cx4_PreWarning_to_PED (PreWarning to PED), 5=Cx5_Braking_to_PED (Braking to PED), 6=Cx6_Reserved, 7=Cx7_Reserved
  compu method CM_ADCU_APS_Stop_Req: 0=Cx0_No_request (No request), 1=Cx1_Stop_control_is_required (Stop control is required), 2=Cx2_No_need_to_stop (No need to stop)
  compu method CM_ADCU_APSComfBrkReq: 0=Cx0_ComfBrakeReq_NoReq, 1=Cx1_ComfBrakeReq_Type1, 2=Cx2_ComfBrakeReq_Type2
  compu method CM_ADCU_APSCrlModeReq: 0=Cx0_None, 1=Cx1_APS, 2=Cx2_RC, 3=Cx3_Reserved
  compu method CM_ADCU_APSCrlReq: 0=Cx0_Req_None, 1=Cx1_Req_Drive, 2=Cx2_Req_LSM
  compu method CM_ADCU_APSCrlTypReq: 0=Cx0_None, 1=Cx1_Comfort, 2=Cx2_Emergency, 3=Cx3_Reserved
  compu method CM_ADCU_APSDistanceStop: 4095=CxFFF_Invalid; unit cm
  compu method CM_ADCU_APSMaxSpeedReq: 31=Cx1F_Invalid; unit km/h  # Source signal range: [0,30]
  compu method CM_ADCU_DA_Mode: 0=Cx0_Off, 1=Cx1_Standby_Inhibit (Standby-Inhibit), 2=Cx2_Standby_Available (Standby-Available), 3=Cx3_Active, 4=Cx4_Override_longitudinal (Override-longitudinal), 5=Cx5_Override_lateral (Override-lateral), 6=Cx6_Failure, 7=Cx7_Reserved
  compu method CM_ADCU_FCW_State: 0=Cx0_Off, 1=Cx1_Standby, 2=Cx2_Active, 3=Cx3_Failure
  compu method CM_ADCU_Parking_CtrlSts: 0=Cx0_OFF, 1=Cx1_ON, 2=Cx2_Failure, 3=Cx3_Reserved
  compu method CM_ADCU_Parking_Mode: 0=Cx0_Off, 1=Cx1_Standby, 2=Cx2_Background_searching (Background searching), 3=Cx3_Searching, 4=Cx4_Guidance_active (Guidance active), 5=Cx5_Recovery_interrupt (Recovery interrupt), 6=Cx6_Completed, 7=Cx7_Failure, 8=Cx8_Terminated, 9=Cx9_Reserved, 10=CxA_Reserved, 11=CxB_Reserved, 12=CxC_Reserved, 13=CxD_Reserved, 14=CxE_Reserved, 15=CxF_Reserved
  compu method CM_ADCU_RemoteParkingMode: 0=Cx0_Off, 1=Cx1_Prepare, 2=Cx2_Standby, 3=Cx3_Moving, 4=Cx4_Recovery_interrupt (Recovery interrupt), 5=Cx5_Voluntarily_Exit (Voluntarily Exit), 6=Cx6_Passive_Exit (Passive Exit), 7=Cx7_Failure, 8=Cx8_Reserved, 9=Cx9_Reserved, 10=CxA_Reserved, 11=CxB_Reserved, 12=CxC_Reserved, 13=CxD_Reserved, 14=CxE_Reserved, 15=CxF_Reserved
  compu method CM_ADCU_TargetGear: 0=Cx0_No_Request (No Request), 1=Cx1_P, 2=Cx2_N, 3=Cx3_R, 4=Cx4_D
  compu method CM_Checksum_090: identical
  compu method CM_Checksum_094: identical
  compu method CM_Checksum_095: identical
  compu method CM_Checksum_097: identical
  compu method CM_Checksum_0B{0..4}: identical
  compu method CM_Checksum_0B{7..9}: identical
  compu method CM_Checksum_0BA: identical
  compu method CM_Checksum_0BC: identical
  compu method CM_Checksum_0D{1..3}: identical
  compu method CM_Checksum_0E0: identical
  compu method CM_Checksum_0E2: identical
  compu method CM_Checksum_0E4: identical
  compu method CM_Checksum_0E6: identical
  compu method CM_Checksum_0F5: identical
  compu method CM_Checksum_0F6: identical
  compu method CM_Checksum_317: identical
  compu method CM_Checksum_318: identical
  compu method CM_IBS_ABPActive: 0=Cx0_INACTIVE, 1=Cx1_ACTIVE
  compu method CM_IBS_ABPAvailable: 0=Cx0_NOT_AVAILABLE, 1=Cx1_AVAILABLE
  compu method CM_IBS_ABSActive: 0=Cx0_Not_Active (Not Active), 1=Cx1_Active
  compu method CM_IBS_ABSFault: 0=Cx0_Noerror, 1=Cx1_Error
  compu method CM_IBS_AEBActive: 0=Cx0_notactive, 1=Cx1_active
  compu method CM_IBS_AEBAvailable: 0=Cx0_NOT_AVAILABLE, 1=Cx1_AVAILABLE
  compu method CM_IBS_APS_Avl: 0=Cx0_AxCapbl_Full, 1=Cx1_reversed, 2=Cx2_AxCapbl_VehBlocked, 3=Cx3_reversed
  compu method CM_IBS_APSComfortAvl: 0=Cx0_NotAvailable, 1=Cx1_Brake_failure (Brake failure), 2=Cx2_Excessive_slope (Excessive slope), 3=Cx3_Available
  compu method CM_IBS_APSCrlReqEcho: 0=Cx0_None, 1=Cx1_Drive, 2=Cx2_LSM, 3=Cx3_reserved
  compu method CM_IBS_APSEmergenyAvl: 0=Cx0_NotAvailable, 1=Cx1_Brake_failure (Brake failure), 2=Cx2_Excessive_slope (Excessive slope), 3=Cx3_Available
  compu method CM_IBS_APSModeEcho: 0=Cx0_None, 1=Cx1_APS, 2=Cx2_RC, 3=Cx3_Reserved
  compu method CM_IBS_APSTrqReqActive: 0=Cx0_INACTIVE, 1=Cx1_ACTIVE
  compu method CM_IBS_AVHAvailable: 0=Cx0_NOT_AVAILABLE, 1=Cx1_AVAILABLE
  compu method CM_IBS_AVHSts: 0=Cx0_OFF, 1=Cx1_STANDBY, 2=Cx2_ACTIVE
  compu method CM_IBS_AWBActive: 0=Cx0_NotActive, 1=Cx1_Active
  compu method CM_IBS_AWBAvailable: 0=Cx0_NOT_AVAILABLE, 1=Cx1_AVAILABLE
  compu method CM_IBS_BrakeFluidWarning: 0=Cx0_BRAKEFLUID_NORMAL_INIT_DEFAULT, 1=Cx1_BRAKEFLUID_EMPTY, 2=Cx2_RESERVED, 3=Cx3_RESERVED
  compu method CM_IBS_BrakeLightRequest: 0=Cx0_brakelightOFF, 1=Cx1_brakelightON, 2=Cx2_notused, 3=Cx3_signalnotavailable
  compu method CM_IBS_BrakePedalStatus: 0=Cx0_NOT_PRESSED_INIT_DEFAULT, 1=Cx1_PRESSED, 2=Cx2_RESERVED, 3=Cx3_ERROR
  compu method CM_IBS_BrakePedalStatusValid: 0=Cx0_Invalid, 1=Cx1_Valid
  compu method CM_IBS_BrakePushrodStroke: phys=raw/64-5 for raw 0..2047; unit mm
  compu method CM_IBS_BrakeTypEcho: 0=Cx0_None, 1=Cx1_Comfort, 2=Cx2_Emergency, 3=Cx3_Reserved
  compu method CM_IBS_CddActive: 0=Cx0_INACTIVE, 1=Cx1_ACTIVE
  compu method CM_IBS_CddAvailable: 0=Cx0_NOT_AVAILABLE, 1=Cx1_AVAILABLE
  compu method CM_IBS_CddError: 0=Cx0_NOT_ERROR, 1=Cx1_ERROR
  compu method CM_IBS_CDPActive: 0=Cx0_Not_Active (Not Active), 1=Cx1_Active
  compu method CM_IBS_CDPAvailable: 0=Cx0_NOT_AVAILABLE, 1=Cx1_AVAILABLE
  compu method CM_IBS_DTCActive: 0=Cx0_Not_Active (Not Active), 1=Cx1_Active
  compu method CM_IBS_DTCFault: 0=Cx0_Noerror, 1=Cx1_Error
  compu method CM_IBS_EBDActive: 0=Cx0_Not_Active (Not Active), 1=Cx1_Active
  compu method CM_IBS_EBDFault: 0=Cx0_Noerror, 1=Cx1_Error
  compu method CM_IBS_EPBControllerSts: 0=Cx0_MasterMode, 1=Cx1_SlaveMode
  compu method CM_IBS_EPBFailureLamp: 0=Cx0_LampOFF, 1=Cx1_LampON
  compu method CM_IBS_EPBFailureStatus: 0=Cx0_No_error (No error), 1=Cx1_error, 2=Cx2_Reserve, 3=Cx3_Reserve
  compu method CM_IBS_EPBFunctionLamp: 0=Cx0_LampOFF, 1=Cx1_LampON, 2=Cx2_flash, 3=Cx3_Invalid
  compu method CM_IBS_EPBTextdisplay: 0=Cx0_Off, 1=Cx1_Park_Brake_Applied (Park Brake Applied), 2=Cx2_Park_Brake_Released (Park Brake Released), 3=Cx3_Parking_brake_malfunction_Visit_service_center_to_fix_the_issue (Parking brake malfunction.Visit service center to fix the issue), 4=Cx4_Reserve
  compu method CM_IBS_EPBworkingSts: 0=Cx0_UNKNOWN, 1=Cx1_APPLIED, 2=Cx2_RELEASED, 3=Cx3_APPLY_IN_PROGRESS (APPLY IN PROGRESS), 4=Cx4_RELEASE_IN_PROGRESS (RELEASE IN PROGRESS), 5=Cx5_COMPLETELY_RELEASED (COMPLETELY RELEASED), 6=Cx6_DYNAMIC_APPLY (DYNAMIC APPLY), 7=Cx7_RESERVED
  compu method CM_IBS_ESClampdisplay: 0=Cx0_ESC_lamp_ON (ESC lamp ON), 1=Cx1_ESC_lamp_OFF (ESC lamp OFF), 2=Cx2_ESC_lamp_FLASH (ESC lamp FLASH)
  compu method CM_IBS_ESCOffSts: 0=Cx0_ESC_OFF (ESC OFF), 1=Cx1_ESC_ON (ESC ON)
  compu method CM_IBS_FactoryMode: 0=Cx0_Not_Active (Not Active), 1=Cx1_Active
  compu method CM_IBS_FLMovingDirection: 0=Cx0_Standstill, 1=Cx1_Forward, 2=Cx2_Backward
  compu method CM_IBS_FLWheelPulseCounter: identical
  compu method CM_IBS_FLWheelSpeed: phys=raw*0.05625 for raw 0..6400; unit km/h
  compu method CM_IBS_FLWheelSpeed_Fault: 0=Cx0_No_error (No error), 1=Cx1_Error
  compu method CM_IBS_FRMovingDirection: 0=Cx0_Standstill, 1=Cx1_Forward, 2=Cx2_Backward
  compu method CM_IBS_FRWheelPulseCounter: identical
  compu method CM_IBS_FRWheelSpeed: phys=raw*0.05625 for raw 0..6400; unit km/h
  compu method CM_IBS_FRWheelSpeed_Fault: 0=Cx0_No_error (No error), 1=Cx1_Error
  compu method CM_IBS_HazWarnReq: 0=Cx0_OFF, 1=Cx1_ON, 2=Cx2_Signalnotavailable
  compu method CM_IBS_HBAActive: 0=Cx0_Not_Active (Not Active), 1=Cx1_Active
  compu method CM_IBS_HDCAvailable: 0=Cx0_NOT_AVAILABLE, 1=Cx1_AVAILABLE
  compu method CM_IBS_HDCSts: 0=Cx0_OFF, 1=Cx1_STANDBY, 2=Cx2_ACTIVE
  compu method CM_IBS_HHCActive: 0=Cx0_notactive, 1=Cx1_active
  compu method CM_IBS_HHCAvailable: 0=Cx0_NOT_AVAILABLE, 1=Cx1_AVAILABLE
  compu method CM_IBS_MaintenaceMode: 0=Cx0_Not_Active (Not Active), 1=Cx1_Active
  compu method CM_IBS_MasterCylinderPressure: phys=raw*0.1 for raw 0..2500; unit BAR
  compu method CM_IBS_PlungerPressure: phys=raw*0.1-5 for raw 0..2047; unit BAR
  compu method CM_IBS_RBSStatus: 0=Cx0_NotActive, 1=Cx1_Active
  compu method CM_IBS_RLMovingDirection: 0=Cx0_Standstill, 1=Cx1_Forward, 2=Cx2_Backward
  compu method CM_IBS_RLWheelPulseCounter: identical
  compu method CM_IBS_RLWheelSpeed: phys=raw*0.05625 for raw 0..6400; unit km/h
  compu method CM_IBS_RLWheelSpeed_Fault: 0=Cx0_No_error (No error), 1=Cx1_Error
  compu method CM_IBS_RollerbenchMode: 0=Cx0_Not_Active (Not Active), 1=Cx1_Active
  compu method CM_IBS_RRMovingDirection: 0=Cx0_Standstill, 1=Cx1_Forward, 2=Cx2_Backward
  compu method CM_IBS_RRWheelPulseCounter: identical
  compu method CM_IBS_RRWheelSpeed: phys=raw*0.05625 for raw 0..6400; unit km/h
  compu method CM_IBS_RRWheelSpeed_Fault: 0=Cx0_No_error (No error), 1=Cx1_Error
  compu method CM_IBS_RWUActive: 0=Cx0_Not_Active (Not Active), 1=Cx1_Active
  compu method CM_IBS_RWUAvailable: 0=Cx0_NOT_AVAILABLE, 1=Cx1_AVAILABLE
  compu method CM_IBS_SystemStatus: 0=Cx0_Normal, 1=Cx1_Degrade, 2=Cx2_Partial, 3=Cx3_Inhibit, 4=Cx4_Reserved, 5=Cx5_Reserved, 6=Cx6_Reserved, 7=Cx7_Reserved
  compu method CM_IBS_TargetGearReq: 0=Cx0_No_Request (No Request), 1=Cx1_P, 2=Cx2_N, 3=Cx3_R, 4=Cx4_D
  compu method CM_IBS_TCSActive: 0=Cx0_NotActive, 1=Cx1_Active
  compu method CM_IBS_TCSFault: 0=Cx0_Noerror, 1=Cx1_Error
  compu method CM_IBS_TireMonSysSts: 0=Cx0_System_not_OK (System not OK), 1=Cx1_System_OK (System OK)
  compu method CM_IBS_TireWarnFrntLe: 0=Cx0_Normal, 1=Cx1_Abnormal
  compu method CM_IBS_TireWarnFrntRi: 0=Cx0_Normal, 1=Cx1_Abnormal
  compu method CM_IBS_TireWarnReLe: 0=Cx0_Normal, 1=Cx1_Abnormal
  compu method CM_IBS_TireWarnReRi: 0=Cx0_Normal, 1=Cx1_Abnormal
  compu method CM_IBS_TPMS_ResetSts: 0=Cx0_OFF, 1=Cx1_ON
  compu method CM_IBS_VCU_DecelerationReqActive: 0=Cx0_NotActive, 1=Cx1_Active
  compu method CM_IBS_VCU_DecelerationRequest_Available: 0=Cx0_Available, 1=Cx1_Not_Available (Not Available), 2=Cx2_Reserved, 3=Cx3_Reserved
  compu method CM_IBS_VDCActive: 0=Cx0_NotActive, 1=Cx1_Active
  compu method CM_IBS_VDCFault: 0=Cx0_Noerror, 1=Cx1_Error
  compu method CM_IBS_VehicleSpeed: phys=raw*0.05625 for raw 0..6400; unit km/h
  compu method CM_IBS_VehicleSpeedValid: 0=Cx0_Invalid, 1=Cx1_Valid
  compu method CM_IBS_VehicleStandstill: 0=Cx0_NOT_STANDSTILL, 1=Cx1_STANDSTILL, 2=Cx2_RESERVED
  compu method CM_IBS_VehicleStandstill_Valid: 0=Cx0_Invalid, 1=Cx1_Valid
  compu method CM_IBS_VlcActive: 0=Cx0_INACTIVE, 1=Cx1_ACTIVE
  compu method CM_IBS_VlcAvalible: 0=Cx0_NOT_AVAILABLE, 1=Cx1_AVAILABLE
  compu method CM_IBS_VlcError: 0=Cx0_NOT_ERROR, 1=Cx1_ERROR
  compu method CM_IBS_WLTorqueAPSReq: phys=raw-20000 for raw 0..40000; unit Nm
  compu method CM_IBS_WLTorqueAPSReqValid: 0=Cx0_NotIntialized, 1=Cx1_Normal, 2=Cx2_Faulty
  compu method CM_IBS_WLTorqueIncrReq: phys=raw-20000 for raw 0..40000; unit Nm
  compu method CM_IBS_WLTorqueIncrReqSts: 0=Cx0_INACTIVE, 1=Cx1_ACTIVE
  compu method CM_IBS_WLTorqueRBSReq: phys=raw-20000 for raw 0..40000; unit Nm
  compu method CM_IBS_WLTorqueRBSReqValid: 0=Cx0_NotIntialized, 1=Cx1_Normal, 2=Cx2_Faulty
  compu method CM_IBS_WLTorqueRedReq: phys=raw-20000 for raw 0..40000; unit Nm
  compu method CM_IBS_WLTorqueRedReqSts: 0=Cx0_INACTIVE, 1=Cx1_ACTIVE
  compu method CM_IBS_WLTorqueVLCReq: phys=raw-20000 for raw 0..32767; unit Nm
  compu method CM_IBS_WLTorqueVLCReqValid: 0=Cx0_NotIntialized, 1=Cx1_Normal, 2=Cx2_Faulty
  compu method CM_MessageCounter_090: 15=CxF_Invalid
  compu method CM_MessageCounter_094: 15=CxF_Invalid
  compu method CM_MessageCounter_095: 15=CxF_Invalid
  compu method CM_MessageCounter_097: 15=CxF_Invalid
  compu method CM_MessageCounter_0B{0..4}: 15=CxF_Invalid
  compu method CM_MessageCounter_0B{7..9}: 15=CxF_Invalid
  compu method CM_MessageCounter_0BA: 15=CxF_Invalid
  compu method CM_MessageCounter_0BC: 15=CxF_Invalid
  compu method CM_MessageCounter_0D{1..3}: 15=CxF_Invalid
  compu method CM_MessageCounter_0E0: 15=CxF_Invalid
  compu method CM_MessageCounter_0E2: 15=CxF_Invalid
  compu method CM_MessageCounter_0E4: 15=CxF_Invalid
  compu method CM_MessageCounter_0E6: 15=CxF_Invalid
  compu method CM_MessageCounter_0F5: 15=CxF_Invalid
  compu method CM_MessageCounter_0F6: 15=CxF_Invalid
  compu method CM_MessageCounter_317: 15=CxF_Invalid
  compu method CM_MessageCounter_318: 15=CxF_Invalid
  compu method CM_SGW_BLEChrgFlaplockCtrlReq: 0=Cx0_No_Request (No Request), 1=Cx1_Unlock, 2=Cx2_Lock, 3=Cx3_Reserved
  compu method CM_SGW_BLEPowerModeReq: 0=Cx0_No_Request (No Request), 1=Cx1_Request_Power_OFF (Request Power OFF), 2=Cx2_Request_Power_ON (Request Power ON), 3=Cx3_Reserve
  compu method CM_SGW_BLESystemReadyReq: 0=Cx0_No_Request (No Request), 1=Cx1_Request_Ready_Remote (Request Ready_Remote), 2=Cx2_Reserve, 3=Cx3_Reserve
  compu method CM_SGW_BLETailgateCtrlReq: 0=Cx0_No_Request (No Request), 1=Cx1_Unlock, 2=Cx2_Lock, 3=Cx3_Reserved
  compu method CM_SGW_KeyLowBatWarning: 0=Cx0_NO_WARNING, 1=Cx1_WARNING
  compu method CM_VCU_AccelerationPedal: phys=raw*0.1 for raw 0..1000; unit percent
  compu method CM_VCU_AccelerationPedalValid: 0=Cx0_Invalid, 1=Cx1_Valid
  compu method CM_VCU_ActDriveMode: 0=Cx0_INVALID, 1=Cx1_ECO, 2=Cx2_NORMAL, 3=Cx3_SPORT, 4=Cx4_OnePedal
  compu method CM_VCU_ActualGear: 0=Cx0_Reserve, 1=Cx1_P, 2=Cx2_N, 3=Cx3_R, 4=Cx4_D
  compu method CM_VCU_ADASOverride: 0=Cx0_off, 1=Cx1_on
  compu method CM_VCU_APSTorqueRequestActive: 0=Cx0_Not_Active (Not Active), 1=Cx1_Active
  compu method CM_VCU_APSTorqueRequestAvailable: 0=Cx0_Not_Available (Not Available), 1=Cx1_Available
  compu method CM_VCU_BMS_Control_of_PosRelay: 0=Cx0_Invaild, 1=Cx1_Open, 2=Cx2_Close
  compu method CM_VCU_BMSTargetThermLevel: 0=Cx0_Level_1_low_ (Level 1(low)), 1=Cx1_Level_2_medium_ (Level 2(medium)), 2=Cx2_Level_3_high_ (Level 3(high)), 3=Cx3_Reserved
  compu method CM_VCU_BrakeCompensateStatus: 0=Cx0_Invalid, 1=Cx1_OFF, 2=Cx2_ON, 3=Cx3_Reserved
  compu method CM_VCU_BrakeCompensateWarn: 0=Cx0_No_display (No display), 1=Cx1_Vehicle_failure_brake_compensation_failed_to_open_ (Vehicle failure, brake compensation failed to open.), 2=Cx2_Reserved, 3=Cx3_Reserved
  compu method CM_VCU_BrakepedalStatus: 0=Cx0_No_pressed (No pressed), 1=Cx1_pressed, 2=Cx2_Invalid
  compu method CM_VCU_BS_Current: phys=raw*0.001-8.192 for raw 0..16383
  compu method CM_VCU_BS_IBSBatSOC: 255=CxFF_Invalid; unit percent  # Source signal range: [0,100]
  compu method CM_VCU_BS_IndicatorSts: 0=Cx0_No_request (No request), 1=Cx1_Low_SOH (Low SOH)
  compu method CM_VCU_BS_LV_Batt: phys=raw*0.001 for raw 0..32767; unit V
  compu method CM_VCU_ChargeEndReason: 0=Cx0_No_Display (No Display), 1=Cx1_Reach_the_charge_cut_off_SOC (Reach the charge cut-off SOC), 2=Cx2_reserved, 3=Cx3_reserved
  compu method CM_VCU_ChargeProcessComment: 0=Cx0_No_comment (No comment), 1=Cx1_Charge_Fault_and_slow (Charge Fault and slow), 2=Cx2_Reserved, 3=Cx3_Reserved
  compu method CM_VCU_ChargeStatus: 0=Cx0_Init, 1=Cx1_Off_Plug (Off Plug), 2=Cx2_AC_Plug_Detected (AC Plug Detected), 3=Cx3_DC_Plug_Detected (DC Plug Detected), 4=Cx4_V2L_Plug_Detected (V2L Plug Detected), 5=Cx5_AC_Charging (AC Charging), 6=Cx6_DC_Charging (DC Charging), 7=Cx7_V2L_Discharging (V2L Discharging), 8=Cx8_Charging_Completed (Charging Completed), 9=Cx9_Charging_Fault (Charging Fault), 10=CxA_AC_Preheating (AC Preheating), 11=CxB_DC_Preheating (DC Preheating), 12=CxC_V2L_completed (V2L completed), 13=CxD_KeepWarming, 14=CxE_V2L_Fault (V2L Fault)
  compu method CM_VCU_CriSysFailure: 0=Cx0_No_Warning, 1=Cx1_Leve1_lighting_prompt_only_ (Leve1 (lighting prompt only)), 2=Cx2_Leve2_power_loss_ (Leve2 (power loss)), 3=Cx3_Leve3_emergency_power_off_ (Leve3 (emergency power off))
  compu method CM_VCU_DCDCFail: 0=Cx0_False, 1=Cx1_True
  compu method CM_VCU_DCFCCurrent: identical
  compu method CM_VCU_DecelerationReq: phys=raw*0.05-5 for raw 0..255; unit m/s^2
  compu method CM_VCU_DecelerationReqactive: 0=Cx0_Inactive_ (Inactive;), 1=Cx1_Active
  compu method CM_VCU_DischargeEndReason: 0=Cx0_No_Display (No Display), 1=Cx1_Reach_the_discharge_cut_off_SOC (Reach the discharge cut-off SOC), 2=Cx2_reserved, 3=Cx3_reserved
  compu method CM_VCU_DischargeEndSoc: identical
  compu method CM_VCU_Display_Cur: identical
  compu method CM_VCU_Display_Power: phys=raw*0.1 for raw 0..4095; unit kW
  compu method CM_VCU_DriveMotOvrTemp: 0=Cx0_False, 1=Cx1_True
  compu method CM_VCU_DriverTorqueRequest: phys=raw-1023 for raw 0..2045
  compu method CM_VCU_DrvModSwitchWarn: 0=Cx0_RESERVE, 1=Cx1_unrecommed_Sport_Low_SOC (unrecommed Sport-Low SOC), 2=Cx2_Vehicle_not_in_P_gear_single_pedal_unavailable (Vehicle not in P gear,single pedal unavailable), 3=Cx3_Vehicle_failure_single_pedal_unavailable_ (Vehicle failure, single pedal unavailable.), 4=Cx4_Reserved, 5=Cx5_Reserved, 6=Cx6_Reserved, 7=Cx7_Reserved
  compu method CM_VCU_EnergyManagementWarn: 0=Cx0_OFF, 1=Cx1_Battery_is_discharging_recommended_to_turn_off_the_air_conditioner_or_other_loads_ (Battery is discharging, recommended to turn off the air conditioner or other loads.), 2=Cx2_Insufficient_vehicle_power_recommended_to_turn_off_the_air_conditioner_or_other_loads_ (Insufficient vehicle power,recommended to turn off the air conditioner or other loads.), 3=Cx3_Reserved
  compu method CM_VCU_EnergyV2L: phys=raw*0.1 for raw 0..1023; unit kWh
  compu method CM_VCU_EPBReq: 0=Cx0_Not_Request (Not Request), 1=Cx1_Apply_Request (Apply Request), 2=Cx2_Release_Request (Release Request), 3=Cx3_Reserved
  compu method CM_VCU_ForwardVmaxAllowed: 0=Cx00_No_request (No request), 1=Cx01_1_170 (1-170), 2=Cx02_1_170 (1-170), 3=Cx03_1_170 (1-170), 4=Cx04_1_170 (1-170), 5=Cx05_1_170 (1-170), 6=Cx06_1_170 (1-170), 7=Cx07_1_170 (1-170), 8=Cx08_1_170 (1-170), 9=Cx09_1_170 (1-170), 10=Cx0A_1_170 (1-170), 11=Cx0B_1_170 (1-170), 12=Cx0C_1_170 (1-170), 13=Cx0D_1_170 (1-170), 14=Cx0E_1_170 (1-170), 15=Cx0F_1_170 (1-170), 16=Cx10_1_170 (1-170), 17=Cx11_1_170 (1-170), 18=Cx12_1_170 (1-170), 19=Cx13_1_170 (1-170), 20=Cx14_1_170 (1-170), 21=Cx15_1_170 (1-170), 22=Cx16_1_170 (1-170), 23=Cx17_1_170 (1-170), 24=Cx18_1_170 (1-170), 25=Cx19_1_170 (1-170), 26=Cx1A_1_170 (1-170), 27=Cx1B_1_170 (1-170), 28=Cx1C_1_170 (1-170), 29=Cx1D_1_170 (1-170), 30=Cx1E_1_170 (1-170), 31=Cx1F_1_170 (1-170), 32=Cx20_1_170 (1-170), 33=Cx21_1_170 (1-170), 34=Cx22_1_170 (1-170), 35=Cx23_1_170 (1-170), 36=Cx24_1_170 (1-170), 37=Cx25_1_170 (1-170), 38=Cx26_1_170 (1-170), 39=Cx27_1_170 (1-170), 40=Cx28_1_170 (1-170), 41=Cx29_1_170 (1-170), 42=Cx2A_1_170 (1-170), 43=Cx2B_1_170 (1-170), 44=Cx2C_1_170 (1-170), 45=Cx2D_1_170 (1-170), 46=Cx2E_1_170 (1-170), 47=Cx2F_1_170 (1-170), 48=Cx30_1_170 (1-170), 49=Cx31_1_170 (1-170), 50=Cx32_1_170 (1-170), 51=Cx33_1_170 (1-170), 52=Cx34_1_170 (1-170), 53=Cx35_1_170 (1-170), 54=Cx36_1_170 (1-170), 55=Cx37_1_170 (1-170), 56=Cx38_1_170 (1-170), 57=Cx39_1_170 (1-170), 58=Cx3A_1_170 (1-170), 59=Cx3B_1_170 (1-170), 60=Cx3C_1_170 (1-170), 61=Cx3D_1_170 (1-170), 62=Cx3E_1_170 (1-170), 63=Cx3F_1_170 (1-170), 64=Cx40_1_170 (1-170), 65=Cx41_1_170 (1-170), 66=Cx42_1_170 (1-170), 67=Cx43_1_170 (1-170), 68=Cx44_1_170 (1-170), 69=Cx45_1_170 (1-170), 70=Cx46_1_170 (1-170), 71=Cx47_1_170 (1-170), 72=Cx48_1_170 (1-170), 73=Cx49_1_170 (1-170), 74=Cx4A_1_170 (1-170), 75=Cx4B_1_170 (1-170), 76=Cx4C_1_170 (1-170), 77=Cx4D_1_170 (1-170), 78=Cx4E_1_170 (1-170), 79=Cx4F_1_170 (1-170), 80=Cx50_1_170 (1-170), 81=Cx51_1_170 (1-170), 82=Cx52_1_170 (1-170), 83=Cx53_1_170 (1-170), 84=Cx54_1_170 (1-170), 85=Cx55_1_170 (1-170), 86=Cx56_1_170 (1-170), 87=Cx57_1_170 (1-170), 88=Cx58_1_170 (1-170), 89=Cx59_1_170 (1-170), 90=Cx5A_1_170 (1-170), 91=Cx5B_1_170 (1-170), 92=Cx5C_1_170 (1-170), 93=Cx5D_1_170 (1-170), 94=Cx5E_1_170 (1-170), 95=Cx5F_1_170 (1-170), 96=Cx60_1_170 (1-170), 97=Cx61_1_170 (1-170), 98=Cx62_1_170 (1-170), 99=Cx63_1_170 (1-170), 100=Cx64_1_170 (1-170), 101=Cx65_1_170 (1-170), 102=Cx66_1_170 (1-170), 103=Cx67_1_170 (1-170), 104=Cx68_1_170 (1-170), 105=Cx69_1_170 (1-170), 106=Cx6A_1_170 (1-170), 107=Cx6B_1_170 (1-170), 108=Cx6C_1_170 (1-170), 109=Cx6D_1_170 (1-170), 110=Cx6E_1_170 (1-170), 111=Cx6F_1_170 (1-170), 112=Cx70_1_170 (1-170), 113=Cx71_1_170 (1-170), 114=Cx72_1_170 (1-170), 115=Cx73_1_170 (1-170), 116=Cx74_1_170 (1-170), 117=Cx75_1_170 (1-170), 118=Cx76_1_170 (1-170), 119=Cx77_1_170 (1-170), 120=Cx78_1_170 (1-170), 121=Cx79_1_170 (1-170), 122=Cx7A_1_170 (1-170), 123=Cx7B_1_170 (1-170), 124=Cx7C_1_170 (1-170), 125=Cx7D_1_170 (1-170), 126=Cx7E_1_170 (1-170), 127=Cx7F_1_170 (1-170), 128=Cx80_1_170 (1-170), 129=Cx81_1_170 (1-170), 130=Cx82_1_170 (1-170), 131=Cx83_1_170 (1-170), 132=Cx84_1_170 (1-170), 133=Cx85_1_170 (1-170), 134=Cx86_1_170 (1-170), 135=Cx87_1_170 (1-170), 136=Cx88_1_170 (1-170), 137=Cx89_1_170 (1-170), 138=Cx8A_1_170 (1-170), 139=Cx8B_1_170 (1-170), 140=Cx8C_1_170 (1-170), 141=Cx8D_1_170 (1-170), 142=Cx8E_1_170 (1-170), 143=Cx8F_1_170 (1-170), 144=Cx90_1_170 (1-170), 145=Cx91_1_170 (1-170), 146=Cx92_1_170 (1-170), 147=Cx93_1_170 (1-170), 148=Cx94_1_170 (1-170), 149=Cx95_1_170 (1-170), 150=Cx96_1_170 (1-170), 151=Cx97_1_170 (1-170), 152=Cx98_1_170 (1-170), 153=Cx99_1_170 (1-170), 154=Cx9A_1_170 (1-170), 155=Cx9B_1_170 (1-170), 156=Cx9C_1_170 (1-170), 157=Cx9D_1_170 (1-170), 158=Cx9E_1_170 (1-170), 159=Cx9F_1_170 (1-170), 160=CxA0_1_170 (1-170), 161=CxA1_1_170 (1-170), 162=CxA2_1_170 (1-170), 163=CxA3_1_170 (1-170), 164=CxA4_1_170 (1-170), 165=CxA5_1_170 (1-170), 166=CxA6_1_170 (1-170), 167=CxA7_1_170 (1-170), 168=CxA8_1_170 (1-170), 169=CxA9_1_170 (1-170), 170=CxAA_1_170 (1-170), 171=CxAB_Reserved, 172=CxAC_Reserved, 173=CxAD_Reserved, 174=CxAE_Reserved, 175=CxAF_Reserved, 176=CxB0_Reserved, 177=CxB1_Reserved, 178=CxB2_Reserved, 179=CxB3_Reserved, 180=CxB4_Reserved, 181=CxB5_Reserved, 182=CxB6_Reserved, 183=CxB7_Reserved, 184=CxB8_Reserved, 185=CxB9_Reserved, 186=CxBA_Reserved, 187=CxBB_Reserved, 188=CxBC_Reserved, 189=CxBD_Reserved, 190=CxBE_Reserved, 191=CxBF_Reserved, 192=CxC0_Reserved, 193=CxC1_Reserved, 194=CxC2_Reserved, 195=CxC3_Reserved, 196=CxC4_Reserved, 197=CxC5_Reserved, 198=CxC6_Reserved, 199=CxC7_Reserved, 200=CxC8_Reserved, 201=CxC9_Reserved, 202=CxCA_Reserved, 203=CxCB_Reserved, 204=CxCC_Reserved, 205=CxCD_Reserved, 206=CxCE_Reserved, 207=CxCF_Reserved, 208=CxD0_Reserved, 209=CxD1_Reserved, 210=CxD2_Reserved, 211=CxD3_Reserved, 212=CxD4_Reserved, 213=CxD5_Reserved, 214=CxD6_Reserved, 215=CxD7_Reserved, 216=CxD8_Reserved, 217=CxD9_Reserved, 218=CxDA_Reserved, 219=CxDB_Reserved, 220=CxDC_Reserved, 221=CxDD_Reserved, 222=CxDE_Reserved, 223=CxDF_Reserved, 224=CxE0_Reserved, 225=CxE1_Reserved, 226=CxE2_Reserved, 227=CxE3_Reserved, 228=CxE4_Reserved, 229=CxE5_Reserved, 230=CxE6_Reserved, 231=CxE7_Reserved, 232=CxE8_Reserved, 233=CxE9_Reserved, 234=CxEA_Reserved, 235=CxEB_Reserved, 236=CxEC_Reserved, 237=CxED_Reserved, 238=CxEE_Reserved, 239=CxEF_Reserved, 240=CxF0_Reserved, 241=CxF1_Reserved, 242=CxF2_Reserved, 243=CxF3_Reserved, 244=CxF4_Reserved, 245=CxF5_Reserved, 246=CxF6_Reserved, 247=CxF7_Reserved, 248=CxF8_Reserved, 249=CxF9_Reserved, 250=CxFA_Reserved, 251=CxFB_Reserved, 252=CxFC_Reserved, 253=CxFD_Reserved, 254=CxFE_Reserved, 255=CxFF_Reserved
  compu method CM_VCU_ForwardVmaxlimitStatus: 0=Cx0_Inactive, 1=Cx1_Active
  compu method CM_VCU_HVBatCriFail: 0=Cx0_False, 1=Cx1_Yellow, 2=Cx2_Red, 3=Cx3_Reserve
  compu method CM_VCU_HVBatOvrTemp: 0=Cx0_False, 1=Cx1_True
  compu method CM_VCU_HVConnectFault: 0=Cx0_Normal, 1=Cx1_Fault
  compu method CM_VCU_HVILError: 0=Cx0_False, 1=Cx1_True
  compu method CM_VCU_HVInsulResFault: 0=Cx0_False, 1=Cx1_True
  compu method CM_VCU_HVStatus: 0=Cx0_Init, 1=Cx1_Standby, 2=Cx2_HV_Ready (HV Ready), 3=Cx3_Drive_ready (Drive ready), 4=Cx4_Preheating, 5=Cx5_Sleep
  compu method CM_VCU_InvldGearSel: 0=Cx0_Normal, 1=Cx1_Shifting_fails_please_brake (Shifting fails, please brake), 2=Cx2_Danger_Too_high_speed_do_not_switch_D_gear (Danger _ Too high speed _ do not switch D gear), 3=Cx3_Danger_Too_high_speed_do_not_switch_R_gear (Danger _ Too high speed _ do not switch R gear), 4=Cx4_Danger_Too_high_speed_do_not_switch_P_gear (Danger _ Too high speed _ do not switch P gear), 5=Cx5_Danger_The_accelerator_pedal_is_too_large_it_is_forbidden_to_switch_driving_gear (Danger _ The accelerator pedal is too large _ it is forbidden to switch driving gear), 6=Cx6_Charging_gun_connected_do_not_switch_gear (Charging gun connected, do not switch gear), 7=Cx7_The_shift_button_is_faulty_Screen_shift_is_recommended (The shift button is faulty _ Screen shift is recommended), 8=Cx8_The_vehicle_is_not_ready_it_is_forbidden_to_switch_driving_gears (The vehicle is not ready_it is forbidden to switch driving gears), 9=Cx9_EPB_unresponsive_unable_to_engage_in_P_gear (EPB unresponsive_unable to engage in P gear), 10=CxA_EPB_unresponsive_unable_to_exit_in_P_gear (EPB unresponsive_unable to exit in P gear), 11=CxB_SWP_is_faulty_PRND_button_is_recommended (SWP is faulty _ PRND button is recommended), 12=CxC_Fault_detected_shift_failed_please_restart_the_vehicle_or_contact_customer_service (Fault detected, shift failed, please restart the vehicle or contact customer service), 13=CxD_Danger_Too_high_speed_do_not_switch_N_gear (Danger _ Too high speed _ do not switch N gear), 14=CxE_Gun_insertion_detected_execute_automatic_P_gear (Gun insertion detected. execute automatic P-gear), 15=CxF_Immo_state_enable_forbid_gear_shifting (Immo state enable,forbid gear shifting)
  compu method CM_VCU_IsoMeasurementSwitch: 0=Cx0_OFF, 1=Cx1_ON
  compu method CM_VCU_Kickdown: 0=Cx0_Invalid, 1=Cx1_Valid
  compu method CM_VCU_KL15eOn: 0=Cx0_Off, 1=Cx1_On
  compu method CM_VCU_LimitLevel: 0=Cx0_level_0_No_limit (level 0-No limit), 1=Cx1_level_1 (level 1), 2=Cx2_level_2 (level 2), 3=Cx3_level_3 (level 3)
  compu method CM_VCU_LimpHome: 0=Cx0_False, 1=Cx1_True
  compu method CM_VCU_ManuallyUnlockComment: 0=Cx0_False, 1=Cx1_True
  compu method CM_VCU_maxChargeSOC: 254=CxFE_No_Request (No Request), 255=CxFF_Invalid
  compu method CM_VCU_MCU_FaultLampReq: 0=Cx0_No_Request (No Request), 1=Cx1_Yellow_LED_request (Yellow-LED request), 2=Cx2_Red_LED_request (Red-LED request), 3=Cx3_Reserve
  compu method CM_VCU_MCUDesiredTorque: 2046=Cx7FE_Init, 2047=Cx7FF_Error, phys=raw-1023 for raw 0..2045; unit Nm  # Source signal range: [0,2045]
  compu method CM_VCU_MCUSurgeDamperState: 0=Cx0_DstC_off, 1=Cx1_DstC_ext, 2=Cx2_DstC_int_ext; unit SED
  compu method CM_VCU_MemoryChargeFault: 0=Cx0_Normal, 1=Cx1_Charge_Fault (Charge Fault)
  compu method CM_VCU_MileagelowRemind: 0=Cx0_No_comment (No comment), 1=Cx1_The_mileage_is_too_low_please_charge (The mileage is too low, please charge)
  compu method CM_VCU_MotorActualTorque: phys=raw-1024 for raw 0..2047
  compu method CM_VCU_MotorActualTorqueValid: 0=Cx0_Invalid, 1=Cx1_Valid
  compu method CM_VCU_OPStandstillReq: 0=Cx0_NO_DEMAND, 1=Cx1_DEMAND, 2=Cx2_Reserve, 3=Cx3_Reserve
  compu method CM_VCU_PlugStatus: 0=Cx0_Init, 1=Cx1_No_Plug_connected, 2=Cx2_AC_Plug_connected_Unlock, 3=Cx3_AC_Plug_connected_Locked, 4=Cx4_DC_Plug_connected, 5=Cx5_V2L_Plug_connected, 6=Cx6_AC_Plug_DC_Plug_Connected (AC Plug&DC Plug Connected), 7=Cx7_Fault
  compu method CM_VCU_PWTErrorLevel: 0=Cx0_Fault_Level0 (Fault Level0), 1=Cx1_Fault_Level1 (Fault Level1), 2=Cx2_Fault_Level2 (Fault Level2), 3=Cx3_Fault_Level3 (Fault Level3), 4=Cx4_Fault_Level4 (Fault Level4), 5=Cx5_Fault_Level5 (Fault Level5), 6=Cx6_Fault_Level6 (Fault Level6), 7=Cx7_Fault_Level7 (Fault Level7), 8=Cx8_Fault_Level8 (Fault Level8), 9=Cx9_Fault_Level9 (Fault Level9), 10=CxA_Fault_Level10 (Fault Level10), 11=CxB_Fault_Level11 (Fault Level11), 12=CxC_Fault_Level12 (Fault Level12), 13=CxD_Fault_Level13 (Fault Level13), 14=CxE_Fault_Level14 (Fault Level14), 15=CxF_Fault_Level15 (Fault Level15)
  compu method CM_VCU_ReachLimitStd: 0=Cx0_No_request (No request), 1=Cx1_Request
  compu method CM_VCU_RegenBrakeLightRequest: 0=Cx0_Brake_lights_Off (Brake lights Off), 1=Cx1_Brake_lights_On (Brake lights On)
  compu method CM_VCU_RegenBrakeLightReqVld: 0=Cx0_INVALID, 1=Cx1_VALID
  compu method CM_VCU_RegenTorqueCap: phys=raw-20000 for raw 0..40000
  compu method CM_VCU_RegenTorqueCapValid: 0=Cx0_invalid, 1=Cx1_valid
  compu method CM_VCU_RegStatus: 0=Cx0_Reserve, 1=Cx1_OFF, 2=Cx2_Primary_energy_recovery_weak_ (Primary energy recovery (weak)), 3=Cx3_Secondary_energy_recovery_medium_ (Secondary energy recovery(medium)), 4=Cx4_Tertiary_energy_recovery_strong_ (Tertiary energy recovery (strong)), 5=Cx5_Reserved, 6=Cx6_Reserved, 7=Cx7_Reserved
  compu method CM_VCU_RemainChrgTime: 1022=Cx3FE_Init, 1023=Cx3FF_Error; unit min
  compu method CM_VCU_RequestedModeBMS: 0=Cx0_InActive, 1=Cx1_HVActive, 2=Cx2_Reserved, 3=Cx3_Reserved, 4=Cx4_Reserved, 5=Cx5_EmergencyOff, 6=Cx6_Reserved, 7=Cx7_Invalid
  compu method CM_VCU_RequestedModeMCU: 0=Cx0_Ready, 1=Cx1_TrqCtrl, 2=Cx2_Active_Hearting (Active Hearting), 3=Cx3_Discharge, 4=Cx4_SpeedCtrl
  compu method CM_VCU_SystemReady: 0=Cx0_Not_Ready (Not Ready), 1=Cx1_Ready
  compu method CM_VCU_TargetGear: 0=Cx0_Reserve, 1=Cx1_P, 2=Cx2_N, 3=Cx3_R, 4=Cx4_D
  compu method CM_VCU_TCSActive: 0=Cx0_NotActive, 1=Cx1_Active
  compu method CM_VCU_TorqueRequestActive: 0=Cx0_Not_Active (Not Active), 1=Cx1_Active
  compu method CM_VCU_TorqueRequestAvailable: 0=Cx0_Not_Available (Not Available), 1=Cx1_Available
  compu method CM_VCU_TrqThresholdDampgCtl: 254=CxFE_Init, 255=CxFF_Error, phys=raw*0.1 for raw 0..250; unit Nm  # Source signal range: [0,250]
  compu method CM_VCU_VehicleSpeed: phys=raw*0.05625 for raw 0..6400; unit km/h
  compu method CM_VCU_VehicleSpeedValid: 0=Cx0_invalid, 1=Cx1_valid
  compu method CM_VCU_VirtualACPedal: phys=raw*0.1 for raw 0..1000; unit percent
  compu method CM_VCU_VirtualACPedalValid: 0=Cx0_Invalid, 1=Cx1_Valid
  compu method CM_VCU_VLCTorqueRequestActive: 0=Cx0_Not_Active (Not Active), 1=Cx1_Active
  compu method CM_VCU_VLCTorqueRequestAvailable: 0=Cx0_Not_Available (Not Available), 1=Cx1_Available
  compu method CM_VCU_WakeUpStatus: identical
  compu method CM_VCU_WheelTrqACT: phys=raw-20000 for raw 0..40000; unit Nm
  compu method CM_VCU_WheelTrqACTValid: 0=Cx0_invalid, 1=Cx1_valid
  compu method CM_AN0: identical
  compu method CM_AN1: identical
  compu method CM_AN{10..19}: identical
  compu method CM_AN2: identical
  compu method CM_AN{20..29}: identical
  compu method CM_AN3: identical
  compu method CM_AN{30..39}: identical
  compu method CM_AN4: identical
  compu method CM_AN{40..47}: identical
  compu method CM_AN{5..9}: identical
  compu method CM_Bts7xx_HS{1..4}_En: identical
  compu method CM_Tle888qk_Out{21..24}_En: identical
  compu method CM_Tle4252d_en: identical
  compu method CM_Tle888qk_Out{21..24}BriCfg: identical
  compu method CM_Tle9201_Dir: identical
  compu method CM_Tle9201_Dis: identical
  compu method CM_Tle9201_Pwm: identical
  compu method CM_Ext_IN2: identical
  compu method CM_EXT_PWM_IN1_Duty: identical
  compu method CM_EXT_PWM_IN1_Period: identical
  compu method CM_EXT_PWM_IN2_Duty: identical
  compu method CM_EXT_PWM_IN2_Period: identical
  compu method CM_Tle888qk_Lout1_En: identical
  compu method CM_Tle888qk_Lout14_En: identical
  compu method CM_Tle888qk_Lout16_En: identical
  compu method CM_Tle888qk_Lout8_En: identical
  compu method CM_Vcu_Lin3_RxMsg1_Sig0: identical
  compu method CM_Vcu_Lin3_RxMsg1_Sig1: identical
  compu method CM_Vcu_Lin3_RxMsg2_Sig{0..3}: identical
  compu method CM_Vcu_Lin3_TxMsg1_Sig{0..3}: identical
  compu method CM_Vcu_Lin3_TxMsg2_Sig{0..3}: identical
package /DataType/Unit
  22 x unit:
    U_C: display-name=¡ãC, factor-si-to-unit=1, offset-si-to-unit=0
    U_A: display-name=A, factor-si-to-unit=1, offset-si-to-unit=0
    U_celsius: display-name=celsius, factor-si-to-unit=1, offset-si-to-unit=0
    U_Degree: display-name=Degree, factor-si-to-unit=1, offset-si-to-unit=0
    U_KW: display-name=KW, factor-si-to-unit=1, offset-si-to-unit=0
    U_p: display-name=%, factor-si-to-unit=1, offset-si-to-unit=0
    U_percent: display-name=percent, factor-si-to-unit=1, offset-si-to-unit=0
    U_V: display-name=V, factor-si-to-unit=1, offset-si-to-unit=0
    U_BAR: display-name=BAR, factor-si-to-unit=1, offset-si-to-unit=0
    U_cm: display-name=cm, factor-si-to-unit=1, offset-si-to-unit=0
    U_degreesYs: display-name=degrees/s, factor-si-to-unit=1, offset-si-to-unit=0
    U_kmYh: display-name=km/h, factor-si-to-unit=1, offset-si-to-unit=0
    U_kW: display-name=kW, factor-si-to-unit=1, offset-si-to-unit=0
    U_kWh: display-name=kWh, factor-si-to-unit=1, offset-si-to-unit=0
    U_min: display-name=min, factor-si-to-unit=1, offset-si-to-unit=0
    U_mm: display-name=mm, factor-si-to-unit=1, offset-si-to-unit=0
    U_mYsX2: display-name=m/s^2, factor-si-to-unit=1, offset-si-to-unit=0
    U_Nm: display-name=Nm, factor-si-to-unit=1, offset-si-to-unit=0
    U_SED: display-name=SED, factor-si-to-unit=1, offset-si-to-unit=0
    U_mV: display-name=mV, factor-si-to-unit=1, offset-si-to-unit=0
    U_ms: display-name=ms, factor-si-to-unit=1, offset-si-to-unit=0
    U_us: display-name=us
package /DataTypes
  126 x impl type:
    VcuRxMsg1_Sig0: category=VALUE, base-type=sint16, range raw -32768..32767
    VcuRxMsg1_Sig2: category=VALUE, base-type=sint16, range raw -32768..32767
    VcuRxMsg1_Sig1: category=VALUE, base-type=sint16, range raw -32768..32767
    VcuRxMsg2_Sig3: category=VALUE, base-type=sint16, range raw -32768..32767
    VcuRxMsg1_Sig3: category=VALUE, base-type=sint16, range raw -32768..32767
    VcuRxMsg2_Sig0: category=VALUE, base-type=sint16, range raw -32768..32767
    VcuRxMsg2_Sig2: category=VALUE, base-type=sint16, range raw -32768..32767
    VcuRxMsg2_Sig1: category=VALUE, base-type=sint16, range raw -32768..32767
    VcuTxMsg1_Sig1: category=VALUE, base-type=sint16, range raw -32768..32767
    VcuTxMsg2_Sig1: category=VALUE, base-type=sint16, range raw -32768..32767
    VcuTxMsg2_Sig2: category=VALUE, base-type=sint16, range raw -32768..32767
    VcuTxMsg1_Sig3: category=VALUE, base-type=sint16, range raw -32768..32767
    VcuTxMsg2_Sig0: category=VALUE, base-type=sint16, range raw -32768..32767
    VcuTxMsg2_Sig3: category=VALUE, base-type=sint16, range raw -32768..32767
    VcuTxMsg1_Sig2: category=VALUE, base-type=sint16, range raw -32768..32767
    VcuTxMsg1_Sig0: category=VALUE, base-type=sint16, range raw -32768..32767
    NvM_Array10Bytes: category=ARRAY, sw-calibration-access=READ-ONLY, type-emitter=RTE
      element Element: array-size=10, implementation-data-type=uint8
    NvM_Array32Bytes: category=ARRAY, sw-calibration-access=READ-ONLY, type-emitter=RTE
      element Element: array-size=32, implementation-data-type=uint8
    NvM_Arry4Bytes: category=ARRAY, sw-calibration-access=READ-ONLY, type-emitter=RTE
      element Element: array-size=4, implementation-data-type=uint8
    EXT1_Valid: category=VALUE, base-type=uint16, range raw 0..1
    EXT3_Valid: category=VALUE, base-type=uint16, range raw 0..1
    EXT_A_IN4: category=VALUE, base-type=sint16, range raw -32768..32767
    EXT2_Valid: category=VALUE, base-type=uint16, range raw 0..1
    EXT4_Valid: category=VALUE, base-type=uint16, range raw 0..1
    EXT_A_IN1: category=VALUE, base-type=sint16, range raw -256..255
    EXT_A_IN2: category=VALUE, base-type=sint16, range raw -32768..32767
    EXT_A_IN3: category=VALUE, base-type=sint16, range raw -256..255
    EXT10_Valid: category=VALUE, base-type=uint16, range raw 0..1
    EXT12_Valid: category=VALUE, base-type=uint16, range raw 0..1
    EXT15_Valid: category=VALUE, base-type=uint16, range raw 0..1
    EXT5_Valid: category=VALUE, base-type=uint16, range raw 0..1
    EXT_A_IN15: category=VALUE, base-type=sint16, range raw -256..255
    EXT7_Valid: category=VALUE, base-type=uint16, range raw 0..1
    EXT_A_IN13: category=VALUE, base-type=sint16, range raw -256..255
    EXT_A_IN5: category=VALUE, base-type=sint16, range raw -256..255
    EXT6_Valid: category=VALUE, base-type=uint16, range raw 0..1
    EXT_A_IN12: category=VALUE, base-type=sint16, range raw -32768..32767
    EXT_A_IN7: category=VALUE, base-type=sint16, range raw -256..255
    EXT13_Valid: category=VALUE, base-type=uint16, range raw 0..1
    EXT_A_IN9: category=VALUE, base-type=sint16, range raw -256..255
    EXT9_Valid: category=VALUE, base-type=uint16, range raw 0..1
    EXT8_Valid: category=VALUE, base-type=uint16, range raw 0..1
    EXT11_Valid: category=VALUE, base-type=uint16, range raw 0..1
    EXT_A_IN6: category=VALUE, base-type=sint16, range raw -32768..32767
    EXT16_Valid: category=VALUE, base-type=uint16, range raw 0..1
    EXT14_Valid: category=VALUE, base-type=uint16, range raw 0..1
    EXT_A_IN16: category=VALUE, base-type=sint16, range raw -32768..32767
    EXT_A_IN11: category=VALUE, base-type=sint16, range raw -256..255
    EXT_A_IN8: category=VALUE, base-type=sint16, range raw -32768..32767
    EXT_A_IN14: category=VALUE, base-type=sint16, range raw -32768..32767
    EXT_A_IN10: category=VALUE, base-type=sint16, range raw -32768..32767
    ECC_PMP2_SpdSet: category=VALUE, base-type=uint8, range raw 0..100
    ECC_PMP3_SpdSet: category=VALUE, base-type=uint8, range raw 0..100
    AN30: category=VALUE, base-type=sint16, range raw -32768..32767
    AN22: category=VALUE, base-type=sint16, range raw -32768..32767
    AN27: category=VALUE, base-type=sint16, range raw -32768..32767
    AN10: category=VALUE, base-type=sint16, range raw -32768..32767
    AN24: category=VALUE, base-type=sint16, range raw -32768..32767
    AN13: category=VALUE, base-type=sint16, range raw -32768..32767
    AN8: category=VALUE, base-type=sint16, range raw -32768..32767
    AN0: category=VALUE, base-type=sint16, range raw -32768..32767
    AN26: category=VALUE, base-type=sint16, range raw -32768..32767
    AN29: category=VALUE, base-type=sint16, range raw -32768..32767
    AN3: category=VALUE, base-type=sint16, range raw -32768..32767
    AN19: category=VALUE, base-type=sint16, range raw -32768..32767
    AN14: category=VALUE, base-type=sint16, range raw -32768..32767
    AN42: category=VALUE, base-type=sint16, range raw -32768..32767
    AN25: category=VALUE, base-type=sint16, range raw -32768..32767
    AN12: category=VALUE, base-type=sint16, range raw -32768..32767
    AN9: category=VALUE, base-type=sint16, range raw -32768..32767
    AN31: category=VALUE, base-type=sint16, range raw -32768..32767
    AN18: category=VALUE, base-type=sint16, range raw -32768..32767
    AN5: category=VALUE, base-type=sint16, range raw -32768..32767
    AN20: category=VALUE, base-type=sint16, range raw -32768..32767
    AN43: category=VALUE, base-type=sint16, range raw -32768..32767
    AN15: category=VALUE, base-type=sint16, range raw -32768..32767
    AN46: category=VALUE, base-type=sint16, range raw -32768..32767
    AN32: category=VALUE, base-type=sint16, range raw -32768..32767
    AN34: category=VALUE, base-type=sint16, range raw -32768..32767
    AN36: category=VALUE, base-type=sint16, range raw -32768..32767
    AN41: category=VALUE, base-type=sint16, range raw -32768..32767
    AN44: category=VALUE, base-type=sint16, range raw -32768..32767
    AN6: category=VALUE, base-type=sint16, range raw -32768..32767
    AN2: category=VALUE, base-type=sint16, range raw -32768..32767
    AN7: category=VALUE, base-type=sint16, range raw -32768..32767
    AN11: category=VALUE, base-type=sint16, range raw -32768..32767
    AN40: category=VALUE, base-type=sint16, range raw -32768..32767
    AN47: category=VALUE, base-type=sint16, range raw -32768..32767
    AN1: category=VALUE, base-type=sint16, range raw -32768..32767
    AN28: category=VALUE, base-type=sint16, range raw -32768..32767
    AN37: category=VALUE, base-type=sint16, range raw -32768..32767
    AN21: category=VALUE, base-type=sint16, range raw -32768..32767
    AN33: category=VALUE, base-type=sint16, range raw -32768..32767
    AN23: category=VALUE, base-type=sint16, range raw -32768..32767
    AN4: category=VALUE, base-type=sint16, range raw -32768..32767
    AN16: category=VALUE, base-type=sint16, range raw -32768..32767
    AN17: category=VALUE, base-type=sint16, range raw -32768..32767
    AN35: category=VALUE, base-type=sint16, range raw -32768..32767
    AN45: category=VALUE, base-type=sint16, range raw -32768..32767
    AN38: category=VALUE, base-type=sint16, range raw -32768..32767
    AN39: category=VALUE, base-type=sint16, range raw -32768..32767
    Tle888qk_Out23_En: category=VALUE, base-type=sint8, range raw -128..127
    Tle888qk_Out22_En: category=VALUE, base-type=sint8, range raw -128..127
    Tle888qk_Out21_En: category=VALUE, base-type=sint8, range raw -128..127
    Bts7xx_HS3_En: category=VALUE, base-type=sint8, range raw -128..127
    Bts7xx_HS1_En: category=VALUE, base-type=sint8, range raw -128..127
    Bts7xx_HS4_En: category=VALUE, base-type=sint8, range raw -128..127
    Bts7xx_HS2_En: category=VALUE, base-type=sint8, range raw -128..127
    Tle888qk_Out24_En: category=VALUE, base-type=sint8, range raw -128..127
    Tle9201_Dir: category=VALUE, base-type=sint8, range raw -128..127
    Tle9201_Pwm: category=VALUE, base-type=sint8, range raw -128..127
    Tle9201_Dis: category=VALUE, base-type=sint8, range raw -128..127
    Tle4252d_en: category=VALUE, base-type=sint8, range raw -128..127
    Tle888qk_Out22BriCfg: category=VALUE, base-type=sint8, range raw -128..127
    Tle888qk_Out23BriCfg: category=VALUE, base-type=sint8, range raw -128..127
    Tle888qk_Out21BriCfg: category=VALUE, base-type=sint8, range raw -128..127
    Tle888qk_Out24BriCfg: category=VALUE, base-type=sint8, range raw -128..127
    Ext_IN2: category=VALUE, base-type=sint8, range raw -128..127
    EXT_PWM_IN1_Duty: category=VALUE, base-type=sint8, range raw -128..127
    EXT_PWM_IN2_Duty: category=VALUE, base-type=sint8, range raw -128..127
    EXT_PWM_IN2_Period: category=VALUE, base-type=sint16, range raw -32768..32767
    EXT_PWM_IN1_Period: category=VALUE, base-type=sint16, range raw -32768..32767
    Tle888qk_Lout1_En: category=VALUE, base-type=sint8, range raw -128..127
    Tle888qk_Lout8_En: category=VALUE, base-type=sint8, range raw -128..127
    Tle888qk_Lout14_En: category=VALUE, base-type=sint8, range raw -128..127
    Tle888qk_Lout16_En: category=VALUE, base-type=sint8, range raw -128..127
