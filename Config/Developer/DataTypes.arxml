AUTOSAR XML (schema 00046)
standard types defined: sint16
package /Predefined_DEV/ImplementationDataTypes
  impl type NvM_RequestResultType: compu {0=NVM_REQ_OK, 1=NVM_REQ_NOT_OK, 2=NVM_REQ_PENDING, 3=NVM_REQ_INTEGRITY_FAILED, 4=NVM_REQ_BLOCK_SKIPPED, 5=NVM_REQ_NV_INVALIDATED, 6=NVM_REQ_CANCELED, 7=NVM_REQ_REDUNDANCY_FAILED, 8=NVM_REQ_RESTORED_FROM_ROM}, implementation-data-type=uint8
  impl type NvM_ServiceIdType: compu {6=NVM_READ_BLOCK, 7=NVM_WRITE_BLOCK, 8=NVM_RESTORE_BLOCK_DEFAULTS, 9=NVM_ERASE_BLOCK, 11=NVM_INVALIDATE_NV_BLOCK, 12=NVM_READ_ALL}, implementation-data-type=uint8
  impl type Dem_UdsStatusByteType: compu {mask 1: 1=DEM_UDS_STATUS_TF, mask 2: 2=DEM_UDS_STATUS_TFTOC, mask 4: 4=DEM_UDS_STATUS_PDTC, mask 8: 8=DEM_UDS_STATUS_CDTC, mask 16: 16=DEM_UDS_STATUS_TNCSLC, mask 32: 32=DEM_UDS_STATUS_TFSLC, mask 64: 64=DEM_UDS_STATUS_TNCTOC, mask 128: 128=DEM_UDS_STATUS_WIR}, range raw 0..255, implementation-data-type=uint8
package /DataType/Semantics
  compu method CM_VcuRxMsg1_Sig{0..3}: identical
  compu method CM_VcuRxMsg2_Sig{0..3}: identical
  compu method CM_VcuTxMsg1_Sig{0..3}: identical
  compu method CM_VcuTxMsg2_Sig{0..3}: identical
package /DataTypes
  19 x impl type:
    VcuRxMsg1_Sig0: category=VALUE, base-type=sint16, range raw -32768..32767
    VcuRxMsg1_Sig2: category=VALUE, base-type=sint16, range raw -32768..32767
    VcuRxMsg1_Sig1: category=VALUE, base-type=sint16, range raw -32768..32767
    VcuRxMsg2_Sig3: category=VALUE, base-type=sint16, range raw -32768..32767
    VcuRxMsg1_Sig3: category=VALUE, base-type=sint16, range raw -32768..32767
    VcuRxMsg2_Sig0: category=VALUE, base-type=sint16, range raw -32768..32767
    VcuRxMsg2_Sig2: category=VALUE, base-type=sint16, range raw -32768..32767
    VcuRxMsg2_Sig1: category=VALUE, base-type=sint16, range raw -32768..32767
    VcuTxMsg1_Sig1: category=VALUE, base-type=sint16, range raw -32768..32767
    VcuTxMsg2_Sig1: category=VALUE, base-type=sint16, range raw -32768..32767
    VcuTxMsg2_Sig2: category=VALUE, base-type=sint16, range raw -32768..32767
    VcuTxMsg1_Sig3: category=VALUE, base-type=sint16, range raw -32768..32767
    VcuTxMsg2_Sig0: category=VALUE, base-type=sint16, range raw -32768..32767
    VcuTxMsg2_Sig3: category=VALUE, base-type=sint16, range raw -32768..32767
    VcuTxMsg1_Sig2: category=VALUE, base-type=sint16, range raw -32768..32767
    VcuTxMsg1_Sig0: category=VALUE, base-type=sint16, range raw -32768..32767
    NvM_Array10Bytes: category=ARRAY, sw-calibration-access=READ-ONLY, type-emitter=RTE
      element Element: array-size=10, implementation-data-type=uint8
    NvM_Array32Bytes: category=ARRAY, sw-calibration-access=READ-ONLY, type-emitter=RTE
      element Element: array-size=32, implementation-data-type=uint8
    NvM_Arry4Bytes: category=ARRAY, sw-calibration-access=READ-ONLY, type-emitter=RTE
      element Element: array-size=4, implementation-data-type=uint8
