[part 2 of 2: package /ComponentTypes]
AUTOSAR XML (schema 00046)
package /ComponentTypes  (continued)
  application sw component type YDF_ErrorHandler  (continued)
    behavior YDF_ErrorHandler_InternalBehavior  (continued)
      runnable RYDF_ErrorHandler_10ms  (continued)
        2378 x sync call:  (continued)
          SC_Event_DTC_0xc19987_GetDTCOfEvent: operation=Event_DTC_0xc19987.GetDTCOfEvent
          SC_Event_DTC_0xc19987_GetEventExtendedDataRecordEx: operation=Event_DTC_0xc19987.GetEventExtendedDataRecordEx
          SC_Event_DTC_0xc19987_GetEventFailed: operation=Event_DTC_0xc19987.GetEventFailed
          SC_Event_DTC_0xc19987_GetEventFreezeFrameDataEx: operation=Event_DTC_0xc19987.GetEventFreezeFrameDataEx
          SC_Event_DTC_0xc19987_GetEventStatus: operation=Event_DTC_0xc19987.GetEventStatus
          SC_Event_DTC_0xc19987_GetEventTested: operation=Event_DTC_0xc19987.GetEventTested
          SC_Event_DTC_0xc19987_GetEventUdsStatus: operation=Event_DTC_0xc19987.GetEventUdsStatus
          SC_Event_DTC_0xc19987_GetFaultDetectionCounter: operation=Event_DTC_0xc19987.GetFaultDetectionCounter
          SC_Event_DTC_0xc19987_ResetEventDebounceStatus: operation=Event_DTC_0xc19987.ResetEventDebounceStatus
          SC_Event_DTC_0xc19987_ResetEventStatus: operation=Event_DTC_0xc19987.ResetEventStatus
          SC_Event_DTC_0xc19987_SetEventStatus: operation=Event_DTC_0xc19987.SetEventStatus
          SC_Event_DTC_0xc19b87_GetDTCOfEvent: operation=Event_DTC_0xc19b87.GetDTCOfEvent
          SC_Event_DTC_0xc19b87_GetEventExtendedDataRecordEx: operation=Event_DTC_0xc19b87.GetEventExtendedDataRecordEx
          SC_Event_DTC_0xc19b87_GetEventFailed: operation=Event_DTC_0xc19b87.GetEventFailed
          SC_Event_DTC_0xc19b87_GetEventFreezeFrameDataEx: operation=Event_DTC_0xc19b87.GetEventFreezeFrameDataEx
          SC_Event_DTC_0xc19b87_GetEventStatus: operation=Event_DTC_0xc19b87.GetEventStatus
          SC_Event_DTC_0xc19b87_GetEventTested: operation=Event_DTC_0xc19b87.GetEventTested
          SC_Event_DTC_0xc19b87_GetEventUdsStatus: operation=Event_DTC_0xc19b87.GetEventUdsStatus
          SC_Event_DTC_0xc19b87_GetFaultDetectionCounter: operation=Event_DTC_0xc19b87.GetFaultDetectionCounter
          SC_Event_DTC_0xc19b87_ResetEventDebounceStatus: operation=Event_DTC_0xc19b87.ResetEventDebounceStatus
          SC_Event_DTC_0xc19b87_ResetEventStatus: operation=Event_DTC_0xc19b87.ResetEventStatus
          SC_Event_DTC_0xc19b87_SetEventStatus: operation=Event_DTC_0xc19b87.SetEventStatus
          SC_Event_DTC_0xc29887_GetDTCOfEvent: operation=Event_DTC_0xc29887.GetDTCOfEvent
          SC_Event_DTC_0xc29887_GetEventExtendedDataRecordEx: operation=Event_DTC_0xc29887.GetEventExtendedDataRecordEx
          SC_Event_DTC_0xc29887_GetEventFailed: operation=Event_DTC_0xc29887.GetEventFailed
          SC_Event_DTC_0xc29887_GetEventFreezeFrameDataEx: operation=Event_DTC_0xc29887.GetEventFreezeFrameDataEx
          SC_Event_DTC_0xc29887_GetEventStatus: operation=Event_DTC_0xc29887.GetEventStatus
          SC_Event_DTC_0xc29887_GetEventTested: operation=Event_DTC_0xc29887.GetEventTested
          SC_Event_DTC_0xc29887_GetEventUdsStatus: operation=Event_DTC_0xc29887.GetEventUdsStatus
          SC_Event_DTC_0xc29887_GetFaultDetectionCounter: operation=Event_DTC_0xc29887.GetFaultDetectionCounter
          SC_Event_DTC_0xc29887_ResetEventDebounceStatus: operation=Event_DTC_0xc29887.ResetEventDebounceStatus
          SC_Event_DTC_0xc29887_ResetEventStatus: operation=Event_DTC_0xc29887.ResetEventStatus
          SC_Event_DTC_0xc29887_SetEventStatus: operation=Event_DTC_0xc29887.SetEventStatus
          SC_Event_DTC_0xd10587_GetDTCOfEvent: operation=Event_DTC_0xd10587.GetDTCOfEvent
          SC_Event_DTC_0xd10587_GetEventExtendedDataRecordEx: operation=Event_DTC_0xd10587.GetEventExtendedDataRecordEx
          SC_Event_DTC_0xd10587_GetEventFailed: operation=Event_DTC_0xd10587.GetEventFailed
          SC_Event_DTC_0xd10587_GetEventFreezeFrameDataEx: operation=Event_DTC_0xd10587.GetEventFreezeFrameDataEx
          SC_Event_DTC_0xd10587_GetEventStatus: operation=Event_DTC_0xd10587.GetEventStatus
          SC_Event_DTC_0xd10587_GetEventTested: operation=Event_DTC_0xd10587.GetEventTested
          SC_Event_DTC_0xd10587_GetEventUdsStatus: operation=Event_DTC_0xd10587.GetEventUdsStatus
          SC_Event_DTC_0xd10587_GetFaultDetectionCounter: operation=Event_DTC_0xd10587.GetFaultDetectionCounter
          SC_Event_DTC_0xd10587_ResetEventDebounceStatus: operation=Event_DTC_0xd10587.ResetEventDebounceStatus
          SC_Event_DTC_0xd10587_ResetEventStatus: operation=Event_DTC_0xd10587.ResetEventStatus
          SC_Event_DTC_0xd10587_SetEventStatus: operation=Event_DTC_0xd10587.SetEventStatus
          SC_DiagHandle_GetEventSts: operation=DiagHandle.GetEventSts
          SC_Event_DTC_0x115a92_GetDTCOfEvent: operation=Event_DTC_0x115a92.GetDTCOfEvent
          SC_Event_DTC_0x115a92_GetEventExtendedDataRecordEx: operation=Event_DTC_0x115a92.GetEventExtendedDataRecordEx
          SC_Event_DTC_0x115a92_GetEventFailed: operation=Event_DTC_0x115a92.GetEventFailed
          SC_Event_DTC_0x115a92_GetEventFreezeFrameDataEx: operation=Event_DTC_0x115a92.GetEventFreezeFrameDataEx
          SC_Event_DTC_0x115a92_GetEventStatus: operation=Event_DTC_0x115a92.GetEventStatus
          SC_Event_DTC_0x115a92_GetEventTested: operation=Event_DTC_0x115a92.GetEventTested
          SC_Event_DTC_0x115a92_GetEventUdsStatus: operation=Event_DTC_0x115a92.GetEventUdsStatus
          SC_Event_DTC_0x115a92_GetFaultDetectionCounter: operation=Event_DTC_0x115a92.GetFaultDetectionCounter
          SC_Event_DTC_0x115a92_ResetEventDebounceStatus: operation=Event_DTC_0x115a92.ResetEventDebounceStatus
          SC_Event_DTC_0x115a92_ResetEventStatus: operation=Event_DTC_0x115a92.ResetEventStatus
          SC_Event_DTC_0x115a92_SetEventStatus: operation=Event_DTC_0x115a92.SetEventStatus
          SC_Event_DTC_0x115c4b_GetDTCOfEvent: operation=Event_DTC_0x115c4b.GetDTCOfEvent
          SC_Event_DTC_0x115c4b_GetEventExtendedDataRecordEx: operation=Event_DTC_0x115c4b.GetEventExtendedDataRecordEx
          SC_Event_DTC_0x115c4b_GetEventFailed: operation=Event_DTC_0x115c4b.GetEventFailed
          SC_Event_DTC_0x115c4b_GetEventFreezeFrameDataEx: operation=Event_DTC_0x115c4b.GetEventFreezeFrameDataEx
          SC_Event_DTC_0x115c4b_GetEventStatus: operation=Event_DTC_0x115c4b.GetEventStatus
          SC_Event_DTC_0x115c4b_GetEventTested: operation=Event_DTC_0x115c4b.GetEventTested
          SC_Event_DTC_0x115c4b_GetEventUdsStatus: operation=Event_DTC_0x115c4b.GetEventUdsStatus
          SC_Event_DTC_0x115c4b_GetFaultDetectionCounter: operation=Event_DTC_0x115c4b.GetFaultDetectionCounter
          SC_Event_DTC_0x115c4b_ResetEventDebounceStatus: operation=Event_DTC_0x115c4b.ResetEventDebounceStatus
          SC_Event_DTC_0x115c4b_ResetEventStatus: operation=Event_DTC_0x115c4b.ResetEventStatus
          SC_Event_DTC_0x115c4b_SetEventStatus: operation=Event_DTC_0x115c4b.SetEventStatus
          SC_Event_DTC_0x115d4b_GetDTCOfEvent: operation=Event_DTC_0x115d4b.GetDTCOfEvent
          SC_Event_DTC_0x115d4b_GetEventExtendedDataRecordEx: operation=Event_DTC_0x115d4b.GetEventExtendedDataRecordEx
          SC_Event_DTC_0x115d4b_GetEventFailed: operation=Event_DTC_0x115d4b.GetEventFailed
          SC_Event_DTC_0x115d4b_GetEventFreezeFrameDataEx: operation=Event_DTC_0x115d4b.GetEventFreezeFrameDataEx
          SC_Event_DTC_0x115d4b_GetEventStatus: operation=Event_DTC_0x115d4b.GetEventStatus
          SC_Event_DTC_0x115d4b_GetEventTested: operation=Event_DTC_0x115d4b.GetEventTested
          SC_Event_DTC_0x115d4b_GetEventUdsStatus: operation=Event_DTC_0x115d4b.GetEventUdsStatus
          SC_Event_DTC_0x115d4b_GetFaultDetectionCounter: operation=Event_DTC_0x115d4b.GetFaultDetectionCounter
          SC_Event_DTC_0x115d4b_ResetEventDebounceStatus: operation=Event_DTC_0x115d4b.ResetEventDebounceStatus
          SC_Event_DTC_0x115d4b_ResetEventStatus: operation=Event_DTC_0x115d4b.ResetEventStatus
          SC_Event_DTC_0x115d4b_SetEventStatus: operation=Event_DTC_0x115d4b.SetEventStatus
          SC_Event_DTC_0x115e1a_GetDTCOfEvent: operation=Event_DTC_0x115e1a.GetDTCOfEvent
          SC_Event_DTC_0x115e1a_GetEventExtendedDataRecordEx: operation=Event_DTC_0x115e1a.GetEventExtendedDataRecordEx
          SC_Event_DTC_0x115e1a_GetEventFailed: operation=Event_DTC_0x115e1a.GetEventFailed
          SC_Event_DTC_0x115e1a_GetEventFreezeFrameDataEx: operation=Event_DTC_0x115e1a.GetEventFreezeFrameDataEx
          SC_Event_DTC_0x115e1a_GetEventStatus: operation=Event_DTC_0x115e1a.GetEventStatus
          SC_Event_DTC_0x115e1a_GetEventTested: operation=Event_DTC_0x115e1a.GetEventTested
          SC_Event_DTC_0x115e1a_GetEventUdsStatus: operation=Event_DTC_0x115e1a.GetEventUdsStatus
          SC_Event_DTC_0x115e1a_GetFaultDetectionCounter: operation=Event_DTC_0x115e1a.GetFaultDetectionCounter
          SC_Event_DTC_0x115e1a_ResetEventDebounceStatus: operation=Event_DTC_0x115e1a.ResetEventDebounceStatus
          SC_Event_DTC_0x115e1a_ResetEventStatus: operation=Event_DTC_0x115e1a.ResetEventStatus
          SC_Event_DTC_0x115e1a_SetEventStatus: operation=Event_DTC_0x115e1a.SetEventStatus
          SC_Event_DTC_0x116097_GetDTCOfEvent: operation=Event_DTC_0x116097.GetDTCOfEvent
          SC_Event_DTC_0x116097_GetEventExtendedDataRecordEx: operation=Event_DTC_0x116097.GetEventExtendedDataRecordEx
          SC_Event_DTC_0x116097_GetEventFailed: operation=Event_DTC_0x116097.GetEventFailed
          SC_Event_DTC_0x116097_GetEventFreezeFrameDataEx: operation=Event_DTC_0x116097.GetEventFreezeFrameDataEx
          SC_Event_DTC_0x116097_GetEventStatus: operation=Event_DTC_0x116097.GetEventStatus
          SC_Event_DTC_0x116097_GetEventTested: operation=Event_DTC_0x116097.GetEventTested
          SC_Event_DTC_0x116097_GetEventUdsStatus: operation=Event_DTC_0x116097.GetEventUdsStatus
          SC_Event_DTC_0x116097_GetFaultDetectionCounter: operation=Event_DTC_0x116097.GetFaultDetectionCounter
          SC_Event_DTC_0x116097_ResetEventDebounceStatus: operation=Event_DTC_0x116097.ResetEventDebounceStatus
          SC_Event_DTC_0x116097_ResetEventStatus: operation=Event_DTC_0x116097.ResetEventStatus
          SC_Event_DTC_0x116097_SetEventStatus: operation=Event_DTC_0x116097.SetEventStatus
          SC_Event_DTC_0x11611c_GetDTCOfEvent: operation=Event_DTC_0x11611c.GetDTCOfEvent
          SC_Event_DTC_0x11611c_GetEventExtendedDataRecordEx: operation=Event_DTC_0x11611c.GetEventExtendedDataRecordEx
          SC_Event_DTC_0x11611c_GetEventFailed: operation=Event_DTC_0x11611c.GetEventFailed
          SC_Event_DTC_0x11611c_GetEventFreezeFrameDataEx: operation=Event_DTC_0x11611c.GetEventFreezeFrameDataEx
          SC_Event_DTC_0x11611c_GetEventStatus: operation=Event_DTC_0x11611c.GetEventStatus
          SC_Event_DTC_0x11611c_GetEventTested: operation=Event_DTC_0x11611c.GetEventTested
          SC_Event_DTC_0x11611c_GetEventUdsStatus: operation=Event_DTC_0x11611c.GetEventUdsStatus
          SC_Event_DTC_0x11611c_GetFaultDetectionCounter: operation=Event_DTC_0x11611c.GetFaultDetectionCounter
          SC_Event_DTC_0x11611c_ResetEventDebounceStatus: operation=Event_DTC_0x11611c.ResetEventDebounceStatus
          SC_Event_DTC_0x11611c_ResetEventStatus: operation=Event_DTC_0x11611c.ResetEventStatus
          SC_Event_DTC_0x11611c_SetEventStatus: operation=Event_DTC_0x11611c.SetEventStatus
          SC_Event_DTC_0x116197_GetDTCOfEvent: operation=Event_DTC_0x116197.GetDTCOfEvent
          SC_Event_DTC_0x116197_GetEventExtendedDataRecordEx: operation=Event_DTC_0x116197.GetEventExtendedDataRecordEx
          SC_Event_DTC_0x116197_GetEventFailed: operation=Event_DTC_0x116197.GetEventFailed
          SC_Event_DTC_0x116197_GetEventFreezeFrameDataEx: operation=Event_DTC_0x116197.GetEventFreezeFrameDataEx
          SC_Event_DTC_0x116197_GetEventStatus: operation=Event_DTC_0x116197.GetEventStatus
          SC_Event_DTC_0x116197_GetEventTested: operation=Event_DTC_0x116197.GetEventTested
          SC_Event_DTC_0x116197_GetEventUdsStatus: operation=Event_DTC_0x116197.GetEventUdsStatus
          SC_Event_DTC_0x116197_GetFaultDetectionCounter: operation=Event_DTC_0x116197.GetFaultDetectionCounter
          SC_Event_DTC_0x116197_ResetEventDebounceStatus: operation=Event_DTC_0x116197.ResetEventDebounceStatus
          SC_Event_DTC_0x116197_ResetEventStatus: operation=Event_DTC_0x116197.ResetEventStatus
          SC_Event_DTC_0x116197_SetEventStatus: operation=Event_DTC_0x116197.SetEventStatus
          SC_Event_DTC_0x11621c_GetDTCOfEvent: operation=Event_DTC_0x11621c.GetDTCOfEvent
          SC_Event_DTC_0x11621c_GetEventExtendedDataRecordEx: operation=Event_DTC_0x11621c.GetEventExtendedDataRecordEx
          SC_Event_DTC_0x11621c_GetEventFailed: operation=Event_DTC_0x11621c.GetEventFailed
          SC_Event_DTC_0x11621c_GetEventFreezeFrameDataEx: operation=Event_DTC_0x11621c.GetEventFreezeFrameDataEx
          SC_Event_DTC_0x11621c_GetEventStatus: operation=Event_DTC_0x11621c.GetEventStatus
          SC_Event_DTC_0x11621c_GetEventTested: operation=Event_DTC_0x11621c.GetEventTested
          SC_Event_DTC_0x11621c_GetEventUdsStatus: operation=Event_DTC_0x11621c.GetEventUdsStatus
          SC_Event_DTC_0x11621c_GetFaultDetectionCounter: operation=Event_DTC_0x11621c.GetFaultDetectionCounter
          SC_Event_DTC_0x11621c_ResetEventDebounceStatus: operation=Event_DTC_0x11621c.ResetEventDebounceStatus
          SC_Event_DTC_0x11621c_ResetEventStatus: operation=Event_DTC_0x11621c.ResetEventStatus
          SC_Event_DTC_0x11621c_SetEventStatus: operation=Event_DTC_0x11621c.SetEventStatus
          SC_Event_DTC_0x116397_GetDTCOfEvent: operation=Event_DTC_0x116397.GetDTCOfEvent
          SC_Event_DTC_0x116397_GetEventExtendedDataRecordEx: operation=Event_DTC_0x116397.GetEventExtendedDataRecordEx
          SC_Event_DTC_0x116397_GetEventFailed: operation=Event_DTC_0x116397.GetEventFailed
          SC_Event_DTC_0x116397_GetEventFreezeFrameDataEx: operation=Event_DTC_0x116397.GetEventFreezeFrameDataEx
          SC_Event_DTC_0x116397_GetEventStatus: operation=Event_DTC_0x116397.GetEventStatus
          SC_Event_DTC_0x116397_GetEventTested: operation=Event_DTC_0x116397.GetEventTested
          SC_Event_DTC_0x116397_GetEventUdsStatus: operation=Event_DTC_0x116397.GetEventUdsStatus
          SC_Event_DTC_0x116397_GetFaultDetectionCounter: operation=Event_DTC_0x116397.GetFaultDetectionCounter
          SC_Event_DTC_0x116397_ResetEventDebounceStatus: operation=Event_DTC_0x116397.ResetEventDebounceStatus
          SC_Event_DTC_0x116397_ResetEventStatus: operation=Event_DTC_0x116397.ResetEventStatus
          SC_Event_DTC_0x116397_SetEventStatus: operation=Event_DTC_0x116397.SetEventStatus
          SC_Event_DTC_0x116494_GetDTCOfEvent: operation=Event_DTC_0x116494.GetDTCOfEvent
          SC_Event_DTC_0x116494_GetEventExtendedDataRecordEx: operation=Event_DTC_0x116494.GetEventExtendedDataRecordEx
          SC_Event_DTC_0x116494_GetEventFailed: operation=Event_DTC_0x116494.GetEventFailed
          SC_Event_DTC_0x116494_GetEventFreezeFrameDataEx: operation=Event_DTC_0x116494.GetEventFreezeFrameDataEx
          SC_Event_DTC_0x116494_GetEventStatus: operation=Event_DTC_0x116494.GetEventStatus
          SC_Event_DTC_0x116494_GetEventTested: operation=Event_DTC_0x116494.GetEventTested
          SC_Event_DTC_0x116494_GetEventUdsStatus: operation=Event_DTC_0x116494.GetEventUdsStatus
          SC_Event_DTC_0x116494_GetFaultDetectionCounter: operation=Event_DTC_0x116494.GetFaultDetectionCounter
          SC_Event_DTC_0x116494_ResetEventDebounceStatus: operation=Event_DTC_0x116494.ResetEventDebounceStatus
          SC_Event_DTC_0x116494_ResetEventStatus: operation=Event_DTC_0x116494.ResetEventStatus
          SC_Event_DTC_0x116494_SetEventStatus: operation=Event_DTC_0x116494.SetEventStatus
          SC_Event_DTC_0x116594_GetDTCOfEvent: operation=Event_DTC_0x116594.GetDTCOfEvent
          SC_Event_DTC_0x116594_GetEventExtendedDataRecordEx: operation=Event_DTC_0x116594.GetEventExtendedDataRecordEx
          SC_Event_DTC_0x116594_GetEventFailed: operation=Event_DTC_0x116594.GetEventFailed
          SC_Event_DTC_0x116594_GetEventFreezeFrameDataEx: operation=Event_DTC_0x116594.GetEventFreezeFrameDataEx
          SC_Event_DTC_0x116594_GetEventStatus: operation=Event_DTC_0x116594.GetEventStatus
          SC_Event_DTC_0x116594_GetEventTested: operation=Event_DTC_0x116594.GetEventTested
          SC_Event_DTC_0x116594_GetEventUdsStatus: operation=Event_DTC_0x116594.GetEventUdsStatus
          SC_Event_DTC_0x116594_GetFaultDetectionCounter: operation=Event_DTC_0x116594.GetFaultDetectionCounter
          SC_Event_DTC_0x116594_ResetEventDebounceStatus: operation=Event_DTC_0x116594.ResetEventDebounceStatus
          SC_Event_DTC_0x116594_ResetEventStatus: operation=Event_DTC_0x116594.ResetEventStatus
          SC_Event_DTC_0x116594_SetEventStatus: operation=Event_DTC_0x116594.SetEventStatus
          SC_Event_DTC_0x116617_GetDTCOfEvent: operation=Event_DTC_0x116617.GetDTCOfEvent
          SC_Event_DTC_0x116617_GetEventExtendedDataRecordEx: operation=Event_DTC_0x116617.GetEventExtendedDataRecordEx
          SC_Event_DTC_0x116617_GetEventFailed: operation=Event_DTC_0x116617.GetEventFailed
          SC_Event_DTC_0x116617_GetEventFreezeFrameDataEx: operation=Event_DTC_0x116617.GetEventFreezeFrameDataEx
          SC_Event_DTC_0x116617_GetEventStatus: operation=Event_DTC_0x116617.GetEventStatus
          SC_Event_DTC_0x116617_GetEventTested: operation=Event_DTC_0x116617.GetEventTested
          SC_Event_DTC_0x116617_GetEventUdsStatus: operation=Event_DTC_0x116617.GetEventUdsStatus
          SC_Event_DTC_0x116617_GetFaultDetectionCounter: operation=Event_DTC_0x116617.GetFaultDetectionCounter
          SC_Event_DTC_0x116617_ResetEventDebounceStatus: operation=Event_DTC_0x116617.ResetEventDebounceStatus
          SC_Event_DTC_0x116617_ResetEventStatus: operation=Event_DTC_0x116617.ResetEventStatus
          SC_Event_DTC_0x116617_SetEventStatus: operation=Event_DTC_0x116617.SetEventStatus
          SC_Event_DTC_0x116716_GetDTCOfEvent: operation=Event_DTC_0x116716.GetDTCOfEvent
          SC_Event_DTC_0x116716_GetEventExtendedDataRecordEx: operation=Event_DTC_0x116716.GetEventExtendedDataRecordEx
          SC_Event_DTC_0x116716_GetEventFailed: operation=Event_DTC_0x116716.GetEventFailed
          SC_Event_DTC_0x116716_GetEventFreezeFrameDataEx: operation=Event_DTC_0x116716.GetEventFreezeFrameDataEx
          SC_Event_DTC_0x116716_GetEventStatus: operation=Event_DTC_0x116716.GetEventStatus
          SC_Event_DTC_0x116716_GetEventTested: operation=Event_DTC_0x116716.GetEventTested
          SC_Event_DTC_0x116716_GetEventUdsStatus: operation=Event_DTC_0x116716.GetEventUdsStatus
          SC_Event_DTC_0x116716_GetFaultDetectionCounter: operation=Event_DTC_0x116716.GetFaultDetectionCounter
          SC_Event_DTC_0x116716_ResetEventDebounceStatus: operation=Event_DTC_0x116716.ResetEventDebounceStatus
          SC_Event_DTC_0x116716_ResetEventStatus: operation=Event_DTC_0x116716.ResetEventStatus
          SC_Event_DTC_0x116716_SetEventStatus: operation=Event_DTC_0x116716.SetEventStatus
          SC_Event_DTC_0x116819_GetDTCOfEvent: operation=Event_DTC_0x116819.GetDTCOfEvent
          SC_Event_DTC_0x116819_GetEventExtendedDataRecordEx: operation=Event_DTC_0x116819.GetEventExtendedDataRecordEx
          SC_Event_DTC_0x116819_GetEventFailed: operation=Event_DTC_0x116819.GetEventFailed
          SC_Event_DTC_0x116819_GetEventFreezeFrameDataEx: operation=Event_DTC_0x116819.GetEventFreezeFrameDataEx
          SC_Event_DTC_0x116819_GetEventStatus: operation=Event_DTC_0x116819.GetEventStatus
          SC_Event_DTC_0x116819_GetEventTested: operation=Event_DTC_0x116819.GetEventTested
          SC_Event_DTC_0x116819_GetEventUdsStatus: operation=Event_DTC_0x116819.GetEventUdsStatus
          SC_Event_DTC_0x116819_GetFaultDetectionCounter: operation=Event_DTC_0x116819.GetFaultDetectionCounter
          SC_Event_DTC_0x116819_ResetEventDebounceStatus: operation=Event_DTC_0x116819.ResetEventDebounceStatus
          SC_Event_DTC_0x116819_ResetEventStatus: operation=Event_DTC_0x116819.ResetEventStatus
          SC_Event_DTC_0x116819_SetEventStatus: operation=Event_DTC_0x116819.SetEventStatus
          SC_Event_DTC_0x116996_GetDTCOfEvent: operation=Event_DTC_0x116996.GetDTCOfEvent
          SC_Event_DTC_0x116996_GetEventExtendedDataRecordEx: operation=Event_DTC_0x116996.GetEventExtendedDataRecordEx
          SC_Event_DTC_0x116996_GetEventFailed: operation=Event_DTC_0x116996.GetEventFailed
          SC_Event_DTC_0x116996_GetEventFreezeFrameDataEx: operation=Event_DTC_0x116996.GetEventFreezeFrameDataEx
          SC_Event_DTC_0x116996_GetEventStatus: operation=Event_DTC_0x116996.GetEventStatus
          SC_Event_DTC_0x116996_GetEventTested: operation=Event_DTC_0x116996.GetEventTested
          SC_Event_DTC_0x116996_GetEventUdsStatus: operation=Event_DTC_0x116996.GetEventUdsStatus
          SC_Event_DTC_0x116996_GetFaultDetectionCounter: operation=Event_DTC_0x116996.GetFaultDetectionCounter
          SC_Event_DTC_0x116996_ResetEventDebounceStatus: operation=Event_DTC_0x116996.ResetEventDebounceStatus
          SC_Event_DTC_0x116996_ResetEventStatus: operation=Event_DTC_0x116996.ResetEventStatus
          SC_Event_DTC_0x116996_SetEventStatus: operation=Event_DTC_0x116996.SetEventStatus
          SC_Event_DTC_0x116a96_GetDTCOfEvent: operation=Event_DTC_0x116a96.GetDTCOfEvent
          SC_Event_DTC_0x116a96_GetEventExtendedDataRecordEx: operation=Event_DTC_0x116a96.GetEventExtendedDataRecordEx
          SC_Event_DTC_0x116a96_GetEventFailed: operation=Event_DTC_0x116a96.GetEventFailed
          SC_Event_DTC_0x116a96_GetEventFreezeFrameDataEx: operation=Event_DTC_0x116a96.GetEventFreezeFrameDataEx
          SC_Event_DTC_0x116a96_GetEventStatus: operation=Event_DTC_0x116a96.GetEventStatus
          SC_Event_DTC_0x116a96_GetEventTested: operation=Event_DTC_0x116a96.GetEventTested
          SC_Event_DTC_0x116a96_GetEventUdsStatus: operation=Event_DTC_0x116a96.GetEventUdsStatus
          SC_Event_DTC_0x116a96_GetFaultDetectionCounter: operation=Event_DTC_0x116a96.GetFaultDetectionCounter
          SC_Event_DTC_0x116a96_ResetEventDebounceStatus: operation=Event_DTC_0x116a96.ResetEventDebounceStatus
          SC_Event_DTC_0x116a96_ResetEventStatus: operation=Event_DTC_0x116a96.ResetEventStatus
          SC_Event_DTC_0x116a96_SetEventStatus: operation=Event_DTC_0x116a96.SetEventStatus
          SC_Event_DTC_0x116c05_GetDTCOfEvent: operation=Event_DTC_0x116c05.GetDTCOfEvent
          SC_Event_DTC_0x116c05_GetEventExtendedDataRecordEx: operation=Event_DTC_0x116c05.GetEventExtendedDataRecordEx
          SC_Event_DTC_0x116c05_GetEventFailed: operation=Event_DTC_0x116c05.GetEventFailed
          SC_Event_DTC_0x116c05_GetEventFreezeFrameDataEx: operation=Event_DTC_0x116c05.GetEventFreezeFrameDataEx
          SC_Event_DTC_0x116c05_GetEventStatus: operation=Event_DTC_0x116c05.GetEventStatus
          SC_Event_DTC_0x116c05_GetEventTested: operation=Event_DTC_0x116c05.GetEventTested
          SC_Event_DTC_0x116c05_GetEventUdsStatus: operation=Event_DTC_0x116c05.GetEventUdsStatus
          SC_Event_DTC_0x116c05_GetFaultDetectionCounter: operation=Event_DTC_0x116c05.GetFaultDetectionCounter
          SC_Event_DTC_0x116c05_ResetEventDebounceStatus: operation=Event_DTC_0x116c05.ResetEventDebounceStatus
          SC_Event_DTC_0x116c05_ResetEventStatus: operation=Event_DTC_0x116c05.ResetEventStatus
          SC_Event_DTC_0x116c05_SetEventStatus: operation=Event_DTC_0x116c05.SetEventStatus
          SC_Event_DTC_0x116d05_GetDTCOfEvent: operation=Event_DTC_0x116d05.GetDTCOfEvent
          SC_Event_DTC_0x116d05_GetEventExtendedDataRecordEx: operation=Event_DTC_0x116d05.GetEventExtendedDataRecordEx
          SC_Event_DTC_0x116d05_GetEventFailed: operation=Event_DTC_0x116d05.GetEventFailed
          SC_Event_DTC_0x116d05_GetEventFreezeFrameDataEx: operation=Event_DTC_0x116d05.GetEventFreezeFrameDataEx
          SC_Event_DTC_0x116d05_GetEventStatus: operation=Event_DTC_0x116d05.GetEventStatus
          SC_Event_DTC_0x116d05_GetEventTested: operation=Event_DTC_0x116d05.GetEventTested
          SC_Event_DTC_0x116d05_GetEventUdsStatus: operation=Event_DTC_0x116d05.GetEventUdsStatus
          SC_Event_DTC_0x116d05_GetFaultDetectionCounter: operation=Event_DTC_0x116d05.GetFaultDetectionCounter
          SC_Event_DTC_0x116d05_ResetEventDebounceStatus: operation=Event_DTC_0x116d05.ResetEventDebounceStatus
          SC_Event_DTC_0x116d05_ResetEventStatus: operation=Event_DTC_0x116d05.ResetEventStatus
          SC_Event_DTC_0x116d05_SetEventStatus: operation=Event_DTC_0x116d05.SetEventStatus
          SC_Event_DTC_0x116e05_GetDTCOfEvent: operation=Event_DTC_0x116e05.GetDTCOfEvent
          SC_Event_DTC_0x116e05_GetEventExtendedDataRecordEx: operation=Event_DTC_0x116e05.GetEventExtendedDataRecordEx
          SC_Event_DTC_0x116e05_GetEventFailed: operation=Event_DTC_0x116e05.GetEventFailed
          SC_Event_DTC_0x116e05_GetEventFreezeFrameDataEx: operation=Event_DTC_0x116e05.GetEventFreezeFrameDataEx
          SC_Event_DTC_0x116e05_GetEventStatus: operation=Event_DTC_0x116e05.GetEventStatus
          SC_Event_DTC_0x116e05_GetEventTested: operation=Event_DTC_0x116e05.GetEventTested
          SC_Event_DTC_0x116e05_GetEventUdsStatus: operation=Event_DTC_0x116e05.GetEventUdsStatus
          SC_Event_DTC_0x116e05_GetFaultDetectionCounter: operation=Event_DTC_0x116e05.GetFaultDetectionCounter
          SC_Event_DTC_0x116e05_ResetEventDebounceStatus: operation=Event_DTC_0x116e05.ResetEventDebounceStatus
          SC_Event_DTC_0x116e05_ResetEventStatus: operation=Event_DTC_0x116e05.ResetEventStatus
          SC_Event_DTC_0x116e05_SetEventStatus: operation=Event_DTC_0x116e05.SetEventStatus
          SC_Event_DTC_0x116f05_GetDTCOfEvent: operation=Event_DTC_0x116f05.GetDTCOfEvent
          SC_Event_DTC_0x116f05_GetEventExtendedDataRecordEx: operation=Event_DTC_0x116f05.GetEventExtendedDataRecordEx
          SC_Event_DTC_0x116f05_GetEventFailed: operation=Event_DTC_0x116f05.GetEventFailed
          SC_Event_DTC_0x116f05_GetEventFreezeFrameDataEx: operation=Event_DTC_0x116f05.GetEventFreezeFrameDataEx
          SC_Event_DTC_0x116f05_GetEventStatus: operation=Event_DTC_0x116f05.GetEventStatus
          SC_Event_DTC_0x116f05_GetEventTested: operation=Event_DTC_0x116f05.GetEventTested
          SC_Event_DTC_0x116f05_GetEventUdsStatus: operation=Event_DTC_0x116f05.GetEventUdsStatus
          SC_Event_DTC_0x116f05_GetFaultDetectionCounter: operation=Event_DTC_0x116f05.GetFaultDetectionCounter
          SC_Event_DTC_0x116f05_ResetEventDebounceStatus: operation=Event_DTC_0x116f05.ResetEventDebounceStatus
          SC_Event_DTC_0x116f05_ResetEventStatus: operation=Event_DTC_0x116f05.ResetEventStatus
          SC_Event_DTC_0x116f05_SetEventStatus: operation=Event_DTC_0x116f05.SetEventStatus
          SC_Event_DTC_0x117097_GetDTCOfEvent: operation=Event_DTC_0x117097.GetDTCOfEvent
          SC_Event_DTC_0x117097_GetEventExtendedDataRecordEx: operation=Event_DTC_0x117097.GetEventExtendedDataRecordEx
          SC_Event_DTC_0x117097_GetEventFailed: operation=Event_DTC_0x117097.GetEventFailed
          SC_Event_DTC_0x117097_GetEventFreezeFrameDataEx: operation=Event_DTC_0x117097.GetEventFreezeFrameDataEx
          SC_Event_DTC_0x117097_GetEventStatus: operation=Event_DTC_0x117097.GetEventStatus
          SC_Event_DTC_0x117097_GetEventTested: operation=Event_DTC_0x117097.GetEventTested
          SC_Event_DTC_0x117097_GetEventUdsStatus: operation=Event_DTC_0x117097.GetEventUdsStatus
          SC_Event_DTC_0x117097_GetFaultDetectionCounter: operation=Event_DTC_0x117097.GetFaultDetectionCounter
          SC_Event_DTC_0x117097_ResetEventDebounceStatus: operation=Event_DTC_0x117097.ResetEventDebounceStatus
          SC_Event_DTC_0x117097_ResetEventStatus: operation=Event_DTC_0x117097.ResetEventStatus
          SC_Event_DTC_0x117097_SetEventStatus: operation=Event_DTC_0x117097.SetEventStatus
          SC_Event_DTC_0x117197_GetDTCOfEvent: operation=Event_DTC_0x117197.GetDTCOfEvent
          SC_Event_DTC_0x117197_GetEventExtendedDataRecordEx: operation=Event_DTC_0x117197.GetEventExtendedDataRecordEx
          SC_Event_DTC_0x117197_GetEventFailed: operation=Event_DTC_0x117197.GetEventFailed
          SC_Event_DTC_0x117197_GetEventFreezeFrameDataEx: operation=Event_DTC_0x117197.GetEventFreezeFrameDataEx
          SC_Event_DTC_0x117197_GetEventStatus: operation=Event_DTC_0x117197.GetEventStatus
          SC_Event_DTC_0x117197_GetEventTested: operation=Event_DTC_0x117197.GetEventTested
          SC_Event_DTC_0x117197_GetEventUdsStatus: operation=Event_DTC_0x117197.GetEventUdsStatus
          SC_Event_DTC_0x117197_GetFaultDetectionCounter: operation=Event_DTC_0x117197.GetFaultDetectionCounter
          SC_Event_DTC_0x117197_ResetEventDebounceStatus: operation=Event_DTC_0x117197.ResetEventDebounceStatus
          SC_Event_DTC_0x117197_ResetEventStatus: operation=Event_DTC_0x117197.ResetEventStatus
          SC_Event_DTC_0x117197_SetEventStatus: operation=Event_DTC_0x117197.SetEventStatus
          SC_Event_DTC_0x117511_GetDTCOfEvent: operation=Event_DTC_0x117511.GetDTCOfEvent
          SC_Event_DTC_0x117511_GetEventExtendedDataRecordEx: operation=Event_DTC_0x117511.GetEventExtendedDataRecordEx
          SC_Event_DTC_0x117511_GetEventFailed: operation=Event_DTC_0x117511.GetEventFailed
          SC_Event_DTC_0x117511_GetEventFreezeFrameDataEx: operation=Event_DTC_0x117511.GetEventFreezeFrameDataEx
          SC_Event_DTC_0x117511_GetEventStatus: operation=Event_DTC_0x117511.GetEventStatus
          SC_Event_DTC_0x117511_GetEventTested: operation=Event_DTC_0x117511.GetEventTested
          SC_Event_DTC_0x117511_GetEventUdsStatus: operation=Event_DTC_0x117511.GetEventUdsStatus
          SC_Event_DTC_0x117511_GetFaultDetectionCounter: operation=Event_DTC_0x117511.GetFaultDetectionCounter
          SC_Event_DTC_0x117511_ResetEventDebounceStatus: operation=Event_DTC_0x117511.ResetEventDebounceStatus
          SC_Event_DTC_0x117511_ResetEventStatus: operation=Event_DTC_0x117511.ResetEventStatus
          SC_Event_DTC_0x117511_SetEventStatus: operation=Event_DTC_0x117511.SetEventStatus
          SC_Event_DTC_0x908255_GetDTCOfEvent: operation=Event_DTC_0x908255.GetDTCOfEvent
          SC_Event_DTC_0x908255_GetEventExtendedDataRecordEx: operation=Event_DTC_0x908255.GetEventExtendedDataRecordEx
          SC_Event_DTC_0x908255_GetEventFailed: operation=Event_DTC_0x908255.GetEventFailed
          SC_Event_DTC_0x908255_GetEventFreezeFrameDataEx: operation=Event_DTC_0x908255.GetEventFreezeFrameDataEx
          SC_Event_DTC_0x908255_GetEventStatus: operation=Event_DTC_0x908255.GetEventStatus
          SC_Event_DTC_0x908255_GetEventTested: operation=Event_DTC_0x908255.GetEventTested
          SC_Event_DTC_0x908255_GetEventUdsStatus: operation=Event_DTC_0x908255.GetEventUdsStatus
          SC_Event_DTC_0x908255_GetFaultDetectionCounter: operation=Event_DTC_0x908255.GetFaultDetectionCounter
          SC_Event_DTC_0x908255_ResetEventDebounceStatus: operation=Event_DTC_0x908255.ResetEventDebounceStatus
          SC_Event_DTC_0x908255_ResetEventStatus: operation=Event_DTC_0x908255.ResetEventStatus
          SC_Event_DTC_0x908255_SetEventStatus: operation=Event_DTC_0x908255.SetEventStatus
          SC_Event_DTC_0x908356_GetDTCOfEvent: operation=Event_DTC_0x908356.GetDTCOfEvent
          SC_Event_DTC_0x908356_GetEventExtendedDataRecordEx: operation=Event_DTC_0x908356.GetEventExtendedDataRecordEx
          SC_Event_DTC_0x908356_GetEventFailed: operation=Event_DTC_0x908356.GetEventFailed
          SC_Event_DTC_0x908356_GetEventFreezeFrameDataEx: operation=Event_DTC_0x908356.GetEventFreezeFrameDataEx
          SC_Event_DTC_0x908356_GetEventStatus: operation=Event_DTC_0x908356.GetEventStatus
          SC_Event_DTC_0x908356_GetEventTested: operation=Event_DTC_0x908356.GetEventTested
          SC_Event_DTC_0x908356_GetEventUdsStatus: operation=Event_DTC_0x908356.GetEventUdsStatus
          SC_Event_DTC_0x908356_GetFaultDetectionCounter: operation=Event_DTC_0x908356.GetFaultDetectionCounter
          SC_Event_DTC_0x908356_ResetEventDebounceStatus: operation=Event_DTC_0x908356.ResetEventDebounceStatus
          SC_Event_DTC_0x908356_ResetEventStatus: operation=Event_DTC_0x908356.ResetEventStatus
          SC_Event_DTC_0x908356_SetEventStatus: operation=Event_DTC_0x908356.SetEventStatus
          SC_Event_DTC_0xc10f87_GetDTCOfEvent: operation=Event_DTC_0xc10f87.GetDTCOfEvent
          SC_Event_DTC_0xc10f87_GetEventExtendedDataRecordEx: operation=Event_DTC_0xc10f87.GetEventExtendedDataRecordEx
          SC_Event_DTC_0xc10f87_GetEventFailed: operation=Event_DTC_0xc10f87.GetEventFailed
          SC_Event_DTC_0xc10f87_GetEventFreezeFrameDataEx: operation=Event_DTC_0xc10f87.GetEventFreezeFrameDataEx
          SC_Event_DTC_0xc10f87_GetEventStatus: operation=Event_DTC_0xc10f87.GetEventStatus
          SC_Event_DTC_0xc10f87_GetEventTested: operation=Event_DTC_0xc10f87.GetEventTested
          SC_Event_DTC_0xc10f87_GetEventUdsStatus: operation=Event_DTC_0xc10f87.GetEventUdsStatus
          SC_Event_DTC_0xc10f87_GetFaultDetectionCounter: operation=Event_DTC_0xc10f87.GetFaultDetectionCounter
          SC_Event_DTC_0xc10f87_ResetEventDebounceStatus: operation=Event_DTC_0xc10f87.ResetEventDebounceStatus
          SC_Event_DTC_0xc10f87_ResetEventStatus: operation=Event_DTC_0xc10f87.ResetEventStatus
          SC_Event_DTC_0xc10f87_SetEventStatus: operation=Event_DTC_0xc10f87.SetEventStatus
          SC_Event_DTC_0xc14687_GetDTCOfEvent: operation=Event_DTC_0xc14687.GetDTCOfEvent
          SC_Event_DTC_0xc14687_GetEventExtendedDataRecordEx: operation=Event_DTC_0xc14687.GetEventExtendedDataRecordEx
          SC_Event_DTC_0xc14687_GetEventFailed: operation=Event_DTC_0xc14687.GetEventFailed
          SC_Event_DTC_0xc14687_GetEventFreezeFrameDataEx: operation=Event_DTC_0xc14687.GetEventFreezeFrameDataEx
          SC_Event_DTC_0xc14687_GetEventStatus: operation=Event_DTC_0xc14687.GetEventStatus
          SC_Event_DTC_0xc14687_GetEventTested: operation=Event_DTC_0xc14687.GetEventTested
          SC_Event_DTC_0xc14687_GetEventUdsStatus: operation=Event_DTC_0xc14687.GetEventUdsStatus
          SC_Event_DTC_0xc14687_GetFaultDetectionCounter: operation=Event_DTC_0xc14687.GetFaultDetectionCounter
          SC_Event_DTC_0xc14687_ResetEventDebounceStatus: operation=Event_DTC_0xc14687.ResetEventDebounceStatus
          SC_Event_DTC_0xc14687_ResetEventStatus: operation=Event_DTC_0xc14687.ResetEventStatus
          SC_Event_DTC_0xc14687_SetEventStatus: operation=Event_DTC_0xc14687.SetEventStatus
          SC_Event_DTC_0xc16b87_GetDTCOfEvent: operation=Event_DTC_0xc16b87.GetDTCOfEvent
          SC_Event_DTC_0xc16b87_GetEventExtendedDataRecordEx: operation=Event_DTC_0xc16b87.GetEventExtendedDataRecordEx
          SC_Event_DTC_0xc16b87_GetEventFailed: operation=Event_DTC_0xc16b87.GetEventFailed
          SC_Event_DTC_0xc16b87_GetEventFreezeFrameDataEx: operation=Event_DTC_0xc16b87.GetEventFreezeFrameDataEx
          SC_Event_DTC_0xc16b87_GetEventStatus: operation=Event_DTC_0xc16b87.GetEventStatus
          SC_Event_DTC_0xc16b87_GetEventTested: operation=Event_DTC_0xc16b87.GetEventTested
          SC_Event_DTC_0xc16b87_GetEventUdsStatus: operation=Event_DTC_0xc16b87.GetEventUdsStatus
          SC_Event_DTC_0xc16b87_GetFaultDetectionCounter: operation=Event_DTC_0xc16b87.GetFaultDetectionCounter
          SC_Event_DTC_0xc16b87_ResetEventDebounceStatus: operation=Event_DTC_0xc16b87.ResetEventDebounceStatus
          SC_Event_DTC_0xc16b87_ResetEventStatus: operation=Event_DTC_0xc16b87.ResetEventStatus
          SC_Event_DTC_0xc16b87_SetEventStatus: operation=Event_DTC_0xc16b87.SetEventStatus
          SC_Event_DTC_0xc29a87_GetDTCOfEvent: operation=Event_DTC_0xc29a87.GetDTCOfEvent
          SC_Event_DTC_0xc29a87_GetEventExtendedDataRecordEx: operation=Event_DTC_0xc29a87.GetEventExtendedDataRecordEx
          SC_Event_DTC_0xc29a87_GetEventFailed: operation=Event_DTC_0xc29a87.GetEventFailed
          SC_Event_DTC_0xc29a87_GetEventFreezeFrameDataEx: operation=Event_DTC_0xc29a87.GetEventFreezeFrameDataEx
          SC_Event_DTC_0xc29a87_GetEventStatus: operation=Event_DTC_0xc29a87.GetEventStatus
          SC_Event_DTC_0xc29a87_GetEventTested: operation=Event_DTC_0xc29a87.GetEventTested
          SC_Event_DTC_0xc29a87_GetEventUdsStatus: operation=Event_DTC_0xc29a87.GetEventUdsStatus
          SC_Event_DTC_0xc29a87_GetFaultDetectionCounter: operation=Event_DTC_0xc29a87.GetFaultDetectionCounter
          SC_Event_DTC_0xc29a87_ResetEventDebounceStatus: operation=Event_DTC_0xc29a87.ResetEventDebounceStatus
          SC_Event_DTC_0xc29a87_ResetEventStatus: operation=Event_DTC_0xc29a87.ResetEventStatus
          SC_Event_DTC_0xc29a87_SetEventStatus: operation=Event_DTC_0xc29a87.SetEventStatus
          SC_Event_DTC_0xd11b87_GetDTCOfEvent: operation=Event_DTC_0xd11b87.GetDTCOfEvent
          SC_Event_DTC_0xd11b87_GetEventExtendedDataRecordEx: operation=Event_DTC_0xd11b87.GetEventExtendedDataRecordEx
          SC_Event_DTC_0xd11b87_GetEventFailed: operation=Event_DTC_0xd11b87.GetEventFailed
          SC_Event_DTC_0xd11b87_GetEventFreezeFrameDataEx: operation=Event_DTC_0xd11b87.GetEventFreezeFrameDataEx
          SC_Event_DTC_0xd11b87_GetEventStatus: operation=Event_DTC_0xd11b87.GetEventStatus
          SC_Event_DTC_0xd11b87_GetEventTested: operation=Event_DTC_0xd11b87.GetEventTested
          SC_Event_DTC_0xd11b87_GetEventUdsStatus: operation=Event_DTC_0xd11b87.GetEventUdsStatus
          SC_Event_DTC_0xd11b87_GetFaultDetectionCounter: operation=Event_DTC_0xd11b87.GetFaultDetectionCounter
          SC_Event_DTC_0xd11b87_ResetEventDebounceStatus: operation=Event_DTC_0xd11b87.ResetEventDebounceStatus
          SC_Event_DTC_0xd11b87_ResetEventStatus: operation=Event_DTC_0xd11b87.ResetEventStatus
          SC_Event_DTC_0xd11b87_SetEventStatus: operation=Event_DTC_0xd11b87.SetEventStatus
          SC_Event_DTC_0xd13787_GetDTCOfEvent: operation=Event_DTC_0xd13787.GetDTCOfEvent
          SC_Event_DTC_0xd13787_GetEventExtendedDataRecordEx: operation=Event_DTC_0xd13787.GetEventExtendedDataRecordEx
          SC_Event_DTC_0xd13787_GetEventFailed: operation=Event_DTC_0xd13787.GetEventFailed
          SC_Event_DTC_0xd13787_GetEventFreezeFrameDataEx: operation=Event_DTC_0xd13787.GetEventFreezeFrameDataEx
          SC_Event_DTC_0xd13787_GetEventStatus: operation=Event_DTC_0xd13787.GetEventStatus
          SC_Event_DTC_0xd13787_GetEventTested: operation=Event_DTC_0xd13787.GetEventTested
          SC_Event_DTC_0xd13787_GetEventUdsStatus: operation=Event_DTC_0xd13787.GetEventUdsStatus
          SC_Event_DTC_0xd13787_GetFaultDetectionCounter: operation=Event_DTC_0xd13787.GetFaultDetectionCounter
          SC_Event_DTC_0xd13787_ResetEventDebounceStatus: operation=Event_DTC_0xd13787.ResetEventDebounceStatus
          SC_Event_DTC_0xd13787_ResetEventStatus: operation=Event_DTC_0xd13787.ResetEventStatus
          SC_Event_DTC_0xd13787_SetEventStatus: operation=Event_DTC_0xd13787.SetEventStatus
          SC_Event_DTC_0xd30087_GetDTCOfEvent: operation=Event_DTC_0xd30087.GetDTCOfEvent
          SC_Event_DTC_0xd30087_GetEventExtendedDataRecordEx: operation=Event_DTC_0xd30087.GetEventExtendedDataRecordEx
          SC_Event_DTC_0xd30087_GetEventFailed: operation=Event_DTC_0xd30087.GetEventFailed
          SC_Event_DTC_0xd30087_GetEventFreezeFrameDataEx: operation=Event_DTC_0xd30087.GetEventFreezeFrameDataEx
          SC_Event_DTC_0xd30087_GetEventStatus: operation=Event_DTC_0xd30087.GetEventStatus
          SC_Event_DTC_0xd30087_GetEventTested: operation=Event_DTC_0xd30087.GetEventTested
          SC_Event_DTC_0xd30087_GetEventUdsStatus: operation=Event_DTC_0xd30087.GetEventUdsStatus
          SC_Event_DTC_0xd30087_GetFaultDetectionCounter: operation=Event_DTC_0xd30087.GetFaultDetectionCounter
          SC_Event_DTC_0xd30087_ResetEventDebounceStatus: operation=Event_DTC_0xd30087.ResetEventDebounceStatus
          SC_Event_DTC_0xd30087_ResetEventStatus: operation=Event_DTC_0xd30087.ResetEventStatus
          SC_Event_DTC_0xd30087_SetEventStatus: operation=Event_DTC_0xd30087.SetEventStatus
          SC_EvtInfo_DTC_0x110012_GetDTCOfEvent: operation=EvtInfo_DTC_0x110012.GetDTCOfEvent
          SC_EvtInfo_DTC_0x110012_GetDebouncingOfEvent: operation=EvtInfo_DTC_0x110012.GetDebouncingOfEvent
          SC_EvtInfo_DTC_0x110012_GetEventEnableCondition: operation=EvtInfo_DTC_0x110012.GetEventEnableCondition
          SC_EvtInfo_DTC_0x110012_GetEventExtendedDataRecordEx: operation=EvtInfo_DTC_0x110012.GetEventExtendedDataRecordEx
          SC_EvtInfo_DTC_0x110012_GetEventFailed: operation=EvtInfo_DTC_0x110012.GetEventFailed
          SC_EvtInfo_DTC_0x110012_GetEventFreezeFrameDataEx: operation=EvtInfo_DTC_0x110012.GetEventFreezeFrameDataEx
          SC_EvtInfo_DTC_0x110012_GetEventStatus: operation=EvtInfo_DTC_0x110012.GetEventStatus
          SC_EvtInfo_DTC_0x110012_GetEventTested: operation=EvtInfo_DTC_0x110012.GetEventTested
          SC_EvtInfo_DTC_0x110012_GetEventUdsStatus: operation=EvtInfo_DTC_0x110012.GetEventUdsStatus
          SC_EvtInfo_DTC_0x110012_GetFaultDetectionCounter: operation=EvtInfo_DTC_0x110012.GetFaultDetectionCounter
          SC_EvtInfo_DTC_0x110012_GetMonitorStatus: operation=EvtInfo_DTC_0x110012.GetMonitorStatus
          SC_EvtInfo_DTC_0x110112_GetDTCOfEvent: operation=EvtInfo_DTC_0x110112.GetDTCOfEvent
          SC_EvtInfo_DTC_0x110112_GetDebouncingOfEvent: operation=EvtInfo_DTC_0x110112.GetDebouncingOfEvent
          SC_EvtInfo_DTC_0x110112_GetEventEnableCondition: operation=EvtInfo_DTC_0x110112.GetEventEnableCondition
          SC_EvtInfo_DTC_0x110112_GetEventExtendedDataRecordEx: operation=EvtInfo_DTC_0x110112.GetEventExtendedDataRecordEx
          SC_EvtInfo_DTC_0x110112_GetEventFailed: operation=EvtInfo_DTC_0x110112.GetEventFailed
          SC_EvtInfo_DTC_0x110112_GetEventFreezeFrameDataEx: operation=EvtInfo_DTC_0x110112.GetEventFreezeFrameDataEx
          SC_EvtInfo_DTC_0x110112_GetEventStatus: operation=EvtInfo_DTC_0x110112.GetEventStatus
          SC_EvtInfo_DTC_0x110112_GetEventTested: operation=EvtInfo_DTC_0x110112.GetEventTested
          SC_EvtInfo_DTC_0x110112_GetEventUdsStatus: operation=EvtInfo_DTC_0x110112.GetEventUdsStatus
          SC_EvtInfo_DTC_0x110112_GetFaultDetectionCounter: operation=EvtInfo_DTC_0x110112.GetFaultDetectionCounter
          SC_EvtInfo_DTC_0x110112_GetMonitorStatus: operation=EvtInfo_DTC_0x110112.GetMonitorStatus
          SC_EvtInfo_DTC_0x110211_GetDTCOfEvent: operation=EvtInfo_DTC_0x110211.GetDTCOfEvent
          SC_EvtInfo_DTC_0x110211_GetDebouncingOfEvent: operation=EvtInfo_DTC_0x110211.GetDebouncingOfEvent
          SC_EvtInfo_DTC_0x110211_GetEventEnableCondition: operation=EvtInfo_DTC_0x110211.GetEventEnableCondition
          SC_EvtInfo_DTC_0x110211_GetEventExtendedDataRecordEx: operation=EvtInfo_DTC_0x110211.GetEventExtendedDataRecordEx
          SC_EvtInfo_DTC_0x110211_GetEventFailed: operation=EvtInfo_DTC_0x110211.GetEventFailed
          SC_EvtInfo_DTC_0x110211_GetEventFreezeFrameDataEx: operation=EvtInfo_DTC_0x110211.GetEventFreezeFrameDataEx
          SC_EvtInfo_DTC_0x110211_GetEventStatus: operation=EvtInfo_DTC_0x110211.GetEventStatus
          SC_EvtInfo_DTC_0x110211_GetEventTested: operation=EvtInfo_DTC_0x110211.GetEventTested
          SC_EvtInfo_DTC_0x110211_GetEventUdsStatus: operation=EvtInfo_DTC_0x110211.GetEventUdsStatus
          SC_EvtInfo_DTC_0x110211_GetFaultDetectionCounter: operation=EvtInfo_DTC_0x110211.GetFaultDetectionCounter
          SC_EvtInfo_DTC_0x110211_GetMonitorStatus: operation=EvtInfo_DTC_0x110211.GetMonitorStatus
          SC_EvtInfo_DTC_0x110311_GetDTCOfEvent: operation=EvtInfo_DTC_0x110311.GetDTCOfEvent
          SC_EvtInfo_DTC_0x110311_GetDebouncingOfEvent: operation=EvtInfo_DTC_0x110311.GetDebouncingOfEvent
          SC_EvtInfo_DTC_0x110311_GetEventEnableCondition: operation=EvtInfo_DTC_0x110311.GetEventEnableCondition
          SC_EvtInfo_DTC_0x110311_GetEventExtendedDataRecordEx: operation=EvtInfo_DTC_0x110311.GetEventExtendedDataRecordEx
          SC_EvtInfo_DTC_0x110311_GetEventFailed: operation=EvtInfo_DTC_0x110311.GetEventFailed
          SC_EvtInfo_DTC_0x110311_GetEventFreezeFrameDataEx: operation=EvtInfo_DTC_0x110311.GetEventFreezeFrameDataEx
          SC_EvtInfo_DTC_0x110311_GetEventStatus: operation=EvtInfo_DTC_0x110311.GetEventStatus
          SC_EvtInfo_DTC_0x110311_GetEventTested: operation=EvtInfo_DTC_0x110311.GetEventTested
          SC_EvtInfo_DTC_0x110311_GetEventUdsStatus: operation=EvtInfo_DTC_0x110311.GetEventUdsStatus
          SC_EvtInfo_DTC_0x110311_GetFaultDetectionCounter: operation=EvtInfo_DTC_0x110311.GetFaultDetectionCounter
          SC_EvtInfo_DTC_0x110311_GetMonitorStatus: operation=EvtInfo_DTC_0x110311.GetMonitorStatus
          SC_EvtInfo_DTC_0x111152_GetDTCOfEvent: operation=EvtInfo_DTC_0x111152.GetDTCOfEvent
          SC_EvtInfo_DTC_0x111152_GetDebouncingOfEvent: operation=EvtInfo_DTC_0x111152.GetDebouncingOfEvent
          SC_EvtInfo_DTC_0x111152_GetEventEnableCondition: operation=EvtInfo_DTC_0x111152.GetEventEnableCondition
          SC_EvtInfo_DTC_0x111152_GetEventExtendedDataRecordEx: operation=EvtInfo_DTC_0x111152.GetEventExtendedDataRecordEx
          SC_EvtInfo_DTC_0x111152_GetEventFailed: operation=EvtInfo_DTC_0x111152.GetEventFailed
          SC_EvtInfo_DTC_0x111152_GetEventFreezeFrameDataEx: operation=EvtInfo_DTC_0x111152.GetEventFreezeFrameDataEx
          SC_EvtInfo_DTC_0x111152_GetEventStatus: operation=EvtInfo_DTC_0x111152.GetEventStatus
          SC_EvtInfo_DTC_0x111152_GetEventTested: operation=EvtInfo_DTC_0x111152.GetEventTested
          SC_EvtInfo_DTC_0x111152_GetEventUdsStatus: operation=EvtInfo_DTC_0x111152.GetEventUdsStatus
          SC_EvtInfo_DTC_0x111152_GetFaultDetectionCounter: operation=EvtInfo_DTC_0x111152.GetFaultDetectionCounter
          SC_EvtInfo_DTC_0x111152_GetMonitorStatus: operation=EvtInfo_DTC_0x111152.GetMonitorStatus
          SC_EvtInfo_DTC_0x111252_GetDTCOfEvent: operation=EvtInfo_DTC_0x111252.GetDTCOfEvent
          SC_EvtInfo_DTC_0x111252_GetDebouncingOfEvent: operation=EvtInfo_DTC_0x111252.GetDebouncingOfEvent
          SC_EvtInfo_DTC_0x111252_GetEventEnableCondition: operation=EvtInfo_DTC_0x111252.GetEventEnableCondition
          SC_EvtInfo_DTC_0x111252_GetEventExtendedDataRecordEx: operation=EvtInfo_DTC_0x111252.GetEventExtendedDataRecordEx
          SC_EvtInfo_DTC_0x111252_GetEventFailed: operation=EvtInfo_DTC_0x111252.GetEventFailed
          SC_EvtInfo_DTC_0x111252_GetEventFreezeFrameDataEx: operation=EvtInfo_DTC_0x111252.GetEventFreezeFrameDataEx
          SC_EvtInfo_DTC_0x111252_GetEventStatus: operation=EvtInfo_DTC_0x111252.GetEventStatus
          SC_EvtInfo_DTC_0x111252_GetEventTested: operation=EvtInfo_DTC_0x111252.GetEventTested
          SC_EvtInfo_DTC_0x111252_GetEventUdsStatus: operation=EvtInfo_DTC_0x111252.GetEventUdsStatus
          SC_EvtInfo_DTC_0x111252_GetFaultDetectionCounter: operation=EvtInfo_DTC_0x111252.GetFaultDetectionCounter
          SC_EvtInfo_DTC_0x111252_GetMonitorStatus: operation=EvtInfo_DTC_0x111252.GetMonitorStatus
          SC_EvtInfo_DTC_0x111352_GetDTCOfEvent: operation=EvtInfo_DTC_0x111352.GetDTCOfEvent
          SC_EvtInfo_DTC_0x111352_GetDebouncingOfEvent: operation=EvtInfo_DTC_0x111352.GetDebouncingOfEvent
          SC_EvtInfo_DTC_0x111352_GetEventEnableCondition: operation=EvtInfo_DTC_0x111352.GetEventEnableCondition
          SC_EvtInfo_DTC_0x111352_GetEventExtendedDataRecordEx: operation=EvtInfo_DTC_0x111352.GetEventExtendedDataRecordEx
          SC_EvtInfo_DTC_0x111352_GetEventFailed: operation=EvtInfo_DTC_0x111352.GetEventFailed
          SC_EvtInfo_DTC_0x111352_GetEventFreezeFrameDataEx: operation=EvtInfo_DTC_0x111352.GetEventFreezeFrameDataEx
          SC_EvtInfo_DTC_0x111352_GetEventStatus: operation=EvtInfo_DTC_0x111352.GetEventStatus
          SC_EvtInfo_DTC_0x111352_GetEventTested: operation=EvtInfo_DTC_0x111352.GetEventTested
          SC_EvtInfo_DTC_0x111352_GetEventUdsStatus: operation=EvtInfo_DTC_0x111352.GetEventUdsStatus
          SC_EvtInfo_DTC_0x111352_GetFaultDetectionCounter: operation=EvtInfo_DTC_0x111352.GetFaultDetectionCounter
          SC_EvtInfo_DTC_0x111352_GetMonitorStatus: operation=EvtInfo_DTC_0x111352.GetMonitorStatus
          SC_EvtInfo_DTC_0x111e71_GetDTCOfEvent: operation=EvtInfo_DTC_0x111e71.GetDTCOfEvent
          SC_EvtInfo_DTC_0x111e71_GetDebouncingOfEvent: operation=EvtInfo_DTC_0x111e71.GetDebouncingOfEvent
          SC_EvtInfo_DTC_0x111e71_GetEventEnableCondition: operation=EvtInfo_DTC_0x111e71.GetEventEnableCondition
          SC_EvtInfo_DTC_0x111e71_GetEventExtendedDataRecordEx: operation=EvtInfo_DTC_0x111e71.GetEventExtendedDataRecordEx
          SC_EvtInfo_DTC_0x111e71_GetEventFailed: operation=EvtInfo_DTC_0x111e71.GetEventFailed
          SC_EvtInfo_DTC_0x111e71_GetEventFreezeFrameDataEx: operation=EvtInfo_DTC_0x111e71.GetEventFreezeFrameDataEx
          SC_EvtInfo_DTC_0x111e71_GetEventStatus: operation=EvtInfo_DTC_0x111e71.GetEventStatus
          SC_EvtInfo_DTC_0x111e71_GetEventTested: operation=EvtInfo_DTC_0x111e71.GetEventTested
          SC_EvtInfo_DTC_0x111e71_GetEventUdsStatus: operation=EvtInfo_DTC_0x111e71.GetEventUdsStatus
          SC_EvtInfo_DTC_0x111e71_GetFaultDetectionCounter: operation=EvtInfo_DTC_0x111e71.GetFaultDetectionCounter
          SC_EvtInfo_DTC_0x111e71_GetMonitorStatus: operation=EvtInfo_DTC_0x111e71.GetMonitorStatus
          SC_EvtInfo_DTC_0x111f16_GetDTCOfEvent: operation=EvtInfo_DTC_0x111f16.GetDTCOfEvent
          SC_EvtInfo_DTC_0x111f16_GetDebouncingOfEvent: operation=EvtInfo_DTC_0x111f16.GetDebouncingOfEvent
          SC_EvtInfo_DTC_0x111f16_GetEventEnableCondition: operation=EvtInfo_DTC_0x111f16.GetEventEnableCondition
          SC_EvtInfo_DTC_0x111f16_GetEventExtendedDataRecordEx: operation=EvtInfo_DTC_0x111f16.GetEventExtendedDataRecordEx
          SC_EvtInfo_DTC_0x111f16_GetEventFailed: operation=EvtInfo_DTC_0x111f16.GetEventFailed
          SC_EvtInfo_DTC_0x111f16_GetEventFreezeFrameDataEx: operation=EvtInfo_DTC_0x111f16.GetEventFreezeFrameDataEx
          SC_EvtInfo_DTC_0x111f16_GetEventStatus: operation=EvtInfo_DTC_0x111f16.GetEventStatus
          SC_EvtInfo_DTC_0x111f16_GetEventTested: operation=EvtInfo_DTC_0x111f16.GetEventTested
          SC_EvtInfo_DTC_0x111f16_GetEventUdsStatus: operation=EvtInfo_DTC_0x111f16.GetEventUdsStatus
          SC_EvtInfo_DTC_0x111f16_GetFaultDetectionCounter: operation=EvtInfo_DTC_0x111f16.GetFaultDetectionCounter
          SC_EvtInfo_DTC_0x111f16_GetMonitorStatus: operation=EvtInfo_DTC_0x111f16.GetMonitorStatus
          SC_EvtInfo_DTC_0x11281e_GetDTCOfEvent: operation=EvtInfo_DTC_0x11281e.GetDTCOfEvent
          SC_EvtInfo_DTC_0x11281e_GetDebouncingOfEvent: operation=EvtInfo_DTC_0x11281e.GetDebouncingOfEvent
          SC_EvtInfo_DTC_0x11281e_GetEventEnableCondition: operation=EvtInfo_DTC_0x11281e.GetEventEnableCondition
          SC_EvtInfo_DTC_0x11281e_GetEventExtendedDataRecordEx: operation=EvtInfo_DTC_0x11281e.GetEventExtendedDataRecordEx
          SC_EvtInfo_DTC_0x11281e_GetEventFailed: operation=EvtInfo_DTC_0x11281e.GetEventFailed
          SC_EvtInfo_DTC_0x11281e_GetEventFreezeFrameDataEx: operation=EvtInfo_DTC_0x11281e.GetEventFreezeFrameDataEx
          SC_EvtInfo_DTC_0x11281e_GetEventStatus: operation=EvtInfo_DTC_0x11281e.GetEventStatus
          SC_EvtInfo_DTC_0x11281e_GetEventTested: operation=EvtInfo_DTC_0x11281e.GetEventTested
          SC_EvtInfo_DTC_0x11281e_GetEventUdsStatus: operation=EvtInfo_DTC_0x11281e.GetEventUdsStatus
          SC_EvtInfo_DTC_0x11281e_GetFaultDetectionCounter: operation=EvtInfo_DTC_0x11281e.GetFaultDetectionCounter
          SC_EvtInfo_DTC_0x11281e_GetMonitorStatus: operation=EvtInfo_DTC_0x11281e.GetMonitorStatus
          SC_EvtInfo_DTC_0x11291c_GetDTCOfEvent: operation=EvtInfo_DTC_0x11291c.GetDTCOfEvent
          SC_EvtInfo_DTC_0x11291c_GetDebouncingOfEvent: operation=EvtInfo_DTC_0x11291c.GetDebouncingOfEvent
          SC_EvtInfo_DTC_0x11291c_GetEventEnableCondition: operation=EvtInfo_DTC_0x11291c.GetEventEnableCondition
          SC_EvtInfo_DTC_0x11291c_GetEventExtendedDataRecordEx: operation=EvtInfo_DTC_0x11291c.GetEventExtendedDataRecordEx
          SC_EvtInfo_DTC_0x11291c_GetEventFailed: operation=EvtInfo_DTC_0x11291c.GetEventFailed
          SC_EvtInfo_DTC_0x11291c_GetEventFreezeFrameDataEx: operation=EvtInfo_DTC_0x11291c.GetEventFreezeFrameDataEx
          SC_EvtInfo_DTC_0x11291c_GetEventStatus: operation=EvtInfo_DTC_0x11291c.GetEventStatus
          SC_EvtInfo_DTC_0x11291c_GetEventTested: operation=EvtInfo_DTC_0x11291c.GetEventTested
          SC_EvtInfo_DTC_0x11291c_GetEventUdsStatus: operation=EvtInfo_DTC_0x11291c.GetEventUdsStatus
          SC_EvtInfo_DTC_0x11291c_GetFaultDetectionCounter: operation=EvtInfo_DTC_0x11291c.GetFaultDetectionCounter
          SC_EvtInfo_DTC_0x11291c_GetMonitorStatus: operation=EvtInfo_DTC_0x11291c.GetMonitorStatus
          SC_EvtInfo_DTC_0x113197_GetDTCOfEvent: operation=EvtInfo_DTC_0x113197.GetDTCOfEvent
          SC_EvtInfo_DTC_0x113197_GetDebouncingOfEvent: operation=EvtInfo_DTC_0x113197.GetDebouncingOfEvent
          SC_EvtInfo_DTC_0x113197_GetEventEnableCondition: operation=EvtInfo_DTC_0x113197.GetEventEnableCondition
          SC_EvtInfo_DTC_0x113197_GetEventExtendedDataRecordEx: operation=EvtInfo_DTC_0x113197.GetEventExtendedDataRecordEx
          SC_EvtInfo_DTC_0x113197_GetEventFailed: operation=EvtInfo_DTC_0x113197.GetEventFailed
          SC_EvtInfo_DTC_0x113197_GetEventFreezeFrameDataEx: operation=EvtInfo_DTC_0x113197.GetEventFreezeFrameDataEx
          SC_EvtInfo_DTC_0x113197_GetEventStatus: operation=EvtInfo_DTC_0x113197.GetEventStatus
          SC_EvtInfo_DTC_0x113197_GetEventTested: operation=EvtInfo_DTC_0x113197.GetEventTested
          SC_EvtInfo_DTC_0x113197_GetEventUdsStatus: operation=EvtInfo_DTC_0x113197.GetEventUdsStatus
          SC_EvtInfo_DTC_0x113197_GetFaultDetectionCounter: operation=EvtInfo_DTC_0x113197.GetFaultDetectionCounter
          SC_EvtInfo_DTC_0x113197_GetMonitorStatus: operation=EvtInfo_DTC_0x113197.GetMonitorStatus
          SC_EvtInfo_DTC_0x113297_GetDTCOfEvent: operation=EvtInfo_DTC_0x113297.GetDTCOfEvent
          SC_EvtInfo_DTC_0x113297_GetDebouncingOfEvent: operation=EvtInfo_DTC_0x113297.GetDebouncingOfEvent
          SC_EvtInfo_DTC_0x113297_GetEventEnableCondition: operation=EvtInfo_DTC_0x113297.GetEventEnableCondition
          SC_EvtInfo_DTC_0x113297_GetEventExtendedDataRecordEx: operation=EvtInfo_DTC_0x113297.GetEventExtendedDataRecordEx
          SC_EvtInfo_DTC_0x113297_GetEventFailed: operation=EvtInfo_DTC_0x113297.GetEventFailed
          SC_EvtInfo_DTC_0x113297_GetEventFreezeFrameDataEx: operation=EvtInfo_DTC_0x113297.GetEventFreezeFrameDataEx
          SC_EvtInfo_DTC_0x113297_GetEventStatus: operation=EvtInfo_DTC_0x113297.GetEventStatus
          SC_EvtInfo_DTC_0x113297_GetEventTested: operation=EvtInfo_DTC_0x113297.GetEventTested
          SC_EvtInfo_DTC_0x113297_GetEventUdsStatus: operation=EvtInfo_DTC_0x113297.GetEventUdsStatus
          SC_EvtInfo_DTC_0x113297_GetFaultDetectionCounter: operation=EvtInfo_DTC_0x113297.GetFaultDetectionCounter
          SC_EvtInfo_DTC_0x113297_GetMonitorStatus: operation=EvtInfo_DTC_0x113297.GetMonitorStatus
          SC_EvtInfo_DTC_0x113397_GetDTCOfEvent: operation=EvtInfo_DTC_0x113397.GetDTCOfEvent
          SC_EvtInfo_DTC_0x113397_GetDebouncingOfEvent: operation=EvtInfo_DTC_0x113397.GetDebouncingOfEvent
          SC_EvtInfo_DTC_0x113397_GetEventEnableCondition: operation=EvtInfo_DTC_0x113397.GetEventEnableCondition
          SC_EvtInfo_DTC_0x113397_GetEventExtendedDataRecordEx: operation=EvtInfo_DTC_0x113397.GetEventExtendedDataRecordEx
          SC_EvtInfo_DTC_0x113397_GetEventFailed: operation=EvtInfo_DTC_0x113397.GetEventFailed
          SC_EvtInfo_DTC_0x113397_GetEventFreezeFrameDataEx: operation=EvtInfo_DTC_0x113397.GetEventFreezeFrameDataEx
          SC_EvtInfo_DTC_0x113397_GetEventStatus: operation=EvtInfo_DTC_0x113397.GetEventStatus
          SC_EvtInfo_DTC_0x113397_GetEventTested: operation=EvtInfo_DTC_0x113397.GetEventTested
          SC_EvtInfo_DTC_0x113397_GetEventUdsStatus: operation=EvtInfo_DTC_0x113397.GetEventUdsStatus
          SC_EvtInfo_DTC_0x113397_GetFaultDetectionCounter: operation=EvtInfo_DTC_0x113397.GetFaultDetectionCounter
          SC_EvtInfo_DTC_0x113397_GetMonitorStatus: operation=EvtInfo_DTC_0x113397.GetMonitorStatus
          SC_EvtInfo_DTC_0x113497_GetDTCOfEvent: operation=EvtInfo_DTC_0x113497.GetDTCOfEvent
          SC_EvtInfo_DTC_0x113497_GetDebouncingOfEvent: operation=EvtInfo_DTC_0x113497.GetDebouncingOfEvent
          SC_EvtInfo_DTC_0x113497_GetEventEnableCondition: operation=EvtInfo_DTC_0x113497.GetEventEnableCondition
          SC_EvtInfo_DTC_0x113497_GetEventExtendedDataRecordEx: operation=EvtInfo_DTC_0x113497.GetEventExtendedDataRecordEx
          SC_EvtInfo_DTC_0x113497_GetEventFailed: operation=EvtInfo_DTC_0x113497.GetEventFailed
          SC_EvtInfo_DTC_0x113497_GetEventFreezeFrameDataEx: operation=EvtInfo_DTC_0x113497.GetEventFreezeFrameDataEx
          SC_EvtInfo_DTC_0x113497_GetEventStatus: operation=EvtInfo_DTC_0x113497.GetEventStatus
          SC_EvtInfo_DTC_0x113497_GetEventTested: operation=EvtInfo_DTC_0x113497.GetEventTested
          SC_EvtInfo_DTC_0x113497_GetEventUdsStatus: operation=EvtInfo_DTC_0x113497.GetEventUdsStatus
          SC_EvtInfo_DTC_0x113497_GetFaultDetectionCounter: operation=EvtInfo_DTC_0x113497.GetFaultDetectionCounter
          SC_EvtInfo_DTC_0x113497_GetMonitorStatus: operation=EvtInfo_DTC_0x113497.GetMonitorStatus
          SC_EvtInfo_DTC_0x113597_GetDTCOfEvent: operation=EvtInfo_DTC_0x113597.GetDTCOfEvent
          SC_EvtInfo_DTC_0x113597_GetDebouncingOfEvent: operation=EvtInfo_DTC_0x113597.GetDebouncingOfEvent
          SC_EvtInfo_DTC_0x113597_GetEventEnableCondition: operation=EvtInfo_DTC_0x113597.GetEventEnableCondition
          SC_EvtInfo_DTC_0x113597_GetEventExtendedDataRecordEx: operation=EvtInfo_DTC_0x113597.GetEventExtendedDataRecordEx
          SC_EvtInfo_DTC_0x113597_GetEventFailed: operation=EvtInfo_DTC_0x113597.GetEventFailed
          SC_EvtInfo_DTC_0x113597_GetEventFreezeFrameDataEx: operation=EvtInfo_DTC_0x113597.GetEventFreezeFrameDataEx
          SC_EvtInfo_DTC_0x113597_GetEventStatus: operation=EvtInfo_DTC_0x113597.GetEventStatus
          SC_EvtInfo_DTC_0x113597_GetEventTested: operation=EvtInfo_DTC_0x113597.GetEventTested
          SC_EvtInfo_DTC_0x113597_GetEventUdsStatus: operation=EvtInfo_DTC_0x113597.GetEventUdsStatus
          SC_EvtInfo_DTC_0x113597_GetFaultDetectionCounter: operation=EvtInfo_DTC_0x113597.GetFaultDetectionCounter
          SC_EvtInfo_DTC_0x113597_GetMonitorStatus: operation=EvtInfo_DTC_0x113597.GetMonitorStatus
          SC_EvtInfo_DTC_0x113697_GetDTCOfEvent: operation=EvtInfo_DTC_0x113697.GetDTCOfEvent
          SC_EvtInfo_DTC_0x113697_GetDebouncingOfEvent: operation=EvtInfo_DTC_0x113697.GetDebouncingOfEvent
          SC_EvtInfo_DTC_0x113697_GetEventEnableCondition: operation=EvtInfo_DTC_0x113697.GetEventEnableCondition
          SC_EvtInfo_DTC_0x113697_GetEventExtendedDataRecordEx: operation=EvtInfo_DTC_0x113697.GetEventExtendedDataRecordEx
          SC_EvtInfo_DTC_0x113697_GetEventFailed: operation=EvtInfo_DTC_0x113697.GetEventFailed
          SC_EvtInfo_DTC_0x113697_GetEventFreezeFrameDataEx: operation=EvtInfo_DTC_0x113697.GetEventFreezeFrameDataEx
          SC_EvtInfo_DTC_0x113697_GetEventStatus: operation=EvtInfo_DTC_0x113697.GetEventStatus
          SC_EvtInfo_DTC_0x113697_GetEventTested: operation=EvtInfo_DTC_0x113697.GetEventTested
          SC_EvtInfo_DTC_0x113697_GetEventUdsStatus: operation=EvtInfo_DTC_0x113697.GetEventUdsStatus
          SC_EvtInfo_DTC_0x113697_GetFaultDetectionCounter: operation=EvtInfo_DTC_0x113697.GetFaultDetectionCounter
          SC_EvtInfo_DTC_0x113697_GetMonitorStatus: operation=EvtInfo_DTC_0x113697.GetMonitorStatus
          SC_EvtInfo_DTC_0x113797_GetDTCOfEvent: operation=EvtInfo_DTC_0x113797.GetDTCOfEvent
          SC_EvtInfo_DTC_0x113797_GetDebouncingOfEvent: operation=EvtInfo_DTC_0x113797.GetDebouncingOfEvent
          SC_EvtInfo_DTC_0x113797_GetEventEnableCondition: operation=EvtInfo_DTC_0x113797.GetEventEnableCondition
          SC_EvtInfo_DTC_0x113797_GetEventExtendedDataRecordEx: operation=EvtInfo_DTC_0x113797.GetEventExtendedDataRecordEx
          SC_EvtInfo_DTC_0x113797_GetEventFailed: operation=EvtInfo_DTC_0x113797.GetEventFailed
          SC_EvtInfo_DTC_0x113797_GetEventFreezeFrameDataEx: operation=EvtInfo_DTC_0x113797.GetEventFreezeFrameDataEx
          SC_EvtInfo_DTC_0x113797_GetEventStatus: operation=EvtInfo_DTC_0x113797.GetEventStatus
          SC_EvtInfo_DTC_0x113797_GetEventTested: operation=EvtInfo_DTC_0x113797.GetEventTested
          SC_EvtInfo_DTC_0x113797_GetEventUdsStatus: operation=EvtInfo_DTC_0x113797.GetEventUdsStatus
          SC_EvtInfo_DTC_0x113797_GetFaultDetectionCounter: operation=EvtInfo_DTC_0x113797.GetFaultDetectionCounter
          SC_EvtInfo_DTC_0x113797_GetMonitorStatus: operation=EvtInfo_DTC_0x113797.GetMonitorStatus
          SC_EvtInfo_DTC_0x113897_GetDTCOfEvent: operation=EvtInfo_DTC_0x113897.GetDTCOfEvent
          SC_EvtInfo_DTC_0x113897_GetDebouncingOfEvent: operation=EvtInfo_DTC_0x113897.GetDebouncingOfEvent
          SC_EvtInfo_DTC_0x113897_GetEventEnableCondition: operation=EvtInfo_DTC_0x113897.GetEventEnableCondition
          SC_EvtInfo_DTC_0x113897_GetEventExtendedDataRecordEx: operation=EvtInfo_DTC_0x113897.GetEventExtendedDataRecordEx
          SC_EvtInfo_DTC_0x113897_GetEventFailed: operation=EvtInfo_DTC_0x113897.GetEventFailed
          SC_EvtInfo_DTC_0x113897_GetEventFreezeFrameDataEx: operation=EvtInfo_DTC_0x113897.GetEventFreezeFrameDataEx
          SC_EvtInfo_DTC_0x113897_GetEventStatus: operation=EvtInfo_DTC_0x113897.GetEventStatus
          SC_EvtInfo_DTC_0x113897_GetEventTested: operation=EvtInfo_DTC_0x113897.GetEventTested
          SC_EvtInfo_DTC_0x113897_GetEventUdsStatus: operation=EvtInfo_DTC_0x113897.GetEventUdsStatus
          SC_EvtInfo_DTC_0x113897_GetFaultDetectionCounter: operation=EvtInfo_DTC_0x113897.GetFaultDetectionCounter
          SC_EvtInfo_DTC_0x113897_GetMonitorStatus: operation=EvtInfo_DTC_0x113897.GetMonitorStatus
          SC_EvtInfo_DTC_0x113997_GetDTCOfEvent: operation=EvtInfo_DTC_0x113997.GetDTCOfEvent
          SC_EvtInfo_DTC_0x113997_GetDebouncingOfEvent: operation=EvtInfo_DTC_0x113997.GetDebouncingOfEvent
          SC_EvtInfo_DTC_0x113997_GetEventEnableCondition: operation=EvtInfo_DTC_0x113997.GetEventEnableCondition
          SC_EvtInfo_DTC_0x113997_GetEventExtendedDataRecordEx: operation=EvtInfo_DTC_0x113997.GetEventExtendedDataRecordEx
          SC_EvtInfo_DTC_0x113997_GetEventFailed: operation=EvtInfo_DTC_0x113997.GetEventFailed
          SC_EvtInfo_DTC_0x113997_GetEventFreezeFrameDataEx: operation=EvtInfo_DTC_0x113997.GetEventFreezeFrameDataEx
          SC_EvtInfo_DTC_0x113997_GetEventStatus: operation=EvtInfo_DTC_0x113997.GetEventStatus
          SC_EvtInfo_DTC_0x113997_GetEventTested: operation=EvtInfo_DTC_0x113997.GetEventTested
          SC_EvtInfo_DTC_0x113997_GetEventUdsStatus: operation=EvtInfo_DTC_0x113997.GetEventUdsStatus
          SC_EvtInfo_DTC_0x113997_GetFaultDetectionCounter: operation=EvtInfo_DTC_0x113997.GetFaultDetectionCounter
          SC_EvtInfo_DTC_0x113997_GetMonitorStatus: operation=EvtInfo_DTC_0x113997.GetMonitorStatus
          SC_EvtInfo_DTC_0x114097_GetDTCOfEvent: operation=EvtInfo_DTC_0x114097.GetDTCOfEvent
          SC_EvtInfo_DTC_0x114097_GetDebouncingOfEvent: operation=EvtInfo_DTC_0x114097.GetDebouncingOfEvent
          SC_EvtInfo_DTC_0x114097_GetEventEnableCondition: operation=EvtInfo_DTC_0x114097.GetEventEnableCondition
          SC_EvtInfo_DTC_0x114097_GetEventExtendedDataRecordEx: operation=EvtInfo_DTC_0x114097.GetEventExtendedDataRecordEx
          SC_EvtInfo_DTC_0x114097_GetEventFailed: operation=EvtInfo_DTC_0x114097.GetEventFailed
          SC_EvtInfo_DTC_0x114097_GetEventFreezeFrameDataEx: operation=EvtInfo_DTC_0x114097.GetEventFreezeFrameDataEx
          SC_EvtInfo_DTC_0x114097_GetEventStatus: operation=EvtInfo_DTC_0x114097.GetEventStatus
          SC_EvtInfo_DTC_0x114097_GetEventTested: operation=EvtInfo_DTC_0x114097.GetEventTested
          SC_EvtInfo_DTC_0x114097_GetEventUdsStatus: operation=EvtInfo_DTC_0x114097.GetEventUdsStatus
          SC_EvtInfo_DTC_0x114097_GetFaultDetectionCounter: operation=EvtInfo_DTC_0x114097.GetFaultDetectionCounter
          SC_EvtInfo_DTC_0x114097_GetMonitorStatus: operation=EvtInfo_DTC_0x114097.GetMonitorStatus
          SC_EvtInfo_DTC_0x114197_GetDTCOfEvent: operation=EvtInfo_DTC_0x114197.GetDTCOfEvent
          SC_EvtInfo_DTC_0x114197_GetDebouncingOfEvent: operation=EvtInfo_DTC_0x114197.GetDebouncingOfEvent
          SC_EvtInfo_DTC_0x114197_GetEventEnableCondition: operation=EvtInfo_DTC_0x114197.GetEventEnableCondition
          SC_EvtInfo_DTC_0x114197_GetEventExtendedDataRecordEx: operation=EvtInfo_DTC_0x114197.GetEventExtendedDataRecordEx
          SC_EvtInfo_DTC_0x114197_GetEventFailed: operation=EvtInfo_DTC_0x114197.GetEventFailed
          SC_EvtInfo_DTC_0x114197_GetEventFreezeFrameDataEx: operation=EvtInfo_DTC_0x114197.GetEventFreezeFrameDataEx
          SC_EvtInfo_DTC_0x114197_GetEventStatus: operation=EvtInfo_DTC_0x114197.GetEventStatus
          SC_EvtInfo_DTC_0x114197_GetEventTested: operation=EvtInfo_DTC_0x114197.GetEventTested
          SC_EvtInfo_DTC_0x114197_GetEventUdsStatus: operation=EvtInfo_DTC_0x114197.GetEventUdsStatus
          SC_EvtInfo_DTC_0x114197_GetFaultDetectionCounter: operation=EvtInfo_DTC_0x114197.GetFaultDetectionCounter
          SC_EvtInfo_DTC_0x114197_GetMonitorStatus: operation=EvtInfo_DTC_0x114197.GetMonitorStatus
          SC_EvtInfo_DTC_0x114297_GetDTCOfEvent: operation=EvtInfo_DTC_0x114297.GetDTCOfEvent
          SC_EvtInfo_DTC_0x114297_GetDebouncingOfEvent: operation=EvtInfo_DTC_0x114297.GetDebouncingOfEvent
          SC_EvtInfo_DTC_0x114297_GetEventEnableCondition: operation=EvtInfo_DTC_0x114297.GetEventEnableCondition
          SC_EvtInfo_DTC_0x114297_GetEventExtendedDataRecordEx: operation=EvtInfo_DTC_0x114297.GetEventExtendedDataRecordEx
          SC_EvtInfo_DTC_0x114297_GetEventFailed: operation=EvtInfo_DTC_0x114297.GetEventFailed
          SC_EvtInfo_DTC_0x114297_GetEventFreezeFrameDataEx: operation=EvtInfo_DTC_0x114297.GetEventFreezeFrameDataEx
          SC_EvtInfo_DTC_0x114297_GetEventStatus: operation=EvtInfo_DTC_0x114297.GetEventStatus
          SC_EvtInfo_DTC_0x114297_GetEventTested: operation=EvtInfo_DTC_0x114297.GetEventTested
          SC_EvtInfo_DTC_0x114297_GetEventUdsStatus: operation=EvtInfo_DTC_0x114297.GetEventUdsStatus
          SC_EvtInfo_DTC_0x114297_GetFaultDetectionCounter: operation=EvtInfo_DTC_0x114297.GetFaultDetectionCounter
          SC_EvtInfo_DTC_0x114297_GetMonitorStatus: operation=EvtInfo_DTC_0x114297.GetMonitorStatus
          SC_EvtInfo_DTC_0x114397_GetDTCOfEvent: operation=EvtInfo_DTC_0x114397.GetDTCOfEvent
          SC_EvtInfo_DTC_0x114397_GetDebouncingOfEvent: operation=EvtInfo_DTC_0x114397.GetDebouncingOfEvent
          SC_EvtInfo_DTC_0x114397_GetEventEnableCondition: operation=EvtInfo_DTC_0x114397.GetEventEnableCondition
          SC_EvtInfo_DTC_0x114397_GetEventExtendedDataRecordEx: operation=EvtInfo_DTC_0x114397.GetEventExtendedDataRecordEx
          SC_EvtInfo_DTC_0x114397_GetEventFailed: operation=EvtInfo_DTC_0x114397.GetEventFailed
          SC_EvtInfo_DTC_0x114397_GetEventFreezeFrameDataEx: operation=EvtInfo_DTC_0x114397.GetEventFreezeFrameDataEx
          SC_EvtInfo_DTC_0x114397_GetEventStatus: operation=EvtInfo_DTC_0x114397.GetEventStatus
          SC_EvtInfo_DTC_0x114397_GetEventTested: operation=EvtInfo_DTC_0x114397.GetEventTested
          SC_EvtInfo_DTC_0x114397_GetEventUdsStatus: operation=EvtInfo_DTC_0x114397.GetEventUdsStatus
          SC_EvtInfo_DTC_0x114397_GetFaultDetectionCounter: operation=EvtInfo_DTC_0x114397.GetFaultDetectionCounter
          SC_EvtInfo_DTC_0x114397_GetMonitorStatus: operation=EvtInfo_DTC_0x114397.GetMonitorStatus
          SC_EvtInfo_DTC_0x114497_GetDTCOfEvent: operation=EvtInfo_DTC_0x114497.GetDTCOfEvent
          SC_EvtInfo_DTC_0x114497_GetDebouncingOfEvent: operation=EvtInfo_DTC_0x114497.GetDebouncingOfEvent
          SC_EvtInfo_DTC_0x114497_GetEventEnableCondition: operation=EvtInfo_DTC_0x114497.GetEventEnableCondition
          SC_EvtInfo_DTC_0x114497_GetEventExtendedDataRecordEx: operation=EvtInfo_DTC_0x114497.GetEventExtendedDataRecordEx
          SC_EvtInfo_DTC_0x114497_GetEventFailed: operation=EvtInfo_DTC_0x114497.GetEventFailed
          SC_EvtInfo_DTC_0x114497_GetEventFreezeFrameDataEx: operation=EvtInfo_DTC_0x114497.GetEventFreezeFrameDataEx
          SC_EvtInfo_DTC_0x114497_GetEventStatus: operation=EvtInfo_DTC_0x114497.GetEventStatus
          SC_EvtInfo_DTC_0x114497_GetEventTested: operation=EvtInfo_DTC_0x114497.GetEventTested
          SC_EvtInfo_DTC_0x114497_GetEventUdsStatus: operation=EvtInfo_DTC_0x114497.GetEventUdsStatus
          SC_EvtInfo_DTC_0x114497_GetFaultDetectionCounter: operation=EvtInfo_DTC_0x114497.GetFaultDetectionCounter
          SC_EvtInfo_DTC_0x114497_GetMonitorStatus: operation=EvtInfo_DTC_0x114497.GetMonitorStatus
          SC_EvtInfo_DTC_0x114571_GetDTCOfEvent: operation=EvtInfo_DTC_0x114571.GetDTCOfEvent
          SC_EvtInfo_DTC_0x114571_GetDebouncingOfEvent: operation=EvtInfo_DTC_0x114571.GetDebouncingOfEvent
          SC_EvtInfo_DTC_0x114571_GetEventEnableCondition: operation=EvtInfo_DTC_0x114571.GetEventEnableCondition
          SC_EvtInfo_DTC_0x114571_GetEventExtendedDataRecordEx: operation=EvtInfo_DTC_0x114571.GetEventExtendedDataRecordEx
          SC_EvtInfo_DTC_0x114571_GetEventFailed: operation=EvtInfo_DTC_0x114571.GetEventFailed
          SC_EvtInfo_DTC_0x114571_GetEventFreezeFrameDataEx: operation=EvtInfo_DTC_0x114571.GetEventFreezeFrameDataEx
          SC_EvtInfo_DTC_0x114571_GetEventStatus: operation=EvtInfo_DTC_0x114571.GetEventStatus
          SC_EvtInfo_DTC_0x114571_GetEventTested: operation=EvtInfo_DTC_0x114571.GetEventTested
          SC_EvtInfo_DTC_0x114571_GetEventUdsStatus: operation=EvtInfo_DTC_0x114571.GetEventUdsStatus
          SC_EvtInfo_DTC_0x114571_GetFaultDetectionCounter: operation=EvtInfo_DTC_0x114571.GetFaultDetectionCounter
          SC_EvtInfo_DTC_0x114571_GetMonitorStatus: operation=EvtInfo_DTC_0x114571.GetMonitorStatus
          SC_EvtInfo_DTC_0x114697_GetDTCOfEvent: operation=EvtInfo_DTC_0x114697.GetDTCOfEvent
          SC_EvtInfo_DTC_0x114697_GetDebouncingOfEvent: operation=EvtInfo_DTC_0x114697.GetDebouncingOfEvent
          SC_EvtInfo_DTC_0x114697_GetEventEnableCondition: operation=EvtInfo_DTC_0x114697.GetEventEnableCondition
          SC_EvtInfo_DTC_0x114697_GetEventExtendedDataRecordEx: operation=EvtInfo_DTC_0x114697.GetEventExtendedDataRecordEx
          SC_EvtInfo_DTC_0x114697_GetEventFailed: operation=EvtInfo_DTC_0x114697.GetEventFailed
          SC_EvtInfo_DTC_0x114697_GetEventFreezeFrameDataEx: operation=EvtInfo_DTC_0x114697.GetEventFreezeFrameDataEx
          SC_EvtInfo_DTC_0x114697_GetEventStatus: operation=EvtInfo_DTC_0x114697.GetEventStatus
          SC_EvtInfo_DTC_0x114697_GetEventTested: operation=EvtInfo_DTC_0x114697.GetEventTested
          SC_EvtInfo_DTC_0x114697_GetEventUdsStatus: operation=EvtInfo_DTC_0x114697.GetEventUdsStatus
          SC_EvtInfo_DTC_0x114697_GetFaultDetectionCounter: operation=EvtInfo_DTC_0x114697.GetFaultDetectionCounter
          SC_EvtInfo_DTC_0x114697_GetMonitorStatus: operation=EvtInfo_DTC_0x114697.GetMonitorStatus
          SC_EvtInfo_DTC_0x114792_GetDTCOfEvent: operation=EvtInfo_DTC_0x114792.GetDTCOfEvent
          SC_EvtInfo_DTC_0x114792_GetDebouncingOfEvent: operation=EvtInfo_DTC_0x114792.GetDebouncingOfEvent
          SC_EvtInfo_DTC_0x114792_GetEventEnableCondition: operation=EvtInfo_DTC_0x114792.GetEventEnableCondition
          SC_EvtInfo_DTC_0x114792_GetEventExtendedDataRecordEx: operation=EvtInfo_DTC_0x114792.GetEventExtendedDataRecordEx
          SC_EvtInfo_DTC_0x114792_GetEventFailed: operation=EvtInfo_DTC_0x114792.GetEventFailed
          SC_EvtInfo_DTC_0x114792_GetEventFreezeFrameDataEx: operation=EvtInfo_DTC_0x114792.GetEventFreezeFrameDataEx
          SC_EvtInfo_DTC_0x114792_GetEventStatus: operation=EvtInfo_DTC_0x114792.GetEventStatus
          SC_EvtInfo_DTC_0x114792_GetEventTested: operation=EvtInfo_DTC_0x114792.GetEventTested
          SC_EvtInfo_DTC_0x114792_GetEventUdsStatus: operation=EvtInfo_DTC_0x114792.GetEventUdsStatus
          SC_EvtInfo_DTC_0x114792_GetFaultDetectionCounter: operation=EvtInfo_DTC_0x114792.GetFaultDetectionCounter
          SC_EvtInfo_DTC_0x114792_GetMonitorStatus: operation=EvtInfo_DTC_0x114792.GetMonitorStatus
          SC_EvtInfo_DTC_0x114892_GetDTCOfEvent: operation=EvtInfo_DTC_0x114892.GetDTCOfEvent
          SC_EvtInfo_DTC_0x114892_GetDebouncingOfEvent: operation=EvtInfo_DTC_0x114892.GetDebouncingOfEvent
          SC_EvtInfo_DTC_0x114892_GetEventEnableCondition: operation=EvtInfo_DTC_0x114892.GetEventEnableCondition
          SC_EvtInfo_DTC_0x114892_GetEventExtendedDataRecordEx: operation=EvtInfo_DTC_0x114892.GetEventExtendedDataRecordEx
          SC_EvtInfo_DTC_0x114892_GetEventFailed: operation=EvtInfo_DTC_0x114892.GetEventFailed
          SC_EvtInfo_DTC_0x114892_GetEventFreezeFrameDataEx: operation=EvtInfo_DTC_0x114892.GetEventFreezeFrameDataEx
          SC_EvtInfo_DTC_0x114892_GetEventStatus: operation=EvtInfo_DTC_0x114892.GetEventStatus
          SC_EvtInfo_DTC_0x114892_GetEventTested: operation=EvtInfo_DTC_0x114892.GetEventTested
          SC_EvtInfo_DTC_0x114892_GetEventUdsStatus: operation=EvtInfo_DTC_0x114892.GetEventUdsStatus
          SC_EvtInfo_DTC_0x114892_GetFaultDetectionCounter: operation=EvtInfo_DTC_0x114892.GetFaultDetectionCounter
          SC_EvtInfo_DTC_0x114892_GetMonitorStatus: operation=EvtInfo_DTC_0x114892.GetMonitorStatus
          SC_EvtInfo_DTC_0x114992_GetDTCOfEvent: operation=EvtInfo_DTC_0x114992.GetDTCOfEvent
          SC_EvtInfo_DTC_0x114992_GetDebouncingOfEvent: operation=EvtInfo_DTC_0x114992.GetDebouncingOfEvent
          SC_EvtInfo_DTC_0x114992_GetEventEnableCondition: operation=EvtInfo_DTC_0x114992.GetEventEnableCondition
          SC_EvtInfo_DTC_0x114992_GetEventExtendedDataRecordEx: operation=EvtInfo_DTC_0x114992.GetEventExtendedDataRecordEx
          SC_EvtInfo_DTC_0x114992_GetEventFailed: operation=EvtInfo_DTC_0x114992.GetEventFailed
          SC_EvtInfo_DTC_0x114992_GetEventFreezeFrameDataEx: operation=EvtInfo_DTC_0x114992.GetEventFreezeFrameDataEx
          SC_EvtInfo_DTC_0x114992_GetEventStatus: operation=EvtInfo_DTC_0x114992.GetEventStatus
          SC_EvtInfo_DTC_0x114992_GetEventTested: operation=EvtInfo_DTC_0x114992.GetEventTested
          SC_EvtInfo_DTC_0x114992_GetEventUdsStatus: operation=EvtInfo_DTC_0x114992.GetEventUdsStatus
          SC_EvtInfo_DTC_0x114992_GetFaultDetectionCounter: operation=EvtInfo_DTC_0x114992.GetFaultDetectionCounter
          SC_EvtInfo_DTC_0x114992_GetMonitorStatus: operation=EvtInfo_DTC_0x114992.GetMonitorStatus
          SC_EvtInfo_DTC_0x115092_GetDTCOfEvent: operation=EvtInfo_DTC_0x115092.GetDTCOfEvent
          SC_EvtInfo_DTC_0x115092_GetDebouncingOfEvent: operation=EvtInfo_DTC_0x115092.GetDebouncingOfEvent
          SC_EvtInfo_DTC_0x115092_GetEventEnableCondition: operation=EvtInfo_DTC_0x115092.GetEventEnableCondition
          SC_EvtInfo_DTC_0x115092_GetEventExtendedDataRecordEx: operation=EvtInfo_DTC_0x115092.GetEventExtendedDataRecordEx
          SC_EvtInfo_DTC_0x115092_GetEventFailed: operation=EvtInfo_DTC_0x115092.GetEventFailed
          SC_EvtInfo_DTC_0x115092_GetEventFreezeFrameDataEx: operation=EvtInfo_DTC_0x115092.GetEventFreezeFrameDataEx
          SC_EvtInfo_DTC_0x115092_GetEventStatus: operation=EvtInfo_DTC_0x115092.GetEventStatus
          SC_EvtInfo_DTC_0x115092_GetEventTested: operation=EvtInfo_DTC_0x115092.GetEventTested
          SC_EvtInfo_DTC_0x115092_GetEventUdsStatus: operation=EvtInfo_DTC_0x115092.GetEventUdsStatus
          SC_EvtInfo_DTC_0x115092_GetFaultDetectionCounter: operation=EvtInfo_DTC_0x115092.GetFaultDetectionCounter
          SC_EvtInfo_DTC_0x115092_GetMonitorStatus: operation=EvtInfo_DTC_0x115092.GetMonitorStatus
          SC_EvtInfo_DTC_0x115192_GetDTCOfEvent: operation=EvtInfo_DTC_0x115192.GetDTCOfEvent
          SC_EvtInfo_DTC_0x115192_GetDebouncingOfEvent: operation=EvtInfo_DTC_0x115192.GetDebouncingOfEvent
          SC_EvtInfo_DTC_0x115192_GetEventEnableCondition: operation=EvtInfo_DTC_0x115192.GetEventEnableCondition
          SC_EvtInfo_DTC_0x115192_GetEventExtendedDataRecordEx: operation=EvtInfo_DTC_0x115192.GetEventExtendedDataRecordEx
          SC_EvtInfo_DTC_0x115192_GetEventFailed: operation=EvtInfo_DTC_0x115192.GetEventFailed
          SC_EvtInfo_DTC_0x115192_GetEventFreezeFrameDataEx: operation=EvtInfo_DTC_0x115192.GetEventFreezeFrameDataEx
          SC_EvtInfo_DTC_0x115192_GetEventStatus: operation=EvtInfo_DTC_0x115192.GetEventStatus
          SC_EvtInfo_DTC_0x115192_GetEventTested: operation=EvtInfo_DTC_0x115192.GetEventTested
          SC_EvtInfo_DTC_0x115192_GetEventUdsStatus: operation=EvtInfo_DTC_0x115192.GetEventUdsStatus
          SC_EvtInfo_DTC_0x115192_GetFaultDetectionCounter: operation=EvtInfo_DTC_0x115192.GetFaultDetectionCounter
          SC_EvtInfo_DTC_0x115192_GetMonitorStatus: operation=EvtInfo_DTC_0x115192.GetMonitorStatus
          SC_EvtInfo_DTC_0x115292_GetDTCOfEvent: operation=EvtInfo_DTC_0x115292.GetDTCOfEvent
          SC_EvtInfo_DTC_0x115292_GetDebouncingOfEvent: operation=EvtInfo_DTC_0x115292.GetDebouncingOfEvent
          SC_EvtInfo_DTC_0x115292_GetEventEnableCondition: operation=EvtInfo_DTC_0x115292.GetEventEnableCondition
          SC_EvtInfo_DTC_0x115292_GetEventExtendedDataRecordEx: operation=EvtInfo_DTC_0x115292.GetEventExtendedDataRecordEx
          SC_EvtInfo_DTC_0x115292_GetEventFailed: operation=EvtInfo_DTC_0x115292.GetEventFailed
          SC_EvtInfo_DTC_0x115292_GetEventFreezeFrameDataEx: operation=EvtInfo_DTC_0x115292.GetEventFreezeFrameDataEx
          SC_EvtInfo_DTC_0x115292_GetEventStatus: operation=EvtInfo_DTC_0x115292.GetEventStatus
          SC_EvtInfo_DTC_0x115292_GetEventTested: operation=EvtInfo_DTC_0x115292.GetEventTested
          SC_EvtInfo_DTC_0x115292_GetEventUdsStatus: operation=EvtInfo_DTC_0x115292.GetEventUdsStatus
          SC_EvtInfo_DTC_0x115292_GetFaultDetectionCounter: operation=EvtInfo_DTC_0x115292.GetFaultDetectionCounter
          SC_EvtInfo_DTC_0x115292_GetMonitorStatus: operation=EvtInfo_DTC_0x115292.GetMonitorStatus
          SC_EvtInfo_DTC_0x115392_GetDTCOfEvent: operation=EvtInfo_DTC_0x115392.GetDTCOfEvent
          SC_EvtInfo_DTC_0x115392_GetDebouncingOfEvent: operation=EvtInfo_DTC_0x115392.GetDebouncingOfEvent
          SC_EvtInfo_DTC_0x115392_GetEventEnableCondition: operation=EvtInfo_DTC_0x115392.GetEventEnableCondition
          SC_EvtInfo_DTC_0x115392_GetEventExtendedDataRecordEx: operation=EvtInfo_DTC_0x115392.GetEventExtendedDataRecordEx
          SC_EvtInfo_DTC_0x115392_GetEventFailed: operation=EvtInfo_DTC_0x115392.GetEventFailed
          SC_EvtInfo_DTC_0x115392_GetEventFreezeFrameDataEx: operation=EvtInfo_DTC_0x115392.GetEventFreezeFrameDataEx
          SC_EvtInfo_DTC_0x115392_GetEventStatus: operation=EvtInfo_DTC_0x115392.GetEventStatus
          SC_EvtInfo_DTC_0x115392_GetEventTested: operation=EvtInfo_DTC_0x115392.GetEventTested
          SC_EvtInfo_DTC_0x115392_GetEventUdsStatus: operation=EvtInfo_DTC_0x115392.GetEventUdsStatus
          SC_EvtInfo_DTC_0x115392_GetFaultDetectionCounter: operation=EvtInfo_DTC_0x115392.GetFaultDetectionCounter
          SC_EvtInfo_DTC_0x115392_GetMonitorStatus: operation=EvtInfo_DTC_0x115392.GetMonitorStatus
          SC_EvtInfo_DTC_0x115492_GetDTCOfEvent: operation=EvtInfo_DTC_0x115492.GetDTCOfEvent
          SC_EvtInfo_DTC_0x115492_GetDebouncingOfEvent: operation=EvtInfo_DTC_0x115492.GetDebouncingOfEvent
          SC_EvtInfo_DTC_0x115492_GetEventEnableCondition: operation=EvtInfo_DTC_0x115492.GetEventEnableCondition
          SC_EvtInfo_DTC_0x115492_GetEventExtendedDataRecordEx: operation=EvtInfo_DTC_0x115492.GetEventExtendedDataRecordEx
          SC_EvtInfo_DTC_0x115492_GetEventFailed: operation=EvtInfo_DTC_0x115492.GetEventFailed
          SC_EvtInfo_DTC_0x115492_GetEventFreezeFrameDataEx: operation=EvtInfo_DTC_0x115492.GetEventFreezeFrameDataEx
          SC_EvtInfo_DTC_0x115492_GetEventStatus: operation=EvtInfo_DTC_0x115492.GetEventStatus
          SC_EvtInfo_DTC_0x115492_GetEventTested: operation=EvtInfo_DTC_0x115492.GetEventTested
          SC_EvtInfo_DTC_0x115492_GetEventUdsStatus: operation=EvtInfo_DTC_0x115492.GetEventUdsStatus
          SC_EvtInfo_DTC_0x115492_GetFaultDetectionCounter: operation=EvtInfo_DTC_0x115492.GetFaultDetectionCounter
          SC_EvtInfo_DTC_0x115492_GetMonitorStatus: operation=EvtInfo_DTC_0x115492.GetMonitorStatus
          SC_EvtInfo_DTC_0x115592_GetDTCOfEvent: operation=EvtInfo_DTC_0x115592.GetDTCOfEvent
          SC_EvtInfo_DTC_0x115592_GetDebouncingOfEvent: operation=EvtInfo_DTC_0x115592.GetDebouncingOfEvent
          SC_EvtInfo_DTC_0x115592_GetEventEnableCondition: operation=EvtInfo_DTC_0x115592.GetEventEnableCondition
          SC_EvtInfo_DTC_0x115592_GetEventExtendedDataRecordEx: operation=EvtInfo_DTC_0x115592.GetEventExtendedDataRecordEx
          SC_EvtInfo_DTC_0x115592_GetEventFailed: operation=EvtInfo_DTC_0x115592.GetEventFailed
          SC_EvtInfo_DTC_0x115592_GetEventFreezeFrameDataEx: operation=EvtInfo_DTC_0x115592.GetEventFreezeFrameDataEx
          SC_EvtInfo_DTC_0x115592_GetEventStatus: operation=EvtInfo_DTC_0x115592.GetEventStatus
          SC_EvtInfo_DTC_0x115592_GetEventTested: operation=EvtInfo_DTC_0x115592.GetEventTested
          SC_EvtInfo_DTC_0x115592_GetEventUdsStatus: operation=EvtInfo_DTC_0x115592.GetEventUdsStatus
          SC_EvtInfo_DTC_0x115592_GetFaultDetectionCounter: operation=EvtInfo_DTC_0x115592.GetFaultDetectionCounter
          SC_EvtInfo_DTC_0x115592_GetMonitorStatus: operation=EvtInfo_DTC_0x115592.GetMonitorStatus
          SC_EvtInfo_DTC_0x115692_GetDTCOfEvent: operation=EvtInfo_DTC_0x115692.GetDTCOfEvent
          SC_EvtInfo_DTC_0x115692_GetDebouncingOfEvent: operation=EvtInfo_DTC_0x115692.GetDebouncingOfEvent
          SC_EvtInfo_DTC_0x115692_GetEventEnableCondition: operation=EvtInfo_DTC_0x115692.GetEventEnableCondition
          SC_EvtInfo_DTC_0x115692_GetEventExtendedDataRecordEx: operation=EvtInfo_DTC_0x115692.GetEventExtendedDataRecordEx
          SC_EvtInfo_DTC_0x115692_GetEventFailed: operation=EvtInfo_DTC_0x115692.GetEventFailed
          SC_EvtInfo_DTC_0x115692_GetEventFreezeFrameDataEx: operation=EvtInfo_DTC_0x115692.GetEventFreezeFrameDataEx
          SC_EvtInfo_DTC_0x115692_GetEventStatus: operation=EvtInfo_DTC_0x115692.GetEventStatus
          SC_EvtInfo_DTC_0x115692_GetEventTested: operation=EvtInfo_DTC_0x115692.GetEventTested
          SC_EvtInfo_DTC_0x115692_GetEventUdsStatus: operation=EvtInfo_DTC_0x115692.GetEventUdsStatus
          SC_EvtInfo_DTC_0x115692_GetFaultDetectionCounter: operation=EvtInfo_DTC_0x115692.GetFaultDetectionCounter
          SC_EvtInfo_DTC_0x115692_GetMonitorStatus: operation=EvtInfo_DTC_0x115692.GetMonitorStatus
          SC_EvtInfo_DTC_0x11571e_GetDTCOfEvent: operation=EvtInfo_DTC_0x11571e.GetDTCOfEvent
          SC_EvtInfo_DTC_0x11571e_GetDebouncingOfEvent: operation=EvtInfo_DTC_0x11571e.GetDebouncingOfEvent
          SC_EvtInfo_DTC_0x11571e_GetEventEnableCondition: operation=EvtInfo_DTC_0x11571e.GetEventEnableCondition
          SC_EvtInfo_DTC_0x11571e_GetEventExtendedDataRecordEx: operation=EvtInfo_DTC_0x11571e.GetEventExtendedDataRecordEx
          SC_EvtInfo_DTC_0x11571e_GetEventFailed: operation=EvtInfo_DTC_0x11571e.GetEventFailed
          SC_EvtInfo_DTC_0x11571e_GetEventFreezeFrameDataEx: operation=EvtInfo_DTC_0x11571e.GetEventFreezeFrameDataEx
          SC_EvtInfo_DTC_0x11571e_GetEventStatus: operation=EvtInfo_DTC_0x11571e.GetEventStatus
          SC_EvtInfo_DTC_0x11571e_GetEventTested: operation=EvtInfo_DTC_0x11571e.GetEventTested
          SC_EvtInfo_DTC_0x11571e_GetEventUdsStatus: operation=EvtInfo_DTC_0x11571e.GetEventUdsStatus
          SC_EvtInfo_DTC_0x11571e_GetFaultDetectionCounter: operation=EvtInfo_DTC_0x11571e.GetFaultDetectionCounter
          SC_EvtInfo_DTC_0x11571e_GetMonitorStatus: operation=EvtInfo_DTC_0x11571e.GetMonitorStatus
          SC_EvtInfo_DTC_0x115816_GetDTCOfEvent: operation=EvtInfo_DTC_0x115816.GetDTCOfEvent
          SC_EvtInfo_DTC_0x115816_GetDebouncingOfEvent: operation=EvtInfo_DTC_0x115816.GetDebouncingOfEvent
          SC_EvtInfo_DTC_0x115816_GetEventEnableCondition: operation=EvtInfo_DTC_0x115816.GetEventEnableCondition
          SC_EvtInfo_DTC_0x115816_GetEventExtendedDataRecordEx: operation=EvtInfo_DTC_0x115816.GetEventExtendedDataRecordEx
          SC_EvtInfo_DTC_0x115816_GetEventFailed: operation=EvtInfo_DTC_0x115816.GetEventFailed
          SC_EvtInfo_DTC_0x115816_GetEventFreezeFrameDataEx: operation=EvtInfo_DTC_0x115816.GetEventFreezeFrameDataEx
          SC_EvtInfo_DTC_0x115816_GetEventStatus: operation=EvtInfo_DTC_0x115816.GetEventStatus
          SC_EvtInfo_DTC_0x115816_GetEventTested: operation=EvtInfo_DTC_0x115816.GetEventTested
          SC_EvtInfo_DTC_0x115816_GetEventUdsStatus: operation=EvtInfo_DTC_0x115816.GetEventUdsStatus
          SC_EvtInfo_DTC_0x115816_GetFaultDetectionCounter: operation=EvtInfo_DTC_0x115816.GetFaultDetectionCounter
          SC_EvtInfo_DTC_0x115816_GetMonitorStatus: operation=EvtInfo_DTC_0x115816.GetMonitorStatus
          SC_EvtInfo_DTC_0x115a92_GetDTCOfEvent: operation=EvtInfo_DTC_0x115a92.GetDTCOfEvent
          SC_EvtInfo_DTC_0x115a92_GetDebouncingOfEvent: operation=EvtInfo_DTC_0x115a92.GetDebouncingOfEvent
          SC_EvtInfo_DTC_0x115a92_GetEventEnableCondition: operation=EvtInfo_DTC_0x115a92.GetEventEnableCondition
          SC_EvtInfo_DTC_0x115a92_GetEventExtendedDataRecordEx: operation=EvtInfo_DTC_0x115a92.GetEventExtendedDataRecordEx
          SC_EvtInfo_DTC_0x115a92_GetEventFailed: operation=EvtInfo_DTC_0x115a92.GetEventFailed
          SC_EvtInfo_DTC_0x115a92_GetEventFreezeFrameDataEx: operation=EvtInfo_DTC_0x115a92.GetEventFreezeFrameDataEx
          SC_EvtInfo_DTC_0x115a92_GetEventStatus: operation=EvtInfo_DTC_0x115a92.GetEventStatus
          SC_EvtInfo_DTC_0x115a92_GetEventTested: operation=EvtInfo_DTC_0x115a92.GetEventTested
          SC_EvtInfo_DTC_0x115a92_GetEventUdsStatus: operation=EvtInfo_DTC_0x115a92.GetEventUdsStatus
          SC_EvtInfo_DTC_0x115a92_GetFaultDetectionCounter: operation=EvtInfo_DTC_0x115a92.GetFaultDetectionCounter
          SC_EvtInfo_DTC_0x115a92_GetMonitorStatus: operation=EvtInfo_DTC_0x115a92.GetMonitorStatus
          SC_EvtInfo_DTC_0x115c4b_GetDTCOfEvent: operation=EvtInfo_DTC_0x115c4b.GetDTCOfEvent
          SC_EvtInfo_DTC_0x115c4b_GetDebouncingOfEvent: operation=EvtInfo_DTC_0x115c4b.GetDebouncingOfEvent
          SC_EvtInfo_DTC_0x115c4b_GetEventEnableCondition: operation=EvtInfo_DTC_0x115c4b.GetEventEnableCondition
          SC_EvtInfo_DTC_0x115c4b_GetEventExtendedDataRecordEx: operation=EvtInfo_DTC_0x115c4b.GetEventExtendedDataRecordEx
          SC_EvtInfo_DTC_0x115c4b_GetEventFailed: operation=EvtInfo_DTC_0x115c4b.GetEventFailed
          SC_EvtInfo_DTC_0x115c4b_GetEventFreezeFrameDataEx: operation=EvtInfo_DTC_0x115c4b.GetEventFreezeFrameDataEx
          SC_EvtInfo_DTC_0x115c4b_GetEventStatus: operation=EvtInfo_DTC_0x115c4b.GetEventStatus
          SC_EvtInfo_DTC_0x115c4b_GetEventTested: operation=EvtInfo_DTC_0x115c4b.GetEventTested
          SC_EvtInfo_DTC_0x115c4b_GetEventUdsStatus: operation=EvtInfo_DTC_0x115c4b.GetEventUdsStatus
          SC_EvtInfo_DTC_0x115c4b_GetFaultDetectionCounter: operation=EvtInfo_DTC_0x115c4b.GetFaultDetectionCounter
          SC_EvtInfo_DTC_0x115c4b_GetMonitorStatus: operation=EvtInfo_DTC_0x115c4b.GetMonitorStatus
          SC_EvtInfo_DTC_0x115d4b_GetDTCOfEvent: operation=EvtInfo_DTC_0x115d4b.GetDTCOfEvent
          SC_EvtInfo_DTC_0x115d4b_GetDebouncingOfEvent: operation=EvtInfo_DTC_0x115d4b.GetDebouncingOfEvent
          SC_EvtInfo_DTC_0x115d4b_GetEventEnableCondition: operation=EvtInfo_DTC_0x115d4b.GetEventEnableCondition
          SC_EvtInfo_DTC_0x115d4b_GetEventExtendedDataRecordEx: operation=EvtInfo_DTC_0x115d4b.GetEventExtendedDataRecordEx
          SC_EvtInfo_DTC_0x115d4b_GetEventFailed: operation=EvtInfo_DTC_0x115d4b.GetEventFailed
          SC_EvtInfo_DTC_0x115d4b_GetEventFreezeFrameDataEx: operation=EvtInfo_DTC_0x115d4b.GetEventFreezeFrameDataEx
          SC_EvtInfo_DTC_0x115d4b_GetEventStatus: operation=EvtInfo_DTC_0x115d4b.GetEventStatus
          SC_EvtInfo_DTC_0x115d4b_GetEventTested: operation=EvtInfo_DTC_0x115d4b.GetEventTested
          SC_EvtInfo_DTC_0x115d4b_GetEventUdsStatus: operation=EvtInfo_DTC_0x115d4b.GetEventUdsStatus
          SC_EvtInfo_DTC_0x115d4b_GetFaultDetectionCounter: operation=EvtInfo_DTC_0x115d4b.GetFaultDetectionCounter
          SC_EvtInfo_DTC_0x115d4b_GetMonitorStatus: operation=EvtInfo_DTC_0x115d4b.GetMonitorStatus
          SC_EvtInfo_DTC_0x115e1a_GetDTCOfEvent: operation=EvtInfo_DTC_0x115e1a.GetDTCOfEvent
          SC_EvtInfo_DTC_0x115e1a_GetDebouncingOfEvent: operation=EvtInfo_DTC_0x115e1a.GetDebouncingOfEvent
          SC_EvtInfo_DTC_0x115e1a_GetEventEnableCondition: operation=EvtInfo_DTC_0x115e1a.GetEventEnableCondition
          SC_EvtInfo_DTC_0x115e1a_GetEventExtendedDataRecordEx: operation=EvtInfo_DTC_0x115e1a.GetEventExtendedDataRecordEx
          SC_EvtInfo_DTC_0x115e1a_GetEventFailed: operation=EvtInfo_DTC_0x115e1a.GetEventFailed
          SC_EvtInfo_DTC_0x115e1a_GetEventFreezeFrameDataEx: operation=EvtInfo_DTC_0x115e1a.GetEventFreezeFrameDataEx
          SC_EvtInfo_DTC_0x115e1a_GetEventStatus: operation=EvtInfo_DTC_0x115e1a.GetEventStatus
          SC_EvtInfo_DTC_0x115e1a_GetEventTested: operation=EvtInfo_DTC_0x115e1a.GetEventTested
          SC_EvtInfo_DTC_0x115e1a_GetEventUdsStatus: operation=EvtInfo_DTC_0x115e1a.GetEventUdsStatus
          SC_EvtInfo_DTC_0x115e1a_GetFaultDetectionCounter: operation=EvtInfo_DTC_0x115e1a.GetFaultDetectionCounter
          SC_EvtInfo_DTC_0x115e1a_GetMonitorStatus: operation=EvtInfo_DTC_0x115e1a.GetMonitorStatus
          SC_EvtInfo_DTC_0x116097_GetDTCOfEvent: operation=EvtInfo_DTC_0x116097.GetDTCOfEvent
          SC_EvtInfo_DTC_0x116097_GetDebouncingOfEvent: operation=EvtInfo_DTC_0x116097.GetDebouncingOfEvent
          SC_EvtInfo_DTC_0x116097_GetEventEnableCondition: operation=EvtInfo_DTC_0x116097.GetEventEnableCondition
          SC_EvtInfo_DTC_0x116097_GetEventExtendedDataRecordEx: operation=EvtInfo_DTC_0x116097.GetEventExtendedDataRecordEx
          SC_EvtInfo_DTC_0x116097_GetEventFailed: operation=EvtInfo_DTC_0x116097.GetEventFailed
          SC_EvtInfo_DTC_0x116097_GetEventFreezeFrameDataEx: operation=EvtInfo_DTC_0x116097.GetEventFreezeFrameDataEx
          SC_EvtInfo_DTC_0x116097_GetEventStatus: operation=EvtInfo_DTC_0x116097.GetEventStatus
          SC_EvtInfo_DTC_0x116097_GetEventTested: operation=EvtInfo_DTC_0x116097.GetEventTested
          SC_EvtInfo_DTC_0x116097_GetEventUdsStatus: operation=EvtInfo_DTC_0x116097.GetEventUdsStatus
          SC_EvtInfo_DTC_0x116097_GetFaultDetectionCounter: operation=EvtInfo_DTC_0x116097.GetFaultDetectionCounter
          SC_EvtInfo_DTC_0x116097_GetMonitorStatus: operation=EvtInfo_DTC_0x116097.GetMonitorStatus
          SC_EvtInfo_DTC_0x11611c_GetDTCOfEvent: operation=EvtInfo_DTC_0x11611c.GetDTCOfEvent
          SC_EvtInfo_DTC_0x11611c_GetDebouncingOfEvent: operation=EvtInfo_DTC_0x11611c.GetDebouncingOfEvent
          SC_EvtInfo_DTC_0x11611c_GetEventEnableCondition: operation=EvtInfo_DTC_0x11611c.GetEventEnableCondition
          SC_EvtInfo_DTC_0x11611c_GetEventExtendedDataRecordEx: operation=EvtInfo_DTC_0x11611c.GetEventExtendedDataRecordEx
          SC_EvtInfo_DTC_0x11611c_GetEventFailed: operation=EvtInfo_DTC_0x11611c.GetEventFailed
          SC_EvtInfo_DTC_0x11611c_GetEventFreezeFrameDataEx: operation=EvtInfo_DTC_0x11611c.GetEventFreezeFrameDataEx
          SC_EvtInfo_DTC_0x11611c_GetEventStatus: operation=EvtInfo_DTC_0x11611c.GetEventStatus
          SC_EvtInfo_DTC_0x11611c_GetEventTested: operation=EvtInfo_DTC_0x11611c.GetEventTested
          SC_EvtInfo_DTC_0x11611c_GetEventUdsStatus: operation=EvtInfo_DTC_0x11611c.GetEventUdsStatus
          SC_EvtInfo_DTC_0x11611c_GetFaultDetectionCounter: operation=EvtInfo_DTC_0x11611c.GetFaultDetectionCounter
          SC_EvtInfo_DTC_0x11611c_GetMonitorStatus: operation=EvtInfo_DTC_0x11611c.GetMonitorStatus
          SC_EvtInfo_DTC_0x116197_GetDTCOfEvent: operation=EvtInfo_DTC_0x116197.GetDTCOfEvent
          SC_EvtInfo_DTC_0x116197_GetDebouncingOfEvent: operation=EvtInfo_DTC_0x116197.GetDebouncingOfEvent
          SC_EvtInfo_DTC_0x116197_GetEventEnableCondition: operation=EvtInfo_DTC_0x116197.GetEventEnableCondition
          SC_EvtInfo_DTC_0x116197_GetEventExtendedDataRecordEx: operation=EvtInfo_DTC_0x116197.GetEventExtendedDataRecordEx
          SC_EvtInfo_DTC_0x116197_GetEventFailed: operation=EvtInfo_DTC_0x116197.GetEventFailed
          SC_EvtInfo_DTC_0x116197_GetEventFreezeFrameDataEx: operation=EvtInfo_DTC_0x116197.GetEventFreezeFrameDataEx
          SC_EvtInfo_DTC_0x116197_GetEventStatus: operation=EvtInfo_DTC_0x116197.GetEventStatus
          SC_EvtInfo_DTC_0x116197_GetEventTested: operation=EvtInfo_DTC_0x116197.GetEventTested
          SC_EvtInfo_DTC_0x116197_GetEventUdsStatus: operation=EvtInfo_DTC_0x116197.GetEventUdsStatus
          SC_EvtInfo_DTC_0x116197_GetFaultDetectionCounter: operation=EvtInfo_DTC_0x116197.GetFaultDetectionCounter
          SC_EvtInfo_DTC_0x116197_GetMonitorStatus: operation=EvtInfo_DTC_0x116197.GetMonitorStatus
          SC_EvtInfo_DTC_0x11621c_GetDTCOfEvent: operation=EvtInfo_DTC_0x11621c.GetDTCOfEvent
          SC_EvtInfo_DTC_0x11621c_GetDebouncingOfEvent: operation=EvtInfo_DTC_0x11621c.GetDebouncingOfEvent
          SC_EvtInfo_DTC_0x11621c_GetEventEnableCondition: operation=EvtInfo_DTC_0x11621c.GetEventEnableCondition
          SC_EvtInfo_DTC_0x11621c_GetEventExtendedDataRecordEx: operation=EvtInfo_DTC_0x11621c.GetEventExtendedDataRecordEx
          SC_EvtInfo_DTC_0x11621c_GetEventFailed: operation=EvtInfo_DTC_0x11621c.GetEventFailed
          SC_EvtInfo_DTC_0x11621c_GetEventFreezeFrameDataEx: operation=EvtInfo_DTC_0x11621c.GetEventFreezeFrameDataEx
          SC_EvtInfo_DTC_0x11621c_GetEventStatus: operation=EvtInfo_DTC_0x11621c.GetEventStatus
          SC_EvtInfo_DTC_0x11621c_GetEventTested: operation=EvtInfo_DTC_0x11621c.GetEventTested
          SC_EvtInfo_DTC_0x11621c_GetEventUdsStatus: operation=EvtInfo_DTC_0x11621c.GetEventUdsStatus
          SC_EvtInfo_DTC_0x11621c_GetFaultDetectionCounter: operation=EvtInfo_DTC_0x11621c.GetFaultDetectionCounter
          SC_EvtInfo_DTC_0x11621c_GetMonitorStatus: operation=EvtInfo_DTC_0x11621c.GetMonitorStatus
          SC_EvtInfo_DTC_0x116397_GetDTCOfEvent: operation=EvtInfo_DTC_0x116397.GetDTCOfEvent
          SC_EvtInfo_DTC_0x116397_GetDebouncingOfEvent: operation=EvtInfo_DTC_0x116397.GetDebouncingOfEvent
          SC_EvtInfo_DTC_0x116397_GetEventEnableCondition: operation=EvtInfo_DTC_0x116397.GetEventEnableCondition
          SC_EvtInfo_DTC_0x116397_GetEventExtendedDataRecordEx: operation=EvtInfo_DTC_0x116397.GetEventExtendedDataRecordEx
          SC_EvtInfo_DTC_0x116397_GetEventFailed: operation=EvtInfo_DTC_0x116397.GetEventFailed
          SC_EvtInfo_DTC_0x116397_GetEventFreezeFrameDataEx: operation=EvtInfo_DTC_0x116397.GetEventFreezeFrameDataEx
          SC_EvtInfo_DTC_0x116397_GetEventStatus: operation=EvtInfo_DTC_0x116397.GetEventStatus
          SC_EvtInfo_DTC_0x116397_GetEventTested: operation=EvtInfo_DTC_0x116397.GetEventTested
          SC_EvtInfo_DTC_0x116397_GetEventUdsStatus: operation=EvtInfo_DTC_0x116397.GetEventUdsStatus
          SC_EvtInfo_DTC_0x116397_GetFaultDetectionCounter: operation=EvtInfo_DTC_0x116397.GetFaultDetectionCounter
          SC_EvtInfo_DTC_0x116397_GetMonitorStatus: operation=EvtInfo_DTC_0x116397.GetMonitorStatus
          SC_EvtInfo_DTC_0x116494_GetDTCOfEvent: operation=EvtInfo_DTC_0x116494.GetDTCOfEvent
          SC_EvtInfo_DTC_0x116494_GetDebouncingOfEvent: operation=EvtInfo_DTC_0x116494.GetDebouncingOfEvent
          SC_EvtInfo_DTC_0x116494_GetEventEnableCondition: operation=EvtInfo_DTC_0x116494.GetEventEnableCondition
          SC_EvtInfo_DTC_0x116494_GetEventExtendedDataRecordEx: operation=EvtInfo_DTC_0x116494.GetEventExtendedDataRecordEx
          SC_EvtInfo_DTC_0x116494_GetEventFailed: operation=EvtInfo_DTC_0x116494.GetEventFailed
          SC_EvtInfo_DTC_0x116494_GetEventFreezeFrameDataEx: operation=EvtInfo_DTC_0x116494.GetEventFreezeFrameDataEx
          SC_EvtInfo_DTC_0x116494_GetEventStatus: operation=EvtInfo_DTC_0x116494.GetEventStatus
          SC_EvtInfo_DTC_0x116494_GetEventTested: operation=EvtInfo_DTC_0x116494.GetEventTested
          SC_EvtInfo_DTC_0x116494_GetEventUdsStatus: operation=EvtInfo_DTC_0x116494.GetEventUdsStatus
          SC_EvtInfo_DTC_0x116494_GetFaultDetectionCounter: operation=EvtInfo_DTC_0x116494.GetFaultDetectionCounter
          SC_EvtInfo_DTC_0x116494_GetMonitorStatus: operation=EvtInfo_DTC_0x116494.GetMonitorStatus
          SC_EvtInfo_DTC_0x116594_GetDTCOfEvent: operation=EvtInfo_DTC_0x116594.GetDTCOfEvent
          SC_EvtInfo_DTC_0x116594_GetDebouncingOfEvent: operation=EvtInfo_DTC_0x116594.GetDebouncingOfEvent
          SC_EvtInfo_DTC_0x116594_GetEventEnableCondition: operation=EvtInfo_DTC_0x116594.GetEventEnableCondition
          SC_EvtInfo_DTC_0x116594_GetEventExtendedDataRecordEx: operation=EvtInfo_DTC_0x116594.GetEventExtendedDataRecordEx
          SC_EvtInfo_DTC_0x116594_GetEventFailed: operation=EvtInfo_DTC_0x116594.GetEventFailed
          SC_EvtInfo_DTC_0x116594_GetEventFreezeFrameDataEx: operation=EvtInfo_DTC_0x116594.GetEventFreezeFrameDataEx
          SC_EvtInfo_DTC_0x116594_GetEventStatus: operation=EvtInfo_DTC_0x116594.GetEventStatus
          SC_EvtInfo_DTC_0x116594_GetEventTested: operation=EvtInfo_DTC_0x116594.GetEventTested
          SC_EvtInfo_DTC_0x116594_GetEventUdsStatus: operation=EvtInfo_DTC_0x116594.GetEventUdsStatus
          SC_EvtInfo_DTC_0x116594_GetFaultDetectionCounter: operation=EvtInfo_DTC_0x116594.GetFaultDetectionCounter
          SC_EvtInfo_DTC_0x116594_GetMonitorStatus: operation=EvtInfo_DTC_0x116594.GetMonitorStatus
          SC_EvtInfo_DTC_0x116617_GetDTCOfEvent: operation=EvtInfo_DTC_0x116617.GetDTCOfEvent
          SC_EvtInfo_DTC_0x116617_GetDebouncingOfEvent: operation=EvtInfo_DTC_0x116617.GetDebouncingOfEvent
          SC_EvtInfo_DTC_0x116617_GetEventEnableCondition: operation=EvtInfo_DTC_0x116617.GetEventEnableCondition
          SC_EvtInfo_DTC_0x116617_GetEventExtendedDataRecordEx: operation=EvtInfo_DTC_0x116617.GetEventExtendedDataRecordEx
          SC_EvtInfo_DTC_0x116617_GetEventFailed: operation=EvtInfo_DTC_0x116617.GetEventFailed
          SC_EvtInfo_DTC_0x116617_GetEventFreezeFrameDataEx: operation=EvtInfo_DTC_0x116617.GetEventFreezeFrameDataEx
          SC_EvtInfo_DTC_0x116617_GetEventStatus: operation=EvtInfo_DTC_0x116617.GetEventStatus
          SC_EvtInfo_DTC_0x116617_GetEventTested: operation=EvtInfo_DTC_0x116617.GetEventTested
          SC_EvtInfo_DTC_0x116617_GetEventUdsStatus: operation=EvtInfo_DTC_0x116617.GetEventUdsStatus
          SC_EvtInfo_DTC_0x116617_GetFaultDetectionCounter: operation=EvtInfo_DTC_0x116617.GetFaultDetectionCounter
          SC_EvtInfo_DTC_0x116617_GetMonitorStatus: operation=EvtInfo_DTC_0x116617.GetMonitorStatus
          SC_EvtInfo_DTC_0x116716_GetDTCOfEvent: operation=EvtInfo_DTC_0x116716.GetDTCOfEvent
          SC_EvtInfo_DTC_0x116716_GetDebouncingOfEvent: operation=EvtInfo_DTC_0x116716.GetDebouncingOfEvent
          SC_EvtInfo_DTC_0x116716_GetEventEnableCondition: operation=EvtInfo_DTC_0x116716.GetEventEnableCondition
          SC_EvtInfo_DTC_0x116716_GetEventExtendedDataRecordEx: operation=EvtInfo_DTC_0x116716.GetEventExtendedDataRecordEx
          SC_EvtInfo_DTC_0x116716_GetEventFailed: operation=EvtInfo_DTC_0x116716.GetEventFailed
          SC_EvtInfo_DTC_0x116716_GetEventFreezeFrameDataEx: operation=EvtInfo_DTC_0x116716.GetEventFreezeFrameDataEx
          SC_EvtInfo_DTC_0x116716_GetEventStatus: operation=EvtInfo_DTC_0x116716.GetEventStatus
          SC_EvtInfo_DTC_0x116716_GetEventTested: operation=EvtInfo_DTC_0x116716.GetEventTested
          SC_EvtInfo_DTC_0x116716_GetEventUdsStatus: operation=EvtInfo_DTC_0x116716.GetEventUdsStatus
          SC_EvtInfo_DTC_0x116716_GetFaultDetectionCounter: operation=EvtInfo_DTC_0x116716.GetFaultDetectionCounter
          SC_EvtInfo_DTC_0x116716_GetMonitorStatus: operation=EvtInfo_DTC_0x116716.GetMonitorStatus
          SC_EvtInfo_DTC_0x116819_GetDTCOfEvent: operation=EvtInfo_DTC_0x116819.GetDTCOfEvent
          SC_EvtInfo_DTC_0x116819_GetDebouncingOfEvent: operation=EvtInfo_DTC_0x116819.GetDebouncingOfEvent
          SC_EvtInfo_DTC_0x116819_GetEventEnableCondition: operation=EvtInfo_DTC_0x116819.GetEventEnableCondition
          SC_EvtInfo_DTC_0x116819_GetEventExtendedDataRecordEx: operation=EvtInfo_DTC_0x116819.GetEventExtendedDataRecordEx
          SC_EvtInfo_DTC_0x116819_GetEventFailed: operation=EvtInfo_DTC_0x116819.GetEventFailed
          SC_EvtInfo_DTC_0x116819_GetEventFreezeFrameDataEx: operation=EvtInfo_DTC_0x116819.GetEventFreezeFrameDataEx
          SC_EvtInfo_DTC_0x116819_GetEventStatus: operation=EvtInfo_DTC_0x116819.GetEventStatus
          SC_EvtInfo_DTC_0x116819_GetEventTested: operation=EvtInfo_DTC_0x116819.GetEventTested
          SC_EvtInfo_DTC_0x116819_GetEventUdsStatus: operation=EvtInfo_DTC_0x116819.GetEventUdsStatus
          SC_EvtInfo_DTC_0x116819_GetFaultDetectionCounter: operation=EvtInfo_DTC_0x116819.GetFaultDetectionCounter
          SC_EvtInfo_DTC_0x116819_GetMonitorStatus: operation=EvtInfo_DTC_0x116819.GetMonitorStatus
          SC_EvtInfo_DTC_0x116996_GetDTCOfEvent: operation=EvtInfo_DTC_0x116996.GetDTCOfEvent
          SC_EvtInfo_DTC_0x116996_GetDebouncingOfEvent: operation=EvtInfo_DTC_0x116996.GetDebouncingOfEvent
          SC_EvtInfo_DTC_0x116996_GetEventEnableCondition: operation=EvtInfo_DTC_0x116996.GetEventEnableCondition
          SC_EvtInfo_DTC_0x116996_GetEventExtendedDataRecordEx: operation=EvtInfo_DTC_0x116996.GetEventExtendedDataRecordEx
          SC_EvtInfo_DTC_0x116996_GetEventFailed: operation=EvtInfo_DTC_0x116996.GetEventFailed
          SC_EvtInfo_DTC_0x116996_GetEventFreezeFrameDataEx: operation=EvtInfo_DTC_0x116996.GetEventFreezeFrameDataEx
          SC_EvtInfo_DTC_0x116996_GetEventStatus: operation=EvtInfo_DTC_0x116996.GetEventStatus
          SC_EvtInfo_DTC_0x116996_GetEventTested: operation=EvtInfo_DTC_0x116996.GetEventTested
          SC_EvtInfo_DTC_0x116996_GetEventUdsStatus: operation=EvtInfo_DTC_0x116996.GetEventUdsStatus
          SC_EvtInfo_DTC_0x116996_GetFaultDetectionCounter: operation=EvtInfo_DTC_0x116996.GetFaultDetectionCounter
          SC_EvtInfo_DTC_0x116996_GetMonitorStatus: operation=EvtInfo_DTC_0x116996.GetMonitorStatus
          SC_EvtInfo_DTC_0x116a96_GetDTCOfEvent: operation=EvtInfo_DTC_0x116a96.GetDTCOfEvent
          SC_EvtInfo_DTC_0x116a96_GetDebouncingOfEvent: operation=EvtInfo_DTC_0x116a96.GetDebouncingOfEvent
          SC_EvtInfo_DTC_0x116a96_GetEventEnableCondition: operation=EvtInfo_DTC_0x116a96.GetEventEnableCondition
          SC_EvtInfo_DTC_0x116a96_GetEventExtendedDataRecordEx: operation=EvtInfo_DTC_0x116a96.GetEventExtendedDataRecordEx
          SC_EvtInfo_DTC_0x116a96_GetEventFailed: operation=EvtInfo_DTC_0x116a96.GetEventFailed
          SC_EvtInfo_DTC_0x116a96_GetEventFreezeFrameDataEx: operation=EvtInfo_DTC_0x116a96.GetEventFreezeFrameDataEx
          SC_EvtInfo_DTC_0x116a96_GetEventStatus: operation=EvtInfo_DTC_0x116a96.GetEventStatus
          SC_EvtInfo_DTC_0x116a96_GetEventTested: operation=EvtInfo_DTC_0x116a96.GetEventTested
          SC_EvtInfo_DTC_0x116a96_GetEventUdsStatus: operation=EvtInfo_DTC_0x116a96.GetEventUdsStatus
          SC_EvtInfo_DTC_0x116a96_GetFaultDetectionCounter: operation=EvtInfo_DTC_0x116a96.GetFaultDetectionCounter
          SC_EvtInfo_DTC_0x116a96_GetMonitorStatus: operation=EvtInfo_DTC_0x116a96.GetMonitorStatus
          SC_EvtInfo_DTC_0x116c05_GetDTCOfEvent: operation=EvtInfo_DTC_0x116c05.GetDTCOfEvent
          SC_EvtInfo_DTC_0x116c05_GetDebouncingOfEvent: operation=EvtInfo_DTC_0x116c05.GetDebouncingOfEvent
          SC_EvtInfo_DTC_0x116c05_GetEventEnableCondition: operation=EvtInfo_DTC_0x116c05.GetEventEnableCondition
          SC_EvtInfo_DTC_0x116c05_GetEventExtendedDataRecordEx: operation=EvtInfo_DTC_0x116c05.GetEventExtendedDataRecordEx
          SC_EvtInfo_DTC_0x116c05_GetEventFailed: operation=EvtInfo_DTC_0x116c05.GetEventFailed
          SC_EvtInfo_DTC_0x116c05_GetEventFreezeFrameDataEx: operation=EvtInfo_DTC_0x116c05.GetEventFreezeFrameDataEx
          SC_EvtInfo_DTC_0x116c05_GetEventStatus: operation=EvtInfo_DTC_0x116c05.GetEventStatus
          SC_EvtInfo_DTC_0x116c05_GetEventTested: operation=EvtInfo_DTC_0x116c05.GetEventTested
          SC_EvtInfo_DTC_0x116c05_GetEventUdsStatus: operation=EvtInfo_DTC_0x116c05.GetEventUdsStatus
          SC_EvtInfo_DTC_0x116c05_GetFaultDetectionCounter: operation=EvtInfo_DTC_0x116c05.GetFaultDetectionCounter
          SC_EvtInfo_DTC_0x116c05_GetMonitorStatus: operation=EvtInfo_DTC_0x116c05.GetMonitorStatus
          SC_EvtInfo_DTC_0x116d05_GetDTCOfEvent: operation=EvtInfo_DTC_0x116d05.GetDTCOfEvent
          SC_EvtInfo_DTC_0x116d05_GetDebouncingOfEvent: operation=EvtInfo_DTC_0x116d05.GetDebouncingOfEvent
          SC_EvtInfo_DTC_0x116d05_GetEventEnableCondition: operation=EvtInfo_DTC_0x116d05.GetEventEnableCondition
          SC_EvtInfo_DTC_0x116d05_GetEventExtendedDataRecordEx: operation=EvtInfo_DTC_0x116d05.GetEventExtendedDataRecordEx
          SC_EvtInfo_DTC_0x116d05_GetEventFailed: operation=EvtInfo_DTC_0x116d05.GetEventFailed
          SC_EvtInfo_DTC_0x116d05_GetEventFreezeFrameDataEx: operation=EvtInfo_DTC_0x116d05.GetEventFreezeFrameDataEx
          SC_EvtInfo_DTC_0x116d05_GetEventStatus: operation=EvtInfo_DTC_0x116d05.GetEventStatus
          SC_EvtInfo_DTC_0x116d05_GetEventTested: operation=EvtInfo_DTC_0x116d05.GetEventTested
          SC_EvtInfo_DTC_0x116d05_GetEventUdsStatus: operation=EvtInfo_DTC_0x116d05.GetEventUdsStatus
          SC_EvtInfo_DTC_0x116d05_GetFaultDetectionCounter: operation=EvtInfo_DTC_0x116d05.GetFaultDetectionCounter
          SC_EvtInfo_DTC_0x116d05_GetMonitorStatus: operation=EvtInfo_DTC_0x116d05.GetMonitorStatus
          SC_EvtInfo_DTC_0x116e05_GetDTCOfEvent: operation=EvtInfo_DTC_0x116e05.GetDTCOfEvent
          SC_EvtInfo_DTC_0x116e05_GetDebouncingOfEvent: operation=EvtInfo_DTC_0x116e05.GetDebouncingOfEvent
          SC_EvtInfo_DTC_0x116e05_GetEventEnableCondition: operation=EvtInfo_DTC_0x116e05.GetEventEnableCondition
          SC_EvtInfo_DTC_0x116e05_GetEventExtendedDataRecordEx: operation=EvtInfo_DTC_0x116e05.GetEventExtendedDataRecordEx
          SC_EvtInfo_DTC_0x116e05_GetEventFailed: operation=EvtInfo_DTC_0x116e05.GetEventFailed
          SC_EvtInfo_DTC_0x116e05_GetEventFreezeFrameDataEx: operation=EvtInfo_DTC_0x116e05.GetEventFreezeFrameDataEx
          SC_EvtInfo_DTC_0x116e05_GetEventStatus: operation=EvtInfo_DTC_0x116e05.GetEventStatus
          SC_EvtInfo_DTC_0x116e05_GetEventTested: operation=EvtInfo_DTC_0x116e05.GetEventTested
          SC_EvtInfo_DTC_0x116e05_GetEventUdsStatus: operation=EvtInfo_DTC_0x116e05.GetEventUdsStatus
          SC_EvtInfo_DTC_0x116e05_GetFaultDetectionCounter: operation=EvtInfo_DTC_0x116e05.GetFaultDetectionCounter
          SC_EvtInfo_DTC_0x116e05_GetMonitorStatus: operation=EvtInfo_DTC_0x116e05.GetMonitorStatus
          SC_EvtInfo_DTC_0x116f05_GetDTCOfEvent: operation=EvtInfo_DTC_0x116f05.GetDTCOfEvent
          SC_EvtInfo_DTC_0x116f05_GetDebouncingOfEvent: operation=EvtInfo_DTC_0x116f05.GetDebouncingOfEvent
          SC_EvtInfo_DTC_0x116f05_GetEventEnableCondition: operation=EvtInfo_DTC_0x116f05.GetEventEnableCondition
          SC_EvtInfo_DTC_0x116f05_GetEventExtendedDataRecordEx: operation=EvtInfo_DTC_0x116f05.GetEventExtendedDataRecordEx
          SC_EvtInfo_DTC_0x116f05_GetEventFailed: operation=EvtInfo_DTC_0x116f05.GetEventFailed
          SC_EvtInfo_DTC_0x116f05_GetEventFreezeFrameDataEx: operation=EvtInfo_DTC_0x116f05.GetEventFreezeFrameDataEx
          SC_EvtInfo_DTC_0x116f05_GetEventStatus: operation=EvtInfo_DTC_0x116f05.GetEventStatus
          SC_EvtInfo_DTC_0x116f05_GetEventTested: operation=EvtInfo_DTC_0x116f05.GetEventTested
          SC_EvtInfo_DTC_0x116f05_GetEventUdsStatus: operation=EvtInfo_DTC_0x116f05.GetEventUdsStatus
          SC_EvtInfo_DTC_0x116f05_GetFaultDetectionCounter: operation=EvtInfo_DTC_0x116f05.GetFaultDetectionCounter
          SC_EvtInfo_DTC_0x116f05_GetMonitorStatus: operation=EvtInfo_DTC_0x116f05.GetMonitorStatus
          SC_EvtInfo_DTC_0x117097_GetDTCOfEvent: operation=EvtInfo_DTC_0x117097.GetDTCOfEvent
          SC_EvtInfo_DTC_0x117097_GetDebouncingOfEvent: operation=EvtInfo_DTC_0x117097.GetDebouncingOfEvent
          SC_EvtInfo_DTC_0x117097_GetEventEnableCondition: operation=EvtInfo_DTC_0x117097.GetEventEnableCondition
          SC_EvtInfo_DTC_0x117097_GetEventExtendedDataRecordEx: operation=EvtInfo_DTC_0x117097.GetEventExtendedDataRecordEx
          SC_EvtInfo_DTC_0x117097_GetEventFailed: operation=EvtInfo_DTC_0x117097.GetEventFailed
          SC_EvtInfo_DTC_0x117097_GetEventFreezeFrameDataEx: operation=EvtInfo_DTC_0x117097.GetEventFreezeFrameDataEx
          SC_EvtInfo_DTC_0x117097_GetEventStatus: operation=EvtInfo_DTC_0x117097.GetEventStatus
          SC_EvtInfo_DTC_0x117097_GetEventTested: operation=EvtInfo_DTC_0x117097.GetEventTested
          SC_EvtInfo_DTC_0x117097_GetEventUdsStatus: operation=EvtInfo_DTC_0x117097.GetEventUdsStatus
          SC_EvtInfo_DTC_0x117097_GetFaultDetectionCounter: operation=EvtInfo_DTC_0x117097.GetFaultDetectionCounter
          SC_EvtInfo_DTC_0x117097_GetMonitorStatus: operation=EvtInfo_DTC_0x117097.GetMonitorStatus
          SC_EvtInfo_DTC_0x117197_GetDTCOfEvent: operation=EvtInfo_DTC_0x117197.GetDTCOfEvent
          SC_EvtInfo_DTC_0x117197_GetDebouncingOfEvent: operation=EvtInfo_DTC_0x117197.GetDebouncingOfEvent
          SC_EvtInfo_DTC_0x117197_GetEventEnableCondition: operation=EvtInfo_DTC_0x117197.GetEventEnableCondition
          SC_EvtInfo_DTC_0x117197_GetEventExtendedDataRecordEx: operation=EvtInfo_DTC_0x117197.GetEventExtendedDataRecordEx
          SC_EvtInfo_DTC_0x117197_GetEventFailed: operation=EvtInfo_DTC_0x117197.GetEventFailed
          SC_EvtInfo_DTC_0x117197_GetEventFreezeFrameDataEx: operation=EvtInfo_DTC_0x117197.GetEventFreezeFrameDataEx
          SC_EvtInfo_DTC_0x117197_GetEventStatus: operation=EvtInfo_DTC_0x117197.GetEventStatus
          SC_EvtInfo_DTC_0x117197_GetEventTested: operation=EvtInfo_DTC_0x117197.GetEventTested
          SC_EvtInfo_DTC_0x117197_GetEventUdsStatus: operation=EvtInfo_DTC_0x117197.GetEventUdsStatus
          SC_EvtInfo_DTC_0x117197_GetFaultDetectionCounter: operation=EvtInfo_DTC_0x117197.GetFaultDetectionCounter
          SC_EvtInfo_DTC_0x117197_GetMonitorStatus: operation=EvtInfo_DTC_0x117197.GetMonitorStatus
          SC_EvtInfo_DTC_0x117511_GetDTCOfEvent: operation=EvtInfo_DTC_0x117511.GetDTCOfEvent
          SC_EvtInfo_DTC_0x117511_GetDebouncingOfEvent: operation=EvtInfo_DTC_0x117511.GetDebouncingOfEvent
          SC_EvtInfo_DTC_0x117511_GetEventEnableCondition: operation=EvtInfo_DTC_0x117511.GetEventEnableCondition
          SC_EvtInfo_DTC_0x117511_GetEventExtendedDataRecordEx: operation=EvtInfo_DTC_0x117511.GetEventExtendedDataRecordEx
          SC_EvtInfo_DTC_0x117511_GetEventFailed: operation=EvtInfo_DTC_0x117511.GetEventFailed
          SC_EvtInfo_DTC_0x117511_GetEventFreezeFrameDataEx: operation=EvtInfo_DTC_0x117511.GetEventFreezeFrameDataEx
          SC_EvtInfo_DTC_0x117511_GetEventStatus: operation=EvtInfo_DTC_0x117511.GetEventStatus
          SC_EvtInfo_DTC_0x117511_GetEventTested: operation=EvtInfo_DTC_0x117511.GetEventTested
          SC_EvtInfo_DTC_0x117511_GetEventUdsStatus: operation=EvtInfo_DTC_0x117511.GetEventUdsStatus
          SC_EvtInfo_DTC_0x117511_GetFaultDetectionCounter: operation=EvtInfo_DTC_0x117511.GetFaultDetectionCounter
          SC_EvtInfo_DTC_0x117511_GetMonitorStatus: operation=EvtInfo_DTC_0x117511.GetMonitorStatus
          SC_EvtInfo_DTC_0x908017_GetDTCOfEvent: operation=EvtInfo_DTC_0x908017.GetDTCOfEvent
          SC_EvtInfo_DTC_0x908017_GetDebouncingOfEvent: operation=EvtInfo_DTC_0x908017.GetDebouncingOfEvent
          SC_EvtInfo_DTC_0x908017_GetEventEnableCondition: operation=EvtInfo_DTC_0x908017.GetEventEnableCondition
          SC_EvtInfo_DTC_0x908017_GetEventExtendedDataRecordEx: operation=EvtInfo_DTC_0x908017.GetEventExtendedDataRecordEx
          SC_EvtInfo_DTC_0x908017_GetEventFailed: operation=EvtInfo_DTC_0x908017.GetEventFailed
          SC_EvtInfo_DTC_0x908017_GetEventFreezeFrameDataEx: operation=EvtInfo_DTC_0x908017.GetEventFreezeFrameDataEx
          SC_EvtInfo_DTC_0x908017_GetEventStatus: operation=EvtInfo_DTC_0x908017.GetEventStatus
          SC_EvtInfo_DTC_0x908017_GetEventTested: operation=EvtInfo_DTC_0x908017.GetEventTested
          SC_EvtInfo_DTC_0x908017_GetEventUdsStatus: operation=EvtInfo_DTC_0x908017.GetEventUdsStatus
          SC_EvtInfo_DTC_0x908017_GetFaultDetectionCounter: operation=EvtInfo_DTC_0x908017.GetFaultDetectionCounter
          SC_EvtInfo_DTC_0x908017_GetMonitorStatus: operation=EvtInfo_DTC_0x908017.GetMonitorStatus
          SC_EvtInfo_DTC_0x908116_GetDTCOfEvent: operation=EvtInfo_DTC_0x908116.GetDTCOfEvent
          SC_EvtInfo_DTC_0x908116_GetDebouncingOfEvent: operation=EvtInfo_DTC_0x908116.GetDebouncingOfEvent
          SC_EvtInfo_DTC_0x908116_GetEventEnableCondition: operation=EvtInfo_DTC_0x908116.GetEventEnableCondition
          SC_EvtInfo_DTC_0x908116_GetEventExtendedDataRecordEx: operation=EvtInfo_DTC_0x908116.GetEventExtendedDataRecordEx
          SC_EvtInfo_DTC_0x908116_GetEventFailed: operation=EvtInfo_DTC_0x908116.GetEventFailed
          SC_EvtInfo_DTC_0x908116_GetEventFreezeFrameDataEx: operation=EvtInfo_DTC_0x908116.GetEventFreezeFrameDataEx
          SC_EvtInfo_DTC_0x908116_GetEventStatus: operation=EvtInfo_DTC_0x908116.GetEventStatus
          SC_EvtInfo_DTC_0x908116_GetEventTested: operation=EvtInfo_DTC_0x908116.GetEventTested
          SC_EvtInfo_DTC_0x908116_GetEventUdsStatus: operation=EvtInfo_DTC_0x908116.GetEventUdsStatus
          SC_EvtInfo_DTC_0x908116_GetFaultDetectionCounter: operation=EvtInfo_DTC_0x908116.GetFaultDetectionCounter
          SC_EvtInfo_DTC_0x908116_GetMonitorStatus: operation=EvtInfo_DTC_0x908116.GetMonitorStatus
          SC_EvtInfo_DTC_0x908255_GetDTCOfEvent: operation=EvtInfo_DTC_0x908255.GetDTCOfEvent
          SC_EvtInfo_DTC_0x908255_GetDebouncingOfEvent: operation=EvtInfo_DTC_0x908255.GetDebouncingOfEvent
          SC_EvtInfo_DTC_0x908255_GetEventEnableCondition: operation=EvtInfo_DTC_0x908255.GetEventEnableCondition
          SC_EvtInfo_DTC_0x908255_GetEventExtendedDataRecordEx: operation=EvtInfo_DTC_0x908255.GetEventExtendedDataRecordEx
          SC_EvtInfo_DTC_0x908255_GetEventFailed: operation=EvtInfo_DTC_0x908255.GetEventFailed
          SC_EvtInfo_DTC_0x908255_GetEventFreezeFrameDataEx: operation=EvtInfo_DTC_0x908255.GetEventFreezeFrameDataEx
          SC_EvtInfo_DTC_0x908255_GetEventStatus: operation=EvtInfo_DTC_0x908255.GetEventStatus
          SC_EvtInfo_DTC_0x908255_GetEventTested: operation=EvtInfo_DTC_0x908255.GetEventTested
          SC_EvtInfo_DTC_0x908255_GetEventUdsStatus: operation=EvtInfo_DTC_0x908255.GetEventUdsStatus
          SC_EvtInfo_DTC_0x908255_GetFaultDetectionCounter: operation=EvtInfo_DTC_0x908255.GetFaultDetectionCounter
          SC_EvtInfo_DTC_0x908255_GetMonitorStatus: operation=EvtInfo_DTC_0x908255.GetMonitorStatus
          SC_EvtInfo_DTC_0x908356_GetDTCOfEvent: operation=EvtInfo_DTC_0x908356.GetDTCOfEvent
          SC_EvtInfo_DTC_0x908356_GetDebouncingOfEvent: operation=EvtInfo_DTC_0x908356.GetDebouncingOfEvent
          SC_EvtInfo_DTC_0x908356_GetEventEnableCondition: operation=EvtInfo_DTC_0x908356.GetEventEnableCondition
          SC_EvtInfo_DTC_0x908356_GetEventExtendedDataRecordEx: operation=EvtInfo_DTC_0x908356.GetEventExtendedDataRecordEx
          SC_EvtInfo_DTC_0x908356_GetEventFailed: operation=EvtInfo_DTC_0x908356.GetEventFailed
          SC_EvtInfo_DTC_0x908356_GetEventFreezeFrameDataEx: operation=EvtInfo_DTC_0x908356.GetEventFreezeFrameDataEx
          SC_EvtInfo_DTC_0x908356_GetEventStatus: operation=EvtInfo_DTC_0x908356.GetEventStatus
          SC_EvtInfo_DTC_0x908356_GetEventTested: operation=EvtInfo_DTC_0x908356.GetEventTested
          SC_EvtInfo_DTC_0x908356_GetEventUdsStatus: operation=EvtInfo_DTC_0x908356.GetEventUdsStatus
          SC_EvtInfo_DTC_0x908356_GetFaultDetectionCounter: operation=EvtInfo_DTC_0x908356.GetFaultDetectionCounter
          SC_EvtInfo_DTC_0x908356_GetMonitorStatus: operation=EvtInfo_DTC_0x908356.GetMonitorStatus
          SC_EvtInfo_DTC_0xc07388_GetDTCOfEvent: operation=EvtInfo_DTC_0xc07388.GetDTCOfEvent
          SC_EvtInfo_DTC_0xc07388_GetDebouncingOfEvent: operation=EvtInfo_DTC_0xc07388.GetDebouncingOfEvent
          SC_EvtInfo_DTC_0xc07388_GetEventEnableCondition: operation=EvtInfo_DTC_0xc07388.GetEventEnableCondition
          SC_EvtInfo_DTC_0xc07388_GetEventExtendedDataRecordEx: operation=EvtInfo_DTC_0xc07388.GetEventExtendedDataRecordEx
          SC_EvtInfo_DTC_0xc07388_GetEventFailed: operation=EvtInfo_DTC_0xc07388.GetEventFailed
          SC_EvtInfo_DTC_0xc07388_GetEventFreezeFrameDataEx: operation=EvtInfo_DTC_0xc07388.GetEventFreezeFrameDataEx
          SC_EvtInfo_DTC_0xc07388_GetEventStatus: operation=EvtInfo_DTC_0xc07388.GetEventStatus
          SC_EvtInfo_DTC_0xc07388_GetEventTested: operation=EvtInfo_DTC_0xc07388.GetEventTested
          SC_EvtInfo_DTC_0xc07388_GetEventUdsStatus: operation=EvtInfo_DTC_0xc07388.GetEventUdsStatus
          SC_EvtInfo_DTC_0xc07388_GetFaultDetectionCounter: operation=EvtInfo_DTC_0xc07388.GetFaultDetectionCounter
          SC_EvtInfo_DTC_0xc07388_GetMonitorStatus: operation=EvtInfo_DTC_0xc07388.GetMonitorStatus
          SC_EvtInfo_DTC_0xc07488_GetDTCOfEvent: operation=EvtInfo_DTC_0xc07488.GetDTCOfEvent
          SC_EvtInfo_DTC_0xc07488_GetDebouncingOfEvent: operation=EvtInfo_DTC_0xc07488.GetDebouncingOfEvent
          SC_EvtInfo_DTC_0xc07488_GetEventEnableCondition: operation=EvtInfo_DTC_0xc07488.GetEventEnableCondition
          SC_EvtInfo_DTC_0xc07488_GetEventExtendedDataRecordEx: operation=EvtInfo_DTC_0xc07488.GetEventExtendedDataRecordEx
          SC_EvtInfo_DTC_0xc07488_GetEventFailed: operation=EvtInfo_DTC_0xc07488.GetEventFailed
          SC_EvtInfo_DTC_0xc07488_GetEventFreezeFrameDataEx: operation=EvtInfo_DTC_0xc07488.GetEventFreezeFrameDataEx
          SC_EvtInfo_DTC_0xc07488_GetEventStatus: operation=EvtInfo_DTC_0xc07488.GetEventStatus
          SC_EvtInfo_DTC_0xc07488_GetEventTested: operation=EvtInfo_DTC_0xc07488.GetEventTested
          SC_EvtInfo_DTC_0xc07488_GetEventUdsStatus: operation=EvtInfo_DTC_0xc07488.GetEventUdsStatus
          SC_EvtInfo_DTC_0xc07488_GetFaultDetectionCounter: operation=EvtInfo_DTC_0xc07488.GetFaultDetectionCounter
          SC_EvtInfo_DTC_0xc07488_GetMonitorStatus: operation=EvtInfo_DTC_0xc07488.GetMonitorStatus
          SC_EvtInfo_DTC_0xc10387_GetDTCOfEvent: operation=EvtInfo_DTC_0xc10387.GetDTCOfEvent
          SC_EvtInfo_DTC_0xc10387_GetDebouncingOfEvent: operation=EvtInfo_DTC_0xc10387.GetDebouncingOfEvent
          SC_EvtInfo_DTC_0xc10387_GetEventEnableCondition: operation=EvtInfo_DTC_0xc10387.GetEventEnableCondition
          SC_EvtInfo_DTC_0xc10387_GetEventExtendedDataRecordEx: operation=EvtInfo_DTC_0xc10387.GetEventExtendedDataRecordEx
          SC_EvtInfo_DTC_0xc10387_GetEventFailed: operation=EvtInfo_DTC_0xc10387.GetEventFailed
          SC_EvtInfo_DTC_0xc10387_GetEventFreezeFrameDataEx: operation=EvtInfo_DTC_0xc10387.GetEventFreezeFrameDataEx
          SC_EvtInfo_DTC_0xc10387_GetEventStatus: operation=EvtInfo_DTC_0xc10387.GetEventStatus
          SC_EvtInfo_DTC_0xc10387_GetEventTested: operation=EvtInfo_DTC_0xc10387.GetEventTested
          SC_EvtInfo_DTC_0xc10387_GetEventUdsStatus: operation=EvtInfo_DTC_0xc10387.GetEventUdsStatus
          SC_EvtInfo_DTC_0xc10387_GetFaultDetectionCounter: operation=EvtInfo_DTC_0xc10387.GetFaultDetectionCounter
          SC_EvtInfo_DTC_0xc10387_GetMonitorStatus: operation=EvtInfo_DTC_0xc10387.GetMonitorStatus
          SC_EvtInfo_DTC_0xc10f87_GetDTCOfEvent: operation=EvtInfo_DTC_0xc10f87.GetDTCOfEvent
          SC_EvtInfo_DTC_0xc10f87_GetDebouncingOfEvent: operation=EvtInfo_DTC_0xc10f87.GetDebouncingOfEvent
          SC_EvtInfo_DTC_0xc10f87_GetEventEnableCondition: operation=EvtInfo_DTC_0xc10f87.GetEventEnableCondition
          SC_EvtInfo_DTC_0xc10f87_GetEventExtendedDataRecordEx: operation=EvtInfo_DTC_0xc10f87.GetEventExtendedDataRecordEx
          SC_EvtInfo_DTC_0xc10f87_GetEventFailed: operation=EvtInfo_DTC_0xc10f87.GetEventFailed
          SC_EvtInfo_DTC_0xc10f87_GetEventFreezeFrameDataEx: operation=EvtInfo_DTC_0xc10f87.GetEventFreezeFrameDataEx
          SC_EvtInfo_DTC_0xc10f87_GetEventStatus: operation=EvtInfo_DTC_0xc10f87.GetEventStatus
          SC_EvtInfo_DTC_0xc10f87_GetEventTested: operation=EvtInfo_DTC_0xc10f87.GetEventTested
          SC_EvtInfo_DTC_0xc10f87_GetEventUdsStatus: operation=EvtInfo_DTC_0xc10f87.GetEventUdsStatus
          SC_EvtInfo_DTC_0xc10f87_GetFaultDetectionCounter: operation=EvtInfo_DTC_0xc10f87.GetFaultDetectionCounter
          SC_EvtInfo_DTC_0xc10f87_GetMonitorStatus: operation=EvtInfo_DTC_0xc10f87.GetMonitorStatus
          SC_EvtInfo_DTC_0xc11087_GetDTCOfEvent: operation=EvtInfo_DTC_0xc11087.GetDTCOfEvent
          SC_EvtInfo_DTC_0xc11087_GetDebouncingOfEvent: operation=EvtInfo_DTC_0xc11087.GetDebouncingOfEvent
          SC_EvtInfo_DTC_0xc11087_GetEventEnableCondition: operation=EvtInfo_DTC_0xc11087.GetEventEnableCondition
          SC_EvtInfo_DTC_0xc11087_GetEventExtendedDataRecordEx: operation=EvtInfo_DTC_0xc11087.GetEventExtendedDataRecordEx
          SC_EvtInfo_DTC_0xc11087_GetEventFailed: operation=EvtInfo_DTC_0xc11087.GetEventFailed
          SC_EvtInfo_DTC_0xc11087_GetEventFreezeFrameDataEx: operation=EvtInfo_DTC_0xc11087.GetEventFreezeFrameDataEx
          SC_EvtInfo_DTC_0xc11087_GetEventStatus: operation=EvtInfo_DTC_0xc11087.GetEventStatus
          SC_EvtInfo_DTC_0xc11087_GetEventTested: operation=EvtInfo_DTC_0xc11087.GetEventTested
          SC_EvtInfo_DTC_0xc11087_GetEventUdsStatus: operation=EvtInfo_DTC_0xc11087.GetEventUdsStatus
          SC_EvtInfo_DTC_0xc11087_GetFaultDetectionCounter: operation=EvtInfo_DTC_0xc11087.GetFaultDetectionCounter
          SC_EvtInfo_DTC_0xc11087_GetMonitorStatus: operation=EvtInfo_DTC_0xc11087.GetMonitorStatus
          SC_EvtInfo_DTC_0xc11187_GetDTCOfEvent: operation=EvtInfo_DTC_0xc11187.GetDTCOfEvent
          SC_EvtInfo_DTC_0xc11187_GetDebouncingOfEvent: operation=EvtInfo_DTC_0xc11187.GetDebouncingOfEvent
          SC_EvtInfo_DTC_0xc11187_GetEventEnableCondition: operation=EvtInfo_DTC_0xc11187.GetEventEnableCondition
          SC_EvtInfo_DTC_0xc11187_GetEventExtendedDataRecordEx: operation=EvtInfo_DTC_0xc11187.GetEventExtendedDataRecordEx
          SC_EvtInfo_DTC_0xc11187_GetEventFailed: operation=EvtInfo_DTC_0xc11187.GetEventFailed
          SC_EvtInfo_DTC_0xc11187_GetEventFreezeFrameDataEx: operation=EvtInfo_DTC_0xc11187.GetEventFreezeFrameDataEx
          SC_EvtInfo_DTC_0xc11187_GetEventStatus: operation=EvtInfo_DTC_0xc11187.GetEventStatus
          SC_EvtInfo_DTC_0xc11187_GetEventTested: operation=EvtInfo_DTC_0xc11187.GetEventTested
          SC_EvtInfo_DTC_0xc11187_GetEventUdsStatus: operation=EvtInfo_DTC_0xc11187.GetEventUdsStatus
          SC_EvtInfo_DTC_0xc11187_GetFaultDetectionCounter: operation=EvtInfo_DTC_0xc11187.GetFaultDetectionCounter
          SC_EvtInfo_DTC_0xc11187_GetMonitorStatus: operation=EvtInfo_DTC_0xc11187.GetMonitorStatus
          SC_EvtInfo_DTC_0xc12987_GetDTCOfEvent: operation=EvtInfo_DTC_0xc12987.GetDTCOfEvent
          SC_EvtInfo_DTC_0xc12987_GetDebouncingOfEvent: operation=EvtInfo_DTC_0xc12987.GetDebouncingOfEvent
          SC_EvtInfo_DTC_0xc12987_GetEventEnableCondition: operation=EvtInfo_DTC_0xc12987.GetEventEnableCondition
          SC_EvtInfo_DTC_0xc12987_GetEventExtendedDataRecordEx: operation=EvtInfo_DTC_0xc12987.GetEventExtendedDataRecordEx
          SC_EvtInfo_DTC_0xc12987_GetEventFailed: operation=EvtInfo_DTC_0xc12987.GetEventFailed
          SC_EvtInfo_DTC_0xc12987_GetEventFreezeFrameDataEx: operation=EvtInfo_DTC_0xc12987.GetEventFreezeFrameDataEx
          SC_EvtInfo_DTC_0xc12987_GetEventStatus: operation=EvtInfo_DTC_0xc12987.GetEventStatus
          SC_EvtInfo_DTC_0xc12987_GetEventTested: operation=EvtInfo_DTC_0xc12987.GetEventTested
          SC_EvtInfo_DTC_0xc12987_GetEventUdsStatus: operation=EvtInfo_DTC_0xc12987.GetEventUdsStatus
          SC_EvtInfo_DTC_0xc12987_GetFaultDetectionCounter: operation=EvtInfo_DTC_0xc12987.GetFaultDetectionCounter
          SC_EvtInfo_DTC_0xc12987_GetMonitorStatus: operation=EvtInfo_DTC_0xc12987.GetMonitorStatus
          SC_EvtInfo_DTC_0xc14087_GetDTCOfEvent: operation=EvtInfo_DTC_0xc14087.GetDTCOfEvent
          SC_EvtInfo_DTC_0xc14087_GetDebouncingOfEvent: operation=EvtInfo_DTC_0xc14087.GetDebouncingOfEvent
          SC_EvtInfo_DTC_0xc14087_GetEventEnableCondition: operation=EvtInfo_DTC_0xc14087.GetEventEnableCondition
          SC_EvtInfo_DTC_0xc14087_GetEventExtendedDataRecordEx: operation=EvtInfo_DTC_0xc14087.GetEventExtendedDataRecordEx
          SC_EvtInfo_DTC_0xc14087_GetEventFailed: operation=EvtInfo_DTC_0xc14087.GetEventFailed
          SC_EvtInfo_DTC_0xc14087_GetEventFreezeFrameDataEx: operation=EvtInfo_DTC_0xc14087.GetEventFreezeFrameDataEx
          SC_EvtInfo_DTC_0xc14087_GetEventStatus: operation=EvtInfo_DTC_0xc14087.GetEventStatus
          SC_EvtInfo_DTC_0xc14087_GetEventTested: operation=EvtInfo_DTC_0xc14087.GetEventTested
          SC_EvtInfo_DTC_0xc14087_GetEventUdsStatus: operation=EvtInfo_DTC_0xc14087.GetEventUdsStatus
          SC_EvtInfo_DTC_0xc14087_GetFaultDetectionCounter: operation=EvtInfo_DTC_0xc14087.GetFaultDetectionCounter
          SC_EvtInfo_DTC_0xc14087_GetMonitorStatus: operation=EvtInfo_DTC_0xc14087.GetMonitorStatus
          SC_EvtInfo_DTC_0xc14687_GetDTCOfEvent: operation=EvtInfo_DTC_0xc14687.GetDTCOfEvent
          SC_EvtInfo_DTC_0xc14687_GetDebouncingOfEvent: operation=EvtInfo_DTC_0xc14687.GetDebouncingOfEvent
          SC_EvtInfo_DTC_0xc14687_GetEventEnableCondition: operation=EvtInfo_DTC_0xc14687.GetEventEnableCondition
          SC_EvtInfo_DTC_0xc14687_GetEventExtendedDataRecordEx: operation=EvtInfo_DTC_0xc14687.GetEventExtendedDataRecordEx
          SC_EvtInfo_DTC_0xc14687_GetEventFailed: operation=EvtInfo_DTC_0xc14687.GetEventFailed
          SC_EvtInfo_DTC_0xc14687_GetEventFreezeFrameDataEx: operation=EvtInfo_DTC_0xc14687.GetEventFreezeFrameDataEx
          SC_EvtInfo_DTC_0xc14687_GetEventStatus: operation=EvtInfo_DTC_0xc14687.GetEventStatus
          SC_EvtInfo_DTC_0xc14687_GetEventTested: operation=EvtInfo_DTC_0xc14687.GetEventTested
          SC_EvtInfo_DTC_0xc14687_GetEventUdsStatus: operation=EvtInfo_DTC_0xc14687.GetEventUdsStatus
          SC_EvtInfo_DTC_0xc14687_GetFaultDetectionCounter: operation=EvtInfo_DTC_0xc14687.GetFaultDetectionCounter
          SC_EvtInfo_DTC_0xc14687_GetMonitorStatus: operation=EvtInfo_DTC_0xc14687.GetMonitorStatus
          SC_EvtInfo_DTC_0xc14787_GetDTCOfEvent: operation=EvtInfo_DTC_0xc14787.GetDTCOfEvent
          SC_EvtInfo_DTC_0xc14787_GetDebouncingOfEvent: operation=EvtInfo_DTC_0xc14787.GetDebouncingOfEvent
          SC_EvtInfo_DTC_0xc14787_GetEventEnableCondition: operation=EvtInfo_DTC_0xc14787.GetEventEnableCondition
          SC_EvtInfo_DTC_0xc14787_GetEventExtendedDataRecordEx: operation=EvtInfo_DTC_0xc14787.GetEventExtendedDataRecordEx
          SC_EvtInfo_DTC_0xc14787_GetEventFailed: operation=EvtInfo_DTC_0xc14787.GetEventFailed
          SC_EvtInfo_DTC_0xc14787_GetEventFreezeFrameDataEx: operation=EvtInfo_DTC_0xc14787.GetEventFreezeFrameDataEx
          SC_EvtInfo_DTC_0xc14787_GetEventStatus: operation=EvtInfo_DTC_0xc14787.GetEventStatus
          SC_EvtInfo_DTC_0xc14787_GetEventTested: operation=EvtInfo_DTC_0xc14787.GetEventTested
          SC_EvtInfo_DTC_0xc14787_GetEventUdsStatus: operation=EvtInfo_DTC_0xc14787.GetEventUdsStatus
          SC_EvtInfo_DTC_0xc14787_GetFaultDetectionCounter: operation=EvtInfo_DTC_0xc14787.GetFaultDetectionCounter
          SC_EvtInfo_DTC_0xc14787_GetMonitorStatus: operation=EvtInfo_DTC_0xc14787.GetMonitorStatus
          SC_EvtInfo_DTC_0xc16687_GetDTCOfEvent: operation=EvtInfo_DTC_0xc16687.GetDTCOfEvent
          SC_EvtInfo_DTC_0xc16687_GetDebouncingOfEvent: operation=EvtInfo_DTC_0xc16687.GetDebouncingOfEvent
          SC_EvtInfo_DTC_0xc16687_GetEventEnableCondition: operation=EvtInfo_DTC_0xc16687.GetEventEnableCondition
          SC_EvtInfo_DTC_0xc16687_GetEventExtendedDataRecordEx: operation=EvtInfo_DTC_0xc16687.GetEventExtendedDataRecordEx
          SC_EvtInfo_DTC_0xc16687_GetEventFailed: operation=EvtInfo_DTC_0xc16687.GetEventFailed
          SC_EvtInfo_DTC_0xc16687_GetEventFreezeFrameDataEx: operation=EvtInfo_DTC_0xc16687.GetEventFreezeFrameDataEx
          SC_EvtInfo_DTC_0xc16687_GetEventStatus: operation=EvtInfo_DTC_0xc16687.GetEventStatus
          SC_EvtInfo_DTC_0xc16687_GetEventTested: operation=EvtInfo_DTC_0xc16687.GetEventTested
          SC_EvtInfo_DTC_0xc16687_GetEventUdsStatus: operation=EvtInfo_DTC_0xc16687.GetEventUdsStatus
          SC_EvtInfo_DTC_0xc16687_GetFaultDetectionCounter: operation=EvtInfo_DTC_0xc16687.GetFaultDetectionCounter
          SC_EvtInfo_DTC_0xc16687_GetMonitorStatus: operation=EvtInfo_DTC_0xc16687.GetMonitorStatus
          SC_EvtInfo_DTC_0xc16b87_GetDTCOfEvent: operation=EvtInfo_DTC_0xc16b87.GetDTCOfEvent
          SC_EvtInfo_DTC_0xc16b87_GetDebouncingOfEvent: operation=EvtInfo_DTC_0xc16b87.GetDebouncingOfEvent
          SC_EvtInfo_DTC_0xc16b87_GetEventEnableCondition: operation=EvtInfo_DTC_0xc16b87.GetEventEnableCondition
          SC_EvtInfo_DTC_0xc16b87_GetEventExtendedDataRecordEx: operation=EvtInfo_DTC_0xc16b87.GetEventExtendedDataRecordEx
          SC_EvtInfo_DTC_0xc16b87_GetEventFailed: operation=EvtInfo_DTC_0xc16b87.GetEventFailed
          SC_EvtInfo_DTC_0xc16b87_GetEventFreezeFrameDataEx: operation=EvtInfo_DTC_0xc16b87.GetEventFreezeFrameDataEx
          SC_EvtInfo_DTC_0xc16b87_GetEventStatus: operation=EvtInfo_DTC_0xc16b87.GetEventStatus
          SC_EvtInfo_DTC_0xc16b87_GetEventTested: operation=EvtInfo_DTC_0xc16b87.GetEventTested
          SC_EvtInfo_DTC_0xc16b87_GetEventUdsStatus: operation=EvtInfo_DTC_0xc16b87.GetEventUdsStatus
          SC_EvtInfo_DTC_0xc16b87_GetFaultDetectionCounter: operation=EvtInfo_DTC_0xc16b87.GetFaultDetectionCounter
          SC_EvtInfo_DTC_0xc16b87_GetMonitorStatus: operation=EvtInfo_DTC_0xc16b87.GetMonitorStatus
          SC_EvtInfo_DTC_0xc19687_GetDTCOfEvent: operation=EvtInfo_DTC_0xc19687.GetDTCOfEvent
          SC_EvtInfo_DTC_0xc19687_GetDebouncingOfEvent: operation=EvtInfo_DTC_0xc19687.GetDebouncingOfEvent
          SC_EvtInfo_DTC_0xc19687_GetEventEnableCondition: operation=EvtInfo_DTC_0xc19687.GetEventEnableCondition
          SC_EvtInfo_DTC_0xc19687_GetEventExtendedDataRecordEx: operation=EvtInfo_DTC_0xc19687.GetEventExtendedDataRecordEx
          SC_EvtInfo_DTC_0xc19687_GetEventFailed: operation=EvtInfo_DTC_0xc19687.GetEventFailed
          SC_EvtInfo_DTC_0xc19687_GetEventFreezeFrameDataEx: operation=EvtInfo_DTC_0xc19687.GetEventFreezeFrameDataEx
          SC_EvtInfo_DTC_0xc19687_GetEventStatus: operation=EvtInfo_DTC_0xc19687.GetEventStatus
          SC_EvtInfo_DTC_0xc19687_GetEventTested: operation=EvtInfo_DTC_0xc19687.GetEventTested
          SC_EvtInfo_DTC_0xc19687_GetEventUdsStatus: operation=EvtInfo_DTC_0xc19687.GetEventUdsStatus
          SC_EvtInfo_DTC_0xc19687_GetFaultDetectionCounter: operation=EvtInfo_DTC_0xc19687.GetFaultDetectionCounter
          SC_EvtInfo_DTC_0xc19687_GetMonitorStatus: operation=EvtInfo_DTC_0xc19687.GetMonitorStatus
          SC_EvtInfo_DTC_0xc19987_GetDTCOfEvent: operation=EvtInfo_DTC_0xc19987.GetDTCOfEvent
          SC_EvtInfo_DTC_0xc19987_GetDebouncingOfEvent: operation=EvtInfo_DTC_0xc19987.GetDebouncingOfEvent
          SC_EvtInfo_DTC_0xc19987_GetEventEnableCondition: operation=EvtInfo_DTC_0xc19987.GetEventEnableCondition
          SC_EvtInfo_DTC_0xc19987_GetEventExtendedDataRecordEx: operation=EvtInfo_DTC_0xc19987.GetEventExtendedDataRecordEx
          SC_EvtInfo_DTC_0xc19987_GetEventFailed: operation=EvtInfo_DTC_0xc19987.GetEventFailed
          SC_EvtInfo_DTC_0xc19987_GetEventFreezeFrameDataEx: operation=EvtInfo_DTC_0xc19987.GetEventFreezeFrameDataEx
          SC_EvtInfo_DTC_0xc19987_GetEventStatus: operation=EvtInfo_DTC_0xc19987.GetEventStatus
          SC_EvtInfo_DTC_0xc19987_GetEventTested: operation=EvtInfo_DTC_0xc19987.GetEventTested
          SC_EvtInfo_DTC_0xc19987_GetEventUdsStatus: operation=EvtInfo_DTC_0xc19987.GetEventUdsStatus
          SC_EvtInfo_DTC_0xc19987_GetFaultDetectionCounter: operation=EvtInfo_DTC_0xc19987.GetFaultDetectionCounter
          SC_EvtInfo_DTC_0xc19987_GetMonitorStatus: operation=EvtInfo_DTC_0xc19987.GetMonitorStatus
          SC_EvtInfo_DTC_0xc19b87_GetDTCOfEvent: operation=EvtInfo_DTC_0xc19b87.GetDTCOfEvent
          SC_EvtInfo_DTC_0xc19b87_GetDebouncingOfEvent: operation=EvtInfo_DTC_0xc19b87.GetDebouncingOfEvent
          SC_EvtInfo_DTC_0xc19b87_GetEventEnableCondition: operation=EvtInfo_DTC_0xc19b87.GetEventEnableCondition
          SC_EvtInfo_DTC_0xc19b87_GetEventExtendedDataRecordEx: operation=EvtInfo_DTC_0xc19b87.GetEventExtendedDataRecordEx
          SC_EvtInfo_DTC_0xc19b87_GetEventFailed: operation=EvtInfo_DTC_0xc19b87.GetEventFailed
          SC_EvtInfo_DTC_0xc19b87_GetEventFreezeFrameDataEx: operation=EvtInfo_DTC_0xc19b87.GetEventFreezeFrameDataEx
          SC_EvtInfo_DTC_0xc19b87_GetEventStatus: operation=EvtInfo_DTC_0xc19b87.GetEventStatus
          SC_EvtInfo_DTC_0xc19b87_GetEventTested: operation=EvtInfo_DTC_0xc19b87.GetEventTested
          SC_EvtInfo_DTC_0xc19b87_GetEventUdsStatus: operation=EvtInfo_DTC_0xc19b87.GetEventUdsStatus
          SC_EvtInfo_DTC_0xc19b87_GetFaultDetectionCounter: operation=EvtInfo_DTC_0xc19b87.GetFaultDetectionCounter
          SC_EvtInfo_DTC_0xc19b87_GetMonitorStatus: operation=EvtInfo_DTC_0xc19b87.GetMonitorStatus
          SC_EvtInfo_DTC_0xc29887_GetDTCOfEvent: operation=EvtInfo_DTC_0xc29887.GetDTCOfEvent
          SC_EvtInfo_DTC_0xc29887_GetDebouncingOfEvent: operation=EvtInfo_DTC_0xc29887.GetDebouncingOfEvent
          SC_EvtInfo_DTC_0xc29887_GetEventEnableCondition: operation=EvtInfo_DTC_0xc29887.GetEventEnableCondition
          SC_EvtInfo_DTC_0xc29887_GetEventExtendedDataRecordEx: operation=EvtInfo_DTC_0xc29887.GetEventExtendedDataRecordEx
          SC_EvtInfo_DTC_0xc29887_GetEventFailed: operation=EvtInfo_DTC_0xc29887.GetEventFailed
          SC_EvtInfo_DTC_0xc29887_GetEventFreezeFrameDataEx: operation=EvtInfo_DTC_0xc29887.GetEventFreezeFrameDataEx
          SC_EvtInfo_DTC_0xc29887_GetEventStatus: operation=EvtInfo_DTC_0xc29887.GetEventStatus
          SC_EvtInfo_DTC_0xc29887_GetEventTested: operation=EvtInfo_DTC_0xc29887.GetEventTested
          SC_EvtInfo_DTC_0xc29887_GetEventUdsStatus: operation=EvtInfo_DTC_0xc29887.GetEventUdsStatus
          SC_EvtInfo_DTC_0xc29887_GetFaultDetectionCounter: operation=EvtInfo_DTC_0xc29887.GetFaultDetectionCounter
          SC_EvtInfo_DTC_0xc29887_GetMonitorStatus: operation=EvtInfo_DTC_0xc29887.GetMonitorStatus
          SC_EvtInfo_DTC_0xc29a87_GetDTCOfEvent: operation=EvtInfo_DTC_0xc29a87.GetDTCOfEvent
          SC_EvtInfo_DTC_0xc29a87_GetDebouncingOfEvent: operation=EvtInfo_DTC_0xc29a87.GetDebouncingOfEvent
          SC_EvtInfo_DTC_0xc29a87_GetEventEnableCondition: operation=EvtInfo_DTC_0xc29a87.GetEventEnableCondition
          SC_EvtInfo_DTC_0xc29a87_GetEventExtendedDataRecordEx: operation=EvtInfo_DTC_0xc29a87.GetEventExtendedDataRecordEx
          SC_EvtInfo_DTC_0xc29a87_GetEventFailed: operation=EvtInfo_DTC_0xc29a87.GetEventFailed
          SC_EvtInfo_DTC_0xc29a87_GetEventFreezeFrameDataEx: operation=EvtInfo_DTC_0xc29a87.GetEventFreezeFrameDataEx
          SC_EvtInfo_DTC_0xc29a87_GetEventStatus: operation=EvtInfo_DTC_0xc29a87.GetEventStatus
          SC_EvtInfo_DTC_0xc29a87_GetEventTested: operation=EvtInfo_DTC_0xc29a87.GetEventTested
          SC_EvtInfo_DTC_0xc29a87_GetEventUdsStatus: operation=EvtInfo_DTC_0xc29a87.GetEventUdsStatus
          SC_EvtInfo_DTC_0xc29a87_GetFaultDetectionCounter: operation=EvtInfo_DTC_0xc29a87.GetFaultDetectionCounter
          SC_EvtInfo_DTC_0xc29a87_GetMonitorStatus: operation=EvtInfo_DTC_0xc29a87.GetMonitorStatus
          SC_EvtInfo_DTC_0xd10587_GetDTCOfEvent: operation=EvtInfo_DTC_0xd10587.GetDTCOfEvent
          SC_EvtInfo_DTC_0xd10587_GetDebouncingOfEvent: operation=EvtInfo_DTC_0xd10587.GetDebouncingOfEvent
          SC_EvtInfo_DTC_0xd10587_GetEventEnableCondition: operation=EvtInfo_DTC_0xd10587.GetEventEnableCondition
          SC_EvtInfo_DTC_0xd10587_GetEventExtendedDataRecordEx: operation=EvtInfo_DTC_0xd10587.GetEventExtendedDataRecordEx
          SC_EvtInfo_DTC_0xd10587_GetEventFailed: operation=EvtInfo_DTC_0xd10587.GetEventFailed
          SC_EvtInfo_DTC_0xd10587_GetEventFreezeFrameDataEx: operation=EvtInfo_DTC_0xd10587.GetEventFreezeFrameDataEx
          SC_EvtInfo_DTC_0xd10587_GetEventStatus: operation=EvtInfo_DTC_0xd10587.GetEventStatus
          SC_EvtInfo_DTC_0xd10587_GetEventTested: operation=EvtInfo_DTC_0xd10587.GetEventTested
          SC_EvtInfo_DTC_0xd10587_GetEventUdsStatus: operation=EvtInfo_DTC_0xd10587.GetEventUdsStatus
          SC_EvtInfo_DTC_0xd10587_GetFaultDetectionCounter: operation=EvtInfo_DTC_0xd10587.GetFaultDetectionCounter
          SC_EvtInfo_DTC_0xd10587_GetMonitorStatus: operation=EvtInfo_DTC_0xd10587.GetMonitorStatus
          SC_EvtInfo_DTC_0xd11b87_GetDTCOfEvent: operation=EvtInfo_DTC_0xd11b87.GetDTCOfEvent
          SC_EvtInfo_DTC_0xd11b87_GetDebouncingOfEvent: operation=EvtInfo_DTC_0xd11b87.GetDebouncingOfEvent
          SC_EvtInfo_DTC_0xd11b87_GetEventEnableCondition: operation=EvtInfo_DTC_0xd11b87.GetEventEnableCondition
          SC_EvtInfo_DTC_0xd11b87_GetEventExtendedDataRecordEx: operation=EvtInfo_DTC_0xd11b87.GetEventExtendedDataRecordEx
          SC_EvtInfo_DTC_0xd11b87_GetEventFailed: operation=EvtInfo_DTC_0xd11b87.GetEventFailed
          SC_EvtInfo_DTC_0xd11b87_GetEventFreezeFrameDataEx: operation=EvtInfo_DTC_0xd11b87.GetEventFreezeFrameDataEx
          SC_EvtInfo_DTC_0xd11b87_GetEventStatus: operation=EvtInfo_DTC_0xd11b87.GetEventStatus
          SC_EvtInfo_DTC_0xd11b87_GetEventTested: operation=EvtInfo_DTC_0xd11b87.GetEventTested
          SC_EvtInfo_DTC_0xd11b87_GetEventUdsStatus: operation=EvtInfo_DTC_0xd11b87.GetEventUdsStatus
          SC_EvtInfo_DTC_0xd11b87_GetFaultDetectionCounter: operation=EvtInfo_DTC_0xd11b87.GetFaultDetectionCounter
          SC_EvtInfo_DTC_0xd11b87_GetMonitorStatus: operation=EvtInfo_DTC_0xd11b87.GetMonitorStatus
          SC_EvtInfo_DTC_0xd13787_GetDTCOfEvent: operation=EvtInfo_DTC_0xd13787.GetDTCOfEvent
          SC_EvtInfo_DTC_0xd13787_GetDebouncingOfEvent: operation=EvtInfo_DTC_0xd13787.GetDebouncingOfEvent
          SC_EvtInfo_DTC_0xd13787_GetEventEnableCondition: operation=EvtInfo_DTC_0xd13787.GetEventEnableCondition
          SC_EvtInfo_DTC_0xd13787_GetEventExtendedDataRecordEx: operation=EvtInfo_DTC_0xd13787.GetEventExtendedDataRecordEx
          SC_EvtInfo_DTC_0xd13787_GetEventFailed: operation=EvtInfo_DTC_0xd13787.GetEventFailed
          SC_EvtInfo_DTC_0xd13787_GetEventFreezeFrameDataEx: operation=EvtInfo_DTC_0xd13787.GetEventFreezeFrameDataEx
          SC_EvtInfo_DTC_0xd13787_GetEventStatus: operation=EvtInfo_DTC_0xd13787.GetEventStatus
          SC_EvtInfo_DTC_0xd13787_GetEventTested: operation=EvtInfo_DTC_0xd13787.GetEventTested
          SC_EvtInfo_DTC_0xd13787_GetEventUdsStatus: operation=EvtInfo_DTC_0xd13787.GetEventUdsStatus
          SC_EvtInfo_DTC_0xd13787_GetFaultDetectionCounter: operation=EvtInfo_DTC_0xd13787.GetFaultDetectionCounter
          SC_EvtInfo_DTC_0xd13787_GetMonitorStatus: operation=EvtInfo_DTC_0xd13787.GetMonitorStatus
          SC_EvtInfo_DTC_0xd30087_GetDTCOfEvent: operation=EvtInfo_DTC_0xd30087.GetDTCOfEvent
          SC_EvtInfo_DTC_0xd30087_GetDebouncingOfEvent: operation=EvtInfo_DTC_0xd30087.GetDebouncingOfEvent
          SC_EvtInfo_DTC_0xd30087_GetEventEnableCondition: operation=EvtInfo_DTC_0xd30087.GetEventEnableCondition
          SC_EvtInfo_DTC_0xd30087_GetEventExtendedDataRecordEx: operation=EvtInfo_DTC_0xd30087.GetEventExtendedDataRecordEx
          SC_EvtInfo_DTC_0xd30087_GetEventFailed: operation=EvtInfo_DTC_0xd30087.GetEventFailed
          SC_EvtInfo_DTC_0xd30087_GetEventFreezeFrameDataEx: operation=EvtInfo_DTC_0xd30087.GetEventFreezeFrameDataEx
          SC_EvtInfo_DTC_0xd30087_GetEventStatus: operation=EvtInfo_DTC_0xd30087.GetEventStatus
          SC_EvtInfo_DTC_0xd30087_GetEventTested: operation=EvtInfo_DTC_0xd30087.GetEventTested
          SC_EvtInfo_DTC_0xd30087_GetEventUdsStatus: operation=EvtInfo_DTC_0xd30087.GetEventUdsStatus
          SC_EvtInfo_DTC_0xd30087_GetFaultDetectionCounter: operation=EvtInfo_DTC_0xd30087.GetFaultDetectionCounter
          SC_EvtInfo_DTC_0xd30087_GetMonitorStatus: operation=EvtInfo_DTC_0xd30087.GetMonitorStatus
          SC_Event_DTC_0x117205_GetDTCOfEvent: operation=Event_DTC_0x117205.GetDTCOfEvent
          SC_Event_DTC_0x117205_GetEventExtendedDataRecordEx: operation=Event_DTC_0x117205.GetEventExtendedDataRecordEx
          SC_Event_DTC_0x117205_GetEventFailed: operation=Event_DTC_0x117205.GetEventFailed
          SC_Event_DTC_0x117205_GetEventFreezeFrameDataEx: operation=Event_DTC_0x117205.GetEventFreezeFrameDataEx
          SC_Event_DTC_0x117205_GetEventStatus: operation=Event_DTC_0x117205.GetEventStatus
          SC_Event_DTC_0x117205_GetEventTested: operation=Event_DTC_0x117205.GetEventTested
          SC_Event_DTC_0x117205_GetEventUdsStatus: operation=Event_DTC_0x117205.GetEventUdsStatus
          SC_Event_DTC_0x117205_GetFaultDetectionCounter: operation=Event_DTC_0x117205.GetFaultDetectionCounter
          SC_Event_DTC_0x117205_ResetEventDebounceStatus: operation=Event_DTC_0x117205.ResetEventDebounceStatus
          SC_Event_DTC_0x117205_ResetEventStatus: operation=Event_DTC_0x117205.ResetEventStatus
          SC_Event_DTC_0x117205_SetEventStatus: operation=Event_DTC_0x117205.SetEventStatus
          SC_Event_DTC_0x117305_GetDTCOfEvent: operation=Event_DTC_0x117305.GetDTCOfEvent
          SC_Event_DTC_0x117305_GetEventExtendedDataRecordEx: operation=Event_DTC_0x117305.GetEventExtendedDataRecordEx
          SC_Event_DTC_0x117305_GetEventFailed: operation=Event_DTC_0x117305.GetEventFailed
          SC_Event_DTC_0x117305_GetEventFreezeFrameDataEx: operation=Event_DTC_0x117305.GetEventFreezeFrameDataEx
          SC_Event_DTC_0x117305_GetEventStatus: operation=Event_DTC_0x117305.GetEventStatus
          SC_Event_DTC_0x117305_GetEventTested: operation=Event_DTC_0x117305.GetEventTested
          SC_Event_DTC_0x117305_GetEventUdsStatus: operation=Event_DTC_0x117305.GetEventUdsStatus
          SC_Event_DTC_0x117305_GetFaultDetectionCounter: operation=Event_DTC_0x117305.GetFaultDetectionCounter
          SC_Event_DTC_0x117305_ResetEventDebounceStatus: operation=Event_DTC_0x117305.ResetEventDebounceStatus
          SC_Event_DTC_0x117305_ResetEventStatus: operation=Event_DTC_0x117305.ResetEventStatus
          SC_Event_DTC_0x117305_SetEventStatus: operation=Event_DTC_0x117305.SetEventStatus
          SC_Event_DTC_0x117405_GetDTCOfEvent: operation=Event_DTC_0x117405.GetDTCOfEvent
          SC_Event_DTC_0x117405_GetEventExtendedDataRecordEx: operation=Event_DTC_0x117405.GetEventExtendedDataRecordEx
          SC_Event_DTC_0x117405_GetEventFailed: operation=Event_DTC_0x117405.GetEventFailed
          SC_Event_DTC_0x117405_GetEventFreezeFrameDataEx: operation=Event_DTC_0x117405.GetEventFreezeFrameDataEx
          SC_Event_DTC_0x117405_GetEventStatus: operation=Event_DTC_0x117405.GetEventStatus
          SC_Event_DTC_0x117405_GetEventTested: operation=Event_DTC_0x117405.GetEventTested
          SC_Event_DTC_0x117405_GetEventUdsStatus: operation=Event_DTC_0x117405.GetEventUdsStatus
          SC_Event_DTC_0x117405_GetFaultDetectionCounter: operation=Event_DTC_0x117405.GetFaultDetectionCounter
          SC_Event_DTC_0x117405_ResetEventDebounceStatus: operation=Event_DTC_0x117405.ResetEventDebounceStatus
          SC_Event_DTC_0x117405_ResetEventStatus: operation=Event_DTC_0x117405.ResetEventStatus
          SC_Event_DTC_0x117405_SetEventStatus: operation=Event_DTC_0x117405.SetEventStatus
          SC_Event_DTC_0x117617_GetDTCOfEvent: operation=Event_DTC_0x117617.GetDTCOfEvent
          SC_Event_DTC_0x117617_GetEventExtendedDataRecordEx: operation=Event_DTC_0x117617.GetEventExtendedDataRecordEx
          SC_Event_DTC_0x117617_GetEventFailed: operation=Event_DTC_0x117617.GetEventFailed
          SC_Event_DTC_0x117617_GetEventFreezeFrameDataEx: operation=Event_DTC_0x117617.GetEventFreezeFrameDataEx
          SC_Event_DTC_0x117617_GetEventStatus: operation=Event_DTC_0x117617.GetEventStatus
          SC_Event_DTC_0x117617_GetEventTested: operation=Event_DTC_0x117617.GetEventTested
          SC_Event_DTC_0x117617_GetEventUdsStatus: operation=Event_DTC_0x117617.GetEventUdsStatus
          SC_Event_DTC_0x117617_GetFaultDetectionCounter: operation=Event_DTC_0x117617.GetFaultDetectionCounter
          SC_Event_DTC_0x117617_ResetEventDebounceStatus: operation=Event_DTC_0x117617.ResetEventDebounceStatus
          SC_Event_DTC_0x117617_ResetEventStatus: operation=Event_DTC_0x117617.ResetEventStatus
          SC_Event_DTC_0x117617_SetEventStatus: operation=Event_DTC_0x117617.SetEventStatus
          SC_Event_DTC_0x117716_GetDTCOfEvent: operation=Event_DTC_0x117716.GetDTCOfEvent
          SC_Event_DTC_0x117716_GetEventExtendedDataRecordEx: operation=Event_DTC_0x117716.GetEventExtendedDataRecordEx
          SC_Event_DTC_0x117716_GetEventFailed: operation=Event_DTC_0x117716.GetEventFailed
          SC_Event_DTC_0x117716_GetEventFreezeFrameDataEx: operation=Event_DTC_0x117716.GetEventFreezeFrameDataEx
          SC_Event_DTC_0x117716_GetEventStatus: operation=Event_DTC_0x117716.GetEventStatus
          SC_Event_DTC_0x117716_GetEventTested: operation=Event_DTC_0x117716.GetEventTested
          SC_Event_DTC_0x117716_GetEventUdsStatus: operation=Event_DTC_0x117716.GetEventUdsStatus
          SC_Event_DTC_0x117716_GetFaultDetectionCounter: operation=Event_DTC_0x117716.GetFaultDetectionCounter
          SC_Event_DTC_0x117716_ResetEventDebounceStatus: operation=Event_DTC_0x117716.ResetEventDebounceStatus
          SC_Event_DTC_0x117716_ResetEventStatus: operation=Event_DTC_0x117716.ResetEventStatus
          SC_Event_DTC_0x117716_SetEventStatus: operation=Event_DTC_0x117716.SetEventStatus
          SC_Event_DTC_0x117819_GetDTCOfEvent: operation=Event_DTC_0x117819.GetDTCOfEvent
          SC_Event_DTC_0x117819_GetEventExtendedDataRecordEx: operation=Event_DTC_0x117819.GetEventExtendedDataRecordEx
          SC_Event_DTC_0x117819_GetEventFailed: operation=Event_DTC_0x117819.GetEventFailed
          SC_Event_DTC_0x117819_GetEventFreezeFrameDataEx: operation=Event_DTC_0x117819.GetEventFreezeFrameDataEx
          SC_Event_DTC_0x117819_GetEventStatus: operation=Event_DTC_0x117819.GetEventStatus
          SC_Event_DTC_0x117819_GetEventTested: operation=Event_DTC_0x117819.GetEventTested
          SC_Event_DTC_0x117819_GetEventUdsStatus: operation=Event_DTC_0x117819.GetEventUdsStatus
          SC_Event_DTC_0x117819_GetFaultDetectionCounter: operation=Event_DTC_0x117819.GetFaultDetectionCounter
          SC_Event_DTC_0x117819_ResetEventDebounceStatus: operation=Event_DTC_0x117819.ResetEventDebounceStatus
          SC_Event_DTC_0x117819_ResetEventStatus: operation=Event_DTC_0x117819.ResetEventStatus
          SC_Event_DTC_0x117819_SetEventStatus: operation=Event_DTC_0x117819.SetEventStatus
          SC_Event_DTC_0x11794b_GetDTCOfEvent: operation=Event_DTC_0x11794b.GetDTCOfEvent
          SC_Event_DTC_0x11794b_GetEventExtendedDataRecordEx: operation=Event_DTC_0x11794b.GetEventExtendedDataRecordEx
          SC_Event_DTC_0x11794b_GetEventFailed: operation=Event_DTC_0x11794b.GetEventFailed
          SC_Event_DTC_0x11794b_GetEventFreezeFrameDataEx: operation=Event_DTC_0x11794b.GetEventFreezeFrameDataEx
          SC_Event_DTC_0x11794b_GetEventStatus: operation=Event_DTC_0x11794b.GetEventStatus
          SC_Event_DTC_0x11794b_GetEventTested: operation=Event_DTC_0x11794b.GetEventTested
          SC_Event_DTC_0x11794b_GetEventUdsStatus: operation=Event_DTC_0x11794b.GetEventUdsStatus
          SC_Event_DTC_0x11794b_GetFaultDetectionCounter: operation=Event_DTC_0x11794b.GetFaultDetectionCounter
          SC_Event_DTC_0x11794b_ResetEventDebounceStatus: operation=Event_DTC_0x11794b.ResetEventDebounceStatus
          SC_Event_DTC_0x11794b_ResetEventStatus: operation=Event_DTC_0x11794b.ResetEventStatus
          SC_Event_DTC_0x11794b_SetEventStatus: operation=Event_DTC_0x11794b.SetEventStatus
          SC_Event_DTC_0x117a4c_GetDTCOfEvent: operation=Event_DTC_0x117a4c.GetDTCOfEvent
          SC_Event_DTC_0x117a4c_GetEventExtendedDataRecordEx: operation=Event_DTC_0x117a4c.GetEventExtendedDataRecordEx
          SC_Event_DTC_0x117a4c_GetEventFailed: operation=Event_DTC_0x117a4c.GetEventFailed
          SC_Event_DTC_0x117a4c_GetEventFreezeFrameDataEx: operation=Event_DTC_0x117a4c.GetEventFreezeFrameDataEx
          SC_Event_DTC_0x117a4c_GetEventStatus: operation=Event_DTC_0x117a4c.GetEventStatus
          SC_Event_DTC_0x117a4c_GetEventTested: operation=Event_DTC_0x117a4c.GetEventTested
          SC_Event_DTC_0x117a4c_GetEventUdsStatus: operation=Event_DTC_0x117a4c.GetEventUdsStatus
          SC_Event_DTC_0x117a4c_GetFaultDetectionCounter: operation=Event_DTC_0x117a4c.GetFaultDetectionCounter
          SC_Event_DTC_0x117a4c_ResetEventDebounceStatus: operation=Event_DTC_0x117a4c.ResetEventDebounceStatus
          SC_Event_DTC_0x117a4c_ResetEventStatus: operation=Event_DTC_0x117a4c.ResetEventStatus
          SC_Event_DTC_0x117a4c_SetEventStatus: operation=Event_DTC_0x117a4c.SetEventStatus
          SC_Event_DTC_0x117b94_GetDTCOfEvent: operation=Event_DTC_0x117b94.GetDTCOfEvent
          SC_Event_DTC_0x117b94_GetEventExtendedDataRecordEx: operation=Event_DTC_0x117b94.GetEventExtendedDataRecordEx
          SC_Event_DTC_0x117b94_GetEventFailed: operation=Event_DTC_0x117b94.GetEventFailed
          SC_Event_DTC_0x117b94_GetEventFreezeFrameDataEx: operation=Event_DTC_0x117b94.GetEventFreezeFrameDataEx
          SC_Event_DTC_0x117b94_GetEventStatus: operation=Event_DTC_0x117b94.GetEventStatus
          SC_Event_DTC_0x117b94_GetEventTested: operation=Event_DTC_0x117b94.GetEventTested
          SC_Event_DTC_0x117b94_GetEventUdsStatus: operation=Event_DTC_0x117b94.GetEventUdsStatus
          SC_Event_DTC_0x117b94_GetFaultDetectionCounter: operation=Event_DTC_0x117b94.GetFaultDetectionCounter
          SC_Event_DTC_0x117b94_ResetEventDebounceStatus: operation=Event_DTC_0x117b94.ResetEventDebounceStatus
          SC_Event_DTC_0x117b94_ResetEventStatus: operation=Event_DTC_0x117b94.ResetEventStatus
          SC_Event_DTC_0x117b94_SetEventStatus: operation=Event_DTC_0x117b94.SetEventStatus
          SC_Event_DTC_0x117c08_GetDTCOfEvent: operation=Event_DTC_0x117c08.GetDTCOfEvent
          SC_Event_DTC_0x117c08_GetEventExtendedDataRecordEx: operation=Event_DTC_0x117c08.GetEventExtendedDataRecordEx
          SC_Event_DTC_0x117c08_GetEventFailed: operation=Event_DTC_0x117c08.GetEventFailed
          SC_Event_DTC_0x117c08_GetEventFreezeFrameDataEx: operation=Event_DTC_0x117c08.GetEventFreezeFrameDataEx
          SC_Event_DTC_0x117c08_GetEventStatus: operation=Event_DTC_0x117c08.GetEventStatus
          SC_Event_DTC_0x117c08_GetEventTested: operation=Event_DTC_0x117c08.GetEventTested
          SC_Event_DTC_0x117c08_GetEventUdsStatus: operation=Event_DTC_0x117c08.GetEventUdsStatus
          SC_Event_DTC_0x117c08_GetFaultDetectionCounter: operation=Event_DTC_0x117c08.GetFaultDetectionCounter
          SC_Event_DTC_0x117c08_ResetEventDebounceStatus: operation=Event_DTC_0x117c08.ResetEventDebounceStatus
          SC_Event_DTC_0x117c08_ResetEventStatus: operation=Event_DTC_0x117c08.ResetEventStatus
          SC_Event_DTC_0x117c08_SetEventStatus: operation=Event_DTC_0x117c08.SetEventStatus
          SC_Event_DTC_0x117d08_GetDTCOfEvent: operation=Event_DTC_0x117d08.GetDTCOfEvent
          SC_Event_DTC_0x117d08_GetEventExtendedDataRecordEx: operation=Event_DTC_0x117d08.GetEventExtendedDataRecordEx
          SC_Event_DTC_0x117d08_GetEventFailed: operation=Event_DTC_0x117d08.GetEventFailed
          SC_Event_DTC_0x117d08_GetEventFreezeFrameDataEx: operation=Event_DTC_0x117d08.GetEventFreezeFrameDataEx
          SC_Event_DTC_0x117d08_GetEventStatus: operation=Event_DTC_0x117d08.GetEventStatus
          SC_Event_DTC_0x117d08_GetEventTested: operation=Event_DTC_0x117d08.GetEventTested
          SC_Event_DTC_0x117d08_GetEventUdsStatus: operation=Event_DTC_0x117d08.GetEventUdsStatus
          SC_Event_DTC_0x117d08_GetFaultDetectionCounter: operation=Event_DTC_0x117d08.GetFaultDetectionCounter
          SC_Event_DTC_0x117d08_ResetEventDebounceStatus: operation=Event_DTC_0x117d08.ResetEventDebounceStatus
          SC_Event_DTC_0x117d08_ResetEventStatus: operation=Event_DTC_0x117d08.ResetEventStatus
          SC_Event_DTC_0x117d08_SetEventStatus: operation=Event_DTC_0x117d08.SetEventStatus
          SC_Event_DTC_0x117e52_GetDTCOfEvent: operation=Event_DTC_0x117e52.GetDTCOfEvent
          SC_Event_DTC_0x117e52_GetEventExtendedDataRecordEx: operation=Event_DTC_0x117e52.GetEventExtendedDataRecordEx
          SC_Event_DTC_0x117e52_GetEventFailed: operation=Event_DTC_0x117e52.GetEventFailed
          SC_Event_DTC_0x117e52_GetEventFreezeFrameDataEx: operation=Event_DTC_0x117e52.GetEventFreezeFrameDataEx
          SC_Event_DTC_0x117e52_GetEventStatus: operation=Event_DTC_0x117e52.GetEventStatus
          SC_Event_DTC_0x117e52_GetEventTested: operation=Event_DTC_0x117e52.GetEventTested
          SC_Event_DTC_0x117e52_GetEventUdsStatus: operation=Event_DTC_0x117e52.GetEventUdsStatus
          SC_Event_DTC_0x117e52_GetFaultDetectionCounter: operation=Event_DTC_0x117e52.GetFaultDetectionCounter
          SC_Event_DTC_0x117e52_ResetEventDebounceStatus: operation=Event_DTC_0x117e52.ResetEventDebounceStatus
          SC_Event_DTC_0x117e52_ResetEventStatus: operation=Event_DTC_0x117e52.ResetEventStatus
          SC_Event_DTC_0x117e52_SetEventStatus: operation=Event_DTC_0x117e52.SetEventStatus
          SC_Event_DTC_0x117f08_GetDTCOfEvent: operation=Event_DTC_0x117f08.GetDTCOfEvent
          SC_Event_DTC_0x117f08_GetEventExtendedDataRecordEx: operation=Event_DTC_0x117f08.GetEventExtendedDataRecordEx
          SC_Event_DTC_0x117f08_GetEventFailed: operation=Event_DTC_0x117f08.GetEventFailed
          SC_Event_DTC_0x117f08_GetEventFreezeFrameDataEx: operation=Event_DTC_0x117f08.GetEventFreezeFrameDataEx
          SC_Event_DTC_0x117f08_GetEventStatus: operation=Event_DTC_0x117f08.GetEventStatus
          SC_Event_DTC_0x117f08_GetEventTested: operation=Event_DTC_0x117f08.GetEventTested
          SC_Event_DTC_0x117f08_GetEventUdsStatus: operation=Event_DTC_0x117f08.GetEventUdsStatus
          SC_Event_DTC_0x117f08_GetFaultDetectionCounter: operation=Event_DTC_0x117f08.GetFaultDetectionCounter
          SC_Event_DTC_0x117f08_ResetEventDebounceStatus: operation=Event_DTC_0x117f08.ResetEventDebounceStatus
          SC_Event_DTC_0x117f08_ResetEventStatus: operation=Event_DTC_0x117f08.ResetEventStatus
          SC_Event_DTC_0x117f08_SetEventStatus: operation=Event_DTC_0x117f08.SetEventStatus
          SC_Event_DTC_0xc14887_GetDTCOfEvent: operation=Event_DTC_0xc14887.GetDTCOfEvent
          SC_Event_DTC_0xc14887_GetEventExtendedDataRecordEx: operation=Event_DTC_0xc14887.GetEventExtendedDataRecordEx
          SC_Event_DTC_0xc14887_GetEventFailed: operation=Event_DTC_0xc14887.GetEventFailed
          SC_Event_DTC_0xc14887_GetEventFreezeFrameDataEx: operation=Event_DTC_0xc14887.GetEventFreezeFrameDataEx
          SC_Event_DTC_0xc14887_GetEventStatus: operation=Event_DTC_0xc14887.GetEventStatus
          SC_Event_DTC_0xc14887_GetEventTested: operation=Event_DTC_0xc14887.GetEventTested
          SC_Event_DTC_0xc14887_GetEventUdsStatus: operation=Event_DTC_0xc14887.GetEventUdsStatus
          SC_Event_DTC_0xc14887_GetFaultDetectionCounter: operation=Event_DTC_0xc14887.GetFaultDetectionCounter
          SC_Event_DTC_0xc14887_ResetEventDebounceStatus: operation=Event_DTC_0xc14887.ResetEventDebounceStatus
          SC_Event_DTC_0xc14887_ResetEventStatus: operation=Event_DTC_0xc14887.ResetEventStatus
          SC_Event_DTC_0xc14887_SetEventStatus: operation=Event_DTC_0xc14887.SetEventStatus
          SC_Event_DTC_0xc20087_GetDTCOfEvent: operation=Event_DTC_0xc20087.GetDTCOfEvent
          SC_Event_DTC_0xc20087_GetEventExtendedDataRecordEx: operation=Event_DTC_0xc20087.GetEventExtendedDataRecordEx
          SC_Event_DTC_0xc20087_GetEventFailed: operation=Event_DTC_0xc20087.GetEventFailed
          SC_Event_DTC_0xc20087_GetEventFreezeFrameDataEx: operation=Event_DTC_0xc20087.GetEventFreezeFrameDataEx
          SC_Event_DTC_0xc20087_GetEventStatus: operation=Event_DTC_0xc20087.GetEventStatus
          SC_Event_DTC_0xc20087_GetEventTested: operation=Event_DTC_0xc20087.GetEventTested
          SC_Event_DTC_0xc20087_GetEventUdsStatus: operation=Event_DTC_0xc20087.GetEventUdsStatus
          SC_Event_DTC_0xc20087_GetFaultDetectionCounter: operation=Event_DTC_0xc20087.GetFaultDetectionCounter
          SC_Event_DTC_0xc20087_ResetEventDebounceStatus: operation=Event_DTC_0xc20087.ResetEventDebounceStatus
          SC_Event_DTC_0xc20087_ResetEventStatus: operation=Event_DTC_0xc20087.ResetEventStatus
          SC_Event_DTC_0xc20087_SetEventStatus: operation=Event_DTC_0xc20087.SetEventStatus
          SC_Event_DTC_0xc20187_GetDTCOfEvent: operation=Event_DTC_0xc20187.GetDTCOfEvent
          SC_Event_DTC_0xc20187_GetEventExtendedDataRecordEx: operation=Event_DTC_0xc20187.GetEventExtendedDataRecordEx
          SC_Event_DTC_0xc20187_GetEventFailed: operation=Event_DTC_0xc20187.GetEventFailed
          SC_Event_DTC_0xc20187_GetEventFreezeFrameDataEx: operation=Event_DTC_0xc20187.GetEventFreezeFrameDataEx
          SC_Event_DTC_0xc20187_GetEventStatus: operation=Event_DTC_0xc20187.GetEventStatus
          SC_Event_DTC_0xc20187_GetEventTested: operation=Event_DTC_0xc20187.GetEventTested
          SC_Event_DTC_0xc20187_GetEventUdsStatus: operation=Event_DTC_0xc20187.GetEventUdsStatus
          SC_Event_DTC_0xc20187_GetFaultDetectionCounter: operation=Event_DTC_0xc20187.GetFaultDetectionCounter
          SC_Event_DTC_0xc20187_ResetEventDebounceStatus: operation=Event_DTC_0xc20187.ResetEventDebounceStatus
          SC_Event_DTC_0xc20187_ResetEventStatus: operation=Event_DTC_0xc20187.ResetEventStatus
          SC_Event_DTC_0xc20187_SetEventStatus: operation=Event_DTC_0xc20187.SetEventStatus
          SC_Event_DTC_0xc20287_GetDTCOfEvent: operation=Event_DTC_0xc20287.GetDTCOfEvent
          SC_Event_DTC_0xc20287_GetEventExtendedDataRecordEx: operation=Event_DTC_0xc20287.GetEventExtendedDataRecordEx
          SC_Event_DTC_0xc20287_GetEventFailed: operation=Event_DTC_0xc20287.GetEventFailed
          SC_Event_DTC_0xc20287_GetEventFreezeFrameDataEx: operation=Event_DTC_0xc20287.GetEventFreezeFrameDataEx
          SC_Event_DTC_0xc20287_GetEventStatus: operation=Event_DTC_0xc20287.GetEventStatus
          SC_Event_DTC_0xc20287_GetEventTested: operation=Event_DTC_0xc20287.GetEventTested
          SC_Event_DTC_0xc20287_GetEventUdsStatus: operation=Event_DTC_0xc20287.GetEventUdsStatus
          SC_Event_DTC_0xc20287_GetFaultDetectionCounter: operation=Event_DTC_0xc20287.GetFaultDetectionCounter
          SC_Event_DTC_0xc20287_ResetEventDebounceStatus: operation=Event_DTC_0xc20287.ResetEventDebounceStatus
          SC_Event_DTC_0xc20287_ResetEventStatus: operation=Event_DTC_0xc20287.ResetEventStatus
          SC_Event_DTC_0xc20287_SetEventStatus: operation=Event_DTC_0xc20287.SetEventStatus
          SC_Event_DTC_0xc20700_GetDTCOfEvent: operation=Event_DTC_0xc20700.GetDTCOfEvent
          SC_Event_DTC_0xc20700_GetEventExtendedDataRecordEx: operation=Event_DTC_0xc20700.GetEventExtendedDataRecordEx
          SC_Event_DTC_0xc20700_GetEventFailed: operation=Event_DTC_0xc20700.GetEventFailed
          SC_Event_DTC_0xc20700_GetEventFreezeFrameDataEx: operation=Event_DTC_0xc20700.GetEventFreezeFrameDataEx
          SC_Event_DTC_0xc20700_GetEventStatus: operation=Event_DTC_0xc20700.GetEventStatus
          SC_Event_DTC_0xc20700_GetEventTested: operation=Event_DTC_0xc20700.GetEventTested
          SC_Event_DTC_0xc20700_GetEventUdsStatus: operation=Event_DTC_0xc20700.GetEventUdsStatus
          SC_Event_DTC_0xc20700_GetFaultDetectionCounter: operation=Event_DTC_0xc20700.GetFaultDetectionCounter
          SC_Event_DTC_0xc20700_ResetEventDebounceStatus: operation=Event_DTC_0xc20700.ResetEventDebounceStatus
          SC_Event_DTC_0xc20700_ResetEventStatus: operation=Event_DTC_0xc20700.ResetEventStatus
          SC_Event_DTC_0xc20700_SetEventStatus: operation=Event_DTC_0xc20700.SetEventStatus
          SC_Event_DTC_0xc20787_GetDTCOfEvent: operation=Event_DTC_0xc20787.GetDTCOfEvent
          SC_Event_DTC_0xc20787_GetEventExtendedDataRecordEx: operation=Event_DTC_0xc20787.GetEventExtendedDataRecordEx
          SC_Event_DTC_0xc20787_GetEventFailed: operation=Event_DTC_0xc20787.GetEventFailed
          SC_Event_DTC_0xc20787_GetEventFreezeFrameDataEx: operation=Event_DTC_0xc20787.GetEventFreezeFrameDataEx
          SC_Event_DTC_0xc20787_GetEventStatus: operation=Event_DTC_0xc20787.GetEventStatus
          SC_Event_DTC_0xc20787_GetEventTested: operation=Event_DTC_0xc20787.GetEventTested
          SC_Event_DTC_0xc20787_GetEventUdsStatus: operation=Event_DTC_0xc20787.GetEventUdsStatus
          SC_Event_DTC_0xc20787_GetFaultDetectionCounter: operation=Event_DTC_0xc20787.GetFaultDetectionCounter
          SC_Event_DTC_0xc20787_ResetEventDebounceStatus: operation=Event_DTC_0xc20787.ResetEventDebounceStatus
          SC_Event_DTC_0xc20787_ResetEventStatus: operation=Event_DTC_0xc20787.ResetEventStatus
          SC_Event_DTC_0xc20787_SetEventStatus: operation=Event_DTC_0xc20787.SetEventStatus
          SC_Event_DTC_0xc29a00_GetDTCOfEvent: operation=Event_DTC_0xc29a00.GetDTCOfEvent
          SC_Event_DTC_0xc29a00_GetEventExtendedDataRecordEx: operation=Event_DTC_0xc29a00.GetEventExtendedDataRecordEx
          SC_Event_DTC_0xc29a00_GetEventFailed: operation=Event_DTC_0xc29a00.GetEventFailed
          SC_Event_DTC_0xc29a00_GetEventFreezeFrameDataEx: operation=Event_DTC_0xc29a00.GetEventFreezeFrameDataEx
          SC_Event_DTC_0xc29a00_GetEventStatus: operation=Event_DTC_0xc29a00.GetEventStatus
          SC_Event_DTC_0xc29a00_GetEventTested: operation=Event_DTC_0xc29a00.GetEventTested
          SC_Event_DTC_0xc29a00_GetEventUdsStatus: operation=Event_DTC_0xc29a00.GetEventUdsStatus
          SC_Event_DTC_0xc29a00_GetFaultDetectionCounter: operation=Event_DTC_0xc29a00.GetFaultDetectionCounter
          SC_Event_DTC_0xc29a00_ResetEventDebounceStatus: operation=Event_DTC_0xc29a00.ResetEventDebounceStatus
          SC_Event_DTC_0xc29a00_ResetEventStatus: operation=Event_DTC_0xc29a00.ResetEventStatus
          SC_Event_DTC_0xc29a00_SetEventStatus: operation=Event_DTC_0xc29a00.SetEventStatus
          SC_Event_DTC_0xd12688_GetDTCOfEvent: operation=Event_DTC_0xd12688.GetDTCOfEvent
          SC_Event_DTC_0xd12688_GetEventExtendedDataRecordEx: operation=Event_DTC_0xd12688.GetEventExtendedDataRecordEx
          SC_Event_DTC_0xd12688_GetEventFailed: operation=Event_DTC_0xd12688.GetEventFailed
          SC_Event_DTC_0xd12688_GetEventFreezeFrameDataEx: operation=Event_DTC_0xd12688.GetEventFreezeFrameDataEx
          SC_Event_DTC_0xd12688_GetEventStatus: operation=Event_DTC_0xd12688.GetEventStatus
          SC_Event_DTC_0xd12688_GetEventTested: operation=Event_DTC_0xd12688.GetEventTested
          SC_Event_DTC_0xd12688_GetEventUdsStatus: operation=Event_DTC_0xd12688.GetEventUdsStatus
          SC_Event_DTC_0xd12688_GetFaultDetectionCounter: operation=Event_DTC_0xd12688.GetFaultDetectionCounter
          SC_Event_DTC_0xd12688_ResetEventDebounceStatus: operation=Event_DTC_0xd12688.ResetEventDebounceStatus
          SC_Event_DTC_0xd12688_ResetEventStatus: operation=Event_DTC_0xd12688.ResetEventStatus
          SC_Event_DTC_0xd12688_SetEventStatus: operation=Event_DTC_0xd12688.SetEventStatus
          SC_EvtInfo_DTC_0x117205_GetDTCOfEvent: operation=EvtInfo_DTC_0x117205.GetDTCOfEvent
          SC_EvtInfo_DTC_0x117205_GetDebouncingOfEvent: operation=EvtInfo_DTC_0x117205.GetDebouncingOfEvent
          SC_EvtInfo_DTC_0x117205_GetEventEnableCondition: operation=EvtInfo_DTC_0x117205.GetEventEnableCondition
          SC_EvtInfo_DTC_0x117205_GetEventExtendedDataRecordEx: operation=EvtInfo_DTC_0x117205.GetEventExtendedDataRecordEx
          SC_EvtInfo_DTC_0x117205_GetEventFailed: operation=EvtInfo_DTC_0x117205.GetEventFailed
          SC_EvtInfo_DTC_0x117205_GetEventFreezeFrameDataEx: operation=EvtInfo_DTC_0x117205.GetEventFreezeFrameDataEx
          SC_EvtInfo_DTC_0x117205_GetEventStatus: operation=EvtInfo_DTC_0x117205.GetEventStatus
          SC_EvtInfo_DTC_0x117205_GetEventTested: operation=EvtInfo_DTC_0x117205.GetEventTested
          SC_EvtInfo_DTC_0x117205_GetEventUdsStatus: operation=EvtInfo_DTC_0x117205.GetEventUdsStatus
          SC_EvtInfo_DTC_0x117205_GetFaultDetectionCounter: operation=EvtInfo_DTC_0x117205.GetFaultDetectionCounter
          SC_EvtInfo_DTC_0x117205_GetMonitorStatus: operation=EvtInfo_DTC_0x117205.GetMonitorStatus
          SC_EvtInfo_DTC_0x117305_GetDTCOfEvent: operation=EvtInfo_DTC_0x117305.GetDTCOfEvent
          SC_EvtInfo_DTC_0x117305_GetDebouncingOfEvent: operation=EvtInfo_DTC_0x117305.GetDebouncingOfEvent
          SC_EvtInfo_DTC_0x117305_GetEventEnableCondition: operation=EvtInfo_DTC_0x117305.GetEventEnableCondition
          SC_EvtInfo_DTC_0x117305_GetEventExtendedDataRecordEx: operation=EvtInfo_DTC_0x117305.GetEventExtendedDataRecordEx
          SC_EvtInfo_DTC_0x117305_GetEventFailed: operation=EvtInfo_DTC_0x117305.GetEventFailed
          SC_EvtInfo_DTC_0x117305_GetEventFreezeFrameDataEx: operation=EvtInfo_DTC_0x117305.GetEventFreezeFrameDataEx
          SC_EvtInfo_DTC_0x117305_GetEventStatus: operation=EvtInfo_DTC_0x117305.GetEventStatus
          SC_EvtInfo_DTC_0x117305_GetEventTested: operation=EvtInfo_DTC_0x117305.GetEventTested
          SC_EvtInfo_DTC_0x117305_GetEventUdsStatus: operation=EvtInfo_DTC_0x117305.GetEventUdsStatus
          SC_EvtInfo_DTC_0x117305_GetFaultDetectionCounter: operation=EvtInfo_DTC_0x117305.GetFaultDetectionCounter
          SC_EvtInfo_DTC_0x117305_GetMonitorStatus: operation=EvtInfo_DTC_0x117305.GetMonitorStatus
          SC_EvtInfo_DTC_0x117405_GetDTCOfEvent: operation=EvtInfo_DTC_0x117405.GetDTCOfEvent
          SC_EvtInfo_DTC_0x117405_GetDebouncingOfEvent: operation=EvtInfo_DTC_0x117405.GetDebouncingOfEvent
          SC_EvtInfo_DTC_0x117405_GetEventEnableCondition: operation=EvtInfo_DTC_0x117405.GetEventEnableCondition
          SC_EvtInfo_DTC_0x117405_GetEventExtendedDataRecordEx: operation=EvtInfo_DTC_0x117405.GetEventExtendedDataRecordEx
          SC_EvtInfo_DTC_0x117405_GetEventFailed: operation=EvtInfo_DTC_0x117405.GetEventFailed
          SC_EvtInfo_DTC_0x117405_GetEventFreezeFrameDataEx: operation=EvtInfo_DTC_0x117405.GetEventFreezeFrameDataEx
          SC_EvtInfo_DTC_0x117405_GetEventStatus: operation=EvtInfo_DTC_0x117405.GetEventStatus
          SC_EvtInfo_DTC_0x117405_GetEventTested: operation=EvtInfo_DTC_0x117405.GetEventTested
          SC_EvtInfo_DTC_0x117405_GetEventUdsStatus: operation=EvtInfo_DTC_0x117405.GetEventUdsStatus
          SC_EvtInfo_DTC_0x117405_GetFaultDetectionCounter: operation=EvtInfo_DTC_0x117405.GetFaultDetectionCounter
          SC_EvtInfo_DTC_0x117405_GetMonitorStatus: operation=EvtInfo_DTC_0x117405.GetMonitorStatus
          SC_EvtInfo_DTC_0x117617_GetDTCOfEvent: operation=EvtInfo_DTC_0x117617.GetDTCOfEvent
          SC_EvtInfo_DTC_0x117617_GetDebouncingOfEvent: operation=EvtInfo_DTC_0x117617.GetDebouncingOfEvent
          SC_EvtInfo_DTC_0x117617_GetEventEnableCondition: operation=EvtInfo_DTC_0x117617.GetEventEnableCondition
          SC_EvtInfo_DTC_0x117617_GetEventExtendedDataRecordEx: operation=EvtInfo_DTC_0x117617.GetEventExtendedDataRecordEx
          SC_EvtInfo_DTC_0x117617_GetEventFailed: operation=EvtInfo_DTC_0x117617.GetEventFailed
          SC_EvtInfo_DTC_0x117617_GetEventFreezeFrameDataEx: operation=EvtInfo_DTC_0x117617.GetEventFreezeFrameDataEx
          SC_EvtInfo_DTC_0x117617_GetEventStatus: operation=EvtInfo_DTC_0x117617.GetEventStatus
          SC_EvtInfo_DTC_0x117617_GetEventTested: operation=EvtInfo_DTC_0x117617.GetEventTested
          SC_EvtInfo_DTC_0x117617_GetEventUdsStatus: operation=EvtInfo_DTC_0x117617.GetEventUdsStatus
          SC_EvtInfo_DTC_0x117617_GetFaultDetectionCounter: operation=EvtInfo_DTC_0x117617.GetFaultDetectionCounter
          SC_EvtInfo_DTC_0x117617_GetMonitorStatus: operation=EvtInfo_DTC_0x117617.GetMonitorStatus
          SC_EvtInfo_DTC_0x117716_GetDTCOfEvent: operation=EvtInfo_DTC_0x117716.GetDTCOfEvent
          SC_EvtInfo_DTC_0x117716_GetDebouncingOfEvent: operation=EvtInfo_DTC_0x117716.GetDebouncingOfEvent
          SC_EvtInfo_DTC_0x117716_GetEventEnableCondition: operation=EvtInfo_DTC_0x117716.GetEventEnableCondition
          SC_EvtInfo_DTC_0x117716_GetEventExtendedDataRecordEx: operation=EvtInfo_DTC_0x117716.GetEventExtendedDataRecordEx
          SC_EvtInfo_DTC_0x117716_GetEventFailed: operation=EvtInfo_DTC_0x117716.GetEventFailed
          SC_EvtInfo_DTC_0x117716_GetEventFreezeFrameDataEx: operation=EvtInfo_DTC_0x117716.GetEventFreezeFrameDataEx
          SC_EvtInfo_DTC_0x117716_GetEventStatus: operation=EvtInfo_DTC_0x117716.GetEventStatus
          SC_EvtInfo_DTC_0x117716_GetEventTested: operation=EvtInfo_DTC_0x117716.GetEventTested
          SC_EvtInfo_DTC_0x117716_GetEventUdsStatus: operation=EvtInfo_DTC_0x117716.GetEventUdsStatus
          SC_EvtInfo_DTC_0x117716_GetFaultDetectionCounter: operation=EvtInfo_DTC_0x117716.GetFaultDetectionCounter
          SC_EvtInfo_DTC_0x117716_GetMonitorStatus: operation=EvtInfo_DTC_0x117716.GetMonitorStatus
          SC_EvtInfo_DTC_0x117819_GetDTCOfEvent: operation=EvtInfo_DTC_0x117819.GetDTCOfEvent
          SC_EvtInfo_DTC_0x117819_GetDebouncingOfEvent: operation=EvtInfo_DTC_0x117819.GetDebouncingOfEvent
          SC_EvtInfo_DTC_0x117819_GetEventEnableCondition: operation=EvtInfo_DTC_0x117819.GetEventEnableCondition
          SC_EvtInfo_DTC_0x117819_GetEventExtendedDataRecordEx: operation=EvtInfo_DTC_0x117819.GetEventExtendedDataRecordEx
          SC_EvtInfo_DTC_0x117819_GetEventFailed: operation=EvtInfo_DTC_0x117819.GetEventFailed
          SC_EvtInfo_DTC_0x117819_GetEventFreezeFrameDataEx: operation=EvtInfo_DTC_0x117819.GetEventFreezeFrameDataEx
          SC_EvtInfo_DTC_0x117819_GetEventStatus: operation=EvtInfo_DTC_0x117819.GetEventStatus
          SC_EvtInfo_DTC_0x117819_GetEventTested: operation=EvtInfo_DTC_0x117819.GetEventTested
          SC_EvtInfo_DTC_0x117819_GetEventUdsStatus: operation=EvtInfo_DTC_0x117819.GetEventUdsStatus
          SC_EvtInfo_DTC_0x117819_GetFaultDetectionCounter: operation=EvtInfo_DTC_0x117819.GetFaultDetectionCounter
          SC_EvtInfo_DTC_0x117819_GetMonitorStatus: operation=EvtInfo_DTC_0x117819.GetMonitorStatus
          SC_EvtInfo_DTC_0x11794b_GetDTCOfEvent: operation=EvtInfo_DTC_0x11794b.GetDTCOfEvent
          SC_EvtInfo_DTC_0x11794b_GetDebouncingOfEvent: operation=EvtInfo_DTC_0x11794b.GetDebouncingOfEvent
          SC_EvtInfo_DTC_0x11794b_GetEventEnableCondition: operation=EvtInfo_DTC_0x11794b.GetEventEnableCondition
          SC_EvtInfo_DTC_0x11794b_GetEventExtendedDataRecordEx: operation=EvtInfo_DTC_0x11794b.GetEventExtendedDataRecordEx
          SC_EvtInfo_DTC_0x11794b_GetEventFailed: operation=EvtInfo_DTC_0x11794b.GetEventFailed
          SC_EvtInfo_DTC_0x11794b_GetEventFreezeFrameDataEx: operation=EvtInfo_DTC_0x11794b.GetEventFreezeFrameDataEx
          SC_EvtInfo_DTC_0x11794b_GetEventStatus: operation=EvtInfo_DTC_0x11794b.GetEventStatus
          SC_EvtInfo_DTC_0x11794b_GetEventTested: operation=EvtInfo_DTC_0x11794b.GetEventTested
          SC_EvtInfo_DTC_0x11794b_GetEventUdsStatus: operation=EvtInfo_DTC_0x11794b.GetEventUdsStatus
          SC_EvtInfo_DTC_0x11794b_GetFaultDetectionCounter: operation=EvtInfo_DTC_0x11794b.GetFaultDetectionCounter
          SC_EvtInfo_DTC_0x11794b_GetMonitorStatus: operation=EvtInfo_DTC_0x11794b.GetMonitorStatus
          SC_EvtInfo_DTC_0x117a4c_GetDTCOfEvent: operation=EvtInfo_DTC_0x117a4c.GetDTCOfEvent
          SC_EvtInfo_DTC_0x117a4c_GetDebouncingOfEvent: operation=EvtInfo_DTC_0x117a4c.GetDebouncingOfEvent
          SC_EvtInfo_DTC_0x117a4c_GetEventEnableCondition: operation=EvtInfo_DTC_0x117a4c.GetEventEnableCondition
          SC_EvtInfo_DTC_0x117a4c_GetEventExtendedDataRecordEx: operation=EvtInfo_DTC_0x117a4c.GetEventExtendedDataRecordEx
          SC_EvtInfo_DTC_0x117a4c_GetEventFailed: operation=EvtInfo_DTC_0x117a4c.GetEventFailed
          SC_EvtInfo_DTC_0x117a4c_GetEventFreezeFrameDataEx: operation=EvtInfo_DTC_0x117a4c.GetEventFreezeFrameDataEx
          SC_EvtInfo_DTC_0x117a4c_GetEventStatus: operation=EvtInfo_DTC_0x117a4c.GetEventStatus
          SC_EvtInfo_DTC_0x117a4c_GetEventTested: operation=EvtInfo_DTC_0x117a4c.GetEventTested
          SC_EvtInfo_DTC_0x117a4c_GetEventUdsStatus: operation=EvtInfo_DTC_0x117a4c.GetEventUdsStatus
          SC_EvtInfo_DTC_0x117a4c_GetFaultDetectionCounter: operation=EvtInfo_DTC_0x117a4c.GetFaultDetectionCounter
          SC_EvtInfo_DTC_0x117a4c_GetMonitorStatus: operation=EvtInfo_DTC_0x117a4c.GetMonitorStatus
          SC_EvtInfo_DTC_0x117b94_GetDTCOfEvent: operation=EvtInfo_DTC_0x117b94.GetDTCOfEvent
          SC_EvtInfo_DTC_0x117b94_GetDebouncingOfEvent: operation=EvtInfo_DTC_0x117b94.GetDebouncingOfEvent
          SC_EvtInfo_DTC_0x117b94_GetEventEnableCondition: operation=EvtInfo_DTC_0x117b94.GetEventEnableCondition
          SC_EvtInfo_DTC_0x117b94_GetEventExtendedDataRecordEx: operation=EvtInfo_DTC_0x117b94.GetEventExtendedDataRecordEx
          SC_EvtInfo_DTC_0x117b94_GetEventFailed: operation=EvtInfo_DTC_0x117b94.GetEventFailed
          SC_EvtInfo_DTC_0x117b94_GetEventFreezeFrameDataEx: operation=EvtInfo_DTC_0x117b94.GetEventFreezeFrameDataEx
          SC_EvtInfo_DTC_0x117b94_GetEventStatus: operation=EvtInfo_DTC_0x117b94.GetEventStatus
          SC_EvtInfo_DTC_0x117b94_GetEventTested: operation=EvtInfo_DTC_0x117b94.GetEventTested
          SC_EvtInfo_DTC_0x117b94_GetEventUdsStatus: operation=EvtInfo_DTC_0x117b94.GetEventUdsStatus
          SC_EvtInfo_DTC_0x117b94_GetFaultDetectionCounter: operation=EvtInfo_DTC_0x117b94.GetFaultDetectionCounter
          SC_EvtInfo_DTC_0x117b94_GetMonitorStatus: operation=EvtInfo_DTC_0x117b94.GetMonitorStatus
          SC_EvtInfo_DTC_0x117c08_GetDTCOfEvent: operation=EvtInfo_DTC_0x117c08.GetDTCOfEvent
          SC_EvtInfo_DTC_0x117c08_GetDebouncingOfEvent: operation=EvtInfo_DTC_0x117c08.GetDebouncingOfEvent
          SC_EvtInfo_DTC_0x117c08_GetEventEnableCondition: operation=EvtInfo_DTC_0x117c08.GetEventEnableCondition
          SC_EvtInfo_DTC_0x117c08_GetEventExtendedDataRecordEx: operation=EvtInfo_DTC_0x117c08.GetEventExtendedDataRecordEx
          SC_EvtInfo_DTC_0x117c08_GetEventFailed: operation=EvtInfo_DTC_0x117c08.GetEventFailed
          SC_EvtInfo_DTC_0x117c08_GetEventFreezeFrameDataEx: operation=EvtInfo_DTC_0x117c08.GetEventFreezeFrameDataEx
          SC_EvtInfo_DTC_0x117c08_GetEventStatus: operation=EvtInfo_DTC_0x117c08.GetEventStatus
          SC_EvtInfo_DTC_0x117c08_GetEventTested: operation=EvtInfo_DTC_0x117c08.GetEventTested
          SC_EvtInfo_DTC_0x117c08_GetEventUdsStatus: operation=EvtInfo_DTC_0x117c08.GetEventUdsStatus
          SC_EvtInfo_DTC_0x117c08_GetFaultDetectionCounter: operation=EvtInfo_DTC_0x117c08.GetFaultDetectionCounter
          SC_EvtInfo_DTC_0x117c08_GetMonitorStatus: operation=EvtInfo_DTC_0x117c08.GetMonitorStatus
          SC_EvtInfo_DTC_0x117d08_GetDTCOfEvent: operation=EvtInfo_DTC_0x117d08.GetDTCOfEvent
          SC_EvtInfo_DTC_0x117d08_GetDebouncingOfEvent: operation=EvtInfo_DTC_0x117d08.GetDebouncingOfEvent
          SC_EvtInfo_DTC_0x117d08_GetEventEnableCondition: operation=EvtInfo_DTC_0x117d08.GetEventEnableCondition
          SC_EvtInfo_DTC_0x117d08_GetEventExtendedDataRecordEx: operation=EvtInfo_DTC_0x117d08.GetEventExtendedDataRecordEx
          SC_EvtInfo_DTC_0x117d08_GetEventFailed: operation=EvtInfo_DTC_0x117d08.GetEventFailed
          SC_EvtInfo_DTC_0x117d08_GetEventFreezeFrameDataEx: operation=EvtInfo_DTC_0x117d08.GetEventFreezeFrameDataEx
          SC_EvtInfo_DTC_0x117d08_GetEventStatus: operation=EvtInfo_DTC_0x117d08.GetEventStatus
          SC_EvtInfo_DTC_0x117d08_GetEventTested: operation=EvtInfo_DTC_0x117d08.GetEventTested
          SC_EvtInfo_DTC_0x117d08_GetEventUdsStatus: operation=EvtInfo_DTC_0x117d08.GetEventUdsStatus
          SC_EvtInfo_DTC_0x117d08_GetFaultDetectionCounter: operation=EvtInfo_DTC_0x117d08.GetFaultDetectionCounter
          SC_EvtInfo_DTC_0x117d08_GetMonitorStatus: operation=EvtInfo_DTC_0x117d08.GetMonitorStatus
          SC_EvtInfo_DTC_0x117e52_GetDTCOfEvent: operation=EvtInfo_DTC_0x117e52.GetDTCOfEvent
          SC_EvtInfo_DTC_0x117e52_GetDebouncingOfEvent: operation=EvtInfo_DTC_0x117e52.GetDebouncingOfEvent
          SC_EvtInfo_DTC_0x117e52_GetEventEnableCondition: operation=EvtInfo_DTC_0x117e52.GetEventEnableCondition
          SC_EvtInfo_DTC_0x117e52_GetEventExtendedDataRecordEx: operation=EvtInfo_DTC_0x117e52.GetEventExtendedDataRecordEx
          SC_EvtInfo_DTC_0x117e52_GetEventFailed: operation=EvtInfo_DTC_0x117e52.GetEventFailed
          SC_EvtInfo_DTC_0x117e52_GetEventFreezeFrameDataEx: operation=EvtInfo_DTC_0x117e52.GetEventFreezeFrameDataEx
          SC_EvtInfo_DTC_0x117e52_GetEventStatus: operation=EvtInfo_DTC_0x117e52.GetEventStatus
          SC_EvtInfo_DTC_0x117e52_GetEventTested: operation=EvtInfo_DTC_0x117e52.GetEventTested
          SC_EvtInfo_DTC_0x117e52_GetEventUdsStatus: operation=EvtInfo_DTC_0x117e52.GetEventUdsStatus
          SC_EvtInfo_DTC_0x117e52_GetFaultDetectionCounter: operation=EvtInfo_DTC_0x117e52.GetFaultDetectionCounter
          SC_EvtInfo_DTC_0x117e52_GetMonitorStatus: operation=EvtInfo_DTC_0x117e52.GetMonitorStatus
          SC_EvtInfo_DTC_0x117f08_GetDTCOfEvent: operation=EvtInfo_DTC_0x117f08.GetDTCOfEvent
          SC_EvtInfo_DTC_0x117f08_GetDebouncingOfEvent: operation=EvtInfo_DTC_0x117f08.GetDebouncingOfEvent
          SC_EvtInfo_DTC_0x117f08_GetEventEnableCondition: operation=EvtInfo_DTC_0x117f08.GetEventEnableCondition
          SC_EvtInfo_DTC_0x117f08_GetEventExtendedDataRecordEx: operation=EvtInfo_DTC_0x117f08.GetEventExtendedDataRecordEx
          SC_EvtInfo_DTC_0x117f08_GetEventFailed: operation=EvtInfo_DTC_0x117f08.GetEventFailed
          SC_EvtInfo_DTC_0x117f08_GetEventFreezeFrameDataEx: operation=EvtInfo_DTC_0x117f08.GetEventFreezeFrameDataEx
          SC_EvtInfo_DTC_0x117f08_GetEventStatus: operation=EvtInfo_DTC_0x117f08.GetEventStatus
          SC_EvtInfo_DTC_0x117f08_GetEventTested: operation=EvtInfo_DTC_0x117f08.GetEventTested
          SC_EvtInfo_DTC_0x117f08_GetEventUdsStatus: operation=EvtInfo_DTC_0x117f08.GetEventUdsStatus
          SC_EvtInfo_DTC_0x117f08_GetFaultDetectionCounter: operation=EvtInfo_DTC_0x117f08.GetFaultDetectionCounter
          SC_EvtInfo_DTC_0x117f08_GetMonitorStatus: operation=EvtInfo_DTC_0x117f08.GetMonitorStatus
          SC_EvtInfo_DTC_0xc14887_GetDTCOfEvent: operation=EvtInfo_DTC_0xc14887.GetDTCOfEvent
          SC_EvtInfo_DTC_0xc14887_GetDebouncingOfEvent: operation=EvtInfo_DTC_0xc14887.GetDebouncingOfEvent
          SC_EvtInfo_DTC_0xc14887_GetEventEnableCondition: operation=EvtInfo_DTC_0xc14887.GetEventEnableCondition
          SC_EvtInfo_DTC_0xc14887_GetEventExtendedDataRecordEx: operation=EvtInfo_DTC_0xc14887.GetEventExtendedDataRecordEx
          SC_EvtInfo_DTC_0xc14887_GetEventFailed: operation=EvtInfo_DTC_0xc14887.GetEventFailed
          SC_EvtInfo_DTC_0xc14887_GetEventFreezeFrameDataEx: operation=EvtInfo_DTC_0xc14887.GetEventFreezeFrameDataEx
          SC_EvtInfo_DTC_0xc14887_GetEventStatus: operation=EvtInfo_DTC_0xc14887.GetEventStatus
          SC_EvtInfo_DTC_0xc14887_GetEventTested: operation=EvtInfo_DTC_0xc14887.GetEventTested
          SC_EvtInfo_DTC_0xc14887_GetEventUdsStatus: operation=EvtInfo_DTC_0xc14887.GetEventUdsStatus
          SC_EvtInfo_DTC_0xc14887_GetFaultDetectionCounter: operation=EvtInfo_DTC_0xc14887.GetFaultDetectionCounter
          SC_EvtInfo_DTC_0xc14887_GetMonitorStatus: operation=EvtInfo_DTC_0xc14887.GetMonitorStatus
          SC_EvtInfo_DTC_0xc20087_GetDTCOfEvent: operation=EvtInfo_DTC_0xc20087.GetDTCOfEvent
          SC_EvtInfo_DTC_0xc20087_GetDebouncingOfEvent: operation=EvtInfo_DTC_0xc20087.GetDebouncingOfEvent
          SC_EvtInfo_DTC_0xc20087_GetEventEnableCondition: operation=EvtInfo_DTC_0xc20087.GetEventEnableCondition
          SC_EvtInfo_DTC_0xc20087_GetEventExtendedDataRecordEx: operation=EvtInfo_DTC_0xc20087.GetEventExtendedDataRecordEx
          SC_EvtInfo_DTC_0xc20087_GetEventFailed: operation=EvtInfo_DTC_0xc20087.GetEventFailed
          SC_EvtInfo_DTC_0xc20087_GetEventFreezeFrameDataEx: operation=EvtInfo_DTC_0xc20087.GetEventFreezeFrameDataEx
          SC_EvtInfo_DTC_0xc20087_GetEventStatus: operation=EvtInfo_DTC_0xc20087.GetEventStatus
          SC_EvtInfo_DTC_0xc20087_GetEventTested: operation=EvtInfo_DTC_0xc20087.GetEventTested
          SC_EvtInfo_DTC_0xc20087_GetEventUdsStatus: operation=EvtInfo_DTC_0xc20087.GetEventUdsStatus
          SC_EvtInfo_DTC_0xc20087_GetFaultDetectionCounter: operation=EvtInfo_DTC_0xc20087.GetFaultDetectionCounter
          SC_EvtInfo_DTC_0xc20087_GetMonitorStatus: operation=EvtInfo_DTC_0xc20087.GetMonitorStatus
          SC_EvtInfo_DTC_0xc20187_GetDTCOfEvent: operation=EvtInfo_DTC_0xc20187.GetDTCOfEvent
          SC_EvtInfo_DTC_0xc20187_GetDebouncingOfEvent: operation=EvtInfo_DTC_0xc20187.GetDebouncingOfEvent
          SC_EvtInfo_DTC_0xc20187_GetEventEnableCondition: operation=EvtInfo_DTC_0xc20187.GetEventEnableCondition
          SC_EvtInfo_DTC_0xc20187_GetEventExtendedDataRecordEx: operation=EvtInfo_DTC_0xc20187.GetEventExtendedDataRecordEx
          SC_EvtInfo_DTC_0xc20187_GetEventFailed: operation=EvtInfo_DTC_0xc20187.GetEventFailed
          SC_EvtInfo_DTC_0xc20187_GetEventFreezeFrameDataEx: operation=EvtInfo_DTC_0xc20187.GetEventFreezeFrameDataEx
          SC_EvtInfo_DTC_0xc20187_GetEventStatus: operation=EvtInfo_DTC_0xc20187.GetEventStatus
          SC_EvtInfo_DTC_0xc20187_GetEventTested: operation=EvtInfo_DTC_0xc20187.GetEventTested
          SC_EvtInfo_DTC_0xc20187_GetEventUdsStatus: operation=EvtInfo_DTC_0xc20187.GetEventUdsStatus
          SC_EvtInfo_DTC_0xc20187_GetFaultDetectionCounter: operation=EvtInfo_DTC_0xc20187.GetFaultDetectionCounter
          SC_EvtInfo_DTC_0xc20187_GetMonitorStatus: operation=EvtInfo_DTC_0xc20187.GetMonitorStatus
          SC_EvtInfo_DTC_0xc20287_GetDTCOfEvent: operation=EvtInfo_DTC_0xc20287.GetDTCOfEvent
          SC_EvtInfo_DTC_0xc20287_GetDebouncingOfEvent: operation=EvtInfo_DTC_0xc20287.GetDebouncingOfEvent
          SC_EvtInfo_DTC_0xc20287_GetEventEnableCondition: operation=EvtInfo_DTC_0xc20287.GetEventEnableCondition
          SC_EvtInfo_DTC_0xc20287_GetEventExtendedDataRecordEx: operation=EvtInfo_DTC_0xc20287.GetEventExtendedDataRecordEx
          SC_EvtInfo_DTC_0xc20287_GetEventFailed: operation=EvtInfo_DTC_0xc20287.GetEventFailed
          SC_EvtInfo_DTC_0xc20287_GetEventFreezeFrameDataEx: operation=EvtInfo_DTC_0xc20287.GetEventFreezeFrameDataEx
          SC_EvtInfo_DTC_0xc20287_GetEventStatus: operation=EvtInfo_DTC_0xc20287.GetEventStatus
          SC_EvtInfo_DTC_0xc20287_GetEventTested: operation=EvtInfo_DTC_0xc20287.GetEventTested
          SC_EvtInfo_DTC_0xc20287_GetEventUdsStatus: operation=EvtInfo_DTC_0xc20287.GetEventUdsStatus
          SC_EvtInfo_DTC_0xc20287_GetFaultDetectionCounter: operation=EvtInfo_DTC_0xc20287.GetFaultDetectionCounter
          SC_EvtInfo_DTC_0xc20287_GetMonitorStatus: operation=EvtInfo_DTC_0xc20287.GetMonitorStatus
          SC_EvtInfo_DTC_0xc20700_GetDTCOfEvent: operation=EvtInfo_DTC_0xc20700.GetDTCOfEvent
          SC_EvtInfo_DTC_0xc20700_GetDebouncingOfEvent: operation=EvtInfo_DTC_0xc20700.GetDebouncingOfEvent
          SC_EvtInfo_DTC_0xc20700_GetEventEnableCondition: operation=EvtInfo_DTC_0xc20700.GetEventEnableCondition
          SC_EvtInfo_DTC_0xc20700_GetEventExtendedDataRecordEx: operation=EvtInfo_DTC_0xc20700.GetEventExtendedDataRecordEx
          SC_EvtInfo_DTC_0xc20700_GetEventFailed: operation=EvtInfo_DTC_0xc20700.GetEventFailed
          SC_EvtInfo_DTC_0xc20700_GetEventFreezeFrameDataEx: operation=EvtInfo_DTC_0xc20700.GetEventFreezeFrameDataEx
          SC_EvtInfo_DTC_0xc20700_GetEventStatus: operation=EvtInfo_DTC_0xc20700.GetEventStatus
          SC_EvtInfo_DTC_0xc20700_GetEventTested: operation=EvtInfo_DTC_0xc20700.GetEventTested
          SC_EvtInfo_DTC_0xc20700_GetEventUdsStatus: operation=EvtInfo_DTC_0xc20700.GetEventUdsStatus
          SC_EvtInfo_DTC_0xc20700_GetFaultDetectionCounter: operation=EvtInfo_DTC_0xc20700.GetFaultDetectionCounter
          SC_EvtInfo_DTC_0xc20700_GetMonitorStatus: operation=EvtInfo_DTC_0xc20700.GetMonitorStatus
          SC_EvtInfo_DTC_0xc20787_GetDTCOfEvent: operation=EvtInfo_DTC_0xc20787.GetDTCOfEvent
          SC_EvtInfo_DTC_0xc20787_GetDebouncingOfEvent: operation=EvtInfo_DTC_0xc20787.GetDebouncingOfEvent
          SC_EvtInfo_DTC_0xc20787_GetEventEnableCondition: operation=EvtInfo_DTC_0xc20787.GetEventEnableCondition
          SC_EvtInfo_DTC_0xc20787_GetEventExtendedDataRecordEx: operation=EvtInfo_DTC_0xc20787.GetEventExtendedDataRecordEx
          SC_EvtInfo_DTC_0xc20787_GetEventFailed: operation=EvtInfo_DTC_0xc20787.GetEventFailed
          SC_EvtInfo_DTC_0xc20787_GetEventFreezeFrameDataEx: operation=EvtInfo_DTC_0xc20787.GetEventFreezeFrameDataEx
          SC_EvtInfo_DTC_0xc20787_GetEventStatus: operation=EvtInfo_DTC_0xc20787.GetEventStatus
          SC_EvtInfo_DTC_0xc20787_GetEventTested: operation=EvtInfo_DTC_0xc20787.GetEventTested
          SC_EvtInfo_DTC_0xc20787_GetEventUdsStatus: operation=EvtInfo_DTC_0xc20787.GetEventUdsStatus
          SC_EvtInfo_DTC_0xc20787_GetFaultDetectionCounter: operation=EvtInfo_DTC_0xc20787.GetFaultDetectionCounter
          SC_EvtInfo_DTC_0xc20787_GetMonitorStatus: operation=EvtInfo_DTC_0xc20787.GetMonitorStatus
          SC_EvtInfo_DTC_0xc29a00_GetDTCOfEvent: operation=EvtInfo_DTC_0xc29a00.GetDTCOfEvent
          SC_EvtInfo_DTC_0xc29a00_GetDebouncingOfEvent: operation=EvtInfo_DTC_0xc29a00.GetDebouncingOfEvent
          SC_EvtInfo_DTC_0xc29a00_GetEventEnableCondition: operation=EvtInfo_DTC_0xc29a00.GetEventEnableCondition
          SC_EvtInfo_DTC_0xc29a00_GetEventExtendedDataRecordEx: operation=EvtInfo_DTC_0xc29a00.GetEventExtendedDataRecordEx
          SC_EvtInfo_DTC_0xc29a00_GetEventFailed: operation=EvtInfo_DTC_0xc29a00.GetEventFailed
          SC_EvtInfo_DTC_0xc29a00_GetEventFreezeFrameDataEx: operation=EvtInfo_DTC_0xc29a00.GetEventFreezeFrameDataEx
          SC_EvtInfo_DTC_0xc29a00_GetEventStatus: operation=EvtInfo_DTC_0xc29a00.GetEventStatus
          SC_EvtInfo_DTC_0xc29a00_GetEventTested: operation=EvtInfo_DTC_0xc29a00.GetEventTested
          SC_EvtInfo_DTC_0xc29a00_GetEventUdsStatus: operation=EvtInfo_DTC_0xc29a00.GetEventUdsStatus
          SC_EvtInfo_DTC_0xc29a00_GetFaultDetectionCounter: operation=EvtInfo_DTC_0xc29a00.GetFaultDetectionCounter
          SC_EvtInfo_DTC_0xc29a00_GetMonitorStatus: operation=EvtInfo_DTC_0xc29a00.GetMonitorStatus
          SC_EvtInfo_DTC_0xd12688_GetDTCOfEvent: operation=EvtInfo_DTC_0xd12688.GetDTCOfEvent
          SC_EvtInfo_DTC_0xd12688_GetDebouncingOfEvent: operation=EvtInfo_DTC_0xd12688.GetDebouncingOfEvent
          SC_EvtInfo_DTC_0xd12688_GetEventEnableCondition: operation=EvtInfo_DTC_0xd12688.GetEventEnableCondition
          SC_EvtInfo_DTC_0xd12688_GetEventExtendedDataRecordEx: operation=EvtInfo_DTC_0xd12688.GetEventExtendedDataRecordEx
          SC_EvtInfo_DTC_0xd12688_GetEventFailed: operation=EvtInfo_DTC_0xd12688.GetEventFailed
          SC_EvtInfo_DTC_0xd12688_GetEventFreezeFrameDataEx: operation=EvtInfo_DTC_0xd12688.GetEventFreezeFrameDataEx
          SC_EvtInfo_DTC_0xd12688_GetEventStatus: operation=EvtInfo_DTC_0xd12688.GetEventStatus
          SC_EvtInfo_DTC_0xd12688_GetEventTested: operation=EvtInfo_DTC_0xd12688.GetEventTested
          SC_EvtInfo_DTC_0xd12688_GetEventUdsStatus: operation=EvtInfo_DTC_0xd12688.GetEventUdsStatus
          SC_EvtInfo_DTC_0xd12688_GetFaultDetectionCounter: operation=EvtInfo_DTC_0xd12688.GetFaultDetectionCounter
          SC_EvtInfo_DTC_0xd12688_GetMonitorStatus: operation=EvtInfo_DTC_0xd12688.GetMonitorStatus
          SC_Event_DTC_0xC07388_GetDTCOfEvent: operation=Event_DTC_0xC07388.GetDTCOfEvent
          SC_Event_DTC_0xC07388_GetEventExtendedDataRecordEx: operation=Event_DTC_0xC07388.GetEventExtendedDataRecordEx
          SC_Event_DTC_0xC07388_GetEventFailed: operation=Event_DTC_0xC07388.GetEventFailed
          SC_Event_DTC_0xC07388_GetEventFreezeFrameDataEx: operation=Event_DTC_0xC07388.GetEventFreezeFrameDataEx
          SC_Event_DTC_0xC07388_GetEventStatus: operation=Event_DTC_0xC07388.GetEventStatus
          SC_Event_DTC_0xC07388_GetEventTested: operation=Event_DTC_0xC07388.GetEventTested
          SC_Event_DTC_0xC07388_GetEventUdsStatus: operation=Event_DTC_0xC07388.GetEventUdsStatus
          SC_Event_DTC_0xC07388_GetFaultDetectionCounter: operation=Event_DTC_0xC07388.GetFaultDetectionCounter
          SC_Event_DTC_0xC07388_ResetEventDebounceStatus: operation=Event_DTC_0xC07388.ResetEventDebounceStatus
          SC_Event_DTC_0xC07388_ResetEventStatus: operation=Event_DTC_0xC07388.ResetEventStatus
          SC_Event_DTC_0xC07388_SetEventStatus: operation=Event_DTC_0xC07388.SetEventStatus
          SC_Event_DTC_0xC07488_GetDTCOfEvent: operation=Event_DTC_0xC07488.GetDTCOfEvent
          SC_Event_DTC_0xC07488_GetEventExtendedDataRecordEx: operation=Event_DTC_0xC07488.GetEventExtendedDataRecordEx
          SC_Event_DTC_0xC07488_GetEventFailed: operation=Event_DTC_0xC07488.GetEventFailed
          SC_Event_DTC_0xC07488_GetEventFreezeFrameDataEx: operation=Event_DTC_0xC07488.GetEventFreezeFrameDataEx
          SC_Event_DTC_0xC07488_GetEventStatus: operation=Event_DTC_0xC07488.GetEventStatus
          SC_Event_DTC_0xC07488_GetEventTested: operation=Event_DTC_0xC07488.GetEventTested
          SC_Event_DTC_0xC07488_GetEventUdsStatus: operation=Event_DTC_0xC07488.GetEventUdsStatus
          SC_Event_DTC_0xC07488_GetFaultDetectionCounter: operation=Event_DTC_0xC07488.GetFaultDetectionCounter
          SC_Event_DTC_0xC07488_ResetEventDebounceStatus: operation=Event_DTC_0xC07488.ResetEventDebounceStatus
          SC_Event_DTC_0xC07488_ResetEventStatus: operation=Event_DTC_0xC07488.ResetEventStatus
          SC_Event_DTC_0xC07488_SetEventStatus: operation=Event_DTC_0xC07488.SetEventStatus
      runnable ErrorHandler_ReportError
  swc implementation YDF_ErrorHandler_Implementation: behavior=YDF_ErrorHandler_InternalBehavior
    code-descriptors:
      code Default: artifact-descriptors=autosar-engineering-object=category=SWSRC
