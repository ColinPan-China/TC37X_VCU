AUTOSAR XML (schema 4-3-0)
package /ComponentTypes
  complex device driver sw component type YDF_XcpHandler
    behavior YDF_XcpHandler_InternalBehavior
      init event YDF_XcpHandler_InitEvent: start-on-event=YDF_XcpHandler_Init
      timing event TMT_YDF_XcpRunnable: start-on-event=YDF_XcpRunnable, period=0.1
      runnable YDF_XcpHandler_Init
      runnable YDF_XcpRunnable
  swc implementation YDF_XcpHandler_Implementation: behavior=YDF_XcpHandler_InternalBehavior
    code-descriptors:
      code Default: artifact-descriptors=autosar-engineering-object=category=SWSRC
