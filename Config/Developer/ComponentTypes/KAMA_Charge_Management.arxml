AUTOSAR XML (schema 4-3-0)
package /ComponentTypes
  application sw component type KAMA_Charge_Management
    behavior KAMA_Charge_Management_InternalBehavior
      timing event TMT_KAMA_R_ChrgMgmt_Cyclic_50ms: start-on-event=KAMA_R_ChrgMgmt_Cyclic_50ms, period=0.05
      init event KAMA_Charge_Management_InitEvent: start-on-event=KAMA_R_ChrgMgmt_Init
      runnable KAMA_R_ChrgMgmt_Cyclic_50ms
      runnable KAMA_R_ChrgMgmt_Init
  swc implementation KAMA_Charge_Management_Implementation: behavior=KAMA_Charge_Management_InternalBehavior
    code-descriptors:
      code Default: artifact-descriptors=autosar-engineering-object=category=SWSRC
