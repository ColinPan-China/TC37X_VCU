AUTOSAR XML (schema 4-3-0)
package /ComponentTypes
  application sw component type YDF_CtAp_CANHandler_TaskCtrl
    behavior YDF_CtAp_CANHandler_TaskCtrl_InternalBehavior
      timing event TMT_Runnable: start-on-event=YDF_CtAp_CANHandler_TaskCtrl_Input_100ms, period=0.1
      timing event TMT_YDF_CtAp_CANHandler_TaskCtrl_Output_100ms: start-on-event=YDF_CtAp_CANHandler_TaskCtrl_Output_100ms, period=0.1
      runnable YDF_CtAp_CANHandler_TaskCtrl_Input_100ms
      runnable YDF_CtAp_CANHandler_TaskCtrl_Output_100ms
  swc implementation YDF_CtAp_CANHandler_TaskCtrl_Implementation: behavior=YDF_CtAp_CANHandler_TaskCtrl_InternalBehavior
