AUTOSAR XML (schema 4-3-0)
package /ComponentTypes
  application sw component type KAMA_Torque_management
    behavior KAMA_Torque_management_InternalBehavior
      timing event TMT_KAMA_R_TorqMgmt_Cyclic_10ms: start-on-event=KAMA_R_TorqMgmt_Cyclic_10ms, period=0.01
      init event KAMA_Torque_management_InitEvent: start-on-event=KAMA_R_TorqMgmt_Init
      runnable KAMA_R_TorqMgmt_Cyclic_10ms
      runnable KAMA_R_TorqMgmt_Init
  swc implementation KAMA_Torque_management_Implementation: behavior=KAMA_Torque_management_InternalBehavior
    code-descriptors:
      code Default: artifact-descriptors=autosar-engineering-object=category=SWSRC
