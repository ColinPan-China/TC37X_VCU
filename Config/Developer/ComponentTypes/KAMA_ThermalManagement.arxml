AUTOSAR XML (schema 4-3-0)
package /ComponentTypes
  application sw component type KAMA_ThermalManagement
    behavior KAMA_ThermalManagement_InternalBehavior
      timing event TMT_R_TherMgmt_Cyclic_100ms: start-on-event=KAMA_R_TherMgmt_Cyclic_100ms, period=0.1
      init event KAMA_ThermalManagement_InitEvent: start-on-event=KAMA_R_TherMgmt_Init
      runnable KAMA_R_TherMgmt_Cyclic_100ms
      runnable KAMA_R_TherMgmt_Init
  swc implementation KAMA_ThermalManagement_Implementation: behavior=KAMA_ThermalManagement_InternalBehavior
