AUTOSAR XML (schema 4-3-0)
package /ComponentTypes
  application sw component type Core2App_SWC
    behavior Core2App_SWC_InternalBehavior
      init event Core2App_SWC_InitEvent: start-on-event=Core2App_SWC_Init
      timing event TMT_Core2App_SWC_Runnable_10ms: start-on-event=Core2App_SWC_Runnable_10ms, period=0.01
      runnable Core2App_SWC_Init
      runnable Core2App_SWC_Runnable_10ms
  swc implementation Core2App_SWC_Implementation: behavior=Core2App_SWC_InternalBehavior
