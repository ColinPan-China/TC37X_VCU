AUTOSAR XML (schema 4-3-0)
package /ComponentTypes
  complex device driver sw component type YDF_ComplexDriver
    behavior YDF_ComplexDriver_InternalBehavior
      4 x timing event:
        TMT_BTS_HSDriver: start-on-event=BTS7200_HSDriver, period=0.1
        TMT_CAN_WKTrcv: start-on-event=CAN_WKTrcv, period=0.002
        TMT_Tle8888_Cyc: start-on-event=TLE8888_Cyc, period=0.01
        TMT_TLE9201_HBDriver: start-on-event=TLE9201_HBDriver, period=0.1
      4 x runnable:
        BTS7200_HSDriver
        CAN_WKTrcv
        TLE8888_Cyc
        TLE9201_HBDriver
  swc implementation YDF_ComplexDriver_Implementation: behavior=YDF_ComplexDriver_InternalBehavior
    code-descriptors:
      code Default: artifact-descriptors=autosar-engineering-object=category=SWSRC
