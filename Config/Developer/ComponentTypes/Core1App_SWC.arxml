AUTOSAR XML (schema 00046)
package /ComponentTypes
  application sw component type Core1App_SWC
    behavior Core1App_SWC_InternalBehavior
      timing event TMT_Core1App_SWC_Runnable_10ms: start-on-event=Core1App_SWC_Runnable_10ms, period=0.01
      init event Core1App_SWC_InitEvent: start-on-event=Core1App_SWC_Init
      runnable Core1App_SWC_Init
      runnable Core1App_SWC_Runnable_10ms
  swc implementation Core1App_SWC_Implementation: behavior=Core1App_SWC_InternalBehavior
