AUTOSAR XML (schema 00046)
package /ComponentTypes
  application sw component type Core1App_SWC
    behavior Core1App_SWC_InternalBehavior
      init event Core1App_SWC_InitEvent: start-on-event=Core1App_SWC_Init
      timing event TMT_Core1App_Runnable100ms: start-on-event=Core1App_Runnable100ms, period=0.1
      runnable Core1App_Runnable100ms
      runnable Core1App_SWC_Init
  swc implementation Core1App_SWC_Implementation: behavior=Core1App_SWC_InternalBehavior
