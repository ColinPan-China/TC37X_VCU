AUTOSAR XML (schema 4-3-0)
package /ComponentTypes
  application sw component type KAMA_DC_charging
    behavior KAMA_DC_charging_InternalBehavior
      timing event TMT_KAMA_R_DCChrging_Cyclic_50ms: start-on-event=KAMA_R_DCChrging_Cyclic_50ms, period=0.05
      timing event TMT_KAMA_R_DCChrging_Interface_10ms: start-on-event=KAMA_R_DCChrging_Interface_10ms, period=0.01
      init event KAMA_DC_charging_InitEvent: start-on-event=KAMA_R_DCChrging_Init
      runnable KAMA_R_DCChrging_Cyclic_50ms
      runnable KAMA_R_DCChrging_Interface_10ms
      runnable KAMA_R_DCChrging_Init
  swc implementation KAMA_DC_charging_Implementation: behavior=KAMA_DC_charging_InternalBehavior
    code-descriptors:
      code Default: artifact-descriptors=autosar-engineering-object=category=SWSRC
