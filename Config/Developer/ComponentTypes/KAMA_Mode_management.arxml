AUTOSAR XML (schema 4-3-0)
package /ComponentTypes
  application sw component type KAMA_Mode_management
    behavior KAMA_Mode_management_InternalBehavior
      timing event TMT_KAMA_R_ModMgmt_Cyclic_20ms: start-on-event=KAMA_R_ModMgmt_Cyclic_20ms, period=0.02
      init event KAMA_Mode_management_InitEvent: start-on-event=KAMA_R_ModMgmt_Init
      runnable KAMA_R_ModMgmt_Cyclic_20ms
      runnable KAMA_R_ModMgmt_Init
  swc implementation KAMA_Mode_management_Implementation: behavior=KAMA_Mode_management_InternalBehavior
    code-descriptors:
      code Default: artifact-descriptors=autosar-engineering-object=category=SWSRC
