AUTOSAR XML (schema 4-3-0)
package /ComponentTypes
  application sw component type KAMA_ErrorManagement
    behavior KAMA_ErrorManagement_InternalBehavior
      timing event TMT_KAMA_R_ErrMgmt_Cyclic_20ms: start-on-event=KAMA_R_ErrMgmt_Cyclic_10ms, period=0.01
      init event KAMA_ErrorManagement_InitEvent: start-on-event=KAMA_R_ErrMgmt_Init
      runnable KAMA_R_ErrMgmt_Cyclic_10ms
      runnable KAMA_R_ErrMgmt_Init
  swc implementation KAMA_ErrorManagement_Implementation: behavior=KAMA_ErrorManagement_InternalBehavior
