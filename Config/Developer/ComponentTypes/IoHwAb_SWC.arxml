AUTOSAR XML (schema 00046)
package /ComponentTypes
  ecu abstraction sw component type IoHwAb_SWC
    behavior IoHwAb_SWC_InternalBehavior
      init event IoHwAb_SWC_InitEvent: start-on-event=IoHwAb_SWC_Init
      timing event TMT_IoHwAb_SWC_Runnable: start-on-event=IoHwAb_SWC_Runnable, period=0.01
      runnable IoHwAb_SWC_Runnable: minimum-start-interval=0.01
      runnable IoHwAb_SWC_Init
  swc implementation IoHwAb_SWC_Implementation: behavior=IoHwAb_SWC_InternalBehavior
