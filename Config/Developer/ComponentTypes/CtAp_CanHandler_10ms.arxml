AUTOSAR XML (schema 00048)
package /ComponentTypes
  application sw component type CtAp_CanHandler_10ms
    behavior CtAp_CanHandler_10ms_InternalBehavior
      timing event TMT_R_CanHandler_Cyclic_10ms: start-on-event=R_CanHandler_Cyclic_10ms, period=0.01
      runnable R_CanHandler_Cyclic_10ms
  swc implementation CtAp_CanHandler_10ms_Implementation: behavior=CtAp_CanHandler_10ms_InternalBehavior
