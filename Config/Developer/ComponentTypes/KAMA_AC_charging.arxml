AUTOSAR XML (schema 4-3-0)
package /ComponentTypes
  application sw component type KAMA_AC_charging
    behavior KAMA_AC_charging_InternalBehavior
      timing event TMT_KAMA_AC_charging: start-on-event=KAMA_R_ACChrging_Cyclic_50ms, period=0.05
      init event KAMA_AC_charging_InitEvent: start-on-event=KAMA_R_ACChrging_Init
      runnable KAMA_R_ACChrging_Cyclic_50ms
      runnable KAMA_R_ACChrging_Init
  swc implementation KAMA_AC_charging_Implementation: behavior=KAMA_AC_charging_InternalBehavior
    code-descriptors:
      code Default: artifact-descriptors=autosar-engineering-object=category=SWSRC
