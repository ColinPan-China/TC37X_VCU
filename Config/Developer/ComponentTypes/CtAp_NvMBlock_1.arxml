AUTOSAR XML (schema 00046)
package /ComponentTypes
  nv block sw component type CtAp_NvMBlock
    7 x provide/require port:
      RTE_RP_RngEstimnInfo: nv-provide-com-spec{ram-block-init-value=fields=[RngEstimn_BMSBattIDcIntgl_As:0, RngEstimn_AccuMilg_m:0], rom-block-init-value=fields=[RngEstimn_BMSBattIDcIntgl_As:0, RngEstimn_AccuMilg_m:0], variable=tec_RngEstimnInfo}, nv-require-com-spec{init-value=fields=[RngEstimn_BMSBattIDcIntgl_As:0, RngEstimn_AccuMilg_m:0], variable=tec_RngEstimnInfo}, provided-required-interface=IF_RngEstimnInfo
      RTE_RP_GearMgmtInfo: nv-provide-com-spec{ram-block-init-value=fields=[GearMgmt_GearMemInfo_Enum:0, GearMgmt_FillAddress:0], rom-block-init-value=fields=[GearMgmt_GearMemInfo_Enum:0, GearMgmt_FillAddress:0], variable=tec_GearMgmtInfo}, nv-require-com-spec{init-value=fields=[GearMgmt_GearMemInfo_Enum:0, GearMgmt_FillAddress:0], variable=tec_GearMgmtInfo}, provided-required-interface=IF_GearMgmtInfo
      RTE_RP_ModMgmtInfo:
        nv-provide-com-spec{ram-block-init-value=fields=[ModMgmt_DrvModMemInfo_Enum:2, ModMgmt_ActRgnStsMemInfo_Enum:3], rom-block-init-value=fields=[ModMgmt_DrvModMemInfo_Enum:2, ModMgmt_ActRgnStsMemInfo_Enum:3], variable=tec_ModMgmtInfo}
        nv-require-com-spec{init-value=fields=[ModMgmt_DrvModMemInfo_Enum:2, ModMgmt_ActRgnStsMemInfo_Enum:3], variable=tec_ModMgmtInfo}
        provided-required-interface=IF_ModMgmtInfo
      RTE_RP_ChrgStatInfo:
        nv-provide-com-spec{ram-block-init-value=fields=[ChrMgmt_ChrgTarSOC_pct:0, ChrMgmt_ChrgMemFlt_Flg:0, ChrMgmt_DchaAbortSOC_pct:0, ChrMgmt_FillAddress:0], rom-block-init-value=fields=[ChrMgmt_ChrgTarSOC_pct:0, ChrMgmt_ChrgMemFlt_Flg:0, ChrMgmt_DchaAbortSOC_pct:0, ChrMgmt_FillAddress:0], variable=tec_ChrgStatInfo}
        nv-require-com-spec{init-value=fields=[ChrMgmt_ChrgTarSOC_pct:0, ChrMgmt_ChrgMemFlt_Flg:0, ChrMgmt_DchaAbortSOC_pct:0, ChrMgmt_FillAddress:0], variable=tec_ChrgStatInfo}
        provided-required-interface=IF_ChrgStatInfo
      RTE_RP_ChrgEgyCalInfo:
        nv-provide-com-spec{ram-block-init-value=fields=[ChrMgmt_OBCSideTotDchaEgy_Wh:0, ChrMgmt_PODSideTotChrgEgy_Wh:0, ChrMgmt_BattSideTotChrgEgy_Wh:0, ChrMgmt_DCChrgrSideTotChrgEgy_Wh:0, ChrMgmt_OBCSideTotChrgEgy_Wh:0, ChrMgmt_BattChrgCnt_Tms:0], rom-block-init-value=fields=[ChrMgmt_OBCSideTotDchaEgy_Wh:0, ChrMgmt_PODSideTotChrgEgy_Wh:0, ChrMgmt_BattSideTotChrgEgy_Wh:0, ChrMgmt_DCChrgrSideTotChrgEgy_Wh:0, ChrMgmt_OBCSideTotChrgEgy_Wh:0, ChrMgmt_BattChrgCnt_Tms:0], variable=tec_ChrgEgyCalInfo}
        nv-require-com-spec{init-value=fields=[ChrMgmt_OBCSideTotDchaEgy_Wh:0, ChrMgmt_PODSideTotChrgEgy_Wh:0, ChrMgmt_BattSideTotChrgEgy_Wh:0, ChrMgmt_DCChrgrSideTotChrgEgy_Wh:0, ChrMgmt_OBCSideTotChrgEgy_Wh:0, ChrMgmt_BattChrgCnt_Tms:0], variable=tec_ChrgEgyCalInfo}
        provided-required-interface=IF_ChrgEgyCalInfo
      RTE_RP_ChassisMgmtInfo:
        nv-provide-com-spec{ram-block-init-value=fields=[ChassisMgmt_BrkCmpStsInfo:2, ChassisMgmt_FillAdressInfo:0], rom-block-init-value=fields=[ChassisMgmt_BrkCmpStsInfo:2, ChassisMgmt_FillAdressInfo:0], variable=tec_ChassisMgmtInfo}
        nv-require-com-spec{init-value=fields=[ChassisMgmt_BrkCmpStsInfo:2, ChassisMgmt_FillAdressInfo:0], variable=tec_ChassisMgmtInfo}
        provided-required-interface=IF_ChassisMgmtInfo
      RTE_RP_RngEstimnFormual2: nv-provide-com-spec{ram-block-init-value=25 x 3197, rom-block-init-value=25 x 3197, variable=tec_RngEstimnFormual2}, nv-require-com-spec{init-value=25 x 3197, variable=tec_RngEstimnFormual2}, provided-required-interface=IF_RngEstimnFormual2
    behavior CtAp_NvMBlock_InternalBehavior
      6 x data received event:
        DRT_R_NvMBlock_ASWInfo_RngEstimnInfo_RTE_RP_RngEstimnInfo_tec_RngEstimnInfo: start-on-event=R_NvMBlock_ASWInfo_RngEstimnInfo, data=RTE_RP_RngEstimnInfo.tec_RngEstimnInfo
        DRT_R_NvMBlock_ASWInfo_ModMgmtInfo_RTE_RP_ModMgmtInfo_tec_ModMgmtInfo: start-on-event=R_NvMBlock_ASWInfo_ModMgmtInfo, data=RTE_RP_ModMgmtInfo.tec_ModMgmtInfo
        DRT_R_NvMBlock_ASWInfo_GearMgmtInfo_RTE_RP_GearMgmtInfo_tec_GearMgmtInfo: start-on-event=R_NvMBlock_ASWInfo_GearMgmtInfo, data=RTE_RP_GearMgmtInfo.tec_GearMgmtInfo
        DRT_R_NvMBlock_ASWInfo_ChrgStatInfo_RTE_RP_ChrgStatInfo_tec_ChrgStatInfo: start-on-event=R_NvMBlock_ASWInfo_ChrgStatInfo, data=RTE_RP_ChrgStatInfo.tec_ChrgStatInfo
        DRT_R_NvMBlock_ASWInfo_ChrgEgyCalInfo_RTE_RP_ChrgEgyCalInfo_tec_ChrgEgyCalInfo: start-on-event=R_NvMBlock_ASWInfo_ChrgEgyCalInfo, data=RTE_RP_ChrgEgyCalInfo.tec_ChrgEgyCalInfo
        DRT_R_NvMBlock_ASWInfo_ChassisMgmtInfo_RTE_RP_ChassisMgmtInfo_tec_ChassisMgmtInfo: start-on-event=R_NvMBlock_ASWInfo_ChassisMgmtInfo, data=RTE_RP_ChassisMgmtInfo.tec_ChassisMgmtInfo
      6 x runnable:
        R_NvMBlock_ASWInfo_ChrgEgyCalInfo
        R_NvMBlock_ASWInfo_RngEstimnInfo
        R_NvMBlock_ASWInfo_ModMgmtInfo
        R_NvMBlock_ASWInfo_GearMgmtInfo
        R_NvMBlock_ASWInfo_ChrgStatInfo
        R_NvMBlock_ASWInfo_ChassisMgmtInfo
    7 x nv block descriptor:
      NVBlockDescriptor_ASWInfo_ModMgmtInfo: nv-block-data-mapping{nv-ram-block-element=RAM_NVBlockDescriptor_ASWInfo_ModMgmtInfo, written-read-nv-data=RTE_RP_ModMgmtInfo.tec_ModMgmtInfo}
        nv block needs NVNeed_NVBlockDescriptor_ASWInfo_ModMgmtInfo: calc-ram-block-crc=false, check-static-block-id=false, n-data-sets=1, n-rom-blocks=1, ram-block-status-control=API, readonly=false, reliability=ERROR-DETECTION, restore-at-start=true, store-at-shutdown=true, store-cyclic=false, store-emergency=false, store-immediate=false, use-auto-validation-at-shut-down=false, use-crc-comp-mechanism=false, write-only-once=false, write-verification=false
        ram block RAM_NVBlockDescriptor_ASWInfo_ModMgmtInfo: type=dt_Nv_ModMgmtInfo, init-value=fields=[ModMgmt_DrvModMemInfo_Enum:2, ModMgmt_FillAddress:3]
        rom block ROM_NVBlockDescriptor_ASWInfo_ModMgmtInfo: sw-calibration-access=READ-ONLY, type=dt_Nv_ModMgmtInfo, init-value=fields=[ModMgmt_DrvModMemInfo_Enum:2, ModMgmt_FillAddress:3]
      NVBlockDescriptor_ASWInfo_GearMgmtInfo: nv-block-data-mapping{nv-ram-block-element=RAM_NVBlockDescriptor_ASWInfo_GearMgmtInfo, written-read-nv-data=RTE_RP_GearMgmtInfo.tec_GearMgmtInfo}
        nv block needs NVNeed_NVBlockDescriptor_ASWInfo_GearMgmtInfo: calc-ram-block-crc=false, check-static-block-id=false, n-data-sets=1, n-rom-blocks=1, ram-block-status-control=API, readonly=false, reliability=ERROR-DETECTION, restore-at-start=true, store-at-shutdown=true, store-cyclic=false, store-emergency=false, store-immediate=false, use-auto-validation-at-shut-down=false, use-crc-comp-mechanism=false, write-only-once=false, write-verification=false
        ram block RAM_NVBlockDescriptor_ASWInfo_GearMgmtInfo: type=dt_Nv_GearMgmtInfo, init-value=fields=[GearMgmt_GearMemInfo_Enum:0, GearMgmt_FillAddress:0]
        rom block ROM_NVBlockDescriptor_ASWInfo_GearMgmtInfo: sw-calibration-access=READ-ONLY, type=dt_Nv_GearMgmtInfo, init-value=fields=[GearMgmt_GearMemInfo_Enum:0, GearMgmt_FillAddress:0]
      NVBlockDescriptor_ASWInfo_ChrgStatInfo: nv-block-data-mapping{nv-ram-block-element=RAM_NVBlockDescriptor_ASWInfo_ChrgStatInfo, written-read-nv-data=RTE_RP_ChrgStatInfo.tec_ChrgStatInfo}
        nv block needs NVNeed_NVBlockDescriptor_ASWInfo_ChrgStatInfo: calc-ram-block-crc=false, check-static-block-id=false, n-data-sets=1, n-rom-blocks=1, ram-block-status-control=API, readonly=false, reliability=ERROR-DETECTION, restore-at-start=true, store-at-shutdown=true, store-cyclic=false, store-emergency=false, store-immediate=false, use-auto-validation-at-shut-down=false, use-crc-comp-mechanism=false, write-only-once=false, write-verification=false
        ram block RAM_NVBlockDescriptor_ASWInfo_ChrgStatInfo: type=dt_Nv_ChrgStatInfo, init-value=fields=[ChrMgmt_ChrgTarSOC_pct:0, ChrMgmt_ChrgMemFlt_Flg:0, ChrMgmt_DchaAbortSOC_pct:0, ChrMgmt_FillAddress:0]
        rom block ROM_NVBlockDescriptor_ASWInfo_ChrgStatInfo: sw-calibration-access=READ-ONLY, type=dt_Nv_ChrgStatInfo, init-value=fields=[ChrMgmt_ChrgTarSOC_pct:0, ChrMgmt_ChrgMemFlt_Flg:0, ChrMgmt_DchaAbortSOC_pct:0, ChrMgmt_FillAddress:0]
      NVBlockDescriptor_ASWInfo_RngEstimnInfo: nv-block-data-mapping{nv-ram-block-element=RAM_NVBlockDescriptor_ASWInfo_RngEstimnInfo, written-read-nv-data=RTE_RP_RngEstimnInfo.tec_RngEstimnInfo}
        nv block needs NVNeed_NVBlockDescriptor_ASWInfo_ChrMgmtInfo: calc-ram-block-crc=false, check-static-block-id=false, n-data-sets=1, n-rom-blocks=1, ram-block-status-control=API, readonly=false, reliability=ERROR-DETECTION, restore-at-start=true, store-at-shutdown=true, store-cyclic=false, store-emergency=false, store-immediate=true, use-auto-validation-at-shut-down=false, use-crc-comp-mechanism=false, write-only-once=false, write-verification=false
        ram block RAM_NVBlockDescriptor_ASWInfo_RngEstimnInfo: type=dt_Nv_RngEstimnInfo, init-value=fields=[RngEstimn_BMSBattIDcIntgl_As:0, RngEstimn_AccuMilg_m:0]
        rom block ROM_NVBlockDescriptor_ASWInfo_RngEstimnInfo: sw-calibration-access=READ-ONLY, type=dt_Nv_RngEstimnInfo, init-value=fields=[RngEstimn_BMSBattIDcIntgl_As:0, RngEstimn_AccuMilg_m:0]
      NVBlockDescriptor_ASWInfo_ChrgEgyCalInfo: nv-block-data-mapping{nv-ram-block-element=RAM_NVBlockDescriptor_ASWInfo_ChrgEgyCalInfo, written-read-nv-data=RTE_RP_ChrgEgyCalInfo.tec_ChrgEgyCalInfo}
        nv block needs NVNeed_NVBlockDescriptor_ASWInfo_ChrgEgyCalInfo: calc-ram-block-crc=false, check-static-block-id=false, n-data-sets=1, n-rom-blocks=1, ram-block-status-control=API, readonly=false, reliability=ERROR-DETECTION, restore-at-start=true, store-at-shutdown=true, store-cyclic=false, store-emergency=false, store-immediate=false, use-auto-validation-at-shut-down=false, use-crc-comp-mechanism=false, write-only-once=false, write-verification=false
        ram block RAM_NVBlockDescriptor_ASWInfo_ChrgEgyCalInfo: type=dt_Nv_ChrgEgyCalInfo, init-value=fields=[ChrMgmt_OBCSideTotDchaEgy_Wh:0, ChrMgmt_PODSideTotChrgEgy_Wh:0, ChrMgmt_BattSideTotChrgEgy_Wh:0, ChrMgmt_DCChrgrSideTotChrgEgy_Wh:0, ChrMgmt_OBCSideTotChrgEgy_Wh:0, ChrMgmt_BattChrgCnt_Tms:0]
        rom block ROM_NVBlockDescriptor_ASWInfo_ChrgEgyCalInfo: sw-calibration-access=READ-WRITE, type=dt_Nv_ChrgEgyCalInfo, init-value=fields=[ChrMgmt_OBCSideTotDchaEgy_Wh:0, ChrMgmt_PODSideTotChrgEgy_Wh:0, ChrMgmt_BattSideTotChrgEgy_Wh:0, ChrMgmt_DCChrgrSideTotChrgEgy_Wh:0, ChrMgmt_OBCSideTotChrgEgy_Wh:0, ChrMgmt_BattChrgCnt_Tms:0]
      NVBlockDescriptor_ASWInfo_ChassisMgmtInfo: nv-block-data-mapping{nv-ram-block-element=RAM_NVBlockDescriptor_ASWInfo_ChassisMgmtInfo, written-read-nv-data=RTE_RP_ChassisMgmtInfo.tec_ChassisMgmtInfo}
        nv block needs NVNeed_NVBlockDescriptor_ASWInfo_ChassisMgmtInfo: calc-ram-block-crc=false, check-static-block-id=false, n-data-sets=1, n-rom-blocks=1, ram-block-status-control=API, readonly=false, reliability=ERROR-DETECTION, restore-at-start=true, store-at-shutdown=true, store-cyclic=false, store-emergency=false, store-immediate=false, use-auto-validation-at-shut-down=false, use-crc-comp-mechanism=false, write-only-once=false, write-verification=false
        ram block RAM_NVBlockDescriptor_ASWInfo_ChassisMgmtInfo: type=dt_Nv_ChassisMgmtInfo, init-value=fields=[ChassisMgmt_BrkCmpStsInfo:2, ChassisMgmt_FillAdressInfo:0]
        rom block ROM_NVBlockDescriptor_ASWInfo_ChassisMgmtInfo: sw-calibration-access=READ-WRITE, type=dt_Nv_ChassisMgmtInfo, init-value=fields=[ChassisMgmt_BrkCmpStsInfo:2, ChassisMgmt_FillAdressInfo:0]
      NVBlockDescriptor_ASWInfo_RngRstimnFormual2: nv-block-data-mapping{nv-ram-block-element=RAM_NVBlockDescriptor_ASWInfo_RngRstimnFormual2, written-read-nv-data=RTE_RP_RngEstimnFormual2.tec_RngEstimnFormual2}
        nv block needs NVNeed_NVBlockDescriptor_ASWInfo_RngRstimnFormual2: calc-ram-block-crc=false, check-static-block-id=false, n-data-sets=1, n-rom-blocks=1, ram-block-status-control=API, readonly=false, reliability=ERROR-DETECTION, resistant-to-changed-sw=true, restore-at-start=true, store-at-shutdown=true, store-cyclic=false, store-emergency=false, store-immediate=false, use-auto-validation-at-shut-down=false, use-crc-comp-mechanism=false, write-only-once=false, write-verification=false
        ram block RAM_NVBlockDescriptor_ASWInfo_RngRstimnFormual2: type=dt_RngEstimn_BattCurrIntegral2kmArrayInfo, init-value=25 x 3197
        rom block ROM_NVBlockDescriptor_ASWInfo_RngRstimnFormual2: sw-calibration-access=READ-ONLY, type=dt_RngEstimn_BattCurrIntegral2kmArrayInfo, init-value=25 x 3197
  swc implementation CtAp_NvMBlock_Implementation: behavior=CtAp_NvMBlock_InternalBehavior
