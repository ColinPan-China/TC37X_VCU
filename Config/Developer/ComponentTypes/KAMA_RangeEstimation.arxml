AUTOSAR XML (schema 4-3-0)
package /ComponentTypes
  application sw component type KAMA_RangeEstimation
    behavior KAMA_RangeEstimation_InternalBehavior
      timing event TMT_R_RangeEst_Cyclic_100ms: start-on-event=KAMA_R_RangeEst_Cyclic_100ms, period=0.1
      init event KAMA_RangeEstimation_InitEvent: start-on-event=KAMA_R_RangeEst_Init
      runnable KAMA_R_RangeEst_Cyclic_100ms
      runnable KAMA_R_RangeEst_Init
  swc implementation KAMA_RangeEstimation_Implementation: behavior=KAMA_RangeEstimation_InternalBehavior
