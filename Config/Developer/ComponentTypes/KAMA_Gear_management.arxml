AUTOSAR XML (schema 4-3-0)
package /ComponentTypes
  application sw component type KAMA_Gear_management
    behavior KAMA_Gear_management_InternalBehavior
      timing event TMT_KAMA_R_GearMgmt_Cyclic_20ms: start-on-event=KAMA_R_GearMgmt_Cyclic_20ms, period=0.02
      init event KAMA_Gear_management_InitEvent: start-on-event=KAMA_R_GearMgmt_Init
      runnable KAMA_R_GearMgmt_Cyclic_20ms
      runnable KAMA_R_GearMgmt_Init
  swc implementation KAMA_Gear_management_Implementation: behavior=KAMA_Gear_management_InternalBehavior
    code-descriptors:
      code Default: artifact-descriptors=autosar-engineering-object=category=SWSRC
