AUTOSAR XML (schema 4-3-0)
package /ECUCompositionTypes
  composition sw component type ECU_Composition_1
    13 x component:
      HookCallout: type=HookCallout
      IoHwAb: type=IoHwAb
      YDF_BIST: type=YDF_BIST
      YDF_CanHandler: type=YDF_CanHandler
      YDF_CddHandler: type=YDF_ComplexDriver
      YDF_DiagHandler: type=YDF_DiagHandler
      YDF_ErrorHandler: type=YDF_ErrorHandler
      YDF_EthHandler: type=YDF_EthHandler
      YDF_Function_Interfance: type=YDF_FunctionInterface
      YDF_LCS: type=YDF_LCS
      YDF_NMHandler: type=YDF_NMHandler
      YDF_PerManager: type=YDF_PerManager
      YDF_XcpHandler: type=YDF_XcpHandler
    connect YDF_LCS.PiLCSMCommand_R -> YDF_LCS.PiLCSMCommand_S
