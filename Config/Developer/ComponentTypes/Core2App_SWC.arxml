AUTOSAR XML (schema 00046)
package /ComponentTypes
  application sw component type Core2App_SWC
    behavior Core2App_SWC_InternalBehavior
      init event Core2App_SWC_InitEvent: start-on-event=Core2App_SWC_Init
      timing event TMT_Core2App_Runnable100ms: start-on-event=Core2App_Runnable100ms, period=0.1
      runnable Core2App_Runnable100ms
      runnable Core2App_SWC_Init
  swc implementation Core2App_SWC_Implementation: behavior=Core2App_SWC_InternalBehavior
