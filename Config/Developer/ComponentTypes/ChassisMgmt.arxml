AUTOSAR XML (schema 00048)
package /ComponentTypes
  composition sw component type ChassisMgmt
