AUTOSAR XML (schema 00046)
package /ComponentTypes
  composition sw component type ChassisMgmt
