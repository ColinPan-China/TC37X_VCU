AUTOSAR XML (schema 00046)
package /ComponentTypes
  application sw component type YDF_EthHandler
    behavior YDF_EthHandler_InternalBehavior
      init event RYDF_EthHandler_InitEvent: start-on-event=RYDF_EthHandler_Init
      timing event TMT_RYDF_EthHandler_10ms: start-on-event=RYDF_EthHandler_10ms, period=0.01
      runnable RYDF_EthHandler_Init
      runnable RYDF_EthHandler_10ms
  swc implementation YDF_EthHandler_Implementation: behavior=YDF_EthHandler_InternalBehavior
    code-descriptors:
      code Default: artifact-descriptors=autosar-engineering-object=category=SWSRC
