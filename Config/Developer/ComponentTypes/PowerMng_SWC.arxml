AUTOSAR XML (schema 00046)
package /ComponentTypes
  application sw component type PowerMng_SWC
    behavior PowerMng_SWC_InternalBehavior
      timing event TMT_Led_Runnable1000ms: start-on-event=Led_Runnable1000ms, period=1
      init event PowerMng_SWC_InitEvent: start-on-event=PowerMng_SWC_Init
      runnable Led_Runnable1000ms
      runnable PowerMng_SWC_Init
  swc implementation PowerMng_SWC_Implementation: behavior=PowerMng_SWC_InternalBehavior
