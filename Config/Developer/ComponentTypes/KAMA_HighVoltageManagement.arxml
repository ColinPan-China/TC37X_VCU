AUTOSAR XML (schema 4-3-0)
package /ComponentTypes
  application sw component type KAMA_HighVoltageManagement
    behavior KAMA_HighVoltageManagement_InternalBehavior
      timing event TMT_R_HvMgmt_Cyclic_20ms: start-on-event=KAMA_R_HvMgmt_Cyclic_20ms, period=0.02
      init event KAMA_HighVoltageManagement_InitEvent: start-on-event=KAMA_R_HvMgmt_Init
      runnable KAMA_R_HvMgmt_Cyclic_20ms
      runnable KAMA_R_HvMgmt_Init
  swc implementation KAMA_HighVoltageManagement_Implementation: behavior=KAMA_HighVoltageManagement_InternalBehavior
    code-descriptors:
      code Default: artifact-descriptors=autosar-engineering-object=category=SWSRC
