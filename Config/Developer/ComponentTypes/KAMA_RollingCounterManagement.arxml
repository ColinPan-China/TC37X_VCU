AUTOSAR XML (schema 4-3-0)
package /ComponentTypes
  application sw component type KAMA_RollingCounterManagement
    behavior KAMA_RollingCounterManagement_InternalBehavior
      4 x timing event:
        TMT_KAMA_RollingCounter_10ms: start-on-event=KAMA_RollingCounter_10ms, period=0.01
        TMT_KAMA_RollingCounter_100ms: start-on-event=KAMA_RollingCounter_100ms, period=0.1
        TMT_KAMA_RollingCounter_50ms: start-on-event=KAMA_RollingCounter_50ms, period=0.05
        TMT_KAMA_RollingCounter_20ms: start-on-event=KAMA_RollingCounter_20ms, period=0.02
      init event KAMA_RollingCounterManagement_InitEvent: start-on-event=KAMA_RollingCounter_Init
      5 x runnable:
        KAMA_RollingCounter_10ms
        KAMA_RollingCounter_20ms
        KAMA_RollingCounter_50ms
        KAMA_RollingCounter_100ms
        KAMA_RollingCounter_Init
  swc implementation KAMA_RollingCounterManagement_Implementation: behavior=KAMA_RollingCounterManagement_InternalBehavior
