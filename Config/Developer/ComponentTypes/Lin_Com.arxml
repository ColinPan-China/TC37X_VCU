AUTOSAR XML (schema 4-3-0)
package /ComponentTypes
  swc implementation YDF_CommDriver_Implementation: behavior=YDF_CommDriver_InternalBehavior
  complex device driver sw component type YDF_CommDriver
    provide port LinModule: provided-interface=LinModule
      provided-com-specs:
        operation=LinA_Master_Send, queue-length=1
        operation=LinB_Master_Send, queue-length=1
        operation=LinC_Master_Send, queue-length=1
        operation=LinA_Slave_Response, queue-length=1
        operation=LinB_Slave_Response, queue-length=1
        operation=LinC_Slave_Response, queue-length=1
        operation=LinARec_GetResult, queue-length=1
        operation=LinBRec_GetResult, queue-length=1
        operation=LinCRec_GetResult, queue-length=1
        operation=LinDRec_GetResult, queue-length=1
        operation=LinD_Slave_Response, queue-length=1
        operation=LinD_Master_Send, queue-length=1
    behavior YDF_CommDriver_InternalBehavior
      12 x operation invoked event:
        OIT_LinModule_LinDRec_GetResult_LinModule_LinDRec_GetResult: start-on-event=LinModule_LinDRec_GetResult, operation=LinModule.LinDRec_GetResult
        OIT_LinModule_LinD_Slave_Response_LinModule_LinD_Slave_Response: start-on-event=LinModule_LinD_Slave_Response, operation=LinModule.LinD_Slave_Response
        OIT_LinModule_LinD_Master_Send_LinModule_LinD_Master_Send: start-on-event=LinModule_LinD_Master_Send, operation=LinModule.LinD_Master_Send
        OIT_LinModule_LinCRec_GetResult_LinModule_LinCRec_GetResult: start-on-event=LinModule_LinCRec_GetResult, operation=LinModule.LinCRec_GetResult
        OIT_LinModule_LinBRec_GetResult_LinModule_LinBRec_GetResult: start-on-event=LinModule_LinBRec_GetResult, operation=LinModule.LinBRec_GetResult
        OIT_LinModule_LinARec_GetResult_LinModule_LinARec_GetResult: start-on-event=LinModule_LinARec_GetResult, operation=LinModule.LinARec_GetResult
        OIT_LinModule_LinC_Slave_Response_LinModule_LinC_Slave_Response: start-on-event=LinModule_LinC_Slave_Response, operation=LinModule.LinC_Slave_Response
        OIT_LinModule_LinB_Slave_Response_LinModule_LinB_Slave_Response: start-on-event=LinModule_LinB_Slave_Response, operation=LinModule.LinB_Slave_Response
        OIT_LinModule_LinA_Slave_Response_LinModule_LinA_Slave_Response: start-on-event=LinModule_LinA_Slave_Response, operation=LinModule.LinA_Slave_Response
        OIT_LinModule_LinC_Master_Send_LinModule_LinC_Master_Send: start-on-event=LinModule_LinC_Master_Send, operation=LinModule.LinC_Master_Send
        OIT_LinModule_LinB_Master_Send_LinModule_LinB_Master_Send: start-on-event=LinModule_LinB_Master_Send, operation=LinModule.LinB_Master_Send
        OIT_LinModule_LinA_Master_Send_LinModule_LinA_Master_Send: start-on-event=LinModule_LinA_Master_Send, operation=LinModule.LinA_Master_Send
      12 x runnable:
        LinModule_LinDRec_GetResult
        LinModule_LinD_Slave_Response
        LinModule_LinD_Master_Send
        LinModule_LinCRec_GetResult
        LinModule_LinBRec_GetResult
        LinModule_LinARec_GetResult
        LinModule_LinC_Slave_Response
        LinModule_LinB_Slave_Response
        LinModule_LinA_Slave_Response
        LinModule_LinC_Master_Send
        LinModule_LinB_Master_Send
        LinModule_LinA_Master_Send
