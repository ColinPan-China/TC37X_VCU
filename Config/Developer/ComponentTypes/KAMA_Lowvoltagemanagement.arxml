AUTOSAR XML (schema 4-3-0)
package /ComponentTypes
  application sw component type KAMA_Lowvoltagemanagement
    behavior KAMA_Lowvoltagemanagement_InternalBehavior
      timing event TMT_KAMA_R_LvMgmt_Cyclic_20ms: start-on-event=KAMA_R_LvMgmt_Cyclic_20ms, period=0.02
      init event KAMA_Lowvoltagemanagement_InitEvent: start-on-event=KAMA_R_LvMgmt_Init
      runnable KAMA_R_LvMgmt_Cyclic_20ms
      runnable KAMA_R_LvMgmt_Init
  swc implementation KAMA_Lowvoltagemanagement_Implementation: behavior=KAMA_Lowvoltagemanagement_InternalBehavior
    code-descriptors:
      code Default: artifact-descriptors=autosar-engineering-object=category=SWSRC
