AUTOSAR XML (schema 4-3-0)
package /ComponentTypes
  complex device driver sw component type YDF_GetIf_Driver
    provide port Get_If: provided-interface=Get_If
      provided-com-specs:
        operation=Get_Ad_Result, queue-length=1
        operation=Get_io_inResult, queue-length=1
        operation=Get_BTS_OutResult, queue-length=1
        operation=Get_CAN_ActiveInf, queue-length=1
        operation=Icu_17_GtmCcu6_PWMIN_CH{1..4}, queue-length=1
        operation=Icu_17_GtmCcu6_PWMIN_PWMSCB1, queue-length=1
        operation=Icu_17_GtmCcu6_PWMIN_PWMSCB2, queue-length=1
        operation=Icu_17_GtmCcu6_PWMIN_LAMPSCB1, queue-length=1
        operation=Icu_17_GtmCcu6_PWMIN_LAMPSCB2, queue-length=1
        operation=Get_Bottom_Ver, queue-length=1
        operation=Get_SentData, queue-length=1
        operation=Get_Level_OutResult, queue-length=1
        operation=Get_PwmOrLevel_OutResult, queue-length=1
        operation=Get_Motor_OutResult, queue-length=1
    behavior YDF_GetIf_Driver_InternalBehavior
      17 x operation invoked event:
        OIT_Get_If_Get_Motor_OutResult_Get_If_Get_Motor_OutResult: start-on-event=Get_If_Get_Motor_OutResult, operation=Get_If.Get_Motor_OutResult
        OIT_Get_If_Get_PwmOrLevel_OutResult_Get_If_Get_PwmOrLevel_OutResult: start-on-event=Get_If_Get_PwmOrLevel_OutResult, operation=Get_If.Get_PwmOrLevel_OutResult
        OIT_Get_If_Get_Level_OutResult_Get_If_Get_Level_OutResult: start-on-event=Get_If_Get_Level_OutResult, operation=Get_If.Get_Level_OutResult
        OIT_Get_If_Get_SentData_Get_If_Get_SentData: start-on-event=Get_If_Get_SentData, operation=Get_If.Get_SentData
        OIT_Get_If_Get_Bottom_Ver_Get_If_Get_Bottom_Ver: start-on-event=Get_If_Get_Bottom_Ver, operation=Get_If.Get_Bottom_Ver
        OIT_Get_If_Icu_17_GtmCcu6_PWMIN_LAMPSCB2_Get_If_Icu_17_GtmCcu6_PWMIN_LAMPSCB2: start-on-event=Get_If_Icu_17_GtmCcu6_PWMIN_LAMPSCB2, operation=Get_If.Icu_17_GtmCcu6_PWMIN_LAMPSCB2
        OIT_Get_If_Icu_17_GtmCcu6_PWMIN_LAMPSCB1_Get_If_Icu_17_GtmCcu6_PWMIN_LAMPSCB1: start-on-event=Get_If_Icu_17_GtmCcu6_PWMIN_LAMPSCB1, operation=Get_If.Icu_17_GtmCcu6_PWMIN_LAMPSCB1
        OIT_Get_If_Icu_17_GtmCcu6_PWMIN_PWMSCB2_Get_If_Icu_17_GtmCcu6_PWMIN_PWMSCB2: start-on-event=Get_If_Icu_17_GtmCcu6_PWMIN_PWMSCB2, operation=Get_If.Icu_17_GtmCcu6_PWMIN_PWMSCB2
        OIT_Get_If_Icu_17_GtmCcu6_PWMIN_PWMSCB1_Get_If_Icu_17_GtmCcu6_PWMIN_PWMSCB1: start-on-event=Get_If_Icu_17_GtmCcu6_PWMIN_PWMSCB1, operation=Get_If.Icu_17_GtmCcu6_PWMIN_PWMSCB1
        OIT_Get_If_Icu_17_GtmCcu6_PWMIN_CH4_Get_If_Icu_17_GtmCcu6_PWMIN_CH4: start-on-event=Get_If_Icu_17_GtmCcu6_PWMIN_CH4, operation=Get_If.Icu_17_GtmCcu6_PWMIN_CH4
        OIT_Get_If_Icu_17_GtmCcu6_PWMIN_CH3_Get_If_Icu_17_GtmCcu6_PWMIN_CH3: start-on-event=Get_If_Icu_17_GtmCcu6_PWMIN_CH3, operation=Get_If.Icu_17_GtmCcu6_PWMIN_CH3
        OIT_Get_If_Icu_17_GtmCcu6_PWMIN_CH2_Get_If_Icu_17_GtmCcu6_PWMIN_CH2: start-on-event=Get_If_Icu_17_GtmCcu6_PWMIN_CH2, operation=Get_If.Icu_17_GtmCcu6_PWMIN_CH2
        OIT_Get_If_Icu_17_GtmCcu6_PWMIN_CH1_Get_If_Icu_17_GtmCcu6_PWMIN_CH1: start-on-event=Get_If_Icu_17_GtmCcu6_PWMIN_CH1, operation=Get_If.Icu_17_GtmCcu6_PWMIN_CH1
        OIT_Get_If_Get_CAN_ActiveInf_Get_If_Get_CAN_ActiveInf: start-on-event=Get_If_Get_CAN_ActiveInf, operation=Get_If.Get_CAN_ActiveInf
        OIT_Get_If_Get_BTS_OutResult_Get_If_Get_BTS_OutResult: start-on-event=Get_If_Get_BTS_OutResult, operation=Get_If.Get_BTS_OutResult
        OIT_Get_If_Get_io_inResult_Get_If_Get_io_inResult: start-on-event=Get_If_Get_io_inResult, operation=Get_If.Get_io_inResult
        OIT_Get_If_Get_Ad_Result_Get_If_Get_Ad_Result: start-on-event=Get_If_Get_Ad_Result, operation=Get_If.Get_Ad_Result
      17 x runnable:
        Get_If_Get_Motor_OutResult
        Get_If_Get_PwmOrLevel_OutResult
        Get_If_Get_Level_OutResult
        Get_If_Get_SentData
        Get_If_Get_Bottom_Ver
        Get_If_Icu_17_GtmCcu6_PWMIN_LAMPSCB2
        Get_If_Icu_17_GtmCcu6_PWMIN_LAMPSCB1
        Get_If_Icu_17_GtmCcu6_PWMIN_PWMSCB2
        Get_If_Icu_17_GtmCcu6_PWMIN_PWMSCB1
        Get_If_Icu_17_GtmCcu6_PWMIN_CH4
        Get_If_Icu_17_GtmCcu6_PWMIN_CH3
        Get_If_Icu_17_GtmCcu6_PWMIN_CH2
        Get_If_Icu_17_GtmCcu6_PWMIN_CH1
        Get_If_Get_CAN_ActiveInf
        Get_If_Get_BTS_OutResult
        Get_If_Get_io_inResult
        Get_If_Get_Ad_Result
  swc implementation YDF_GetIf_Driver_Implementation: behavior=YDF_GetIf_Driver_InternalBehavior
    code-descriptors:
      code Default: artifact-descriptors=autosar-engineering-object=category=SWSRC
