AUTOSAR XML (schema 00046)
package /ComponentTypes
  application sw component type IoHwAb
    provide port IoHwAb_ServiceType: provided-interface=IoHwAb_ServiceType
      provided-com-specs:
        operation=IoHwAb_DioSetChannelVal, queue-length=1
        operation=IoHwAb_DioGetChannelVal, queue-length=1
        operation=IoHwAb_AdcReadValues, queue-length=1
        operation=IoHwAb_AdcGetChannelValue, queue-length=1
        operation=IoHwAb_AdcConvert12BitValueTomv, queue-length=1
    behavior IoHwAb_InternalBehavior
      5 x operation invoked event:
        OIT_IoHwAb_ServiceType_IoHwAb_DioSetChannelVal_IoHwAb_ServiceType_IoHwAb_DioSetChannelVal: start-on-event=IoHwAb_ServiceType_IoHwAb_DioSetChannelVal, operation=IoHwAb_ServiceType.IoHwAb_DioSetChannelVal
        OIT_IoHwAb_ServiceType_IoHwAb_DioGetChannelVal_IoHwAb_ServiceType_IoHwAb_DioGetChannelVal: start-on-event=IoHwAb_ServiceType_IoHwAb_DioGetChannelVal, operation=IoHwAb_ServiceType.IoHwAb_DioGetChannelVal
        OIT_IoHwAb_ServiceType_IoHwAb_AdcReadValues_IoHwAb_ServiceType_IoHwAb_AdcReadValues: start-on-event=IoHwAb_ServiceType_IoHwAb_AdcReadValues, operation=IoHwAb_ServiceType.IoHwAb_AdcReadValues
        OIT_IoHwAb_ServiceType_IoHwAb_AdcGetChannelValue_IoHwAb_ServiceType_IoHwAb_AdcGetChannelValue: start-on-event=IoHwAb_ServiceType_IoHwAb_AdcGetChannelValue, operation=IoHwAb_ServiceType.IoHwAb_AdcGetChannelValue
        OIT_IoHwAb_ServiceType_IoHwAb_AdcConvert12BitValueTomv_IoHwAb_ServiceType_IoHwAb_AdcConvert12BitValueTomv: start-on-event=IoHwAb_ServiceType_IoHwAb_AdcConvert12BitValueTomv, operation=IoHwAb_ServiceType.IoHwAb_AdcConvert12BitValueTomv
      init event IoHwAb_InitEvent: start-on-event=IoHwAb_Init
      6 x runnable:
        IoHwAb_ServiceType_IoHwAb_DioSetChannelVal
        IoHwAb_ServiceType_IoHwAb_DioGetChannelVal
        IoHwAb_ServiceType_IoHwAb_AdcReadValues
        IoHwAb_ServiceType_IoHwAb_AdcGetChannelValue
        IoHwAb_ServiceType_IoHwAb_AdcConvert12BitValueTomv
        IoHwAb_Init
  swc implementation IoHwAb_Implementation: behavior=IoHwAb_InternalBehavior
    code-descriptors:
      code Default: artifact-descriptors=autosar-engineering-object=category=SWSRC
