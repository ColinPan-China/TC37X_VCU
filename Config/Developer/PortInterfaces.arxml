[part 2 of 2: packages /PortInterfaces to /SwAddrMethods]
AUTOSAR XML (schema 00046)
package /PortInterfaces  (continued)
  5 x nv data interface:
    IF_ModMgmtInfo
      nv-datas:
        data tec_ModMgmtInfo: type=dt_Nv_ModMgmtInfo
    IF_GearMgmtInfo
      nv-datas:
        data tec_GearMgmtInfo: type=dt_Nv_GearMgmtInfo
    IF_RngEstimnInfo
      nv-datas:
        data tec_RngEstimnInfo: type=dt_Nv_RngEstimnInfo
    IF_ChrgStatInfo
      nv-datas:
        data tec_ChrgStatInfo: type=dt_Nv_ChrgStatInfo
    IF_ChrgEgyCalInfo
      nv-datas:
        data tec_ChrgEgyCalInfo: type=dt_Nv_ChrgEgyCalInfo
  825 x sender receiver interface:
    IF_ChassisMgmt_ErrResBrkPedlFlt_Flg
      data tec_ChassisMgmt_ErrResBrkPedlFlt_Flg: type=boolean
    IF_ChassisMgmt_IBSRbsDesTqOverFltDTCInfo_Bus
      data tec_ChassisMgmt_IBSRbsDesTqOverFltDTCInfo_Bus: type=dt_ChassisMgmt_IBSRbsDesTqOverFltDTCInfo
    IF_ChassisMgmt_IBSVlcCtrlDesTqOverFltDTCInfo_Bus
      data tec_ChassisMgmt_IBSVlcCtrlDesTqOverFltDTCInfo_Bus: type=dt_ChassisMgmt_IBSVlcCtrlDesTqOverFltDTCInfo
    IF_ChassisMgmt_IBSApsCtrlDesTqOverFltDTCInfo_Bus
      data tec_ChassisMgmt_IBSApsCtrlDesTqOverFltDTCInfo_Bus: type=dt_ChassisMgmt_IBSApsCtrlDesTqOverFltDTCInfo
    IF_FctSftyMon_OldUnCfmdActGear_Enum
      data tec_FctSftyMon_OldUnCfmdActGear_Enum: type=uint8
    VCU_MaxTorqueLimit
      data VCU_MaxTorqueLimit: type=VCU_MaxTorqueLimit
    VCU_MinTorqueLimit
      data VCU_MinTorqueLimit: type=VCU_MinTorqueLimit
    BMS_BattVolt
      data BMS_BattVolt: type=BMS_BattVolt
    POD_OBC_CCCurrentLimit
      data POD_OBC_CCCurrentLimit: type=POD_OBC_CCCurrentLimit
    POD_OBC_CPStatus
      data POD_OBC_CPStatus: type=POD_OBC_CPStatus
    Ecu_KeyWakeStatus
      data Keywake: type=boolean
    Ecu_ChargeWakeStatus
      data Chargewake: type=boolean
    Ecu_AccWakeStatus
      data Accwake: type=boolean
    Ecu_12VInWakeStatus
      data st12VInwake: type=boolean
    Ecu_CHCANWakeStatus
      data CHCANwake: type=boolean
    Ecu_PTCANWakeStatus
      data PTCANwake: type=boolean
    Ecu_LinWakeStatus
      data Linwake: type=boolean
    Ecu_ETHWakeStatus
      data ETHwake: type=boolean
    Ecu_SBCWakeStatus
      data SBCwake: type=boolean
    IF_ComM_CGWPNC14
      data tec_ComM_CGWPNC14: type=boolean
    IF_ComM_CGWPNC1
      data tec_ComM_CGWPNC1: type=boolean
    IF_ComM_CGWPNC17
      data tec_ComM_CGWPNC17: type=boolean
    IF_ComM_CGWPNC3
      data tec_ComM_CGWPNC3: type=boolean
    IF_ComM_VCUPNC3
      data tec_ComM_VCUPNC3: type=boolean
    IF_ComM_VCUPNC1
      data tec_ComM_VCUPNC1: type=boolean
    IF_ComM_VCUPNC14
      data tec_ComM_VCUPNC14: type=boolean
    IF_ComM_VCUPNC17
      data tec_ComM_VCUPNC17: type=boolean
    IF_ComM_VCUPNC4
      data tec_ComM_VCUPNC4: type=boolean
    IF_ComM_CGWPNC0
      data tec_ComM_CGWPNC0: type=boolean
    BSW_ECUMState
      data BSWState: type=uint8
    BSW_FuSaHWErrorStatus
      data HWErrorStatus: type=boolean
    UDS_PwrCutRequest
      data PwrCutRequest: type=boolean
    BSW_NVMFailErrorStatus
      data NVMFailErrorStatus: type=boolean
    PTCAN_BusoffStatus
      data BusoffStatus: type=boolean
    CHCAN_BusoffStatus
      data BusoffStatus: type=boolean
    DCCAN_BusoffStatus
      data BusoffStatus: type=boolean
    IF_ComM_BMSPNC15
      data tec_ComM_BMSPNC15: type=boolean
    IF_ComM_CGWPNC15
      data tec_ComM_CGWPNC15: type=boolean
    IF_ComM_BMSAWB
      data tec_ComM_BMSAWB: type=boolean
    IF_ComM_CGWAWB
      data tec_ComM_CGWAWB: type=boolean
    IF_ErrMgmt_HvBattFailLamp
      data tec_ErrMgmt_HvBattFailLamp: type=uint8
    IF_ComM_CGWPNC2
      data tec_ComM_CGWPNC2: type=boolean
    IF_ComM_CGWPNC21
      data tec_ComM_CGWPNC21: type=boolean
    IF_ComM_CGWPNC13
      data tec_ComM_CGWPNC13: type=boolean
    IF_ComM_CGWPNC16
      data tec_ComM_CGWPNC16: type=boolean
    IF_ComM_VCUPNC2
      data tec_ComM_VCUPNC2: type=boolean
    IF_ComM_VCUPNC21
      data tec_ComM_VCUPNC21: type=boolean
    IF_ComM_VCUPNC13
      data tec_ComM_VCUPNC13: type=boolean
    IF_ComM_VCUPNC16
      data tec_ComM_VCUPNC16: type=boolean
    IF_ComM_BMSPNC16
      data tec_ComM_BMSPNC16: type=boolean
    POD_DCDC_Side2Overtempfault
      data POD_DCDC_Side2Overtempfault: type=POD_DCDC_Side2Overtempfault
    POD_OBC_PrimarySideTemp
      data POD_OBC_PrimarySideTemp: type=POD_OBC_PrimarySideTemp
    POD_OBC_SecondarySideTemp
      data POD_OBC_SecondarySideTemp: type=POD_OBC_SecondarySideTemp
    POD_OBC_Side1Overtempfault
      data POD_OBC_Side1Overtempfault: type=POD_OBC_Side1Overtempfault
    POD_OBC_Side2Overtempfault
      data POD_OBC_Side2Overtempfault: type=POD_OBC_Side2Overtempfault
    BS_BatVltOORHIDiag
      data BS_BatVltOORHIDiag: type=BS_BatVltOORHIDiag
    BS_BatVltOORLoDiag
      data BS_BatVltOORLoDiag: type=BS_BatVltOORLoDiag
    BS_ShntVltOORHiDiag
      data BS_ShntVltOORHiDiag: type=BS_ShntVltOORHiDiag
    BCP_AllowChargeVoltageMax
      data BCP_AllowChargeVoltageMax: sw-impl-policy=QUEUED, type=BCP_AllowChargeVoltageMax
    BCP_AllowTempMax
      data BCP_AllowTempMax: sw-impl-policy=QUEUED, type=BCP_AllowTempMax
    BCP_BatteryChargeVoltageMax
      data BCP_BatteryChargeVoltageMax: sw-impl-policy=QUEUED, type=BCP_BatteryChargeVoltageMax
    BCP_BatteryNominalEnergy
      data BCP_BatteryNominalEnergy: sw-impl-policy=QUEUED, type=BCP_BatteryNominalEnergy
    BCP_BatteryTotalVoltage
      data BCP_BatteryTotalVoltage: sw-impl-policy=QUEUED, type=BCP_BatteryTotalVoltage
    BCP_ChargeCurrentMax
      data BCP_ChargeCurrentMax: sw-impl-policy=QUEUED, type=BCP_ChargeCurrentMax
    BCP_SOC
      data BCP_SOC: sw-impl-policy=QUEUED, type=BCP_SOC
    BCS_BatteryVoltMax
      data BCS_BatteryVoltMax: sw-impl-policy=QUEUED, type=BCS_BatteryVoltMax
    BCS_BatteryVoltMaxGroup
      data BCS_BatteryVoltMaxGroup: sw-impl-policy=QUEUED, type=BCS_BatteryVoltMaxGroup
    BCS_ChargeCurrentMeasure
      data BCS_ChargeCurrentMeasure: sw-impl-policy=QUEUED, type=BCS_ChargeCurrentMeasure
    BCS_ChargeVoltageMeasure
      data BCS_ChargeVoltageMeasure: sw-impl-policy=QUEUED, type=BCS_ChargeVoltageMeasure
    BCS_EstimatedTimeRemaining
      data BCS_EstimatedTimeRemaining: sw-impl-policy=QUEUED, type=BCS_EstimatedTimeRemaining
    BCS_SOC
      data BCS_SOC: sw-impl-policy=QUEUED, type=BCS_SOC
    BRM_BatteryChargeTimes
      data BRM_BatteryChargeTimes: sw-impl-policy=QUEUED, type=BRM_BatteryChargeTimes
    BRM_BatteryProductDay
      data BRM_BatteryProductDay: sw-impl-policy=QUEUED, type=BRM_BatteryProductDay
    BRM_BatteryProductMonth
      data BRM_BatteryProductMonth: sw-impl-policy=QUEUED, type=BRM_BatteryProductMonth
    BRM_BatteryProductYear
      data BRM_BatteryProductYear: sw-impl-policy=QUEUED, type=BRM_BatteryProductYear
    BRM_BatteryProperty
      data BRM_BatteryProperty: sw-impl-policy=QUEUED, type=BRM_BatteryProperty
    BRM_BatterySN
      data BRM_BatterySN: sw-impl-policy=QUEUED, type=BRM_BatterySN
    BRM_BatterySystemRatedCapacity
      data BRM_BatterySystemRatedCapacity: sw-impl-policy=QUEUED, type=BRM_BatterySystemRatedCapacity
    BRM_BatterySystemRatedVoltage
      data BRM_BatterySystemRatedVoltage: sw-impl-policy=QUEUED, type=BRM_BatterySystemRatedVoltage
    BRM_BatteryType
      data BRM_BatteryType: sw-impl-policy=QUEUED, type=BRM_BatteryType
    BRM_Manufacturer
      data BRM_Manufacturer: sw-impl-policy=QUEUED, type=BRM_Manufacturer
    BRM_ProtocolVersion
      data BRM_ProtocolVersion: sw-impl-policy=QUEUED, type=BRM_ProtocolVersion
    BRM_VehicleIdByte1_8
      data BRM_VehicleIdByte1_8: sw-impl-policy=QUEUED, type=BRM_VehicleIdByte1_8
    BRM_VehicleIdByte17
      data BRM_VehicleIdByte17: sw-impl-policy=QUEUED, type=BRM_VehicleIdByte17
    BRM_VehicleIdByte9_16
      data BRM_VehicleIdByte9_16: sw-impl-policy=QUEUED, type=BRM_VehicleIdByte9_16
    BSD_AbortSOC
      data BSD_AbortSOC: type=BSD_AbortSOC
    BSD_BatteryTempMax
      data BSD_BatteryTempMax: type=BSD_BatteryTempMax
    BSD_BatteryTempMin
      data BSD_BatteryTempMin: type=BSD_BatteryTempMin
    BSD_BatteryVoltageMax
      data BSD_BatteryVoltageMax: type=BSD_BatteryVoltageMax
    BSD_BatteryVoltageMin
      data BSD_BatteryVoltageMin: type=BSD_BatteryVoltageMin
    BSM_BatteryTempMax
      data BSM_BatteryTempMax: type=BSM_BatteryTempMax
    BSM_BatteryTempMaxNo
      data BSM_BatteryTempMaxNo: type=BSM_BatteryTempMaxNo
    BSM_BatteryTempMin
      data BSM_BatteryTempMin: type=BSM_BatteryTempMin
    BSM_BatteryTempMinNo
      data BSM_BatteryTempMinNo: type=BSM_BatteryTempMinNo
    BSM_BatteryVoltageMaxNo
      data BSM_BatteryVoltageMaxNo: type=BSM_BatteryVoltageMaxNo
    BMT_BatteryTemp0
      data BMT_BatteryTemp0: sw-impl-policy=QUEUED, type=BMT_BatteryTemp0
    BMT_BatteryTemp1
      data BMT_BatteryTemp1: sw-impl-policy=QUEUED, type=BMT_BatteryTemp1
    BMT_BatteryTemp10
      data BMT_BatteryTemp10: sw-impl-policy=QUEUED, type=BMT_BatteryTemp10
    BMT_BatteryTemp11
      data BMT_BatteryTemp11: sw-impl-policy=QUEUED, type=BMT_BatteryTemp11
    BMT_BatteryTemp12
      data BMT_BatteryTemp12: sw-impl-policy=QUEUED, type=BMT_BatteryTemp12
    BMT_BatteryTemp13
      data BMT_BatteryTemp13: sw-impl-policy=QUEUED, type=BMT_BatteryTemp13
    BMT_BatteryTemp14
      data BMT_BatteryTemp14: sw-impl-policy=QUEUED, type=BMT_BatteryTemp14
    BMT_BatteryTemp15
      data BMT_BatteryTemp15: sw-impl-policy=QUEUED, type=BMT_BatteryTemp15
    BMT_BatteryTemp2
      data BMT_BatteryTemp2: sw-impl-policy=QUEUED, type=BMT_BatteryTemp2
    BMT_BatteryTemp3
      data BMT_BatteryTemp3: sw-impl-policy=QUEUED, type=BMT_BatteryTemp3
    BMT_BatteryTemp4
      data BMT_BatteryTemp4: sw-impl-policy=QUEUED, type=BMT_BatteryTemp4
    BMT_BatteryTemp5
      data BMT_BatteryTemp5: sw-impl-policy=QUEUED, type=BMT_BatteryTemp5
    BMT_BatteryTemp6
      data BMT_BatteryTemp6: sw-impl-policy=QUEUED, type=BMT_BatteryTemp6
    BMT_BatteryTemp7
      data BMT_BatteryTemp7: sw-impl-policy=QUEUED, type=BMT_BatteryTemp7
    BMT_BatteryTemp8
      data BMT_BatteryTemp8: sw-impl-policy=QUEUED, type=BMT_BatteryTemp8
    BMT_BatteryTemp9
      data BMT_BatteryTemp9: sw-impl-policy=QUEUED, type=BMT_BatteryTemp9
    BMV_BatteryGroupID0
      data BMV_BatteryGroupID0: sw-impl-policy=QUEUED, type=BMV_BatteryGroupID0
    BMV_BatteryGroupID1
      data BMV_BatteryGroupID1: sw-impl-policy=QUEUED, type=BMV_BatteryGroupID1
    BMV_BatteryGroupID10
      data BMV_BatteryGroupID10: sw-impl-policy=QUEUED, type=BMV_BatteryGroupID10
    BMV_BatteryGroupID100
      data BMV_BatteryGroupID100: sw-impl-policy=QUEUED, type=BMV_BatteryGroupID100
    BMV_BatteryGroupID101
      data BMV_BatteryGroupID101: sw-impl-policy=QUEUED, type=BMV_BatteryGroupID101
    BMV_BatteryGroupID102
      data BMV_BatteryGroupID102: sw-impl-policy=QUEUED, type=BMV_BatteryGroupID102
    BMV_BatteryGroupID103
      data BMV_BatteryGroupID103: sw-impl-policy=QUEUED, type=BMV_BatteryGroupID103
    BMV_BatteryGroupID104
      data BMV_BatteryGroupID104: sw-impl-policy=QUEUED, type=BMV_BatteryGroupID104
    BMV_BatteryGroupID105
      data BMV_BatteryGroupID105: sw-impl-policy=QUEUED, type=BMV_BatteryGroupID105
    BMV_BatteryGroupID106
      data BMV_BatteryGroupID106: sw-impl-policy=QUEUED, type=BMV_BatteryGroupID106
    BMV_BatteryGroupID107
      data BMV_BatteryGroupID107: sw-impl-policy=QUEUED, type=BMV_BatteryGroupID107
    BMV_BatteryGroupID108
      data BMV_BatteryGroupID108: sw-impl-policy=QUEUED, type=BMV_BatteryGroupID108
    BMV_BatteryGroupID109
      data BMV_BatteryGroupID109: sw-impl-policy=QUEUED, type=BMV_BatteryGroupID109
    BMV_BatteryGroupID11
      data BMV_BatteryGroupID11: sw-impl-policy=QUEUED, type=BMV_BatteryGroupID11
    BMV_BatteryGroupID110
      data BMV_BatteryGroupID110: sw-impl-policy=QUEUED, type=BMV_BatteryGroupID110
    BMV_BatteryGroupID111
      data BMV_BatteryGroupID111: sw-impl-policy=QUEUED, type=BMV_BatteryGroupID111
    BMV_BatteryGroupID112
      data BMV_BatteryGroupID112: sw-impl-policy=QUEUED, type=BMV_BatteryGroupID112
    BMV_BatteryGroupID113
      data BMV_BatteryGroupID113: sw-impl-policy=QUEUED, type=BMV_BatteryGroupID113
    BMV_BatteryGroupID114
      data BMV_BatteryGroupID114: sw-impl-policy=QUEUED, type=BMV_BatteryGroupID114
    BMV_BatteryGroupID115
      data BMV_BatteryGroupID115: sw-impl-policy=QUEUED, type=BMV_BatteryGroupID115
    BMV_BatteryGroupID116
      data BMV_BatteryGroupID116: sw-impl-policy=QUEUED, type=BMV_BatteryGroupID116
    BMV_BatteryGroupID117
      data BMV_BatteryGroupID117: sw-impl-policy=QUEUED, type=BMV_BatteryGroupID117
    BMV_BatteryGroupID118
      data BMV_BatteryGroupID118: sw-impl-policy=QUEUED, type=BMV_BatteryGroupID118
    BMV_BatteryGroupID119
      data BMV_BatteryGroupID119: sw-impl-policy=QUEUED, type=BMV_BatteryGroupID119
    BMV_BatteryGroupID12
      data BMV_BatteryGroupID12: sw-impl-policy=QUEUED, type=BMV_BatteryGroupID12
    BMV_BatteryGroupID120
      data BMV_BatteryGroupID120: sw-impl-policy=QUEUED, type=BMV_BatteryGroupID120
    BMV_BatteryGroupID121
      data BMV_BatteryGroupID121: sw-impl-policy=QUEUED, type=BMV_BatteryGroupID121
    BMV_BatteryGroupID122
      data BMV_BatteryGroupID122: sw-impl-policy=QUEUED, type=BMV_BatteryGroupID122
    BMV_BatteryGroupID123
      data BMV_BatteryGroupID123: sw-impl-policy=QUEUED, type=BMV_BatteryGroupID123
    BMV_BatteryGroupID124
      data BMV_BatteryGroupID124: sw-impl-policy=QUEUED, type=BMV_BatteryGroupID124
    BMV_BatteryGroupID125
      data BMV_BatteryGroupID125: sw-impl-policy=QUEUED, type=BMV_BatteryGroupID125
    BMV_BatteryGroupID126
      data BMV_BatteryGroupID126: sw-impl-policy=QUEUED, type=BMV_BatteryGroupID126
    BMV_BatteryGroupID127
      data BMV_BatteryGroupID127: sw-impl-policy=QUEUED, type=BMV_BatteryGroupID127
    BMV_BatteryGroupID128
      data BMV_BatteryGroupID128: sw-impl-policy=QUEUED, type=BMV_BatteryGroupID128
    BMV_BatteryGroupID129
      data BMV_BatteryGroupID129: sw-impl-policy=QUEUED, type=BMV_BatteryGroupID129
    BMV_BatteryGroupID13
      data BMV_BatteryGroupID13: sw-impl-policy=QUEUED, type=BMV_BatteryGroupID13
    BMV_BatteryGroupID130
      data BMV_BatteryGroupID130: sw-impl-policy=QUEUED, type=BMV_BatteryGroupID130
    BMV_BatteryGroupID131
      data BMV_BatteryGroupID131: sw-impl-policy=QUEUED, type=BMV_BatteryGroupID131
    BMV_BatteryGroupID132
      data BMV_BatteryGroupID132: sw-impl-policy=QUEUED, type=BMV_BatteryGroupID132
    BMV_BatteryGroupID133
      data BMV_BatteryGroupID133: sw-impl-policy=QUEUED, type=BMV_BatteryGroupID133
    BMV_BatteryGroupID134
      data BMV_BatteryGroupID134: sw-impl-policy=QUEUED, type=BMV_BatteryGroupID134
    BMV_BatteryGroupID135
      data BMV_BatteryGroupID135: sw-impl-policy=QUEUED, type=BMV_BatteryGroupID135
    BMV_BatteryGroupID136
      data BMV_BatteryGroupID136: sw-impl-policy=QUEUED, type=BMV_BatteryGroupID136
    BMV_BatteryGroupID137
      data BMV_BatteryGroupID137: sw-impl-policy=QUEUED, type=BMV_BatteryGroupID137
    BMV_BatteryGroupID138
      data BMV_BatteryGroupID138: sw-impl-policy=QUEUED, type=BMV_BatteryGroupID138
    BMV_BatteryGroupID139
      data BMV_BatteryGroupID139: sw-impl-policy=QUEUED, type=BMV_BatteryGroupID139
    BMV_BatteryGroupID14
      data BMV_BatteryGroupID14: sw-impl-policy=QUEUED, type=BMV_BatteryGroupID14
    BMV_BatteryGroupID140
      data BMV_BatteryGroupID140: sw-impl-policy=QUEUED, type=BMV_BatteryGroupID140
    BMV_BatteryGroupID141
      data BMV_BatteryGroupID141: sw-impl-policy=QUEUED, type=BMV_BatteryGroupID141
    BMV_BatteryGroupID142
      data BMV_BatteryGroupID142: sw-impl-policy=QUEUED, type=BMV_BatteryGroupID142
    BMV_BatteryGroupID143
      data BMV_BatteryGroupID143: sw-impl-policy=QUEUED, type=BMV_BatteryGroupID143
    BMV_BatteryGroupID144
      data BMV_BatteryGroupID144: sw-impl-policy=QUEUED, type=BMV_BatteryGroupID144
    BMV_BatteryGroupID145
      data BMV_BatteryGroupID145: sw-impl-policy=QUEUED, type=BMV_BatteryGroupID145
    BMV_BatteryGroupID146
      data BMV_BatteryGroupID146: sw-impl-policy=QUEUED, type=BMV_BatteryGroupID146
    BMV_BatteryGroupID147
      data BMV_BatteryGroupID147: sw-impl-policy=QUEUED, type=BMV_BatteryGroupID147
    BMV_BatteryGroupID148
      data BMV_BatteryGroupID148: sw-impl-policy=QUEUED, type=BMV_BatteryGroupID148
    BMV_BatteryGroupID149
      data BMV_BatteryGroupID149: sw-impl-policy=QUEUED, type=BMV_BatteryGroupID149
    BMV_BatteryGroupID15
      data BMV_BatteryGroupID15: sw-impl-policy=QUEUED, type=BMV_BatteryGroupID15
    BMV_BatteryGroupID150
      data BMV_BatteryGroupID150: sw-impl-policy=QUEUED, type=BMV_BatteryGroupID150
    BMV_BatteryGroupID151
      data BMV_BatteryGroupID151: sw-impl-policy=QUEUED, type=BMV_BatteryGroupID151
    BMV_BatteryGroupID152
      data BMV_BatteryGroupID152: sw-impl-policy=QUEUED, type=BMV_BatteryGroupID152
    BMV_BatteryGroupID153
      data BMV_BatteryGroupID153: sw-impl-policy=QUEUED, type=BMV_BatteryGroupID153
    BMV_BatteryGroupID154
      data BMV_BatteryGroupID154: sw-impl-policy=QUEUED, type=BMV_BatteryGroupID154
    BMV_BatteryGroupID155
      data BMV_BatteryGroupID155: sw-impl-policy=QUEUED, type=BMV_BatteryGroupID155
    BMV_BatteryGroupID156
      data BMV_BatteryGroupID156: sw-impl-policy=QUEUED, type=BMV_BatteryGroupID156
    BMV_BatteryGroupID157
      data BMV_BatteryGroupID157: sw-impl-policy=QUEUED, type=BMV_BatteryGroupID157
    BMV_BatteryGroupID158
      data BMV_BatteryGroupID158: sw-impl-policy=QUEUED, type=BMV_BatteryGroupID158
    BMV_BatteryGroupID159
      data BMV_BatteryGroupID159: sw-impl-policy=QUEUED, type=BMV_BatteryGroupID159
    BMV_BatteryGroupID16
      data BMV_BatteryGroupID16: sw-impl-policy=QUEUED, type=BMV_BatteryGroupID16
    BMV_BatteryGroupID160
      data BMV_BatteryGroupID160: sw-impl-policy=QUEUED, type=BMV_BatteryGroupID160
    BMV_BatteryGroupID161
      data BMV_BatteryGroupID161: sw-impl-policy=QUEUED, type=BMV_BatteryGroupID161
    BMV_BatteryGroupID162
      data BMV_BatteryGroupID162: sw-impl-policy=QUEUED, type=BMV_BatteryGroupID162
    BMV_BatteryGroupID163
      data BMV_BatteryGroupID163: sw-impl-policy=QUEUED, type=BMV_BatteryGroupID163
    BMV_BatteryGroupID164
      data BMV_BatteryGroupID164: sw-impl-policy=QUEUED, type=BMV_BatteryGroupID164
    BMV_BatteryGroupID165
      data BMV_BatteryGroupID165: sw-impl-policy=QUEUED, type=BMV_BatteryGroupID165
    BMV_BatteryGroupID166
      data BMV_BatteryGroupID166: sw-impl-policy=QUEUED, type=BMV_BatteryGroupID166
    BMV_BatteryGroupID167
      data BMV_BatteryGroupID167: sw-impl-policy=QUEUED, type=BMV_BatteryGroupID167
    BMV_BatteryGroupID168
      data BMV_BatteryGroupID168: sw-impl-policy=QUEUED, type=BMV_BatteryGroupID168
    BMV_BatteryGroupID169
      data BMV_BatteryGroupID169: sw-impl-policy=QUEUED, type=BMV_BatteryGroupID169
    BMV_BatteryGroupID17
      data BMV_BatteryGroupID17: sw-impl-policy=QUEUED, type=BMV_BatteryGroupID17
    BMV_BatteryGroupID170
      data BMV_BatteryGroupID170: sw-impl-policy=QUEUED, type=BMV_BatteryGroupID170
    BMV_BatteryGroupID171
      data BMV_BatteryGroupID171: sw-impl-policy=QUEUED, type=BMV_BatteryGroupID171
    BMV_BatteryGroupID172
      data BMV_BatteryGroupID172: sw-impl-policy=QUEUED, type=BMV_BatteryGroupID172
    BMV_BatteryGroupID173
      data BMV_BatteryGroupID173: sw-impl-policy=QUEUED, type=BMV_BatteryGroupID173
    BMV_BatteryGroupID174
      data BMV_BatteryGroupID174: sw-impl-policy=QUEUED, type=BMV_BatteryGroupID174
    BMV_BatteryGroupID175
      data BMV_BatteryGroupID175: sw-impl-policy=QUEUED, type=BMV_BatteryGroupID175
    BMV_BatteryGroupID176
      data BMV_BatteryGroupID176: sw-impl-policy=QUEUED, type=BMV_BatteryGroupID176
    BMV_BatteryGroupID177
      data BMV_BatteryGroupID177: sw-impl-policy=QUEUED, type=BMV_BatteryGroupID177
    BMV_BatteryGroupID178
      data BMV_BatteryGroupID178: sw-impl-policy=QUEUED, type=BMV_BatteryGroupID178
    BMV_BatteryGroupID179
      data BMV_BatteryGroupID179: sw-impl-policy=QUEUED, type=BMV_BatteryGroupID179
    BMV_BatteryGroupID18
      data BMV_BatteryGroupID18: sw-impl-policy=QUEUED, type=BMV_BatteryGroupID18
    BMV_BatteryGroupID180
      data BMV_BatteryGroupID180: sw-impl-policy=QUEUED, type=BMV_BatteryGroupID180
    BMV_BatteryGroupID181
      data BMV_BatteryGroupID181: sw-impl-policy=QUEUED, type=BMV_BatteryGroupID181
    BMV_BatteryGroupID182
      data BMV_BatteryGroupID182: sw-impl-policy=QUEUED, type=BMV_BatteryGroupID182
    BMV_BatteryGroupID183
      data BMV_BatteryGroupID183: sw-impl-policy=QUEUED, type=BMV_BatteryGroupID183
    BMV_BatteryGroupID184
      data BMV_BatteryGroupID184: sw-impl-policy=QUEUED, type=BMV_BatteryGroupID184
    BMV_BatteryGroupID185
      data BMV_BatteryGroupID185: sw-impl-policy=QUEUED, type=BMV_BatteryGroupID185
    BMV_BatteryGroupID186
      data BMV_BatteryGroupID186: sw-impl-policy=QUEUED, type=BMV_BatteryGroupID186
    BMV_BatteryGroupID187
      data BMV_BatteryGroupID187: sw-impl-policy=QUEUED, type=BMV_BatteryGroupID187
    BMV_BatteryGroupID188
      data BMV_BatteryGroupID188: sw-impl-policy=QUEUED, type=BMV_BatteryGroupID188
    BMV_BatteryGroupID189
      data BMV_BatteryGroupID189: sw-impl-policy=QUEUED, type=BMV_BatteryGroupID189
    BMV_BatteryGroupID19
      data BMV_BatteryGroupID19: sw-impl-policy=QUEUED, type=BMV_BatteryGroupID19
    BMV_BatteryGroupID190
      data BMV_BatteryGroupID190: sw-impl-policy=QUEUED, type=BMV_BatteryGroupID190
    BMV_BatteryGroupID191
      data BMV_BatteryGroupID191: sw-impl-policy=QUEUED, type=BMV_BatteryGroupID191
    BMV_BatteryGroupID192
      data BMV_BatteryGroupID192: sw-impl-policy=QUEUED, type=BMV_BatteryGroupID192
    BMV_BatteryGroupID193
      data BMV_BatteryGroupID193: sw-impl-policy=QUEUED, type=BMV_BatteryGroupID193
    BMV_BatteryGroupID194
      data BMV_BatteryGroupID194: sw-impl-policy=QUEUED, type=BMV_BatteryGroupID194
    BMV_BatteryGroupID195
      data BMV_BatteryGroupID195: sw-impl-policy=QUEUED, type=BMV_BatteryGroupID195
    BMV_BatteryGroupID196
      data BMV_BatteryGroupID196: sw-impl-policy=QUEUED, type=BMV_BatteryGroupID196
    BMV_BatteryGroupID197
      data BMV_BatteryGroupID197: sw-impl-policy=QUEUED, type=BMV_BatteryGroupID197
    BMV_BatteryGroupID198
      data BMV_BatteryGroupID198: sw-impl-policy=QUEUED, type=BMV_BatteryGroupID198
    BMV_BatteryGroupID199
      data BMV_BatteryGroupID199: sw-impl-policy=QUEUED, type=BMV_BatteryGroupID199
    BMV_BatteryGroupID2
      data BMV_BatteryGroupID2: sw-impl-policy=QUEUED, type=BMV_BatteryGroupID2
    BMV_BatteryGroupID20
      data BMV_BatteryGroupID20: sw-impl-policy=QUEUED, type=BMV_BatteryGroupID20
    BMV_BatteryGroupID200
      data BMV_BatteryGroupID200: sw-impl-policy=QUEUED, type=BMV_BatteryGroupID200
    BMV_BatteryGroupID201
      data BMV_BatteryGroupID201: sw-impl-policy=QUEUED, type=BMV_BatteryGroupID201
    BMV_BatteryGroupID202
      data BMV_BatteryGroupID202: sw-impl-policy=QUEUED, type=BMV_BatteryGroupID202
    BMV_BatteryGroupID203
      data BMV_BatteryGroupID203: sw-impl-policy=QUEUED, type=BMV_BatteryGroupID203
    BMV_BatteryGroupID204
      data BMV_BatteryGroupID204: sw-impl-policy=QUEUED, type=BMV_BatteryGroupID204
    BMV_BatteryGroupID205
      data BMV_BatteryGroupID205: sw-impl-policy=QUEUED, type=BMV_BatteryGroupID205
    BMV_BatteryGroupID206
      data BMV_BatteryGroupID206: sw-impl-policy=QUEUED, type=BMV_BatteryGroupID206
    BMV_BatteryGroupID207
      data BMV_BatteryGroupID207: sw-impl-policy=QUEUED, type=BMV_BatteryGroupID207
    BMV_BatteryGroupID208
      data BMV_BatteryGroupID208: sw-impl-policy=QUEUED, type=BMV_BatteryGroupID208
    BMV_BatteryGroupID209
      data BMV_BatteryGroupID209: sw-impl-policy=QUEUED, type=BMV_BatteryGroupID209
    BMV_BatteryGroupID21
      data BMV_BatteryGroupID21: sw-impl-policy=QUEUED, type=BMV_BatteryGroupID21
    BMV_BatteryGroupID210
      data BMV_BatteryGroupID210: sw-impl-policy=QUEUED, type=BMV_BatteryGroupID210
    BMV_BatteryGroupID211
      data BMV_BatteryGroupID211: sw-impl-policy=QUEUED, type=BMV_BatteryGroupID211
    BMV_BatteryGroupID212
      data BMV_BatteryGroupID212: sw-impl-policy=QUEUED, type=BMV_BatteryGroupID212
    BMV_BatteryGroupID213
      data BMV_BatteryGroupID213: sw-impl-policy=QUEUED, type=BMV_BatteryGroupID213
    BMV_BatteryGroupID214
      data BMV_BatteryGroupID214: sw-impl-policy=QUEUED, type=BMV_BatteryGroupID214
    BMV_BatteryGroupID215
      data BMV_BatteryGroupID215: sw-impl-policy=QUEUED, type=BMV_BatteryGroupID215
    BMV_BatteryGroupID216
      data BMV_BatteryGroupID216: sw-impl-policy=QUEUED, type=BMV_BatteryGroupID216
    BMV_BatteryGroupID217
      data BMV_BatteryGroupID217: sw-impl-policy=QUEUED, type=BMV_BatteryGroupID217
    BMV_BatteryGroupID218
      data BMV_BatteryGroupID218: sw-impl-policy=QUEUED, type=BMV_BatteryGroupID218
    BMV_BatteryGroupID219
      data BMV_BatteryGroupID219: sw-impl-policy=QUEUED, type=BMV_BatteryGroupID219
    BMV_BatteryGroupID22
      data BMV_BatteryGroupID22: sw-impl-policy=QUEUED, type=BMV_BatteryGroupID22
    BMV_BatteryGroupID220
      data BMV_BatteryGroupID220: sw-impl-policy=QUEUED, type=BMV_BatteryGroupID220
    BMV_BatteryGroupID221
      data BMV_BatteryGroupID221: sw-impl-policy=QUEUED, type=BMV_BatteryGroupID221
    BMV_BatteryGroupID222
      data BMV_BatteryGroupID222: sw-impl-policy=QUEUED, type=BMV_BatteryGroupID222
    BMV_BatteryGroupID223
      data BMV_BatteryGroupID223: sw-impl-policy=QUEUED, type=BMV_BatteryGroupID223
    BMV_BatteryGroupID224
      data BMV_BatteryGroupID224: sw-impl-policy=QUEUED, type=BMV_BatteryGroupID224
    BMV_BatteryGroupID225
      data BMV_BatteryGroupID225: sw-impl-policy=QUEUED, type=BMV_BatteryGroupID225
    BMV_BatteryGroupID226
      data BMV_BatteryGroupID226: sw-impl-policy=QUEUED, type=BMV_BatteryGroupID226
    BMV_BatteryGroupID227
      data BMV_BatteryGroupID227: sw-impl-policy=QUEUED, type=BMV_BatteryGroupID227
    BMV_BatteryGroupID228
      data BMV_BatteryGroupID228: sw-impl-policy=QUEUED, type=BMV_BatteryGroupID228
    BMV_BatteryGroupID229
      data BMV_BatteryGroupID229: sw-impl-policy=QUEUED, type=BMV_BatteryGroupID229
    BMV_BatteryGroupID23
      data BMV_BatteryGroupID23: sw-impl-policy=QUEUED, type=BMV_BatteryGroupID23
    BMV_BatteryGroupID230
      data BMV_BatteryGroupID230: sw-impl-policy=QUEUED, type=BMV_BatteryGroupID230
    BMV_BatteryGroupID231
      data BMV_BatteryGroupID231: sw-impl-policy=QUEUED, type=BMV_BatteryGroupID231
    BMV_BatteryGroupID232
      data BMV_BatteryGroupID232: sw-impl-policy=QUEUED, type=BMV_BatteryGroupID232
    BMV_BatteryGroupID233
      data BMV_BatteryGroupID233: sw-impl-policy=QUEUED, type=BMV_BatteryGroupID233
    BMV_BatteryGroupID234
      data BMV_BatteryGroupID234: sw-impl-policy=QUEUED, type=BMV_BatteryGroupID234
    BMV_BatteryGroupID235
      data BMV_BatteryGroupID235: sw-impl-policy=QUEUED, type=BMV_BatteryGroupID235
    BMV_BatteryGroupID236
      data BMV_BatteryGroupID236: sw-impl-policy=QUEUED, type=BMV_BatteryGroupID236
    BMV_BatteryGroupID237
      data BMV_BatteryGroupID237: sw-impl-policy=QUEUED, type=BMV_BatteryGroupID237
    BMV_BatteryGroupID238
      data BMV_BatteryGroupID238: sw-impl-policy=QUEUED, type=BMV_BatteryGroupID238
    BMV_BatteryGroupID239
      data BMV_BatteryGroupID239: sw-impl-policy=QUEUED, type=BMV_BatteryGroupID239
    BMV_BatteryGroupID24
      data BMV_BatteryGroupID24: sw-impl-policy=QUEUED, type=BMV_BatteryGroupID24
    BMV_BatteryGroupID240
      data BMV_BatteryGroupID240: sw-impl-policy=QUEUED, type=BMV_BatteryGroupID240
    BMV_BatteryGroupID241
      data BMV_BatteryGroupID241: sw-impl-policy=QUEUED, type=BMV_BatteryGroupID241
    BMV_BatteryGroupID242
      data BMV_BatteryGroupID242: sw-impl-policy=QUEUED, type=BMV_BatteryGroupID242
    BMV_BatteryGroupID243
      data BMV_BatteryGroupID243: sw-impl-policy=QUEUED, type=BMV_BatteryGroupID243
    BMV_BatteryGroupID244
      data BMV_BatteryGroupID244: sw-impl-policy=QUEUED, type=BMV_BatteryGroupID244
    BMV_BatteryGroupID245
      data BMV_BatteryGroupID245: sw-impl-policy=QUEUED, type=BMV_BatteryGroupID245
    BMV_BatteryGroupID246
      data BMV_BatteryGroupID246: sw-impl-policy=QUEUED, type=BMV_BatteryGroupID246
    BMV_BatteryGroupID247
      data BMV_BatteryGroupID247: sw-impl-policy=QUEUED, type=BMV_BatteryGroupID247
    BMV_BatteryGroupID248
      data BMV_BatteryGroupID248: sw-impl-policy=QUEUED, type=BMV_BatteryGroupID248
    BMV_BatteryGroupID249
      data BMV_BatteryGroupID249: sw-impl-policy=QUEUED, type=BMV_BatteryGroupID249
    BMV_BatteryGroupID25
      data BMV_BatteryGroupID25: sw-impl-policy=QUEUED, type=BMV_BatteryGroupID25
    BMV_BatteryGroupID250
      data BMV_BatteryGroupID250: sw-impl-policy=QUEUED, type=BMV_BatteryGroupID250
    BMV_BatteryGroupID251
      data BMV_BatteryGroupID251: sw-impl-policy=QUEUED, type=BMV_BatteryGroupID251
    BMV_BatteryGroupID252
      data BMV_BatteryGroupID252: sw-impl-policy=QUEUED, type=BMV_BatteryGroupID252
    BMV_BatteryGroupID253
      data BMV_BatteryGroupID253: sw-impl-policy=QUEUED, type=BMV_BatteryGroupID253
    BMV_BatteryGroupID254
      data BMV_BatteryGroupID254: sw-impl-policy=QUEUED, type=BMV_BatteryGroupID254
    BMV_BatteryGroupID255
      data BMV_BatteryGroupID255: sw-impl-policy=QUEUED, type=BMV_BatteryGroupID255
    BMV_BatteryGroupID26
      data BMV_BatteryGroupID26: sw-impl-policy=QUEUED, type=BMV_BatteryGroupID26
    BMV_BatteryGroupID27
      data BMV_BatteryGroupID27: sw-impl-policy=QUEUED, type=BMV_BatteryGroupID27
    BMV_BatteryGroupID28
      data BMV_BatteryGroupID28: sw-impl-policy=QUEUED, type=BMV_BatteryGroupID28
    BMV_BatteryGroupID29
      data BMV_BatteryGroupID29: sw-impl-policy=QUEUED, type=BMV_BatteryGroupID29
    BMV_BatteryGroupID3
      data BMV_BatteryGroupID3: sw-impl-policy=QUEUED, type=BMV_BatteryGroupID3
    BMV_BatteryGroupID30
      data BMV_BatteryGroupID30: sw-impl-policy=QUEUED, type=BMV_BatteryGroupID30
    BMV_BatteryGroupID31
      data BMV_BatteryGroupID31: sw-impl-policy=QUEUED, type=BMV_BatteryGroupID31
    BMV_BatteryGroupID32
      data BMV_BatteryGroupID32: sw-impl-policy=QUEUED, type=BMV_BatteryGroupID32
    BMV_BatteryGroupID33
      data BMV_BatteryGroupID33: sw-impl-policy=QUEUED, type=BMV_BatteryGroupID33
    BMV_BatteryGroupID34
      data BMV_BatteryGroupID34: sw-impl-policy=QUEUED, type=BMV_BatteryGroupID34
    BMV_BatteryGroupID35
      data BMV_BatteryGroupID35: sw-impl-policy=QUEUED, type=BMV_BatteryGroupID35
    BMV_BatteryGroupID36
      data BMV_BatteryGroupID36: sw-impl-policy=QUEUED, type=BMV_BatteryGroupID36
    BMV_BatteryGroupID37
      data BMV_BatteryGroupID37: sw-impl-policy=QUEUED, type=BMV_BatteryGroupID37
    BMV_BatteryGroupID38
      data BMV_BatteryGroupID38: sw-impl-policy=QUEUED, type=BMV_BatteryGroupID38
    BMV_BatteryGroupID39
      data BMV_BatteryGroupID39: sw-impl-policy=QUEUED, type=BMV_BatteryGroupID39
    BMV_BatteryGroupID4
      data BMV_BatteryGroupID4: sw-impl-policy=QUEUED, type=BMV_BatteryGroupID4
    BMV_BatteryGroupID40
      data BMV_BatteryGroupID40: sw-impl-policy=QUEUED, type=BMV_BatteryGroupID40
    BMV_BatteryGroupID41
      data BMV_BatteryGroupID41: sw-impl-policy=QUEUED, type=BMV_BatteryGroupID41
    BMV_BatteryGroupID42
      data BMV_BatteryGroupID42: sw-impl-policy=QUEUED, type=BMV_BatteryGroupID42
    BMV_BatteryGroupID43
      data BMV_BatteryGroupID43: sw-impl-policy=QUEUED, type=BMV_BatteryGroupID43
    BMV_BatteryGroupID44
      data BMV_BatteryGroupID44: sw-impl-policy=QUEUED, type=BMV_BatteryGroupID44
    BMV_BatteryGroupID45
      data BMV_BatteryGroupID45: sw-impl-policy=QUEUED, type=BMV_BatteryGroupID45
    BMV_BatteryGroupID46
      data BMV_BatteryGroupID46: sw-impl-policy=QUEUED, type=BMV_BatteryGroupID46
    BMV_BatteryGroupID47
      data BMV_BatteryGroupID47: sw-impl-policy=QUEUED, type=BMV_BatteryGroupID47
    BMV_BatteryGroupID48
      data BMV_BatteryGroupID48: sw-impl-policy=QUEUED, type=BMV_BatteryGroupID48
    BMV_BatteryGroupID49
      data BMV_BatteryGroupID49: sw-impl-policy=QUEUED, type=BMV_BatteryGroupID49
    BMV_BatteryGroupID5
      data BMV_BatteryGroupID5: sw-impl-policy=QUEUED, type=BMV_BatteryGroupID5
    BMV_BatteryGroupID50
      data BMV_BatteryGroupID50: sw-impl-policy=QUEUED, type=BMV_BatteryGroupID50
    BMV_BatteryGroupID51
      data BMV_BatteryGroupID51: sw-impl-policy=QUEUED, type=BMV_BatteryGroupID51
    BMV_BatteryGroupID52
      data BMV_BatteryGroupID52: sw-impl-policy=QUEUED, type=BMV_BatteryGroupID52
    BMV_BatteryGroupID53
      data BMV_BatteryGroupID53: sw-impl-policy=QUEUED, type=BMV_BatteryGroupID53
    BMV_BatteryGroupID54
      data BMV_BatteryGroupID54: sw-impl-policy=QUEUED, type=BMV_BatteryGroupID54
    BMV_BatteryGroupID55
      data BMV_BatteryGroupID55: sw-impl-policy=QUEUED, type=BMV_BatteryGroupID55
    BMV_BatteryGroupID56
      data BMV_BatteryGroupID56: sw-impl-policy=QUEUED, type=BMV_BatteryGroupID56
    BMV_BatteryGroupID57
      data BMV_BatteryGroupID57: sw-impl-policy=QUEUED, type=BMV_BatteryGroupID57
    BMV_BatteryGroupID58
      data BMV_BatteryGroupID58: sw-impl-policy=QUEUED, type=BMV_BatteryGroupID58
    BMV_BatteryGroupID59
      data BMV_BatteryGroupID59: sw-impl-policy=QUEUED, type=BMV_BatteryGroupID59
    BMV_BatteryGroupID6
      data BMV_BatteryGroupID6: sw-impl-policy=QUEUED, type=BMV_BatteryGroupID6
    BMV_BatteryGroupID60
      data BMV_BatteryGroupID60: sw-impl-policy=QUEUED, type=BMV_BatteryGroupID60
    BMV_BatteryGroupID61
      data BMV_BatteryGroupID61: sw-impl-policy=QUEUED, type=BMV_BatteryGroupID61
    BMV_BatteryGroupID62
      data BMV_BatteryGroupID62: sw-impl-policy=QUEUED, type=BMV_BatteryGroupID62
    BMV_BatteryGroupID63
      data BMV_BatteryGroupID63: sw-impl-policy=QUEUED, type=BMV_BatteryGroupID63
    BMV_BatteryGroupID64
      data BMV_BatteryGroupID64: sw-impl-policy=QUEUED, type=BMV_BatteryGroupID64
    BMV_BatteryGroupID65
      data BMV_BatteryGroupID65: sw-impl-policy=QUEUED, type=BMV_BatteryGroupID65
    BMV_BatteryGroupID66
      data BMV_BatteryGroupID66: sw-impl-policy=QUEUED, type=BMV_BatteryGroupID66
    BMV_BatteryGroupID67
      data BMV_BatteryGroupID67: sw-impl-policy=QUEUED, type=BMV_BatteryGroupID67
    BMV_BatteryGroupID68
      data BMV_BatteryGroupID68: sw-impl-policy=QUEUED, type=BMV_BatteryGroupID68
    BMV_BatteryGroupID69
      data BMV_BatteryGroupID69: sw-impl-policy=QUEUED, type=BMV_BatteryGroupID69
    BMV_BatteryGroupID7
      data BMV_BatteryGroupID7: sw-impl-policy=QUEUED, type=BMV_BatteryGroupID7
    BMV_BatteryGroupID70
      data BMV_BatteryGroupID70: sw-impl-policy=QUEUED, type=BMV_BatteryGroupID70
    BMV_BatteryGroupID71
      data BMV_BatteryGroupID71: sw-impl-policy=QUEUED, type=BMV_BatteryGroupID71
    BMV_BatteryGroupID72
      data BMV_BatteryGroupID72: sw-impl-policy=QUEUED, type=BMV_BatteryGroupID72
    BMV_BatteryGroupID73
      data BMV_BatteryGroupID73: sw-impl-policy=QUEUED, type=BMV_BatteryGroupID73
    BMV_BatteryGroupID74
      data BMV_BatteryGroupID74: sw-impl-policy=QUEUED, type=BMV_BatteryGroupID74
    BMV_BatteryGroupID75
      data BMV_BatteryGroupID75: sw-impl-policy=QUEUED, type=BMV_BatteryGroupID75
    BMV_BatteryGroupID76
      data BMV_BatteryGroupID76: sw-impl-policy=QUEUED, type=BMV_BatteryGroupID76
    BMV_BatteryGroupID77
      data BMV_BatteryGroupID77: sw-impl-policy=QUEUED, type=BMV_BatteryGroupID77
    BMV_BatteryGroupID78
      data BMV_BatteryGroupID78: sw-impl-policy=QUEUED, type=BMV_BatteryGroupID78
    BMV_BatteryGroupID79
      data BMV_BatteryGroupID79: sw-impl-policy=QUEUED, type=BMV_BatteryGroupID79
    BMV_BatteryGroupID8
      data BMV_BatteryGroupID8: sw-impl-policy=QUEUED, type=BMV_BatteryGroupID8
    BMV_BatteryGroupID80
      data BMV_BatteryGroupID80: sw-impl-policy=QUEUED, type=BMV_BatteryGroupID80
    BMV_BatteryGroupID81
      data BMV_BatteryGroupID81: sw-impl-policy=QUEUED, type=BMV_BatteryGroupID81
    BMV_BatteryGroupID82
      data BMV_BatteryGroupID82: sw-impl-policy=QUEUED, type=BMV_BatteryGroupID82
    BMV_BatteryGroupID83
      data BMV_BatteryGroupID83: sw-impl-policy=QUEUED, type=BMV_BatteryGroupID83
    BMV_BatteryGroupID84
      data BMV_BatteryGroupID84: sw-impl-policy=QUEUED, type=BMV_BatteryGroupID84
    BMV_BatteryGroupID85
      data BMV_BatteryGroupID85: sw-impl-policy=QUEUED, type=BMV_BatteryGroupID85
    BMV_BatteryGroupID86
      data BMV_BatteryGroupID86: sw-impl-policy=QUEUED, type=BMV_BatteryGroupID86
    BMV_BatteryGroupID87
      data BMV_BatteryGroupID87: sw-impl-policy=QUEUED, type=BMV_BatteryGroupID87
    BMV_BatteryGroupID88
      data BMV_BatteryGroupID88: sw-impl-policy=QUEUED, type=BMV_BatteryGroupID88
    BMV_BatteryGroupID89
      data BMV_BatteryGroupID89: sw-impl-policy=QUEUED, type=BMV_BatteryGroupID89
    BMV_BatteryGroupID9
      data BMV_BatteryGroupID9: sw-impl-policy=QUEUED, type=BMV_BatteryGroupID9
    BMV_BatteryGroupID90
      data BMV_BatteryGroupID90: sw-impl-policy=QUEUED, type=BMV_BatteryGroupID90
    BMV_BatteryGroupID91
      data BMV_BatteryGroupID91: sw-impl-policy=QUEUED, type=BMV_BatteryGroupID91
    BMV_BatteryGroupID92
      data BMV_BatteryGroupID92: sw-impl-policy=QUEUED, type=BMV_BatteryGroupID92
    BMV_BatteryGroupID93
      data BMV_BatteryGroupID93: sw-impl-policy=QUEUED, type=BMV_BatteryGroupID93
    BMV_BatteryGroupID94
      data BMV_BatteryGroupID94: sw-impl-policy=QUEUED, type=BMV_BatteryGroupID94
    BMV_BatteryGroupID95
      data BMV_BatteryGroupID95: sw-impl-policy=QUEUED, type=BMV_BatteryGroupID95
    BMV_BatteryGroupID96
      data BMV_BatteryGroupID96: sw-impl-policy=QUEUED, type=BMV_BatteryGroupID96
    BMV_BatteryGroupID97
      data BMV_BatteryGroupID97: sw-impl-policy=QUEUED, type=BMV_BatteryGroupID97
    BMV_BatteryGroupID98
      data BMV_BatteryGroupID98: sw-impl-policy=QUEUED, type=BMV_BatteryGroupID98
    BMV_BatteryGroupID99
      data BMV_BatteryGroupID99: sw-impl-policy=QUEUED, type=BMV_BatteryGroupID99
    BMV_BatteryVoltageMin0
      data BMV_BatteryVoltageMin0: sw-impl-policy=QUEUED, type=BMV_BatteryVoltageMin0
    BMV_BatteryVoltageMin1
      data BMV_BatteryVoltageMin1: sw-impl-policy=QUEUED, type=BMV_BatteryVoltageMin1
    BMV_BatteryVoltageMin10
      data BMV_BatteryVoltageMin10: sw-impl-policy=QUEUED, type=BMV_BatteryVoltageMin10
    BMV_BatteryVoltageMin100
      data BMV_BatteryVoltageMin100: sw-impl-policy=QUEUED, type=BMV_BatteryVoltageMin100
    BMV_BatteryVoltageMin101
      data BMV_BatteryVoltageMin101: sw-impl-policy=QUEUED, type=BMV_BatteryVoltageMin101
    BMV_BatteryVoltageMin102
      data BMV_BatteryVoltageMin102: sw-impl-policy=QUEUED, type=BMV_BatteryVoltageMin102
    BMV_BatteryVoltageMin103
      data BMV_BatteryVoltageMin103: sw-impl-policy=QUEUED, type=BMV_BatteryVoltageMin103
    BMV_BatteryVoltageMin104
      data BMV_BatteryVoltageMin104: sw-impl-policy=QUEUED, type=BMV_BatteryVoltageMin104
    BMV_BatteryVoltageMin105
      data BMV_BatteryVoltageMin105: sw-impl-policy=QUEUED, type=BMV_BatteryVoltageMin105
    BMV_BatteryVoltageMin106
      data BMV_BatteryVoltageMin106: sw-impl-policy=QUEUED, type=BMV_BatteryVoltageMin106
    BMV_BatteryVoltageMin107
      data BMV_BatteryVoltageMin107: sw-impl-policy=QUEUED, type=BMV_BatteryVoltageMin107
    BMV_BatteryVoltageMin108
      data BMV_BatteryVoltageMin108: sw-impl-policy=QUEUED, type=BMV_BatteryVoltageMin108
    BMV_BatteryVoltageMin109
      data BMV_BatteryVoltageMin109: sw-impl-policy=QUEUED, type=BMV_BatteryVoltageMin109
    BMV_BatteryVoltageMin11
      data BMV_BatteryVoltageMin11: sw-impl-policy=QUEUED, type=BMV_BatteryVoltageMin11
    BMV_BatteryVoltageMin110
      data BMV_BatteryVoltageMin110: sw-impl-policy=QUEUED, type=BMV_BatteryVoltageMin110
    BMV_BatteryVoltageMin111
      data BMV_BatteryVoltageMin111: sw-impl-policy=QUEUED, type=BMV_BatteryVoltageMin111
    BMV_BatteryVoltageMin112
      data BMV_BatteryVoltageMin112: sw-impl-policy=QUEUED, type=BMV_BatteryVoltageMin112
    BMV_BatteryVoltageMin113
      data BMV_BatteryVoltageMin113: sw-impl-policy=QUEUED, type=BMV_BatteryVoltageMin113
    BMV_BatteryVoltageMin114
      data BMV_BatteryVoltageMin114: sw-impl-policy=QUEUED, type=BMV_BatteryVoltageMin114
    BMV_BatteryVoltageMin115
      data BMV_BatteryVoltageMin115: sw-impl-policy=QUEUED, type=BMV_BatteryVoltageMin115
    BMV_BatteryVoltageMin116
      data BMV_BatteryVoltageMin116: sw-impl-policy=QUEUED, type=BMV_BatteryVoltageMin116
    BMV_BatteryVoltageMin117
      data BMV_BatteryVoltageMin117: sw-impl-policy=QUEUED, type=BMV_BatteryVoltageMin117
    BMV_BatteryVoltageMin118
      data BMV_BatteryVoltageMin118: sw-impl-policy=QUEUED, type=BMV_BatteryVoltageMin118
    BMV_BatteryVoltageMin119
      data BMV_BatteryVoltageMin119: sw-impl-policy=QUEUED, type=BMV_BatteryVoltageMin119
    BMV_BatteryVoltageMin12
      data BMV_BatteryVoltageMin12: sw-impl-policy=QUEUED, type=BMV_BatteryVoltageMin12
    BMV_BatteryVoltageMin120
      data BMV_BatteryVoltageMin120: sw-impl-policy=QUEUED, type=BMV_BatteryVoltageMin120
    BMV_BatteryVoltageMin121
      data BMV_BatteryVoltageMin121: sw-impl-policy=QUEUED, type=BMV_BatteryVoltageMin121
    BMV_BatteryVoltageMin122
      data BMV_BatteryVoltageMin122: sw-impl-policy=QUEUED, type=BMV_BatteryVoltageMin122
    BMV_BatteryVoltageMin123
      data BMV_BatteryVoltageMin123: sw-impl-policy=QUEUED, type=BMV_BatteryVoltageMin123
    BMV_BatteryVoltageMin124
      data BMV_BatteryVoltageMin124: sw-impl-policy=QUEUED, type=BMV_BatteryVoltageMin124
    BMV_BatteryVoltageMin125
      data BMV_BatteryVoltageMin125: sw-impl-policy=QUEUED, type=BMV_BatteryVoltageMin125
    BMV_BatteryVoltageMin126
      data BMV_BatteryVoltageMin126: sw-impl-policy=QUEUED, type=BMV_BatteryVoltageMin126
    BMV_BatteryVoltageMin127
      data BMV_BatteryVoltageMin127: sw-impl-policy=QUEUED, type=BMV_BatteryVoltageMin127
    BMV_BatteryVoltageMin128
      data BMV_BatteryVoltageMin128: sw-impl-policy=QUEUED, type=BMV_BatteryVoltageMin128
    BMV_BatteryVoltageMin129
      data BMV_BatteryVoltageMin129: sw-impl-policy=QUEUED, type=BMV_BatteryVoltageMin129
    BMV_BatteryVoltageMin13
      data BMV_BatteryVoltageMin13: sw-impl-policy=QUEUED, type=BMV_BatteryVoltageMin13
    BMV_BatteryVoltageMin130
      data BMV_BatteryVoltageMin130: sw-impl-policy=QUEUED, type=BMV_BatteryVoltageMin130
    BMV_BatteryVoltageMin131
      data BMV_BatteryVoltageMin131: sw-impl-policy=QUEUED, type=BMV_BatteryVoltageMin131
    BMV_BatteryVoltageMin132
      data BMV_BatteryVoltageMin132: sw-impl-policy=QUEUED, type=BMV_BatteryVoltageMin132
    BMV_BatteryVoltageMin133
      data BMV_BatteryVoltageMin133: sw-impl-policy=QUEUED, type=BMV_BatteryVoltageMin133
    BMV_BatteryVoltageMin134
      data BMV_BatteryVoltageMin134: sw-impl-policy=QUEUED, type=BMV_BatteryVoltageMin134
    BMV_BatteryVoltageMin135
      data BMV_BatteryVoltageMin135: sw-impl-policy=QUEUED, type=BMV_BatteryVoltageMin135
    BMV_BatteryVoltageMin136
      data BMV_BatteryVoltageMin136: sw-impl-policy=QUEUED, type=BMV_BatteryVoltageMin136
    BMV_BatteryVoltageMin137
      data BMV_BatteryVoltageMin137: sw-impl-policy=QUEUED, type=BMV_BatteryVoltageMin137
    BMV_BatteryVoltageMin138
      data BMV_BatteryVoltageMin138: sw-impl-policy=QUEUED, type=BMV_BatteryVoltageMin138
    BMV_BatteryVoltageMin139
      data BMV_BatteryVoltageMin139: sw-impl-policy=QUEUED, type=BMV_BatteryVoltageMin139
    BMV_BatteryVoltageMin14
      data BMV_BatteryVoltageMin14: sw-impl-policy=QUEUED, type=BMV_BatteryVoltageMin14
    BMV_BatteryVoltageMin140
      data BMV_BatteryVoltageMin140: sw-impl-policy=QUEUED, type=BMV_BatteryVoltageMin140
    BMV_BatteryVoltageMin141
      data BMV_BatteryVoltageMin141: sw-impl-policy=QUEUED, type=BMV_BatteryVoltageMin141
    BMV_BatteryVoltageMin142
      data BMV_BatteryVoltageMin142: sw-impl-policy=QUEUED, type=BMV_BatteryVoltageMin142
    BMV_BatteryVoltageMin143
      data BMV_BatteryVoltageMin143: sw-impl-policy=QUEUED, type=BMV_BatteryVoltageMin143
    BMV_BatteryVoltageMin144
      data BMV_BatteryVoltageMin144: sw-impl-policy=QUEUED, type=BMV_BatteryVoltageMin144
    BMV_BatteryVoltageMin145
      data BMV_BatteryVoltageMin145: sw-impl-policy=QUEUED, type=BMV_BatteryVoltageMin145
    BMV_BatteryVoltageMin146
      data BMV_BatteryVoltageMin146: sw-impl-policy=QUEUED, type=BMV_BatteryVoltageMin146
    BMV_BatteryVoltageMin147
      data BMV_BatteryVoltageMin147: sw-impl-policy=QUEUED, type=BMV_BatteryVoltageMin147
    BMV_BatteryVoltageMin148
      data BMV_BatteryVoltageMin148: sw-impl-policy=QUEUED, type=BMV_BatteryVoltageMin148
    BMV_BatteryVoltageMin149
      data BMV_BatteryVoltageMin149: sw-impl-policy=QUEUED, type=BMV_BatteryVoltageMin149
    BMV_BatteryVoltageMin15
      data BMV_BatteryVoltageMin15: sw-impl-policy=QUEUED, type=BMV_BatteryVoltageMin15
    BMV_BatteryVoltageMin150
      data BMV_BatteryVoltageMin150: sw-impl-policy=QUEUED, type=BMV_BatteryVoltageMin150
    BMV_BatteryVoltageMin151
      data BMV_BatteryVoltageMin151: sw-impl-policy=QUEUED, type=BMV_BatteryVoltageMin151
    BMV_BatteryVoltageMin152
      data BMV_BatteryVoltageMin152: sw-impl-policy=QUEUED, type=BMV_BatteryVoltageMin152
    BMV_BatteryVoltageMin153
      data BMV_BatteryVoltageMin153: sw-impl-policy=QUEUED, type=BMV_BatteryVoltageMin153
    BMV_BatteryVoltageMin154
      data BMV_BatteryVoltageMin154: sw-impl-policy=QUEUED, type=BMV_BatteryVoltageMin154
    BMV_BatteryVoltageMin155
      data BMV_BatteryVoltageMin155: sw-impl-policy=QUEUED, type=BMV_BatteryVoltageMin155
    BMV_BatteryVoltageMin156
      data BMV_BatteryVoltageMin156: sw-impl-policy=QUEUED, type=BMV_BatteryVoltageMin156
    BMV_BatteryVoltageMin157
      data BMV_BatteryVoltageMin157: sw-impl-policy=QUEUED, type=BMV_BatteryVoltageMin157
    BMV_BatteryVoltageMin158
      data BMV_BatteryVoltageMin158: sw-impl-policy=QUEUED, type=BMV_BatteryVoltageMin158
    BMV_BatteryVoltageMin159
      data BMV_BatteryVoltageMin159: sw-impl-policy=QUEUED, type=BMV_BatteryVoltageMin159
    BMV_BatteryVoltageMin16
      data BMV_BatteryVoltageMin16: sw-impl-policy=QUEUED, type=BMV_BatteryVoltageMin16
    BMV_BatteryVoltageMin160
      data BMV_BatteryVoltageMin160: sw-impl-policy=QUEUED, type=BMV_BatteryVoltageMin160
    BMV_BatteryVoltageMin161
      data BMV_BatteryVoltageMin161: sw-impl-policy=QUEUED, type=BMV_BatteryVoltageMin161
    BMV_BatteryVoltageMin162
      data BMV_BatteryVoltageMin162: sw-impl-policy=QUEUED, type=BMV_BatteryVoltageMin162
    BMV_BatteryVoltageMin163
      data BMV_BatteryVoltageMin163: sw-impl-policy=QUEUED, type=BMV_BatteryVoltageMin163
    BMV_BatteryVoltageMin164
      data BMV_BatteryVoltageMin164: sw-impl-policy=QUEUED, type=BMV_BatteryVoltageMin164
    BMV_BatteryVoltageMin165
      data BMV_BatteryVoltageMin165: sw-impl-policy=QUEUED, type=BMV_BatteryVoltageMin165
    BMV_BatteryVoltageMin166
      data BMV_BatteryVoltageMin166: sw-impl-policy=QUEUED, type=BMV_BatteryVoltageMin166
    BMV_BatteryVoltageMin167
      data BMV_BatteryVoltageMin167: sw-impl-policy=QUEUED, type=BMV_BatteryVoltageMin167
    BMV_BatteryVoltageMin168
      data BMV_BatteryVoltageMin168: sw-impl-policy=QUEUED, type=BMV_BatteryVoltageMin168
    BMV_BatteryVoltageMin169
      data BMV_BatteryVoltageMin169: sw-impl-policy=QUEUED, type=BMV_BatteryVoltageMin169
    BMV_BatteryVoltageMin17
      data BMV_BatteryVoltageMin17: sw-impl-policy=QUEUED, type=BMV_BatteryVoltageMin17
    BMV_BatteryVoltageMin170
      data BMV_BatteryVoltageMin170: sw-impl-policy=QUEUED, type=BMV_BatteryVoltageMin170
    BMV_BatteryVoltageMin171
      data BMV_BatteryVoltageMin171: sw-impl-policy=QUEUED, type=BMV_BatteryVoltageMin171
    BMV_BatteryVoltageMin172
      data BMV_BatteryVoltageMin172: sw-impl-policy=QUEUED, type=BMV_BatteryVoltageMin172
    BMV_BatteryVoltageMin173
      data BMV_BatteryVoltageMin173: sw-impl-policy=QUEUED, type=BMV_BatteryVoltageMin173
    BMV_BatteryVoltageMin174
      data BMV_BatteryVoltageMin174: sw-impl-policy=QUEUED, type=BMV_BatteryVoltageMin174
    BMV_BatteryVoltageMin175
      data BMV_BatteryVoltageMin175: sw-impl-policy=QUEUED, type=BMV_BatteryVoltageMin175
    BMV_BatteryVoltageMin176
      data BMV_BatteryVoltageMin176: sw-impl-policy=QUEUED, type=BMV_BatteryVoltageMin176
    BMV_BatteryVoltageMin177
      data BMV_BatteryVoltageMin177: sw-impl-policy=QUEUED, type=BMV_BatteryVoltageMin177
    BMV_BatteryVoltageMin178
      data BMV_BatteryVoltageMin178: sw-impl-policy=QUEUED, type=BMV_BatteryVoltageMin178
    BMV_BatteryVoltageMin179
      data BMV_BatteryVoltageMin179: sw-impl-policy=QUEUED, type=BMV_BatteryVoltageMin179
    BMV_BatteryVoltageMin18
      data BMV_BatteryVoltageMin18: sw-impl-policy=QUEUED, type=BMV_BatteryVoltageMin18
    BMV_BatteryVoltageMin180
      data BMV_BatteryVoltageMin180: sw-impl-policy=QUEUED, type=BMV_BatteryVoltageMin180
    BMV_BatteryVoltageMin181
      data BMV_BatteryVoltageMin181: sw-impl-policy=QUEUED, type=BMV_BatteryVoltageMin181
    BMV_BatteryVoltageMin182
      data BMV_BatteryVoltageMin182: sw-impl-policy=QUEUED, type=BMV_BatteryVoltageMin182
    BMV_BatteryVoltageMin183
      data BMV_BatteryVoltageMin183: sw-impl-policy=QUEUED, type=BMV_BatteryVoltageMin183
    BMV_BatteryVoltageMin184
      data BMV_BatteryVoltageMin184: sw-impl-policy=QUEUED, type=BMV_BatteryVoltageMin184
    BMV_BatteryVoltageMin185
      data BMV_BatteryVoltageMin185: sw-impl-policy=QUEUED, type=BMV_BatteryVoltageMin185
    BMV_BatteryVoltageMin186
      data BMV_BatteryVoltageMin186: sw-impl-policy=QUEUED, type=BMV_BatteryVoltageMin186
    BMV_BatteryVoltageMin187
      data BMV_BatteryVoltageMin187: sw-impl-policy=QUEUED, type=BMV_BatteryVoltageMin187
    BMV_BatteryVoltageMin188
      data BMV_BatteryVoltageMin188: sw-impl-policy=QUEUED, type=BMV_BatteryVoltageMin188
    BMV_BatteryVoltageMin189
      data BMV_BatteryVoltageMin189: sw-impl-policy=QUEUED, type=BMV_BatteryVoltageMin189
    BMV_BatteryVoltageMin19
      data BMV_BatteryVoltageMin19: sw-impl-policy=QUEUED, type=BMV_BatteryVoltageMin19
    BMV_BatteryVoltageMin190
      data BMV_BatteryVoltageMin190: sw-impl-policy=QUEUED, type=BMV_BatteryVoltageMin190
    BMV_BatteryVoltageMin191
      data BMV_BatteryVoltageMin191: sw-impl-policy=QUEUED, type=BMV_BatteryVoltageMin191
    BMV_BatteryVoltageMin192
      data BMV_BatteryVoltageMin192: sw-impl-policy=QUEUED, type=BMV_BatteryVoltageMin192
    BMV_BatteryVoltageMin193
      data BMV_BatteryVoltageMin193: sw-impl-policy=QUEUED, type=BMV_BatteryVoltageMin193
    BMV_BatteryVoltageMin194
      data BMV_BatteryVoltageMin194: sw-impl-policy=QUEUED, type=BMV_BatteryVoltageMin194
    BMV_BatteryVoltageMin195
      data BMV_BatteryVoltageMin195: sw-impl-policy=QUEUED, type=BMV_BatteryVoltageMin195
    BMV_BatteryVoltageMin196
      data BMV_BatteryVoltageMin196: sw-impl-policy=QUEUED, type=BMV_BatteryVoltageMin196
    BMV_BatteryVoltageMin197
      data BMV_BatteryVoltageMin197: sw-impl-policy=QUEUED, type=BMV_BatteryVoltageMin197
    BMV_BatteryVoltageMin198
      data BMV_BatteryVoltageMin198: sw-impl-policy=QUEUED, type=BMV_BatteryVoltageMin198
    BMV_BatteryVoltageMin199
      data BMV_BatteryVoltageMin199: sw-impl-policy=QUEUED, type=BMV_BatteryVoltageMin199
    BMV_BatteryVoltageMin2
      data BMV_BatteryVoltageMin2: sw-impl-policy=QUEUED, type=BMV_BatteryVoltageMin2
    BMV_BatteryVoltageMin20
      data BMV_BatteryVoltageMin20: sw-impl-policy=QUEUED, type=BMV_BatteryVoltageMin20
    BMV_BatteryVoltageMin200
      data BMV_BatteryVoltageMin200: sw-impl-policy=QUEUED, type=BMV_BatteryVoltageMin200
    BMV_BatteryVoltageMin201
      data BMV_BatteryVoltageMin201: sw-impl-policy=QUEUED, type=BMV_BatteryVoltageMin201
    BMV_BatteryVoltageMin202
      data BMV_BatteryVoltageMin202: sw-impl-policy=QUEUED, type=BMV_BatteryVoltageMin202
    BMV_BatteryVoltageMin203
      data BMV_BatteryVoltageMin203: sw-impl-policy=QUEUED, type=BMV_BatteryVoltageMin203
    BMV_BatteryVoltageMin204
      data BMV_BatteryVoltageMin204: sw-impl-policy=QUEUED, type=BMV_BatteryVoltageMin204
    BMV_BatteryVoltageMin205
      data BMV_BatteryVoltageMin205: sw-impl-policy=QUEUED, type=BMV_BatteryVoltageMin205
    BMV_BatteryVoltageMin206
      data BMV_BatteryVoltageMin206: sw-impl-policy=QUEUED, type=BMV_BatteryVoltageMin206
    BMV_BatteryVoltageMin207
      data BMV_BatteryVoltageMin207: sw-impl-policy=QUEUED, type=BMV_BatteryVoltageMin207
    BMV_BatteryVoltageMin208
      data BMV_BatteryVoltageMin208: sw-impl-policy=QUEUED, type=BMV_BatteryVoltageMin208
    BMV_BatteryVoltageMin209
      data BMV_BatteryVoltageMin209: sw-impl-policy=QUEUED, type=BMV_BatteryVoltageMin209
    BMV_BatteryVoltageMin21
      data BMV_BatteryVoltageMin21: sw-impl-policy=QUEUED, type=BMV_BatteryVoltageMin21
    BMV_BatteryVoltageMin210
      data BMV_BatteryVoltageMin210: sw-impl-policy=QUEUED, type=BMV_BatteryVoltageMin210
    BMV_BatteryVoltageMin211
      data BMV_BatteryVoltageMin211: sw-impl-policy=QUEUED, type=BMV_BatteryVoltageMin211
    BMV_BatteryVoltageMin212
      data BMV_BatteryVoltageMin212: sw-impl-policy=QUEUED, type=BMV_BatteryVoltageMin212
    BMV_BatteryVoltageMin213
      data BMV_BatteryVoltageMin213: sw-impl-policy=QUEUED, type=BMV_BatteryVoltageMin213
    BMV_BatteryVoltageMin214
      data BMV_BatteryVoltageMin214: sw-impl-policy=QUEUED, type=BMV_BatteryVoltageMin214
    BMV_BatteryVoltageMin215
      data BMV_BatteryVoltageMin215: sw-impl-policy=QUEUED, type=BMV_BatteryVoltageMin215
    BMV_BatteryVoltageMin216
      data BMV_BatteryVoltageMin216: sw-impl-policy=QUEUED, type=BMV_BatteryVoltageMin216
    BMV_BatteryVoltageMin217
      data BMV_BatteryVoltageMin217: sw-impl-policy=QUEUED, type=BMV_BatteryVoltageMin217
    BMV_BatteryVoltageMin218
      data BMV_BatteryVoltageMin218: sw-impl-policy=QUEUED, type=BMV_BatteryVoltageMin218
    BMV_BatteryVoltageMin219
      data BMV_BatteryVoltageMin219: sw-impl-policy=QUEUED, type=BMV_BatteryVoltageMin219
    BMV_BatteryVoltageMin22
      data BMV_BatteryVoltageMin22: sw-impl-policy=QUEUED, type=BMV_BatteryVoltageMin22
    BMV_BatteryVoltageMin220
      data BMV_BatteryVoltageMin220: sw-impl-policy=QUEUED, type=BMV_BatteryVoltageMin220
    BMV_BatteryVoltageMin221
      data BMV_BatteryVoltageMin221: sw-impl-policy=QUEUED, type=BMV_BatteryVoltageMin221
    BMV_BatteryVoltageMin222
      data BMV_BatteryVoltageMin222: sw-impl-policy=QUEUED, type=BMV_BatteryVoltageMin222
    BMV_BatteryVoltageMin223
      data BMV_BatteryVoltageMin223: sw-impl-policy=QUEUED, type=BMV_BatteryVoltageMin223
    BMV_BatteryVoltageMin224
      data BMV_BatteryVoltageMin224: sw-impl-policy=QUEUED, type=BMV_BatteryVoltageMin224
    BMV_BatteryVoltageMin225
      data BMV_BatteryVoltageMin225: sw-impl-policy=QUEUED, type=BMV_BatteryVoltageMin225
    BMV_BatteryVoltageMin226
      data BMV_BatteryVoltageMin226: sw-impl-policy=QUEUED, type=BMV_BatteryVoltageMin226
    BMV_BatteryVoltageMin227
      data BMV_BatteryVoltageMin227: sw-impl-policy=QUEUED, type=BMV_BatteryVoltageMin227
    BMV_BatteryVoltageMin228
      data BMV_BatteryVoltageMin228: sw-impl-policy=QUEUED, type=BMV_BatteryVoltageMin228
    BMV_BatteryVoltageMin229
      data BMV_BatteryVoltageMin229: sw-impl-policy=QUEUED, type=BMV_BatteryVoltageMin229
    BMV_BatteryVoltageMin23
      data BMV_BatteryVoltageMin23: sw-impl-policy=QUEUED, type=BMV_BatteryVoltageMin23
    BMV_BatteryVoltageMin230
      data BMV_BatteryVoltageMin230: sw-impl-policy=QUEUED, type=BMV_BatteryVoltageMin230
    BMV_BatteryVoltageMin231
      data BMV_BatteryVoltageMin231: sw-impl-policy=QUEUED, type=BMV_BatteryVoltageMin231
    BMV_BatteryVoltageMin232
      data BMV_BatteryVoltageMin232: sw-impl-policy=QUEUED, type=BMV_BatteryVoltageMin232
    BMV_BatteryVoltageMin233
      data BMV_BatteryVoltageMin233: sw-impl-policy=QUEUED, type=BMV_BatteryVoltageMin233
    BMV_BatteryVoltageMin234
      data BMV_BatteryVoltageMin234: sw-impl-policy=QUEUED, type=BMV_BatteryVoltageMin234
    BMV_BatteryVoltageMin235
      data BMV_BatteryVoltageMin235: sw-impl-policy=QUEUED, type=BMV_BatteryVoltageMin235
    BMV_BatteryVoltageMin236
      data BMV_BatteryVoltageMin236: sw-impl-policy=QUEUED, type=BMV_BatteryVoltageMin236
    BMV_BatteryVoltageMin237
      data BMV_BatteryVoltageMin237: sw-impl-policy=QUEUED, type=BMV_BatteryVoltageMin237
    BMV_BatteryVoltageMin238
      data BMV_BatteryVoltageMin238: sw-impl-policy=QUEUED, type=BMV_BatteryVoltageMin238
    BMV_BatteryVoltageMin239
      data BMV_BatteryVoltageMin239: sw-impl-policy=QUEUED, type=BMV_BatteryVoltageMin239
    BMV_BatteryVoltageMin24
      data BMV_BatteryVoltageMin24: sw-impl-policy=QUEUED, type=BMV_BatteryVoltageMin24
    BMV_BatteryVoltageMin240
      data BMV_BatteryVoltageMin240: sw-impl-policy=QUEUED, type=BMV_BatteryVoltageMin240
    BMV_BatteryVoltageMin241
      data BMV_BatteryVoltageMin241: sw-impl-policy=QUEUED, type=BMV_BatteryVoltageMin241
    BMV_BatteryVoltageMin242
      data BMV_BatteryVoltageMin242: sw-impl-policy=QUEUED, type=BMV_BatteryVoltageMin242
    BMV_BatteryVoltageMin243
      data BMV_BatteryVoltageMin243: sw-impl-policy=QUEUED, type=BMV_BatteryVoltageMin243
    BMV_BatteryVoltageMin244
      data BMV_BatteryVoltageMin244: sw-impl-policy=QUEUED, type=BMV_BatteryVoltageMin244
    BMV_BatteryVoltageMin245
      data BMV_BatteryVoltageMin245: sw-impl-policy=QUEUED, type=BMV_BatteryVoltageMin245
    BMV_BatteryVoltageMin246
      data BMV_BatteryVoltageMin246: sw-impl-policy=QUEUED, type=BMV_BatteryVoltageMin246
    BMV_BatteryVoltageMin247
      data BMV_BatteryVoltageMin247: sw-impl-policy=QUEUED, type=BMV_BatteryVoltageMin247
    BMV_BatteryVoltageMin248
      data BMV_BatteryVoltageMin248: sw-impl-policy=QUEUED, type=BMV_BatteryVoltageMin248
    BMV_BatteryVoltageMin249
      data BMV_BatteryVoltageMin249: sw-impl-policy=QUEUED, type=BMV_BatteryVoltageMin249
    BMV_BatteryVoltageMin25
      data BMV_BatteryVoltageMin25: sw-impl-policy=QUEUED, type=BMV_BatteryVoltageMin25
    BMV_BatteryVoltageMin250
      data BMV_BatteryVoltageMin250: sw-impl-policy=QUEUED, type=BMV_BatteryVoltageMin250
    BMV_BatteryVoltageMin251
      data BMV_BatteryVoltageMin251: sw-impl-policy=QUEUED, type=BMV_BatteryVoltageMin251
    BMV_BatteryVoltageMin252
      data BMV_BatteryVoltageMin252: sw-impl-policy=QUEUED, type=BMV_BatteryVoltageMin252
    BMV_BatteryVoltageMin253
      data BMV_BatteryVoltageMin253: sw-impl-policy=QUEUED, type=BMV_BatteryVoltageMin253
    BMV_BatteryVoltageMin254
      data BMV_BatteryVoltageMin254: sw-impl-policy=QUEUED, type=BMV_BatteryVoltageMin254
    BMV_BatteryVoltageMin255
      data BMV_BatteryVoltageMin255: sw-impl-policy=QUEUED, type=BMV_BatteryVoltageMin255
    BMV_BatteryVoltageMin26
      data BMV_BatteryVoltageMin26: sw-impl-policy=QUEUED, type=BMV_BatteryVoltageMin26
    BMV_BatteryVoltageMin27
      data BMV_BatteryVoltageMin27: sw-impl-policy=QUEUED, type=BMV_BatteryVoltageMin27
    BMV_BatteryVoltageMin28
      data BMV_BatteryVoltageMin28: sw-impl-policy=QUEUED, type=BMV_BatteryVoltageMin28
    BMV_BatteryVoltageMin29
      data BMV_BatteryVoltageMin29: sw-impl-policy=QUEUED, type=BMV_BatteryVoltageMin29
    BMV_BatteryVoltageMin3
      data BMV_BatteryVoltageMin3: sw-impl-policy=QUEUED, type=BMV_BatteryVoltageMin3
    BMV_BatteryVoltageMin30
      data BMV_BatteryVoltageMin30: sw-impl-policy=QUEUED, type=BMV_BatteryVoltageMin30
    BMV_BatteryVoltageMin31
      data BMV_BatteryVoltageMin31: sw-impl-policy=QUEUED, type=BMV_BatteryVoltageMin31
    BMV_BatteryVoltageMin32
      data BMV_BatteryVoltageMin32: sw-impl-policy=QUEUED, type=BMV_BatteryVoltageMin32
    BMV_BatteryVoltageMin33
      data BMV_BatteryVoltageMin33: sw-impl-policy=QUEUED, type=BMV_BatteryVoltageMin33
    BMV_BatteryVoltageMin34
      data BMV_BatteryVoltageMin34: sw-impl-policy=QUEUED, type=BMV_BatteryVoltageMin34
    BMV_BatteryVoltageMin35
      data BMV_BatteryVoltageMin35: sw-impl-policy=QUEUED, type=BMV_BatteryVoltageMin35
    BMV_BatteryVoltageMin36
      data BMV_BatteryVoltageMin36: sw-impl-policy=QUEUED, type=BMV_BatteryVoltageMin36
    BMV_BatteryVoltageMin37
      data BMV_BatteryVoltageMin37: sw-impl-policy=QUEUED, type=BMV_BatteryVoltageMin37
    BMV_BatteryVoltageMin38
      data BMV_BatteryVoltageMin38: sw-impl-policy=QUEUED, type=BMV_BatteryVoltageMin38
    BMV_BatteryVoltageMin39
      data BMV_BatteryVoltageMin39: sw-impl-policy=QUEUED, type=BMV_BatteryVoltageMin39
    BMV_BatteryVoltageMin4
      data BMV_BatteryVoltageMin4: sw-impl-policy=QUEUED, type=BMV_BatteryVoltageMin4
    BMV_BatteryVoltageMin40
      data BMV_BatteryVoltageMin40: sw-impl-policy=QUEUED, type=BMV_BatteryVoltageMin40
    BMV_BatteryVoltageMin41
      data BMV_BatteryVoltageMin41: sw-impl-policy=QUEUED, type=BMV_BatteryVoltageMin41
    BMV_BatteryVoltageMin42
      data BMV_BatteryVoltageMin42: sw-impl-policy=QUEUED, type=BMV_BatteryVoltageMin42
    BMV_BatteryVoltageMin43
      data BMV_BatteryVoltageMin43: sw-impl-policy=QUEUED, type=BMV_BatteryVoltageMin43
    BMV_BatteryVoltageMin44
      data BMV_BatteryVoltageMin44: sw-impl-policy=QUEUED, type=BMV_BatteryVoltageMin44
    BMV_BatteryVoltageMin45
      data BMV_BatteryVoltageMin45: sw-impl-policy=QUEUED, type=BMV_BatteryVoltageMin45
    BMV_BatteryVoltageMin46
      data BMV_BatteryVoltageMin46: sw-impl-policy=QUEUED, type=BMV_BatteryVoltageMin46
    BMV_BatteryVoltageMin47
      data BMV_BatteryVoltageMin47: sw-impl-policy=QUEUED, type=BMV_BatteryVoltageMin47
    BMV_BatteryVoltageMin48
      data BMV_BatteryVoltageMin48: sw-impl-policy=QUEUED, type=BMV_BatteryVoltageMin48
    BMV_BatteryVoltageMin49
      data BMV_BatteryVoltageMin49: sw-impl-policy=QUEUED, type=BMV_BatteryVoltageMin49
    BMV_BatteryVoltageMin5
      data BMV_BatteryVoltageMin5: sw-impl-policy=QUEUED, type=BMV_BatteryVoltageMin5
    BMV_BatteryVoltageMin50
      data BMV_BatteryVoltageMin50: sw-impl-policy=QUEUED, type=BMV_BatteryVoltageMin50
    BMV_BatteryVoltageMin51
      data BMV_BatteryVoltageMin51: sw-impl-policy=QUEUED, type=BMV_BatteryVoltageMin51
    BMV_BatteryVoltageMin52
      data BMV_BatteryVoltageMin52: sw-impl-policy=QUEUED, type=BMV_BatteryVoltageMin52
    BMV_BatteryVoltageMin53
      data BMV_BatteryVoltageMin53: sw-impl-policy=QUEUED, type=BMV_BatteryVoltageMin53
    BMV_BatteryVoltageMin54
      data BMV_BatteryVoltageMin54: sw-impl-policy=QUEUED, type=BMV_BatteryVoltageMin54
    BMV_BatteryVoltageMin55
      data BMV_BatteryVoltageMin55: sw-impl-policy=QUEUED, type=BMV_BatteryVoltageMin55
    BMV_BatteryVoltageMin56
      data BMV_BatteryVoltageMin56: sw-impl-policy=QUEUED, type=BMV_BatteryVoltageMin56
    BMV_BatteryVoltageMin57
      data BMV_BatteryVoltageMin57: sw-impl-policy=QUEUED, type=BMV_BatteryVoltageMin57
    BMV_BatteryVoltageMin58
      data BMV_BatteryVoltageMin58: sw-impl-policy=QUEUED, type=BMV_BatteryVoltageMin58
    BMV_BatteryVoltageMin59
      data BMV_BatteryVoltageMin59: sw-impl-policy=QUEUED, type=BMV_BatteryVoltageMin59
    BMV_BatteryVoltageMin6
      data BMV_BatteryVoltageMin6: sw-impl-policy=QUEUED, type=BMV_BatteryVoltageMin6
    BMV_BatteryVoltageMin60
      data BMV_BatteryVoltageMin60: sw-impl-policy=QUEUED, type=BMV_BatteryVoltageMin60
    BMV_BatteryVoltageMin61
      data BMV_BatteryVoltageMin61: sw-impl-policy=QUEUED, type=BMV_BatteryVoltageMin61
    BMV_BatteryVoltageMin62
      data BMV_BatteryVoltageMin62: sw-impl-policy=QUEUED, type=BMV_BatteryVoltageMin62
    BMV_BatteryVoltageMin63
      data BMV_BatteryVoltageMin63: sw-impl-policy=QUEUED, type=BMV_BatteryVoltageMin63
    BMV_BatteryVoltageMin64
      data BMV_BatteryVoltageMin64: sw-impl-policy=QUEUED, type=BMV_BatteryVoltageMin64
    BMV_BatteryVoltageMin65
      data BMV_BatteryVoltageMin65: sw-impl-policy=QUEUED, type=BMV_BatteryVoltageMin65
    BMV_BatteryVoltageMin66
      data BMV_BatteryVoltageMin66: sw-impl-policy=QUEUED, type=BMV_BatteryVoltageMin66
    BMV_BatteryVoltageMin67
      data BMV_BatteryVoltageMin67: sw-impl-policy=QUEUED, type=BMV_BatteryVoltageMin67
    BMV_BatteryVoltageMin68
      data BMV_BatteryVoltageMin68: sw-impl-policy=QUEUED, type=BMV_BatteryVoltageMin68
    BMV_BatteryVoltageMin69
      data BMV_BatteryVoltageMin69: sw-impl-policy=QUEUED, type=BMV_BatteryVoltageMin69
    BMV_BatteryVoltageMin7
      data BMV_BatteryVoltageMin7: sw-impl-policy=QUEUED, type=BMV_BatteryVoltageMin7
    BMV_BatteryVoltageMin70
      data BMV_BatteryVoltageMin70: sw-impl-policy=QUEUED, type=BMV_BatteryVoltageMin70
    BMV_BatteryVoltageMin71
      data BMV_BatteryVoltageMin71: sw-impl-policy=QUEUED, type=BMV_BatteryVoltageMin71
    BMV_BatteryVoltageMin72
      data BMV_BatteryVoltageMin72: sw-impl-policy=QUEUED, type=BMV_BatteryVoltageMin72
    BMV_BatteryVoltageMin73
      data BMV_BatteryVoltageMin73: sw-impl-policy=QUEUED, type=BMV_BatteryVoltageMin73
    BMV_BatteryVoltageMin74
      data BMV_BatteryVoltageMin74: sw-impl-policy=QUEUED, type=BMV_BatteryVoltageMin74
    BMV_BatteryVoltageMin75
      data BMV_BatteryVoltageMin75: sw-impl-policy=QUEUED, type=BMV_BatteryVoltageMin75
    BMV_BatteryVoltageMin76
      data BMV_BatteryVoltageMin76: sw-impl-policy=QUEUED, type=BMV_BatteryVoltageMin76
    BMV_BatteryVoltageMin77
      data BMV_BatteryVoltageMin77: sw-impl-policy=QUEUED, type=BMV_BatteryVoltageMin77
    BMV_BatteryVoltageMin78
      data BMV_BatteryVoltageMin78: sw-impl-policy=QUEUED, type=BMV_BatteryVoltageMin78
    BMV_BatteryVoltageMin79
      data BMV_BatteryVoltageMin79: sw-impl-policy=QUEUED, type=BMV_BatteryVoltageMin79
    BMV_BatteryVoltageMin8
      data BMV_BatteryVoltageMin8: sw-impl-policy=QUEUED, type=BMV_BatteryVoltageMin8
    BMV_BatteryVoltageMin80
      data BMV_BatteryVoltageMin80: sw-impl-policy=QUEUED, type=BMV_BatteryVoltageMin80
    BMV_BatteryVoltageMin81
      data BMV_BatteryVoltageMin81: sw-impl-policy=QUEUED, type=BMV_BatteryVoltageMin81
    BMV_BatteryVoltageMin82
      data BMV_BatteryVoltageMin82: sw-impl-policy=QUEUED, type=BMV_BatteryVoltageMin82
    BMV_BatteryVoltageMin83
      data BMV_BatteryVoltageMin83: sw-impl-policy=QUEUED, type=BMV_BatteryVoltageMin83
    BMV_BatteryVoltageMin84
      data BMV_BatteryVoltageMin84: sw-impl-policy=QUEUED, type=BMV_BatteryVoltageMin84
    BMV_BatteryVoltageMin85
      data BMV_BatteryVoltageMin85: sw-impl-policy=QUEUED, type=BMV_BatteryVoltageMin85
    BMV_BatteryVoltageMin86
      data BMV_BatteryVoltageMin86: sw-impl-policy=QUEUED, type=BMV_BatteryVoltageMin86
    BMV_BatteryVoltageMin87
      data BMV_BatteryVoltageMin87: sw-impl-policy=QUEUED, type=BMV_BatteryVoltageMin87
    BMV_BatteryVoltageMin88
      data BMV_BatteryVoltageMin88: sw-impl-policy=QUEUED, type=BMV_BatteryVoltageMin88
    BMV_BatteryVoltageMin89
      data BMV_BatteryVoltageMin89: sw-impl-policy=QUEUED, type=BMV_BatteryVoltageMin89
    BMV_BatteryVoltageMin9
      data BMV_BatteryVoltageMin9: sw-impl-policy=QUEUED, type=BMV_BatteryVoltageMin9
    BMV_BatteryVoltageMin90
      data BMV_BatteryVoltageMin90: sw-impl-policy=QUEUED, type=BMV_BatteryVoltageMin90
    BMV_BatteryVoltageMin91
      data BMV_BatteryVoltageMin91: sw-impl-policy=QUEUED, type=BMV_BatteryVoltageMin91
    BMV_BatteryVoltageMin92
      data BMV_BatteryVoltageMin92: sw-impl-policy=QUEUED, type=BMV_BatteryVoltageMin92
    BMV_BatteryVoltageMin93
      data BMV_BatteryVoltageMin93: sw-impl-policy=QUEUED, type=BMV_BatteryVoltageMin93
    BMV_BatteryVoltageMin94
      data BMV_BatteryVoltageMin94: sw-impl-policy=QUEUED, type=BMV_BatteryVoltageMin94
    BMV_BatteryVoltageMin95
      data BMV_BatteryVoltageMin95: sw-impl-policy=QUEUED, type=BMV_BatteryVoltageMin95
    BMV_BatteryVoltageMin96
      data BMV_BatteryVoltageMin96: sw-impl-policy=QUEUED, type=BMV_BatteryVoltageMin96
    BMV_BatteryVoltageMin97
      data BMV_BatteryVoltageMin97: sw-impl-policy=QUEUED, type=BMV_BatteryVoltageMin97
    BMV_BatteryVoltageMin98
      data BMV_BatteryVoltageMin98: sw-impl-policy=QUEUED, type=BMV_BatteryVoltageMin98
    BMV_BatteryVoltageMin99
      data BMV_BatteryVoltageMin99: sw-impl-policy=QUEUED, type=BMV_BatteryVoltageMin99
    BMS_AllowCellTemperature
      data BMS_AllowCellTemperature: type=BMS_AllowCellTemperature
    BMS_BatChagSum
      data BMS_BatChagSum: type=BMS_BatChagSum
    BMS_BatProDatDay
      data BMS_BatProDatDay: type=BMS_BatProDatDay
    BMS_BatProDatMonth
      data BMS_BatProDatMonth: type=BMS_BatProDatMonth
    BMS_BatProDatYear
      data BMS_BatProDatYear: type=BMS_BatProDatYear
    BMS_BatProRights
      data BMS_BatProRights: type=BMS_BatProRights
    BMS_BatType
      data BMS_BatType: type=BMS_BatType
    BMS_MaxCellTempNO
      data BMS_MaxCellTempNO: type=BMS_MaxCellTempNO
    BMS_MaxCellVoltage
      data BMS_MaxCellVoltage: type=BMS_MaxCellVoltage
    BMS_MaxCellVoltageModuleNO
      data BMS_MaxCellVoltageModuleNO: type=BMS_MaxCellVoltageModuleNO
    BMS_MaxCellVoltageNO
      data BMS_MaxCellVoltageNO: type=BMS_MaxCellVoltageNO
    BMS_MinCellTempNO
      data BMS_MinCellTempNO: type=BMS_MinCellTempNO
    BMS_MinCellVoltage
      data BMS_MinCellVoltage: type=BMS_MinCellVoltage
    BMS_RatBatVoltage
      data BMS_RatBatVoltage: type=BMS_RatBatVoltage
    BMS_RatEnergy
      data BMS_RatEnergy: type=BMS_RatEnergy
    CTS_Year
      data CTS_Year: type=CTS_Year
    CCS_OutputCurrent
      data CCS_OutputCurrent: type=CCS_OutputCurrent
    IF_ChassisMgmt_OnePedlCtrlReqStdlSts_Flg
      data tec_ChassisMgmt_OnePedlCtrlReqStdlSts_Flg: type=boolean
    BS_IBSCommError_CalcData
      data BS_IBSCommError_CalcData: type=BS_IBSCommError_CalcData
    BS_IBSCommError_MeasTemp
      data BS_IBSCommError_MeasTemp: type=BS_IBSCommError_MeasTemp
    BS_IBSCommError_MVI
      data BS_IBSCommError_MVI: type=BS_IBSCommError_MVI
    BS_IBSCommError_Rtn
      data BS_IBSCommError_Rtn: type=BS_IBSCommError_Rtn
    BS_IBSCommError_VehStrtUp
      data BS_IBSCommError_VehStrtUp: type=BS_IBSCommError_VehStrtUp
    IF_ComM_LinMsgErrInfo_Bus
      data tec_ComM_LinMsgErrInfo_Bus: type=dt_ComM_LinMsgErrInfo
    IF_ChassisMgmt_IBSIntvTqActv
      data tec_ChassisMgmt_IBSIntvTqActv: type=boolean
    VCU_BS_IBSBatSOC
      data VCU_BS_IBSBatSOC: type=VCU_BS_IBSBatSOC
    VCU_BS_LV_Batt
      data VCU_BS_LV_Batt: type=VCU_BS_LV_Batt
    VCU_ComsumpPowerInstant
      data VCU_ComsumpPowerInstant: type=VCU_ComsumpPowerInstant
    VCU_DisChgPowerLimit
      data VCU_DisChgPowerLimit: type=VCU_DisChgPowerLimit
    VCU_DisplayPowerPercent
      data VCU_DisplayPowerPercent: type=VCU_DisplayPowerPercent
    VCU_DTC_Number
      data VCU_DTC_Number: type=VCU_DTC_Number
    VCU_EnergyReturnedRegen
      data VCU_EnergyReturnedRegen: type=VCU_EnergyReturnedRegen
    VCU_LowTempInhibitPowerUpWarn
      data VCU_LowTempInhibitPowerUpWarn: type=VCU_LowTempInhibitPowerUpWarn
    VCU_MaxTorqueGradient
      data VCU_MaxTorqueGradient: type=VCU_MaxTorqueGradient
    VCU_OnepadelFault
      data VCU_OnepadelFault: type=VCU_OnepadelFault
    VCU_ChargeCurrWU_Ena
      data VCU_ChargeCurrWU_Ena: type=VCU_ChargeCurrWU_Ena
    VCU_ChargeCurrWU_Treshold
      data VCU_ChargeCurrWU_Treshold: type=VCU_ChargeCurrWU_Treshold
    VCU_DisChargeCurrWU_Ena
      data VCU_DisChargeCurrWU_Ena: type=VCU_DisChargeCurrWU_Ena
    VCU_DisChargeCurrWU_Treshold
      data VCU_DisChargeCurrWU_Treshold: type=VCU_DisChargeCurrWU_Treshold
    VCU_SOCWU_Ena
      data VCU_SOCWU_Ena: type=VCU_SOCWU_Ena
    VCU_SOCWU_Treshold
      data VCU_SOCWU_Treshold: type=VCU_SOCWU_Treshold
    BS_BatVltHIRes
      data BS_BatVltHIRes: type=BS_BatVltHIRes
    IF_ComM_BSBatVltHlResInfo
      data tec_ComM_BSBatVltHlResInfo: type=float32
    IF_ComM_CGWVehStatusInfo
      data tec_ComM_CGWVehStatusInfo: type=uint8
    IVI_OdometerInfor
      data IVI_OdometerInfor: type=IVI_OdometerInfor
    SGW_TimeInfoDay
      data SGW_TimeInfoDay: type=SGW_TimeInfoDay
    SGW_TimeInfoHour
      data SGW_TimeInfoHour: type=SGW_TimeInfoHour
    SGW_TimeInfoMinute
      data SGW_TimeInfoMinute: type=SGW_TimeInfoMinute
    SGW_TimeInfoMonth
      data SGW_TimeInfoMonth: type=SGW_TimeInfoMonth
    SGW_TimeInfoYear
      data SGW_TimeInfoYear: type=SGW_TimeInfoYear
    IF_ComM_IVIOdometerInfo
      data tec_ComM_IVIOdometerInfo: type=float32
    IF_ComM_SGWTimeDayInfo
      data tec_ComM_SGWTimeDayInfo: type=uint8
    IF_ComM_SGWTimeHourInfo
      data tec_ComM_SGWTimeHourInfo: type=uint8
    IF_ComM_SGWTimeMinuteInfo
      data tec_ComM_SGWTimeMinuteInfo: type=uint8
    IF_ComM_SGWTimeMonthInfo
      data tec_ComM_SGWTimeMonthInfo: type=uint8
    IF_ComM_SGWTimeSecondInfo
      data tec_ComM_SGWTimeSecondInfo: type=uint8
    IF_ComM_SGWTimeYearInfo
      data tec_ComM_SGWTimeYearInfo: type=uint8
    IF_ErrMgmt_HvNormDwn_Flg
      data tec_ErrMgmt_HvNormDwn_Flg: type=boolean
    IF_DiagApp_SpdLmtInfo
      data tec_DiagApp_SpdLmtInfo: type=uint8
    IF_DiagApp_TireRadiusInfo
      data tec_DiagApp_TireRadiusInfo: type=uint8
    IF_VotMot_TireRadiusReadInfo
      data tec_VotMot_TireRadiusReadInfo: type=uint8
    IF_TorqPahMgmt_SpdLmtReadInfo
      data tec_TorqPahMgmt_SpdLmtReadInfo: type=float32
    IF_LvMgmt_AppNMReqInfo
      data tec_LvMgmt_AppNMReqInfo: type=uint8
    IF_DiagApp_SpdLmtUpdateInfo
      data tec_DiagApp_SpdLmtUpdateInfo: type=boolean
    IF_DiagApp_TireRadiusUpdateInfo
      data tec_DiagApp_TireRadiusUpdateInfo: type=boolean
    CGW_VIN0
      data CGW_VIN0: type=CGW_VIN0
    CGW_VIN2
      data CGW_VIN2: type=CGW_VIN2
    CGW_VIN13
      data CGW_VIN13: type=CGW_VIN13
    CGW_VIN14
      data CGW_VIN14: type=CGW_VIN14
    CGW_VIN4
      data CGW_VIN4: type=CGW_VIN4
    CGW_VIN12
      data CGW_VIN12: type=CGW_VIN12
    CGW_VIN15
      data CGW_VIN15: type=CGW_VIN15
    CGW_VIN16
      data CGW_VIN16: type=CGW_VIN16
    CGW_VIN8
      data CGW_VIN8: type=CGW_VIN8
    CGW_VIN3
      data CGW_VIN3: type=CGW_VIN3
    CGW_VIN10
      data CGW_VIN10: type=CGW_VIN10
    CGW_VIN6
      data CGW_VIN6: type=CGW_VIN6
    CGW_VIN1
      data CGW_VIN1: type=CGW_VIN1
    CGW_VIN11
      data CGW_VIN11: type=CGW_VIN11
    CGW_VIN5
      data CGW_VIN5: type=CGW_VIN5
    CGW_VIN9
      data CGW_VIN9: type=CGW_VIN9
    CGW_VIN7
      data CGW_VIN7: type=CGW_VIN7
    CGW_VERSION1
      data CGW_VERSION1: type=CGW_VERSION1
    CGW_VERSION2
      data CGW_VERSION2: type=CGW_VERSION2
    IF_ChassisMgmt_AccrPedlSplyVolt1HiDTCInfo
      data tec_ChassisMgmt_AccrPedlSplyVolt1HiDTCInfo: type=dt_ChassisMgmt_AccrPedlSplyVolt1HiDTCInfo
    IF_ChassisMgmt_AccrPedlSplyVolt2LoDTCInfo
      data tec_ChassisMgmt_AccrPedlSplyVolt2LoDTCInfo: type=dt_ChassisMgmt_AccrPedlSplyVolt2LoDTCInfo
    IF_ChassisMgmt_AccrPedlSplyVolt2HiDTCInfo
      data tec_ChassisMgmt_AccrPedlSplyVolt2HiDTCInfo: type=dt_ChassisMgmt_AccrPedlSplyVolt2HiDTCInfo
    IF_ComM_IBSCddActvInfo
      data tec_ComM_IBSCddActvInfo: type=boolean
    IF_ChassisMgmt_VirtAccrPedlPosnInfo
      data tec_ChassisMgmt_VirtAccrPedlPosnInfo: type=float32
    IF_ChassisMgmt_VirtAccrPedlVldInfo
      data tec_ChassisMgmt_VirtAccrPedlVldInfo: type=boolean
    IF_ChassisMgmt_AccrPedlRawPosnInfo
      data tec_ChassisMgmt_AccrPedlRawPosnInfo: type=float32
    IF_ChassisMgmt_AccrPedlKdStsInfo
      data tec_ChassisMgmt_AccrPedlKdStsInfo: type=boolean
    IF_ComM_BSNodComFailrInfo
      data tec_ComM_BSNodComFailrInfo: type=boolean
    IF_ComM_BSBattSOHInfo
      data tec_ComM_BSBattSOHInfo: type=float32
    IF_ComM_IVILVLimPopInfo
      data tec_ComM_IVILVLimPopInfo: type=uint8
    IF_LvMgmt_IndicatorLightStsInfo
      data tec_LvMgmt_IndicatorLightStsInfo: type=boolean
    IF_LvMgmt_VCUlimLvlInfo
      data tec_LvMgmt_VCUlimLvlInfo: type=uint8
    IF_LvMgmt_ReachLimStdInfo
      data tec_LvMgmt_ReachLimStdInfo: type=boolean
    IF_DiagApp_DisableDCMReqInfo
      data tec_DiagApp_DisableDCMReqInfo: type=boolean
    IF_IOAbs_AccrPedl1SplyVoltInfo
      data tec_IOAbs_AccrPedl1SplyVoltInfo: type=uint16
    IF_IOAbs_AccrPedl2SplyVoltInfo
      data tec_IOAbs_AccrPedl2SplyVoltInfo: type=uint16
    IF_ChassisMgmt_AccrPedlSplyVolt1LoDTCInfo
      data tec_ChassisMgmt_AccrPedlSplyVolt1LoDTCInfo: type=dt_ChassisMgmt_AccrPedlSplyVolt1LoDTCInfo
    IF_ComM_OBCLostSpcInfo
      data tec_ComM_OBCLostSpcInfo: type=boolean
    VCU_ACU_DriverWarningLampSts
      data VCU_ACU_DriverWarningLampSts: type=VCU_ACU_DriverWarningLampSts
    VCU_ACU_PassengerAirbagSts
      data VCU_ACU_PassengerAirbagSts: type=VCU_ACU_PassengerAirbagSts
    VCU_ACU_PassengerWarningLampSts
      data VCU_ACU_PassengerWarningLampSts: type=VCU_ACU_PassengerWarningLampSts
    VCU_BCM_FLSeatBeltRemindReq
      data VCU_BCM_FLSeatBeltRemindReq: type=VCU_BCM_FLSeatBeltRemindReq
    VCU_BCM_FRSeatBeltRemindReq
      data VCU_BCM_FRSeatBeltRemindReq: type=VCU_BCM_FRSeatBeltRemindReq
    VCU_BCM_RLSeatBeltRemindReq
      data VCU_BCM_RLSeatBeltRemindReq: type=VCU_BCM_RLSeatBeltRemindReq
    VCU_BCM_RRSeatBeltRemindReq
      data VCU_BCM_RRSeatBeltRemindReq: type=VCU_BCM_RRSeatBeltRemindReq
    VCU_BS_IndicatorLightSts
      data VCU_BS_IndicatorLightSts: type=VCU_BS_IndicatorLightSts
    VCU_CGW_VehicleState
      data VCU_CGW_VehicleState: type=VCU_CGW_VehicleState
    VCU_DCDCFail
      data VCU_DCDCFail: data-constr=DC_VCU_DCDCFail, type=VCU_DCDCFail_1
    VCU_DCM_FL_DoorFLSts
      data VCU_DCM_FL_DoorFLSts: type=VCU_DCM_FL_DoorFLSts
    VCU_DCM_FR_DoorFRSts
      data VCU_DCM_FR_DoorFRSts: type=VCU_DCM_FR_DoorFRSts
    VCU_DCM_RL_DoorRLSts
      data VCU_DCM_RL_DoorRLSts: type=VCU_DCM_RL_DoorRLSts
    VCU_DCM_RR_DoorRRSts
      data VCU_DCM_RR_DoorRRSts: type=VCU_DCM_RR_DoorRRSts
    VCU_DriveMotOvrTemp
      data VCU_DriveMotOvrTemp: type=VCU_DriveMotOvrTemp_1
    VCU_HVBatCriFail
      data VCU_HVBatCriFail: type=VCU_HVBatCriFail_1
    VCU_HVBatOvrTemp
      data VCU_HVBatOvrTemp: type=VCU_HVBatOvrTemp
    VCU_IBS_BrakeFluidWarning
      data VCU_IBS_BrakeFluidWarning: type=VCU_IBS_BrakeFluidWarning
    VCU_IBS_EBDFault
      data VCU_IBS_EBDFault: type=VCU_IBS_EBDFault
    VCU_IBS_RollerbenchMode
      data VCU_IBS_RollerbenchMode: type=VCU_IBS_RollerbenchMode
    VCU_IBS_SystemStatus
      data VCU_IBS_SystemStatus: type=VCU_IBS_SystemStatus
    VCU_IVI_VrState
      data VCU_IVI_VrState: type=VCU_IVI_VrState
    IF_ComM_DrvrWarnLampStsInfo
      data tec_ComM_DrvrWarnLampStsInfo: type=uint8
    IF_ComM_PassAirbStsInfo
      data tec_ComM_PassAirbStsInfo: type=uint8
    IF_ComM_DoorFLStsInfo
      data tec_ComM_DoorFLStsInfo: type=uint8
    IF_ComM_DoorFRStsInfo
      data tec_ComM_DoorFRStsInfo: type=uint8
    IF_ComM_DoorRLStsInfo
      data tec_ComM_DoorRLStsInfo: type=uint8
    IF_ComM_DoorRRStsInfo
      data tec_ComM_DoorRRStsInfo: type=uint8
    IF_ComM_IBSSysStsInfo
      data tec_ComM_IBSSysStsInfo: type=uint8
    IF_DiagApp_StayInRunReqInfo
      data tec_DiagApp_StayInRunReqInfo: type=boolean
    IF_ComM_EBDFltStsInfo
      data tec_ComM_EBDFltStsInfo: type=uint8
    IF_ComM_BrkFldWarnStsInfo
      data tec_ComM_BrkFldWarnStsInfo: type=uint8
    IF_ComM_RollrBenchModInfo
      data tec_ComM_RollrBenchModInfo: type=uint8
    IF_ComM_VrOnOffSetInfo
      data tec_ComM_VrOnOffSetInfo: type=uint8
    IF_ComM_PassWarnLampStsInfo
      data tec_ComM_PassWarnLampStsInfo: type=uint8
    IF_ComM_RRSeatBltRmnReqInfo
      data tec_ComM_RRSeatBltRmnReqInfo: type=uint8
    IF_ComM_RLSeatBltRmnReqInfo
      data tec_ComM_RLSeatBltRmnReqInfo: type=uint8
    IF_ComM_FRSeatBltRmnReqInfo
      data tec_ComM_FRSeatBltRmnReqInfo: type=uint8
    IF_ComM_FLSeatBltRmnReqInfo
      data tec_ComM_FLSeatBltRmnReqInfo: type=uint8
    IF_ComM_VCUPNC5
      data tec_ComM_VCUPNC5: type=boolean
    IF_ComM_VCUPNC6
      data tec_ComM_VCUPNC6: type=boolean
    IF_ComM_VCUPNC0
      data tec_ComM_VCUPNC0: type=boolean
    IF_ComM_CGWPNC6
      data tec_ComM_CGWPNC6: type=boolean
    IF_ComM_CGWPNC5
      data tec_ComM_CGWPNC5: type=boolean
    IF_ComM_CGWPNC4
      data tec_ComM_CGWPNC4: type=boolean
    SG_VCU_DiagInfor_SigGroup
      data SG_VCU_DiagInfor_SigGroup: type=SG_VCU_DiagInfor_SigGroup
    SG_Uds_EPT_Boot_Request_SigGroup_1
      data SG_Uds_EPT_Boot_Request_SigGroup: type=SG_Uds_EPT_Boot_Request_SigGroup
    SG_Uds_EPT_Boot_Response_SigGroup_1
      data SG_Uds_EPT_Boot_Response_SigGroup: type=SG_Uds_EPT_Boot_Response_SigGroup
    CHSG_IBS_Status_03_SigGroup
      data CHSG_IBS_Status_03_SigGroup: type=SG_IBS_Status_03_SigGroup
    CHSG_IBS_Status_03_SigGroup_1
      data CHSG_IBS_Status_03_SigGroup: type=SG_IBS_Status_03_SigGroup_1
    IF_ComM_DCMFRMsgErrInfo_Bus
      data tec_ComM_DCMFRTimeoutInfo_Bus: type=dt_ComM_DCMFRTimeoutInfo
      data tec_ComM_DCMFRTimeoutDTCInfo_Bus: type=dt_ComM_DCMFRTimeoutDTCInfo
    IF_ComM_DCMRLMsgErrInfo_Bus
      data tec_ComM_DCMRLTimeoutInfo_Bus: type=dt_ComM_DCMRLTimeoutInfo
      data tec_ComM_DCMRLTimeoutDTCInfo_Bus: type=dt_ComM_DCMRLTimeoutDTCInfo
    IF_ComM_DCMRRMsgErrInfo_Bus
      data tec_ComM_DCMRRTimeoutInfo_Bus: type=dt_ComM_DCMRRTimeoutInfo
      data tec_ComM_DCMRRTimeoutDTCInfo_Bus: type=dt_ComM_DCMRRTimeoutDTCInfo
    IF_ComM_BCM05MsgErrInfo_Bus
      data tec_ComM_BCM05TimeoutDTCInfo_Bus: type=dt_ComM_BCM05TimeoutDTCInfo
      data tec_ComM_BCM05CRCDTCInfo_Bus: type=dt_ComM_BCM05CRCDTCInfo
    IF_DiagApp_ClearRangeEstNVMReqInfo
      data tec_DiagApp_ClearRangeEstNVMReqInfo: type=boolean
    IF_RngEst_ClearNVMSucessInfo
      data tec_RngEst_ClearNVMSucessInfo: type=uint8
    IF_EgyMgmt_V2LDisChgPwrLmtInfo
      data tec_EgyMgmt_V2LDisChgPwrLmtInfo: type=float32
    IF_ComM_NMStatusInfo
      data tec_ComM_NMStatusInfo: type=uint8
    VCU_PNC5
      data VCU_PNC5: type=VCU_PNC5
    VCU_HVBatOvrTempLIN
      data VCU_HVBatOvrTempLIN: type=VCU_HVBatOvrTempLIN
    VCU_BattNomC20LIN
      data VCU_BattNomC20LIN: type=VCU_BattNomC20LIN
    VCU_Batt_U0_MinLIN
      data VCU_Batt_U0_MinLIN: type=VCU_Batt_U0_MinLIN
    VCU_IBS_BrakeFluidWarningLIN
      data VCU_IBS_BrakeFluidWarningLIN: type=VCU_IBS_BrakeFluidWarningLIN
    VCU_CGW_VehicleStateLIN
      data VCU_CGW_VehicleStateLIN: type=VCU_CGW_VehicleStateLIN
    VCU_HstTempDataRqTrgLIN
      data VCU_HstTempDataRqTrgLIN: type=VCU_HstTempDataRqTrgLIN
    VCU_DCDCFailLIN
      data VCU_DCDCFailLIN: type=VCU_DCDCFailLIN
    VCU_HVBatCriFailLIN
      data VCU_HVBatCriFailLIN: type=VCU_HVBatCriFailLIN
    VCU_ACU_PassengerAirbagStsLIN
      data VCU_ACU_PassengerAirbagStsLIN: type=VCU_ACU_PassengerAirbagStsLIN
    VCU_SOCWU_EnaLIN
      data VCU_SOCWU_EnaLIN: type=VCU_SOCWU_EnaLIN
    VCU_DCM_FL_DoorFLStsLIN
      data VCU_DCM_FL_DoorFLStsLIN: type=VCU_DCM_FL_DoorFLStsLIN
    VCU_BattTypeLIN
      data VCU_BattTypeLIN: type=VCU_BattTypeLIN
    VCU_IBS_SystemStatusLIN
      data VCU_IBS_SystemStatusLIN: type=VCU_IBS_SystemStatusLIN
    VCU_BCM_FRSeatBeltRemindReqLIN
      data VCU_BCM_FRSeatBeltRemindReqLIN: type=VCU_BCM_FRSeatBeltRemindReqLIN
    VCU_IBSClrDiagInfLIN
      data VCU_IBSClrDiagInfLIN: type=VCU_IBSClrDiagInfLIN
    VCU_BS_IndicatorLightStsLIN
      data VCU_BS_IndicatorLightStsLIN: type=VCU_BS_IndicatorLightStsLIN
    VCU_Batt_U0_MaxLIN
      data VCU_Batt_U0_MaxLIN: type=VCU_Batt_U0_MaxLIN
    VCU_ACU_DriverWarningLampStsLIN
      data VCU_ACU_DriverWarningLampStsLIN: type=VCU_ACU_DriverWarningLampStsLIN
    VCU_SOCWU_TresholdLIN
      data VCU_SOCWU_TresholdLIN: type=VCU_SOCWU_TresholdLIN
    VCU_IVI_VrStateLIN
      data VCU_IVI_VrStateLIN: type=VCU_IVI_VrStateLIN
    VCU_DisChargeCurrWU_TresholdLIN
      data VCU_DisChargeCurrWU_TresholdLIN: type=VCU_DisChargeCurrWU_TresholdLIN
    VCU_DCM_RR_DoorRRStsLIN
      data VCU_DCM_RR_DoorRRStsLIN: type=VCU_DCM_RR_DoorRRStsLIN
    VCU_BCM_FLSeatBeltRemindReqLIN
      data VCU_BCM_FLSeatBeltRemindReqLIN: type=VCU_BCM_FLSeatBeltRemindReqLIN
    VCU_DCM_RL_DoorRLStsLIN
      data VCU_DCM_RL_DoorRLStsLIN: type=VCU_DCM_RL_DoorRLStsLIN
    VCU_DisChargeCurrWU_EnaLIN
      data VCU_DisChargeCurrWU_EnaLIN: type=VCU_DisChargeCurrWU_EnaLIN
    VCU_ACU_PassengerWarningLampStsLIN
      data VCU_ACU_PassengerWarningLampStsLIN: type=VCU_ACU_PassengerWarningLampStsLIN
    VCU_ChargeCurrWU_TresholdLIN
      data VCU_ChargeCurrWU_TresholdLIN: type=VCU_ChargeCurrWU_TresholdLIN
    VCU_DCM_FR_DoorFRStsLIN
      data VCU_DCM_FR_DoorFRStsLIN: type=VCU_DCM_FR_DoorFRStsLIN
    VCU_BCM_RLSeatBeltRemindReqLIN
      data VCU_BCM_RLSeatBeltRemindReqLIN: type=VCU_BCM_RLSeatBeltRemindReqLIN
    VCU_IBS_EBDFaultLIN
      data VCU_IBS_EBDFaultLIN: type=VCU_IBS_EBDFaultLIN
    VCU_IBS_RollerbenchModeLIN
      data VCU_IBS_RollerbenchModeLIN: type=VCU_IBS_RollerbenchModeLIN
    VCU_ChargeCurrWU_EnaLIN
      data VCU_ChargeCurrWU_EnaLIN: type=VCU_ChargeCurrWU_EnaLIN
    VCU_BCM_RRSeatBeltRemindReqLIN
      data VCU_BCM_RRSeatBeltRemindReqLIN: type=VCU_BCM_RRSeatBeltRemindReqLIN
    VCU_DriveMotOvrTempLIN
      data VCU_DriveMotOvrTempLIN: type=VCU_DriveMotOvrTempLIN
    IF_ChrMgmt_PosRlyReqSts_Enum
      data tec_ChrMgmt_PosRlyReqSts_Enum: type=uint8
    IF_ChassisMgmt_IBSVlcDesTq_Nm
      data tec_ChassisMgmt_IBSVlcDesTq_Nm: type=float32
    IF_ChassisMgmt_IBSApsDesTq_Nm
      data tec_ChassisMgmt_IBSApsDesTq_Nm: type=float32
    IF_ComM_IBSTcsFltSts_Flg
      data tec_ComM_IBSTcsFltSts_Flg: type=boolean
    IF_ChrMgmt_PckPTCAllwbl_Flg
      data tec_ChrMgmt_PckPTCAllwbl_Flg: type=boolean
    IF_ComM_OBCChrgOutpPwrAvl_Kw
      data tec_ComM_OBCChrgOutpPwrAvl_Kw: type=float32
  nv data interface IF_ChassisMgmtInfo
    nv-datas:
      data tec_ChassisMgmtInfo: sw-calibration-access=READ-WRITE, type=dt_Nv_ChassisMgmtInfo
  306 x sender receiver interface:
    IF_ComM_ACUYawRate
      data tec_ComM_ACUYawRate: type=float32
    IF_ComM_TriggerASWMsgReqInfo
      data tec_ComM_TriggerASWMsgReqInfo: type=boolean
    SG_VCU_DiagInfor_SigGroup_1
      data SG_VCU_DiagInfor_SigGroup: type=SG_VCU_DiagInfor_SigGroup
    IF_ChrMgmt_PreheatReqHvOff
      data tec_ChrMgmt_PreheatReqHvOff: type=boolean
    IF_ComM_SGWSysRdyReq
      data tec_ComM_SGWSysRdyReq: type=uint8
    IF_ComM_DCMAmbTempVld
      data tec_ComM_DCMAmbTempVld: type=boolean
    IF_ComM_DCMAmbTemp
      data tec_ComM_DCMAmbTemp: type=float32
    IF_RngEstimn_MilgLowRmn
      data tec_RngEstimn_MilgLowRmn: type=boolean
    IF_ComM_ADCUPrkMod
      data tec_ComM_ADCUPrkMod: type=uint8
    IF_ComM_ADCUAccMod
      data tec_ComM_ADCUAccMod: type=uint8
    IF_ChassisMgmt_CrpCtrlSts
      data tec_ChassisMgmt_CrpCtrlSts: type=boolean
    IF_ComM_IBSDtcFltSts
      data tec_ComM_IBSDtcFltSts: type=boolean
    IF_FctSftyMon_WakeUpFinish
      data tec_FctSftyMon_WakeUpFinish: type=boolean
    IF_ComM_ADCURemPrkMod
      data tec_ComM_ADCURemPrkMod: type=uint8
    IF_ComM_ADCUAEBSt
      data tec_ComM_ADCUAEBSt: type=uint8
    IF_ComM_ADCUDAMod
      data tec_ComM_ADCUDAMod: type=uint8
    IF_FctSftyMon_EPBReqCmpl
      data tec_FctSftyMon_EPBReqCmpl: type=boolean
    IF_FctSftyMon_EPBWrkSts
      data tec_FctSftyMon_EPBWrkSts: type=uint8
    IF_FctSftyMon_EPBPrkReqFail
      data tec_FctSftyMon_EPBPrkReqFail: type=boolean
    IF_FctSftyMon_EPBRelsReqFail
      data tec_FctSftyMon_EPBRelsReqFail: type=boolean
    IF_GearMgmt_ADASReqVld
      data tec_GearMgmt_ADASReqVld: type=boolean
    IF_GearMgmt_GearCalEPBPrk
      data tec_GearMgmt_GearCalEPBPrk: type=boolean
    IF_GearMgmt_GearCalEPBRels
      data tec_GearMgmt_GearCalEPBRels: type=boolean
    IF_ComM_IBSEPBControllerSts
      data tec_ComM_IBSEPBControllerSts: type=uint8
    IF_ComM_IBSSUBEPBWrkSts
      data tec_ComM_IBSSUBEPBWrkSts: type=uint8
    IF_ComM_IBSSUBEPBControllerSts
      data tec_ComM_IBSSUBEPBControllerSts: type=uint8
    IF_FctSftyMon_TarGearPInhbTq
      data tec_FctSftyMon_TarGearPInhbTq: type=boolean
    IF_FctSftyMon_EPBReq
      data tec_FctSftyMon_EPBReq: type=uint8
    IF_TorqPahMgmt_MotDftlProtnActv
      data tec_TorqPahMgmt_MotDftlProtnActv: type=boolean
    IF_TorqPahMgmt_MotDampLmtTq
      data tec_TorqPahMgmt_MotDampLmtTq: type=float32
    IF_ComM_SGWDchaSwtSts
      data tec_ComM_SGWDchaSwtSts: type=uint8
    IF_DCChrMgmt_BSTTxReqSts
      data tec_DCChrMgmt_BSTTxReqSts: type=boolean
    IF_ComM_BMSPTCRlyStsInfo
      data tec_ComM_BMSPTCRlyStsInfo: type=uint8
    IF_ComM_BSBatVltHIDiag
      data tec_ComM_BSBatVltHIDiag: type=boolean
    IF_ComM_BSBatVltLOWDiag
      data tec_ComM_BSBatVltLOWDiag: type=boolean
    IF_ComM_BSBatCrntDSGDiag
      data tec_ComM_BSBatCrntDSGDiag: type=boolean
    IF_ComM_BSBatCrntCHGDiag
      data tec_ComM_BSBatCrntCHGDiag: type=boolean
    IF_ComM_BSBatTempHIDiag
      data tec_ComM_BSBatTempHIDiag: type=boolean
    IF_ComM_BSBatTempLOWDiag
      data tec_ComM_BSBatTempLOWDiag: type=boolean
    IF_ComM_BSLowerSOC
      data tec_ComM_BSLowerSOC: type=boolean
    IF_ComM_BSComFtonNet
      data tec_ComM_BSComFtonNet: type=boolean
    IF_ComM_BSBattSOH
      data tec_ComM_BSBattSOH: type=float32
    IF_LvMgmt_BSRespErrDTC_Bus
      data tec_LvMgmt_BSRespErrDTC_Bus: type=dt_LvMgmt_BSRespErrDTC
    IF_LvMgmt_BSBattChrgIDcHiDTC_Bus
      data tec_LvMgmt_BSBattChrgIDcHiDTC_Bus: type=dt_LvMgmt_BSBattChrgIDcHiDTC
    IF_LvMgmt_BSBattTempHiDTC_Bus
      data tec_LvMgmt_BSBattTempHiDTC_Bus: type=dt_LvMgmt_BSBattTempHiDTC
    IF_LvMgmt_BSBattTempLoDTC_Bus
      data tec_LvMgmt_BSBattTempLoDTC_Bus: type=dt_LvMgmt_BSBattTempLoDTC
    IF_LvMgmt_BSBattSOCLoDTC_Bus
      data tec_LvMgmt_BSBattSOCLoDTC_Bus: type=dt_LvMgmt_BSBattSOCLoDTC
    IF_ComM_BSBatCrnt
      data tec_ComM_BSBatCrnt: type=float32
    IF_ComM_PODDCDC02Update
      data tec_ComM_PODDCDC02Update: type=boolean
    IF_ComM_PODOBCSts03Update
      data tec_ComM_PODOBCSts03Update: type=boolean
    IF_ComM_IVIVrState
      data tec_ComM_IVIVrState: type=boolean
    IF_ComM_MCUFailCodeUpdate
      data tec_ComM_MCUFailCodeUpdate: type=boolean
    IF_ComM_TCU01Update
      data tec_ComM_TCU01Update: type=boolean
    IF_ComM_ADCUDAMsgErrInfo_Bus
      data tec_ComM_ADCUDACRCDTCInfo_Bus: type=dt_ComM_ADCUDACRCDTCInfo
      data tec_ComM_ADCUDATimeoutDTCInfo_Bus: type=dt_ComM_ADCUDATimeoutDTCInfo
    IF_ComM_SGW16MsgErrInfo_Bus
      data tec_ComM_SGW16TimeoutDTCInfo_Bus: type=dt_ComM_SGW16TimeoutDTCInfo
      data tec_ComM_SGW16TimeoutInfo_Bus: type=dt_ComM_SGW16TimeoutInfo
    IF_ComM_SGW17MsgErrInfo_Bus
      data tec_ComM_SGW17TimeoutInfo_Bus: type=dt_ComM_SGW17TimeoutInfo
      data tec_ComM_SGW17TimeoutDTCInfo_Bus: type=dt_ComM_SGW17TimeoutDTCInfo
    IF_ComM_IBSAPSMsgErrInfo_Bus
      data tec_ComM_IBSAPSCRCDTCInfo_Bus: type=dt_ComM_IBSAPSCRCDTCInfo
      data tec_ComM_IBSAPSTimeoutDTCInfo_Bus: type=dt_ComM_IBSAPSTimeoutDTCInfo
    IF_ComM_ADCUAEB01MsgErrInfo_Bus
      data tec_ComM_ADCUAEB01CRCDTCInfo_Bus: type=dt_ComM_ADCUAEB01CRCDTCInfo
      data tec_ComM_ADCUAEB01TimeoutDTCInfo_Bus: type=dt_ComM_ADCUAEB01TimeoutDTCInfo
    IF_ComM_ADCUAPS01MsgErrInfo_Bus
      data tec_ComM_ADCUAPS01CRCDTCInfo_Bus: type=dt_ComM_ADCUAPS01CRCDTCInfo
      data tec_ComM_ADCUAPS01TimeoutDTCInfo_Bus: type=dt_ComM_ADCUAPS01TimeoutDTCInfo
    IF_ComM_ACUInfoUpdate
      data tec_ComM_ACUInfoUpdate: type=boolean
    IF_ComM_BMSSts01Update
      data tec_ComM_BMSSts01Update: type=boolean
    FRC_Vl_OV
      data FRC_Vl_OV: type=FRC_Vl_OV
    FRC_Vl_UV
      data FRC_Vl_UV: type=FRC_Vl_UV
    FRC_ComFtonNet
      data FRC_ComFtonNet: type=FRC_ComFtonNet
    IF_ComM_FRCComFtonNet
      data tec_ComM_FRCComFtonNet: type=boolean
    IF_ComM_FRCVlOV
      data tec_ComM_FRCVlOV: type=boolean
    IF_ComM_FRCVlUV
      data tec_ComM_FRCVlUV: type=boolean
    BS_BatVlt_LOW_Diag
      data BS_BatVlt_LOW_Diag: type=BS_BatVlt_LOW_Diag
    BS_BatTemp_LOW_Diag
      data BS_BatTemp_LOW_Diag: type=BS_BatTemp_LOW_Diag
    BS_BatVlt_HI_Diag
      data BS_BatVlt_HI_Diag: type=BS_BatVlt_HI_Diag
    BS_ComFtonNet
      data BS_ComFtonNet: type=BS_ComFtonNet
    BS_LowerSOC
      data BS_LowerSOC: type=BS_LowerSOC
    BS_BatCrntRawVal
      data BS_BatCrntRawVal: type=BS_BatCrntRawVal
    BS_BatCrnt_DSG_Diag
      data BS_BatCrnt_DSG_Diag: type=BS_BatCrnt_DSG_Diag
    BS_BatCrnt_CHG_Diag
      data BS_BatCrnt_CHG_Diag: type=BS_BatCrnt_CHG_Diag
    BS_BatTemp_HI_Diag
      data BS_BatTemp_HI_Diag: type=BS_BatTemp_HI_Diag
    IF_ComM_FRCMsgErrDTC_Bus
      data tec_ComM_FRCMsgErrDTC_Bus: type=dt_ComM_FRCMsgErrDTC
    IF_ComM_FRCRespErrDTC_Bus
      data tec_ComM_FRCRespErrDTC_Bus: type=dt_ComM_FRCRespErrDTC
    IF_ComM_FRCSplyUDcHiDTC_Bus
      data tec_ComM_FRCSplyUDcHiDTC_Bus: type=dt_ComM_FRCSplyUDcHiDTC
    IF_ComM_FRCSplyUDcLoDTC_Bus
      data tec_ComM_FRCSplyUDcLoDTC_Bus: type=dt_ComM_FRCSplyUDcLoDTC
    IF_ComM_FRCNodComFailrInfo
      data tec_ComM_FRCNodComFailrInfo: type=boolean
    IF_DCCAN_BusoffStatus_BusoffStatus
      data tec_DCCAN_BusoffStatus_BusoffStatus: type=boolean
    IF_ComM_BSDIAGFLAGIsUpdated
      data tec_ComM_BSDIAGFLAGIsUpdated: type=boolean
    VCU_wakeup_cycleLIN
      data VCU_wakeup_cycleLIN: type=VCU_wakeup_cycleLIN_1
    SG_SGW_PT_01_SigGroup
      data SG_SGW_PT_01_SigGroup: type=SG_SGW_PT_01_SigGroup
    SG_POD_DCDC_02_SigGroup
      data SG_POD_DCDC_02_SigGroup: type=SG_POD_DCDC_02_SigGroup
    SG_SGW_Time_SigGroup
      data SG_SGW_Time_SigGroup: type=SG_SGW_Time_SigGroup
    SG_BMS_CellVoltage_SigGroup
      data SG_BMS_CellVoltage_SigGroup: type=SG_BMS_CellVoltage_SigGroup
    SG_IBS_WheelSpeed_01_SigGroup
      data SG_IBS_WheelSpeed_01_SigGroup: type=SG_IBS_WheelSpeed_01_SigGroup
    SG_CGW_01_SigGroup
      data SG_CGW_01_SigGroup: type=SG_CGW_01_SigGroup
    SG_IBS_VCU_MotorControl_SigGroup
      data SG_IBS_VCU_MotorControl_SigGroup: type=SG_IBS_VCU_MotorControl_SigGroup
    SG_SGW_04_SigGroup
      data SG_SGW_04_SigGroup: type=SG_SGW_04_SigGroup
    SG_PRND_SigGroup
      data SG_PRND_SigGroup: type=SG_PRND_SigGroup
    SG_DCM_FR_SigGroup
      data SG_DCM_FR_SigGroup: type=SG_DCM_FR_SigGroup
    SG_CGW_VIN3VER_SigGroup
      data SG_CGW_VIN3VER_SigGroup: type=SG_CGW_VIN3VER_SigGroup
    SG_BMS_ErrorInfo_SigGroup
      data SG_BMS_ErrorInfo_SigGroup: type=SG_BMS_ErrorInfo_SigGroup
    SG_CGW_VIN2_SigGroup
      data SG_CGW_VIN2_SigGroup: type=SG_CGW_VIN2_SigGroup
    SG_BMS_status_02_SigGroup
      data SG_BMS_status_02_SigGroup: type=SG_BMS_status_02_SigGroup
    SG_IBS_Status_05_SigGroup
      data SG_IBS_Status_05_SigGroup: type=SG_IBS_Status_05_SigGroup
    SG_BMS_CellTemp_SigGroup
      data SG_BMS_CellTemp_SigGroup: type=SG_BMS_CellTemp_SigGroup
    SG_IBS_Status_04_SigGroup
      data SG_IBS_Status_04_SigGroup: type=SG_IBS_Status_04_SigGroup
    SG_SGW_17_SigGroup
      data SG_SGW_17_SigGroup: type=SG_SGW_17_SigGroup
    SG_BMS_status_04_SigGroup
      data SG_BMS_status_04_SigGroup: type=SG_BMS_status_04_SigGroup
    SG_BMS_PRO_SigGroup
      data SG_BMS_PRO_SigGroup: type=SG_BMS_PRO_SigGroup
    SG_ACU_01_SigGroup
      data SG_ACU_01_SigGroup: type=SG_ACU_01_SigGroup
    SG_ADCU_DA_SigGroup
      data SG_ADCU_DA_SigGroup: type=SG_ADCU_DA_SigGroup
    SG_POD_Status_02_SigGroup
      data SG_POD_Status_02_SigGroup: type=SG_POD_Status_02_SigGroup
    SG_CGW_VIN1_SigGroup
      data SG_CGW_VIN1_SigGroup: type=SG_CGW_VIN1_SigGroup
    SG_IVI_01_SigGroup
      data SG_IVI_01_SigGroup: type=SG_IVI_01_SigGroup
    SG_MCU_02_SigGroup
      data SG_MCU_02_SigGroup: type=SG_MCU_02_SigGroup
    SG_MCU_Temperature_02_SigGroup
      data SG_MCU_Temperature_02_SigGroup: type=SG_MCU_Temperature_02_SigGroup
    SG_IBS_Status_03_SigGroup
      data SG_IBS_Status_03_SigGroup: type=SG_IBS_Status_03_SigGroup
    SG_BMS_Charge_01_SigGroup
      data SG_BMS_Charge_01_SigGroup: type=SG_BMS_Charge_01_SigGroup
    SG_CGW_02_SigGroup
      data SG_CGW_02_SigGroup: type=SG_CGW_02_SigGroup
    SG_POD_OBC_STATUS_02_SigGroup
      data SG_POD_OBC_STATUS_02_SigGroup: type=SG_POD_OBC_STATUS_02_SigGroup
    SG_BMS_TCU_SigGroup
      data SG_BMS_TCU_SigGroup: type=SG_BMS_TCU_SigGroup
    SG_ACU_info_SigGroup
      data SG_ACU_info_SigGroup: type=SG_ACU_Info_SigGroup
    SG_ADCU_APS_02_SigGroup
      data SG_ADCU_APS_02_SigGroup: type=SG_ADCU_APS_02_SigGroup
    SG_MCU_FailureCode_SigGroup
      data SG_MCU_FailureCode_SigGroup: type=SG_MCU_FailureCode_SigGroup
    SG_IVI_OdometerInfor_SigGroup
      data SG_IVI_OdometerInfor_SigGroup: type=SG_IVI_OdometerInfor_SigGroup
    SG_DCM_RL_SigGroup
      data SG_DCM_RL_SigGroup: type=SG_DCM_RL_SigGroup
    SG_ADCU_APS_01_SigGroup
      data SG_ADCU_APS_01_SigGroup: type=SG_ADCU_APS_01_SigGroup
    SG_MCU_Temperature_01_SigGroup
      data SG_MCU_Temperature_01_SigGroup: type=SG_MCU_Temperature_01_SigGroup
    SG_POD_DCDC_01_SigGroup
      data SG_POD_DCDC_01_SigGroup: type=SG_POD_DCDC_01_SigGroup
    SG_IBS_Status_02_SigGroup
      data SG_IBS_Status_02_SigGroup: type=SG_IBS_Status_02_SigGroup
    SG_BCM_05_SigGroup
      data SG_BCM_05_SigGroup: type=SG_BCM_05_SigGroup
    SG_IBS_APS_SigGroup
      data SG_IBS_APS_SigGroup: type=SG_IBS_APS_SigGroup
    SG_SGW_FVSynchronization_01_SigGrou
      data SG_SGW_FVSynchronization_01_SigGrou: type=SG_SGW_FVSynchronization_01_SigGrou
    SG_BMS_BatInfor_02_SigGroup
      data SG_BMS_BatInfor_02_SigGroup: type=SG_BMS_BatInfor_02_SigGroup
    SG_BCM_06_SigGroup
      data SG_BCM_06_SigGroup: type=SG_BCM_06_SigGroup
    SG_IBS_Status_01_SigGroup
      data SG_IBS_Status_01_SigGroup: type=SG_IBS_Status_01_SigGroup
    SG_IBS_Status_06_SigGroup
      data SG_IBS_Status_06_SigGroup: type=SG_IBS_Status_06_SigGroup
    SG_BMS_status_03_SigGroup
      data SG_BMS_status_03_SigGroup: type=SG_BMS_status_03_SigGroup
    SG_DCM_FR_02_SigGroup
      data SG_DCM_FR_02_SigGroup: type=SG_DCM_FR_02_SigGroup
    SG_BCM_Authentication_SigGroup
      data SG_BCM_Authentication_SigGroup: type=SG_BCM_Authentication_SigGroup
    SG_SGW_01_SigGroup
      data SG_SGW_01_SigGroup: type=SG_SGW_01_SigGroup
    SG_IBS_Torque_SigGroup
      data SG_IBS_Torque_SigGroup: type=SG_IBS_Torque_SigGroup
    SG_DCM_FL_02_SigGroup
      data SG_DCM_FL_02_SigGroup: type=SG_DCM_FL_02_SigGroup
    SG_IBS_ACC_SigGroup
      data SG_IBS_ACC_SigGroup: type=SG_IBS_ACC_SigGroup
    SG_POD_OBC_CHRGSTATION_SigGroup
      data SG_POD_OBC_CHRGSTATION_SigGroup: type=SG_POD_OBC_CHRGSTATION_SigGroup
    SG_POD_OBC_STATUS_03_SigGroup
      data SG_POD_OBC_STATUS_03_SigGroup: type=SG_POD_OBC_STATUS_03_SigGroup
    SG_POD_OBC_STATUS_04_SigGroup
      data SG_POD_OBC_STATUS_04_SigGroup: type=SG_POD_OBC_STATUS_04_SigGroup
    SG_ACU_02_SigGroup
      data SG_ACU_02_SigGroup: type=SG_ACU_02_SigGroup
    SG_POD_Status_01_SigGroup
      data SG_POD_Status_01_SigGroup: type=SG_POD_Status_01_SigGroup
    SG_BMS_VersionInfor_SigGroup
      data SG_BMS_VersionInfor_SigGroup: type=SG_BMS_VersionInfor_SigGroup
    SG_BMS_BatInfor_01_SigGroup
      data SG_BMS_BatInfor_01_SigGroup: type=SG_BMS_BatInfor_01_SigGroup
    SG_BMS_status_01_SigGroup
      data SG_BMS_status_01_SigGroup: type=SG_BMS_status_01_SigGroup
    SG_MCU_DeratingStatus_SigGroup
      data SG_MCU_DeratingStatus_SigGroup: type=SG_MCU_DeratingStatus_SigGroup
    SG_SGW_VCU_01_SigGroup
      data SG_SGW_VCU_01_SigGroup: type=SG_SGW_VCU_01_SigGroup
    SG_SGW_IBS_01_SigGroup
      data SG_SGW_IBS_01_SigGroup: type=SG_SGW_IBS_01_SigGroup
    SG_DCM_RR_SigGroup
      data SG_DCM_RR_SigGroup: type=SG_DCM_RR_SigGroup
    SG_BMS_DIRelayState_SigGroup
      data SG_BMS_DIRelayState_SigGroup: type=SG_BMS_DIRelayState_SigGroup
    SG_TCU_02_SigGroup
      data SG_TCU_02_SigGroup: type=SG_TCU_02_SigGroup
    SG_SGW_16_SigGroup
      data SG_SGW_16_SigGroup: type=SG_SGW_16_SigGroup
    SG_APTC_TCU_SigGroup
      data SG_APTC_TCU_SigGroup: type=SG_APTC_TCU_SigGroup
    SG_ADCU_ACC_02_SigGroup
      data SG_ADCU_ACC_02_SigGroup: type=SG_ADCU_ACC_02_SigGroup
    SG_TCU_01_SigGroup
      data SG_TCU_01_SigGroup: type=SG_TCU_01_SigGroup
    SG_ADCU_AEB_01_SigGroup
      data SG_ADCU_AEB_01_SigGroup: type=SG_ADCU_AEB_01_SigGroup
    SG_BMS_BatInfor_03_SigGroup
      data SG_BMS_BatInfor_03_SigGroup: type=SG_BMS_BatInfor_03_SigGroup
    SG_BMS_Charge_03_SigGroup
      data SG_BMS_Charge_03_SigGroup: type=SG_BMS_Charge_03_SigGroup
    SG_BCM_11_SigGroup
      data SG_BCM_11_SigGroup: type=SG_BCM_11_SigGroup
    SG_BMS_Charge_02_SigGroup
      data SG_BMS_Charge_02_SigGroup: type=SG_BMS_Charge_02_SigGroup
    SG_IBS_WheelSpeed_02_SigGroup
      data SG_IBS_WheelSpeed_02_SigGroup: type=SG_IBS_WheelSpeed_02_SigGroup
    SG_EVCOM_State_01_SigGroup
      data SG_EVCOM_State_01_SigGroup: type=SG_EVCOM_State_01_SigGroup
    SG_VCU_HMIsignals_02_SigGroup
      data SG_VCU_HMIsignals_02_SigGroup: type=SG_VCU_HMIsignals_02_SigGroup
    SG_VCU_TCU_SigGroup
      data SG_VCU_TCU_SigGroup: type=SG_VCU_TCU_SigGroup
    SG_VCU_IBS_01_SigGroup
      data SG_VCU_IBS_01_SigGroup: type=SG_VCU_IBS_01_SigGroup
    SG_VCU_03_SigGroup
      data SG_VCU_03_SigGroup: type=SG_VCU_03_SigGroup
    SG_VCU_BMS_SigGroup
      data SG_VCU_BMS_SigGroup: type=SG_VCU_BMS_SigGroup
    SG_VCU_DiagInfor_SigGroup_2
      data SG_VCU_DiagInfor_SigGroup: type=SG_VCU_DiagInfor_SigGroup
    SG_VCU_05_SigGroup
      data SG_VCU_05_SigGroup: type=SG_VCU_05_SigGroup
    SG_VCU_HMIsignals_03_SigGroup
      data SG_VCU_HMIsignals_03_SigGroup: type=SG_VCU_HMIsignals_03_SigGroup
    SG_VCU_Chassis_01_SigGroup
      data SG_VCU_Chassis_01_SigGroup: type=SG_VCU_Chassis_01_SigGroup
    SG_VCU_MCU_02_SigGroup
      data SG_VCU_MCU_02_SigGroup: type=SG_VCU_MCU_02_SigGroup
    SG_VCU_SynReq_01_SigGroup
      data SG_VCU_SynReq_01_SigGroup: type=SG_VCU_SynReq_01_SigGroup
    SG_VCU_MCU_05_SigGroup
      data SG_VCU_MCU_05_SigGroup: type=SG_VCU_MCU_05_SigGroup
    SG_VCU_POD_SigGroup
      data SG_VCU_POD_SigGroup: type=SG_VCU_POD_SigGroup
    SG_VCU_06_SigGroup
      data SG_VCU_06_SigGroup: type=SG_VCU_06_SigGroup
    SG_VCU_02_SigGroup
      data SG_VCU_02_SigGroup: type=SG_VCU_02_SigGroup
    SG_VCU_04_SigGroup
      data SG_VCU_04_SigGroup: type=SG_VCU_04_SigGroup
    SG_VCU_PlugInChrgInfo_SigGroup
      data SG_VCU_PlugInChrgInfo_SigGroup: type=SG_VCU_PlugInChrgInfo_SigGroup
    SG_VCU_DCDC_SigGroup
      data SG_VCU_DCDC_SigGroup: type=SG_VCU_DCDC_SigGroup
    SG_VCU_AccPedal_SigGroup
      data SG_VCU_AccPedal_SigGroup: type=SG_VCU_AccPedal_SigGroup
    SG_VCU_HMIsignals_01_SigGroup
      data SG_VCU_HMIsignals_01_SigGroup: type=SG_VCU_HMIsignals_01_SigGroup
    SG_MCU_01_SigGroup_2
      data SG_MCU_01_SigGroup: type=SG_MCU_01_SigGroup
    SG_VCU_MCU_03_SigGroup
      data SG_VCU_MCU_03_SigGroup: type=SG_VCU_MCU_03_SigGroup
    SG_VCU_MCU_03_SigGroup_1
      data SG_VCU_MCU_03_SigGroup: type=SG_VCU_MCU_03_SigGroup
    IF_ComM_BSBatCrntRawValMult
      data tec_ComM_BSBatCrntRawValMult: type=uint8
    IF_ComM_BSBattIntRes
      data tec_ComM_BSBattIntRes: type=float32
    IF_ComM_BSBattU0MinRtn
      data tec_ComM_BSBattU0MinRtn: type=float32
    IF_ComM_BSBattU0MaxRtn
      data tec_ComM_BSBattU0MaxRtn: type=float32
    IF_ComM_BSRawTemp1
      data tec_ComM_BSRawTemp1: type=float32
    IF_ComM_BSBattNomRtnC20
      data tec_ComM_BSBattNomRtnC20: type=uint8
    IF_ComM_BSBattTypeRtnC20
      data tec_ComM_BSBattTypeRtnC20: type=uint8
    IF_ComM_BSBattSOFVolt
      data tec_ComM_BSBattSOFVolt: type=float32
    BS_BatCrntRawValMult
      data BS_BatCrntRawValMult: type=BS_BatCrntRawValMult
    BS_Batt_U0_MinRtn
      data BS_Batt_U0_MinRtn: type=BS_Batt_U0_MinRtn
    BS_RawTemp1
      data BS_RawTemp1: type=BS_RawTemp1
    BS_BattNomRtnC20
      data BS_BattNomRtnC20: type=BS_BattNomRtnC20
    BS_BattSOFVolt
      data BS_BattSOFVolt: type=BS_BattSOFVolt
    BS_BattTypeRtnC20
      data BS_BattTypeRtnC20: type=BS_BattTypeRtnC20
    BS_Batt_U0_MaxRtn
      data BS_Batt_U0_MaxRtn: type=BS_Batt_U0_MaxRtn
    BS_BattIntRes
      data BS_BattIntRes: type=BS_BattIntRes
    SG_SGW_FVSynchronization_01_SigGrou_1
      data SG_SGW_FVSynchronization_01_SigGrou: type=SG_SGW_FVSynchronization_01_SigGrou
    IF_MilCal_VCU_VehicleSpeedValid
      data tec_MilCal_VCU_VehicleSpeedValid: type=VCU_VehicleSpeedValid
    IF_MilCal_VCU_VehicleSpeed
      data tec_MilCal_VCU_VehicleSpeed: type=VCU_VehicleSpeed
    SG_ACU_info_SigGroup_1
      data SG_ACU_info_SigGroup: type=SG_ACU_Info_SigGroup
    SG_ADCU_ACC_02_SigGroup_1
      data SG_ADCU_ACC_02_SigGroup: type=SG_ADCU_ACC_02_SigGroup
    SG_ADCU_AEB_01_SigGroup_1
      data SG_ADCU_AEB_01_SigGroup: type=SG_ADCU_AEB_01_SigGroup
    SG_ADCU_APS_01_SigGroup_1
      data SG_ADCU_APS_01_SigGroup: type=SG_ADCU_APS_01_SigGroup
    SG_BCM_05_SigGroup_1
      data SG_BCM_05_SigGroup: type=SG_BCM_05_SigGroup
    SG_BCM_06_SigGroup_1
      data SG_BCM_06_SigGroup: type=SG_BCM_06_SigGroup
    SG_ADCU_AEB_01_SigGroup_2
      data SG_ADCU_AEB_01_SigGroup: type=SG_ADCU_AEB_01_SigGroup
    SG_BMS_CellTemp_SigGroup_1
      data SG_BMS_CellTemp_SigGroup: type=SG_BMS_CellTemp_SigGroup
    SG_BMS_CellVoltage_SigGroup_1
      data SG_BMS_CellVoltage_SigGroup: type=SG_BMS_CellVoltage_SigGroup
    SG_BMS_status_01_SigGroup_1
      data SG_BMS_status_01_SigGroup: type=SG_BMS_status_01_SigGroup
    SG_BMS_status_04_SigGroup_1
      data SG_BMS_status_04_SigGroup: type=SG_BMS_status_04_SigGroup
    SG_DCM_FL_02_SigGroup_1
      data SG_DCM_FL_02_SigGroup: type=SG_DCM_FL_02_SigGroup
    SG_IBS_ACC_SigGroup_1
      data SG_IBS_ACC_SigGroup: type=SG_IBS_ACC_SigGroup
    SG_IBS_APS_SigGroup_1
      data SG_IBS_APS_SigGroup: type=SG_IBS_APS_SigGroup
    SG_IBS_Status_01_SigGroup_1
      data SG_IBS_Status_01_SigGroup: type=SG_IBS_Status_01_SigGroup
    SG_IBS_Status_02_SigGroup_1
      data SG_IBS_Status_02_SigGroup: type=SG_IBS_Status_02_SigGroup
    SG_IBS_Status_03_SigGroup_1
      data SG_IBS_Status_03_SigGroup: type=SG_IBS_Status_03_SigGroup
    SG_IBS_Status_04_SigGroup_1
      data SG_IBS_Status_04_SigGroup: type=SG_IBS_Status_04_SigGroup
    SG_IBS_Status_05_SigGroup_1
      data SG_IBS_Status_05_SigGroup: type=SG_IBS_Status_05_SigGroup
    SG_IBS_Status_06_SigGroup_1
      data SG_IBS_Status_06_SigGroup: type=SG_IBS_Status_06_SigGroup
    SG_IBS_WheelSpeed_01_SigGroup_1
      data SG_IBS_WheelSpeed_01_SigGroup: type=SG_IBS_WheelSpeed_01_SigGroup
    SG_IBS_WheelSpeed_02_SigGroup_1
      data SG_IBS_WheelSpeed_02_SigGroup: type=SG_IBS_WheelSpeed_02_SigGroup
    SG_SGW_01_SigGroup_1
      data SG_SGW_01_SigGroup: type=SG_SGW_01_SigGroup
    SG_BMS_status_04_SigGroup_2
      data SG_BMS_status_04_SigGroup: type=SG_BMS_status_04_SigGroup
    SG_IBS_ACC_SigGroup_2
      data SG_IBS_ACC_SigGroup: type=SG_IBS_ACC_SigGroup
    SG_IBS_Status_01_SigGroup_2
      data SG_IBS_Status_01_SigGroup: type=SG_IBS_Status_01_SigGroup
    SG_IBS_ACC_SigGroup_3
      data SG_IBS_ACC_SigGroup: type=SG_IBS_ACC_SigGroup
    BS_IBSBatSOC_LIN
      data BS_IBSBatSOC_LIN: type=BS_IBSBatSOC_LIN
    VCU_SOCWU_Ena_LIN00
      data VCU_SOCWU_Ena_LIN: type=VCU_SOCWU_Ena_LIN
    VCU_ChargeCurrWU_Treshold_LIN00
      data VCU_ChargeCurrWU_Treshold_LIN: type=VCU_ChargeCurrWU_Treshold_LIN
    VCU_BS_IndicatorLightSts_LIN00
      data VCU_BS_IndicatorLightSts_LIN: type=VCU_BS_IndicatorLightSts_LIN
    VCU_wakeup_cycle_LIN00
      data VCU_wakeup_cycle_LIN: type=VCU_wakeup_cycle_LIN
    VCU_IBS_EBDFault_LIN00
      data VCU_IBS_EBDFault_LIN: type=VCU_IBS_EBDFault_LIN
    VCU_SOCWU_Treshold_LIN00
      data VCU_SOCWU_Treshold_LIN: type=VCU_SOCWU_Treshold_LIN
    VCU_IBS_RollerbenchMode_LIN00
      data VCU_IBS_RollerbenchMode_LIN: type=VCU_IBS_RollerbenchMode_LIN
    VCU_BCM_FLSeatBeltRemindReq_LIN00
      data VCU_BCM_FLSeatBeltRemindReq_LIN: type=VCU_BCM_FLSeatBeltRemindReq_LIN
    VCU_DCM_RR_DoorRRSts_LIN00
      data VCU_DCM_RR_DoorRRSts_LIN: type=VCU_DCM_RR_DoorRRSts_LIN
    VCU_DCM_FL_DoorFLSts_LIN00
      data VCU_DCM_FL_DoorFLSts_LIN: type=VCU_DCM_FL_DoorFLSts_LIN
    VCU_BCM_RLSeatBeltRemindReq_LIN00
      data VCU_BCM_RLSeatBeltRemindReq_LIN: type=VCU_BCM_RLSeatBeltRemindReq_LIN
    VCU_Batt_U0_Max_LIN00
      data VCU_Batt_U0_Max_LIN: type=VCU_Batt_U0_Max_LIN
    VCU_BattNomC20_LIN00
      data VCU_BattNomC20_LIN: type=VCU_BattNomC20_LIN
    VCU_ACU_DriverWarningLampSts_LIN00
      data VCU_ACU_DriverWarningLampSts_LIN: type=VCU_ACU_DriverWarningLampSts_LIN
    VCU_ACU_PassengerWarningLampSts_LIN00
      data VCU_ACU_PassengerWarningLampSts_LIN: type=VCU_ACU_PassengerWarningLampSts_LIN
    VCU_ACU_PassengerAirbagSts_LIN00
      data VCU_ACU_PassengerAirbagSts_LIN: type=VCU_ACU_PassengerAirbagSts_LIN
    VCU_DCDCFail_LIN_LIN00
      data VCU_DCDCFail_LIN_LIN: type=VCU_DCDCFail_LIN_LIN
    VCU_ChargeCurrWU_Ena_LIN00
      data VCU_ChargeCurrWU_Ena_LIN: type=VCU_ChargeCurrWU_Ena_LIN
    VCU_DisChargeCurrWU_Treshold_LIN00
      data VCU_DisChargeCurrWU_Treshold_LIN: type=VCU_DisChargeCurrWU_Treshold_LIN
    VCU_Batt_U0_Min_LIN00
      data VCU_Batt_U0_Min_LIN: type=VCU_Batt_U0_Min_LIN
    VCU_DisChargeCurrWU_Ena_LIN00
      data VCU_DisChargeCurrWU_Ena_LIN: type=VCU_DisChargeCurrWU_Ena_LIN
    VCU_HVBatCriFail_LIN_LIN00
      data VCU_HVBatCriFail_LIN_LIN: type=VCU_HVBatCriFail_LIN_LIN
    VCU_IBSClrDiagInf_LIN00
      data VCU_IBSClrDiagInf_LIN: type=VCU_IBSClrDiagInf_LIN
    VCU_DCM_FR_DoorFRSts_LIN00
      data VCU_DCM_FR_DoorFRSts_LIN: type=VCU_DCM_FR_DoorFRSts_LIN
    VCU_BCM_FRSeatBeltRemindReq_LIN00
      data VCU_BCM_FRSeatBeltRemindReq_LIN: type=VCU_BCM_FRSeatBeltRemindReq_LIN
    VCU_BattType_LIN00
      data VCU_BattType_LIN: type=VCU_BattType_LIN
    VCU_HVBatOvrTemp_LIN_LIN00
      data VCU_HVBatOvrTemp_LIN_LIN: type=VCU_HVBatOvrTemp_LIN_LIN
    VCU_DCM_RL_DoorRLSts_LIN00
      data VCU_DCM_RL_DoorRLSts_LIN: type=VCU_DCM_RL_DoorRLSts_LIN
    VCU_IBS_BrakeFluidWarning_LIN00
      data VCU_IBS_BrakeFluidWarning_LIN: type=VCU_IBS_BrakeFluidWarning_LIN
    VCU_CGW_VehicleState_LIN00
      data VCU_CGW_VehicleState_LIN: type=VCU_CGW_VehicleState_LIN
    VCU_IBS_SystemStatus_LIN00
      data VCU_IBS_SystemStatus_LIN: type=VCU_IBS_SystemStatus_LIN
    VCU_HstTempDataRqTrg_LIN00
      data VCU_HstTempDataRqTrg_LIN: type=VCU_HstTempDataRqTrg_LIN
    VCU_BCM_RRSeatBeltRemindReq_LIN00
      data VCU_BCM_RRSeatBeltRemindReq_LIN: type=VCU_BCM_RRSeatBeltRemindReq_LIN
    VCU_IVI_VrState_LIN00
      data VCU_IVI_VrState_LIN: type=VCU_IVI_VrState_LIN
    VCU_ACU_WarningLampSts_LIN00
      data VCU_ACU_WarningLampSts_LIN: type=VCU_ACU_WarningLampSts_LIN
    VCU_DriveMotOvrTemp_LIN_LIN00
      data VCU_DriveMotOvrTemp_LIN_LIN: type=VCU_DriveMotOvrTemp_LIN_LIN
    IF_SecOC_BCM_Immo_State_YDF
      data BCM_Immo_State_YDF: type=boolean
    IF_SecOC_BCM_Authentication_YDF
      data BCM_Authentication_YDF: type=BCM_Authentication_YDF
    IF_ComM_IBSPlgrPrs_mm
      data tec_ComM_IBSPlgrPrs_mm: type=float32
    BS_BattSOH_LIN
      data BS_BattSOH_LIN: type=BS_BattSOH_LIN
    IF_VehMot_VehTirRdInfo
      data tec_VehMot_VehTirRdInfo: type=float32
    IF_TorqPahMgmt_TqLmtFltLampRq
      data tec_TorqPahMgmt_TqLmtFltLampRq: type=boolean
    IF_ComM_IVIBuldChkStsInfo
      data tec_ComM_IVIBuldChkStsInfo: type=boolean
    IF_ComM_BSHCrnt
      data tec_ComM_BSHCrnt: type=float32
    IF_ComM_BSQuiescentCurrent
      data tec_ComM_BSQuiescentCurrent: type=float32
    VCU_IVI_BulbCheckStsLIN01
      data VCU_IVI_BulbCheckStsLIN01: type=VCU_IVI_BulbCheckStsLIN01
    Resp_Error_LIN01
      data Resp_Error_LIN01: type=Resp_Error_LIN01
    IF_ComM_BSBattIDcInfo
      data tec_ComM_BSBattIDcInfo: type=float32
    IF_ComM_BSBattTempInfo
      data tec_ComM_BSBattTempInfo: type=float32
    SOH_LIN01
      data SOH_LIN01: type=SOH_LIN01
    I_BATT_LIN01
      data I_BATT_LIN01: type=I_BATT_LIN01
    U_BATT_LIN01
      data U_BATT_LIN01: type=U_BATT_LIN01
    IBATT_QUIESCENT_LIN01
      data IBATT_QUIESCENT_LIN01: type=IBATT_QUIESCENT_LIN01
    I_RANGE_LIN01
      data I_RANGE_LIN01: type=I_RANGE_LIN01
    SOC_LIN01
      data SOC_LIN01: type=SOC_LIN01
    T_BATT_LIN01
      data T_BATT_LIN01: type=T_BATT_LIN01
    ChargeCurrWU_Ena_LIN01
      data ChargeCurrWU_Ena_LIN01: type=ChargeCurrWU_Ena_LIN01
    SOCWU_Ena_LIN01
      data SOCWU_Ena_LIN01: type=SOCWU_Ena_LIN01
    DisChargeCurrWU_Treshold_LIN01
      data DisChargeCurrWU_Treshold_LIN01: type=DisChargeCurrWU_Treshold_LIN01
    SOCWU_Treshold_LIN01
      data SOCWU_Treshold_LIN01: type=SOCWU_Treshold_LIN01
    DisChargeCurrWU_Ena_LIN01
      data DisChargeCurrWU_Ena_LIN01: type=DisChargeCurrWU_Ena_LIN01
    ChargeCurrWU_Treshold_LIN01
      data ChargeCurrWU_Treshold_LIN01: type=ChargeCurrWU_Treshold_LIN01
    IF_Ecu_SelfWakeStatus_SelfWake
      data tec_Ecu_SelfWakeStatus_SelfWake: type=boolean
    IF_ComM_BS01_IsUpdated
      data tec_ComM_BS01_IsUpdated: type=boolean
    SOF_V2_LIN01
      data SOF_V2_LIN01: type=SOF_V2_LIN01
    SOF_V1_LIN01
      data SOF_V1_LIN01: type=SOF_V1_LIN01
    IF_ComM_BSSOFV1Info
      data tec_ComM_BSSOFV1Info: type=float32
    IF_ComM_BSSOFV2Info
      data tec_ComM_BSSOFV2Info: type=float32
    SG_IVI_03_SigGroup
      data SG_IVI_03_SigGroup: type=SG_IVI_03_SigGroup
    SG_VCU_HMIsignals_03_SigGroup_1
      data SG_VCU_HMIsignals_03_SigGroup: type=SG_VCU_HMIsignals_03_SigGroup
    BST_AbortChargparameter
      data BST_AbortChargparameter: type=BST_AbortChargparameter
    IF_ComM_DCMFRAmbTempInfo
      data tec_ComM_DCMFRAmbTempInfo: type=float32
  nv data interface IF_RngEstimnFormual2
    nv-datas:
      data tec_RngEstimnFormual2: type=dt_RngEstimn_BattCurrIntegral2kmArrayInfo
  4 x sender receiver interface:
    IF_ComM_WarnLampStsInfo
      data tec_ComM_WarnLampStsInfo: type=uint8
    IF_ComM_EPSSteerGearAgVld
      data tec_ComM_EPSSteerGearAgVld: type=boolean
    IF_ComM_EPSSteerGearAg
      data tec_ComM_EPSSteerGearAg: type=float32
    SG_EPS_CONV_SigGroup
      data SG_EPS_CONV_SigGroup: type=SG_EPS_CONV_SigGroup
package /SwAddrMethods
  sw addr method VAR
  sw addr method CAL
