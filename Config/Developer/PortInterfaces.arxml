[part 1 of 2: packages /Predefined_DEV/PortInterfaces to /PortInterfaces]
AUTOSAR XML (schema 00046)
package /Predefined_DEV/PortInterfaces
  43 x client server interface:
    NvMAdministration: is-service=true
      operation SetBlockProtection: possible-error=NvMAdministration/E_NOT_OK
        arg ProtectionEnabled: type=boolean, direction=IN, server-argument-impl-policy=USE-ARGUMENT-TYPE
      error E_NOT_OK: error-code=1
    NvMNotifyInitBlock: is-service=true
      operation InitBlock
    NvMNotifyJobFinished: is-service=true
      operation JobFinished
        arg ServiceId: type=NvM_ServiceIdType, direction=IN, server-argument-impl-policy=USE-ARGUMENT-TYPE
        arg JobResult: type=NvM_RequestResultType, direction=IN, server-argument-impl-policy=USE-ARGUMENT-TYPE
    NvMService: is-service=true
      operation GetErrorStatus: possible-error=NvMService/E_NOT_OK
        arg ErrorStatus: type=NvM_RequestResultType, direction=OUT, server-argument-impl-policy=USE-ARGUMENT-TYPE
      error E_NOT_OK: error-code=1
    NvMService_AC2: is-service=true
      operation GetErrorStatus: possible-error=NvMService_AC2/E_NOT_OK
        arg ErrorStatus: type=NvM_RequestResultType, direction=OUT, server-argument-impl-policy=USE-ARGUMENT-TYPE
      operation ReadBlock: possible-error=NvMService_AC2/E_NOT_OK
        arg DstPtr: type=dtRef_VOID, direction=IN, server-argument-impl-policy=USE-ARGUMENT-TYPE
      operation WriteBlock: possible-error=NvMService_AC2/E_NOT_OK
        arg SrcPtr: type=dtRef_const_VOID, direction=IN, server-argument-impl-policy=USE-ARGUMENT-TYPE
      error E_NOT_OK: error-code=1
    NvMService_AC2_Defs: is-service=true
      4 x operation, all with possible-error=NvMService_AC2_Defs/E_NOT_OK:
        GetErrorStatus
          arg ErrorStatus: type=NvM_RequestResultType, direction=OUT, server-argument-impl-policy=USE-ARGUMENT-TYPE
        ReadBlock
          arg DstPtr: type=dtRef_VOID, direction=IN, server-argument-impl-policy=USE-ARGUMENT-TYPE
        RestoreBlockDefaults
          arg DstPtr: type=dtRef_VOID, direction=IN, server-argument-impl-policy=USE-ARGUMENT-TYPE
        WriteBlock
          arg SrcPtr: type=dtRef_const_VOID, direction=IN, server-argument-impl-policy=USE-ARGUMENT-TYPE
      error E_NOT_OK: error-code=1
    NvMService_AC2_DS: is-service=true
      5 x operation, all with possible-error=NvMService_AC2_DS/E_NOT_OK:
        GetDataIndex
          arg DataIndex: type=uint8, direction=OUT, server-argument-impl-policy=USE-ARGUMENT-TYPE
        GetErrorStatus
          arg ErrorStatus: type=NvM_RequestResultType, direction=OUT, server-argument-impl-policy=USE-ARGUMENT-TYPE
        ReadBlock
          arg DstPtr: type=dtRef_VOID, direction=IN, server-argument-impl-policy=USE-ARGUMENT-TYPE
        SetDataIndex
          arg DataIndex: type=uint8, direction=IN, server-argument-impl-policy=USE-ARGUMENT-TYPE
        WriteBlock
          arg SrcPtr: type=dtRef_const_VOID, direction=IN, server-argument-impl-policy=USE-ARGUMENT-TYPE
      error E_NOT_OK: error-code=1
    NvMService_AC2_DS_Defs: is-service=true
      6 x operation, all with possible-error=NvMService_AC2_DS_Defs/E_NOT_OK:
        GetDataIndex
          arg DataIndex: type=uint8, direction=OUT, server-argument-impl-policy=USE-ARGUMENT-TYPE
        GetErrorStatus
          arg ErrorStatus: type=NvM_RequestResultType, direction=OUT, server-argument-impl-policy=USE-ARGUMENT-TYPE
        ReadBlock
          arg DstPtr: type=dtRef_VOID, direction=IN, server-argument-impl-policy=USE-ARGUMENT-TYPE
        RestoreBlockDefaults
          arg DstPtr: type=dtRef_VOID, direction=IN, server-argument-impl-policy=USE-ARGUMENT-TYPE
        SetDataIndex
          arg DataIndex: type=uint8, direction=IN, server-argument-impl-policy=USE-ARGUMENT-TYPE
        WriteBlock
          arg SrcPtr: type=dtRef_const_VOID, direction=IN, server-argument-impl-policy=USE-ARGUMENT-TYPE
      error E_NOT_OK: error-code=1
    NvMService_AC2_SRBS: is-service=true
      4 x operation, all with possible-error=NvMService_AC2_SRBS/E_NOT_OK:
        GetErrorStatus
          arg ErrorStatus: type=NvM_RequestResultType, direction=OUT, server-argument-impl-policy=USE-ARGUMENT-TYPE
        ReadBlock
          arg DstPtr: type=dtRef_VOID, direction=IN, server-argument-impl-policy=USE-ARGUMENT-TYPE
        SetRamBlockStatus
          arg RamBlockStatus: type=boolean, direction=IN, server-argument-impl-policy=USE-ARGUMENT-TYPE
        WriteBlock
          arg SrcPtr: type=dtRef_const_VOID, direction=IN, server-argument-impl-policy=USE-ARGUMENT-TYPE
      error E_NOT_OK: error-code=1
    NvMService_AC2_SRBS_Defs: is-service=true
      5 x operation, all with possible-error=NvMService_AC2_SRBS_Defs/E_NOT_OK:
        GetErrorStatus
          arg ErrorStatus: type=NvM_RequestResultType, direction=OUT, server-argument-impl-policy=USE-ARGUMENT-TYPE
        ReadBlock
          arg DstPtr: type=dtRef_VOID, direction=IN, server-argument-impl-policy=USE-ARGUMENT-TYPE
        RestoreBlockDefaults
          arg DstPtr: type=dtRef_VOID, direction=IN, server-argument-impl-policy=USE-ARGUMENT-TYPE
        SetRamBlockStatus
          arg RamBlockStatus: type=boolean, direction=IN, server-argument-impl-policy=USE-ARGUMENT-TYPE
        WriteBlock
          arg SrcPtr: type=dtRef_const_VOID, direction=IN, server-argument-impl-policy=USE-ARGUMENT-TYPE
      error E_NOT_OK: error-code=1
    NvMService_AC2_SRBS_DS: is-service=true
      6 x operation, all with possible-error=NvMService_AC2_SRBS_DS/E_NOT_OK:
        GetDataIndex
          arg DataIndex: type=uint8, direction=OUT, server-argument-impl-policy=USE-ARGUMENT-TYPE
        GetErrorStatus
          arg ErrorStatus: type=NvM_RequestResultType, direction=OUT, server-argument-impl-policy=USE-ARGUMENT-TYPE
        ReadBlock
          arg DstPtr: type=dtRef_VOID, direction=IN, server-argument-impl-policy=USE-ARGUMENT-TYPE
        SetDataIndex
          arg DataIndex: type=uint8, direction=IN, server-argument-impl-policy=USE-ARGUMENT-TYPE
        SetRamBlockStatus
          arg RamBlockStatus: type=boolean, direction=IN, server-argument-impl-policy=USE-ARGUMENT-TYPE
        WriteBlock
          arg SrcPtr: type=dtRef_const_VOID, direction=IN, server-argument-impl-policy=USE-ARGUMENT-TYPE
      error E_NOT_OK: error-code=1
    NvMService_AC2_SRBS_DS_Defs: is-service=true
      7 x operation, all with possible-error=NvMService_AC2_SRBS_DS_Defs/E_NOT_OK:
        GetDataIndex
          arg DataIndex: type=uint8, direction=OUT, server-argument-impl-policy=USE-ARGUMENT-TYPE
        GetErrorStatus
          arg ErrorStatus: type=NvM_RequestResultType, direction=OUT, server-argument-impl-policy=USE-ARGUMENT-TYPE
        ReadBlock
          arg DstPtr: type=dtRef_VOID, direction=IN, server-argument-impl-policy=USE-ARGUMENT-TYPE
        RestoreBlockDefaults
          arg DstPtr: type=dtRef_VOID, direction=IN, server-argument-impl-policy=USE-ARGUMENT-TYPE
        SetDataIndex
          arg DataIndex: type=uint8, direction=IN, server-argument-impl-policy=USE-ARGUMENT-TYPE
        SetRamBlockStatus
          arg RamBlockStatus: type=boolean, direction=IN, server-argument-impl-policy=USE-ARGUMENT-TYPE
        WriteBlock
          arg SrcPtr: type=dtRef_const_VOID, direction=IN, server-argument-impl-policy=USE-ARGUMENT-TYPE
      error E_NOT_OK: error-code=1
    NvMService_AC3: is-service=true
      5 x operation, all with possible-error=NvMService_AC3/E_NOT_OK:
        EraseBlock
        GetErrorStatus
          arg ErrorStatus: type=NvM_RequestResultType, direction=OUT, server-argument-impl-policy=USE-ARGUMENT-TYPE
        InvalidateNvBlock
        ReadBlock
          arg DstPtr: type=dtRef_VOID, direction=IN, server-argument-impl-policy=USE-ARGUMENT-TYPE
        WriteBlock
          arg SrcPtr: type=dtRef_const_VOID, direction=IN, server-argument-impl-policy=USE-ARGUMENT-TYPE
      error E_NOT_OK: error-code=1
    NvMService_AC3_Defs: is-service=true
      6 x operation, all with possible-error=NvMService_AC3_Defs/E_NOT_OK:
        EraseBlock
        GetErrorStatus
          arg ErrorStatus: type=NvM_RequestResultType, direction=OUT, server-argument-impl-policy=USE-ARGUMENT-TYPE
        InvalidateNvBlock
        ReadBlock
          arg DstPtr: type=dtRef_VOID, direction=IN, server-argument-impl-policy=USE-ARGUMENT-TYPE
        RestoreBlockDefaults
          arg DstPtr: type=dtRef_VOID, direction=IN, server-argument-impl-policy=USE-ARGUMENT-TYPE
        WriteBlock
          arg SrcPtr: type=dtRef_const_VOID, direction=IN, server-argument-impl-policy=USE-ARGUMENT-TYPE
      error E_NOT_OK: error-code=1
    NvMService_AC3_DS: is-service=true
      7 x operation, all with possible-error=NvMService_AC3_DS/E_NOT_OK:
        EraseBlock
        GetDataIndex
          arg DataIndex: type=uint8, direction=OUT, server-argument-impl-policy=USE-ARGUMENT-TYPE
        GetErrorStatus
          arg ErrorStatus: type=NvM_RequestResultType, direction=OUT, server-argument-impl-policy=USE-ARGUMENT-TYPE
        InvalidateNvBlock
        ReadBlock
          arg DstPtr: type=dtRef_VOID, direction=IN, server-argument-impl-policy=USE-ARGUMENT-TYPE
        SetDataIndex
          arg DataIndex: type=uint8, direction=IN, server-argument-impl-policy=USE-ARGUMENT-TYPE
        WriteBlock
          arg SrcPtr: type=dtRef_const_VOID, direction=IN, server-argument-impl-policy=USE-ARGUMENT-TYPE
      error E_NOT_OK: error-code=1
    NvMService_AC3_DS_Defs: is-service=true
      8 x operation, all with possible-error=NvMService_AC3_DS_Defs/E_NOT_OK:
        EraseBlock
        GetDataIndex
          arg DataIndex: type=uint8, direction=OUT, server-argument-impl-policy=USE-ARGUMENT-TYPE
        GetErrorStatus
          arg ErrorStatus: type=NvM_RequestResultType, direction=OUT, server-argument-impl-policy=USE-ARGUMENT-TYPE
        InvalidateNvBlock
        ReadBlock
          arg DstPtr: type=dtRef_VOID, direction=IN, server-argument-impl-policy=USE-ARGUMENT-TYPE
        RestoreBlockDefaults
          arg DstPtr: type=dtRef_VOID, direction=IN, server-argument-impl-policy=USE-ARGUMENT-TYPE
        SetDataIndex
          arg DataIndex: type=uint8, direction=IN, server-argument-impl-policy=USE-ARGUMENT-TYPE
        WriteBlock
          arg SrcPtr: type=dtRef_const_VOID, direction=IN, server-argument-impl-policy=USE-ARGUMENT-TYPE
      error E_NOT_OK: error-code=1
    NvMService_AC3_SRBS: is-service=true
      6 x operation, all with possible-error=NvMService_AC3_SRBS/E_NOT_OK:
        EraseBlock
        GetErrorStatus
          arg ErrorStatus: type=NvM_RequestResultType, direction=OUT, server-argument-impl-policy=USE-ARGUMENT-TYPE
        InvalidateNvBlock
        ReadBlock
          arg DstPtr: type=dtRef_VOID, direction=IN, server-argument-impl-policy=USE-ARGUMENT-TYPE
        SetRamBlockStatus
          arg RamBlockStatus: type=boolean, direction=IN, server-argument-impl-policy=USE-ARGUMENT-TYPE
        WriteBlock
          arg SrcPtr: type=dtRef_const_VOID, direction=IN, server-argument-impl-policy=USE-ARGUMENT-TYPE
      error E_NOT_OK: error-code=1
    NvMService_AC3_SRBS_Defs: is-service=true
      7 x operation, all with possible-error=NvMService_AC3_SRBS_Defs/E_NOT_OK:
        EraseBlock
        GetErrorStatus
          arg ErrorStatus: type=NvM_RequestResultType, direction=OUT, server-argument-impl-policy=USE-ARGUMENT-TYPE
        InvalidateNvBlock
        ReadBlock
          arg DstPtr: type=dtRef_VOID, direction=IN, server-argument-impl-policy=USE-ARGUMENT-TYPE
        RestoreBlockDefaults
          arg DstPtr: type=dtRef_VOID, direction=IN, server-argument-impl-policy=USE-ARGUMENT-TYPE
        SetRamBlockStatus
          arg RamBlockStatus: type=boolean, direction=IN, server-argument-impl-policy=USE-ARGUMENT-TYPE
        WriteBlock
          arg SrcPtr: type=dtRef_const_VOID, direction=IN, server-argument-impl-policy=USE-ARGUMENT-TYPE
      error E_NOT_OK: error-code=1
    NvMService_AC3_SRBS_DS: is-service=true
      8 x operation, all with possible-error=NvMService_AC3_SRBS_DS/E_NOT_OK:
        EraseBlock
        GetDataIndex
          arg DataIndex: type=uint8, direction=OUT, server-argument-impl-policy=USE-ARGUMENT-TYPE
        GetErrorStatus
          arg ErrorStatus: type=NvM_RequestResultType, direction=OUT, server-argument-impl-policy=USE-ARGUMENT-TYPE
        InvalidateNvBlock
        ReadBlock
          arg DstPtr: type=dtRef_VOID, direction=IN, server-argument-impl-policy=USE-ARGUMENT-TYPE
        SetDataIndex
          arg DataIndex: type=uint8, direction=IN, server-argument-impl-policy=USE-ARGUMENT-TYPE
        SetRamBlockStatus
          arg RamBlockStatus: type=boolean, direction=IN, server-argument-impl-policy=USE-ARGUMENT-TYPE
        WriteBlock
          arg SrcPtr: type=dtRef_const_VOID, direction=IN, server-argument-impl-policy=USE-ARGUMENT-TYPE
      error E_NOT_OK: error-code=1
    NvMService_AC3_SRBS_DS_Defs: is-service=true
      9 x operation, all with possible-error=NvMService_AC3_SRBS_DS_Defs/E_NOT_OK:
        EraseBlock
        GetDataIndex
          arg DataIndex: type=uint8, direction=OUT, server-argument-impl-policy=USE-ARGUMENT-TYPE
        GetErrorStatus
          arg ErrorStatus: type=NvM_RequestResultType, direction=OUT, server-argument-impl-policy=USE-ARGUMENT-TYPE
        InvalidateNvBlock
        ReadBlock
          arg DstPtr: type=dtRef_VOID, direction=IN, server-argument-impl-policy=USE-ARGUMENT-TYPE
        RestoreBlockDefaults
          arg DstPtr: type=dtRef_VOID, direction=IN, server-argument-impl-policy=USE-ARGUMENT-TYPE
        SetDataIndex
          arg DataIndex: type=uint8, direction=IN, server-argument-impl-policy=USE-ARGUMENT-TYPE
        SetRamBlockStatus
          arg RamBlockStatus: type=boolean, direction=IN, server-argument-impl-policy=USE-ARGUMENT-TYPE
        WriteBlock
          arg SrcPtr: type=dtRef_const_VOID, direction=IN, server-argument-impl-policy=USE-ARGUMENT-TYPE
      error E_NOT_OK: error-code=1
    NvMService_SRBS: is-service=true
      operation GetErrorStatus: possible-error=NvMService_SRBS/E_NOT_OK
        arg ErrorStatus: type=NvM_RequestResultType, direction=OUT, server-argument-impl-policy=USE-ARGUMENT-TYPE
      operation SetRamBlockStatus: possible-error=NvMService_SRBS/E_NOT_OK
        arg RamBlockStatus: type=boolean, direction=IN, server-argument-impl-policy=USE-ARGUMENT-TYPE
      error E_NOT_OK: error-code=1
    CallbackDTCStatusChange: is-service=true, service-kind=DIAGNOSTIC-EVENT-MANAGER
      operation DTCStatusChanged: possible-error=CallbackDTCStatusChange/E_NOT_OK
        arg DTC: type=uint32, direction=IN, server-argument-impl-policy=USE-ARGUMENT-TYPE
        arg DTCStatusOld: type=Dem_UdsStatusByteType, direction=IN, server-argument-impl-policy=USE-ARGUMENT-TYPE
        arg DTCStatusNew: type=Dem_UdsStatusByteType, direction=IN, server-argument-impl-policy=USE-ARGUMENT-TYPE
      error E_NOT_OK: error-code=1
    NvSWC_NvMAdministration
      operation SetBlockProtection: possible-error=NvSWC_NvMAdministration/E_NOT_OK
        arg ProtectionEnabled: type=boolean, direction=IN, server-argument-impl-policy=USE-ARGUMENT-TYPE
      error E_NOT_OK: error-code=1
    NvSWC_NvMNotifyInitBlock
      operation InitBlock
    NvSWC_NvMNotifyJobFinished
      operation JobFinished
        arg ServiceId: type=NvM_ServiceIdType, direction=IN, server-argument-impl-policy=USE-ARGUMENT-TYPE
        arg JobResult: type=NvM_RequestResultType, direction=IN, server-argument-impl-policy=USE-ARGUMENT-TYPE
    NvSWC_NvMService
      operation GetErrorStatus: possible-error=NvSWC_NvMService/E_NOT_OK
        arg ErrorStatus: type=NvM_RequestResultType, direction=OUT, server-argument-impl-policy=USE-ARGUMENT-TYPE
      error E_NOT_OK: error-code=1
    NvSWC_NvMService_AC2
      operation GetErrorStatus: possible-error=NvSWC_NvMService_AC2/E_NOT_OK
        arg ErrorStatus: type=NvM_RequestResultType, direction=OUT, server-argument-impl-policy=USE-ARGUMENT-TYPE
      operation ReadBlock: possible-error=NvSWC_NvMService_AC2/E_NOT_OK
        arg DstPtr: type=dtRef_VOID, direction=IN, server-argument-impl-policy=USE-ARGUMENT-TYPE
      operation WriteBlock: possible-error=NvSWC_NvMService_AC2/E_NOT_OK
        arg SrcPtr: type=dtRef_const_VOID, direction=IN, server-argument-impl-policy=USE-ARGUMENT-TYPE
      error E_NOT_OK: error-code=1
    NvSWC_NvMService_AC2_Defs
      4 x operation, all with possible-error=NvSWC_NvMService_AC2_Defs/E_NOT_OK:
        GetErrorStatus
          arg ErrorStatus: type=NvM_RequestResultType, direction=OUT, server-argument-impl-policy=USE-ARGUMENT-TYPE
        ReadBlock
          arg DstPtr: type=dtRef_VOID, direction=IN, server-argument-impl-policy=USE-ARGUMENT-TYPE
        RestoreBlockDefaults
          arg DstPtr: type=dtRef_VOID, direction=IN, server-argument-impl-policy=USE-ARGUMENT-TYPE
        WriteBlock
          arg SrcPtr: type=dtRef_const_VOID, direction=IN, server-argument-impl-policy=USE-ARGUMENT-TYPE
      error E_NOT_OK: error-code=1
    NvSWC_NvMService_AC2_DS
      5 x operation, all with possible-error=NvSWC_NvMService_AC2_DS/E_NOT_OK:
        GetDataIndex
          arg DataIndex: type=uint8, direction=OUT, server-argument-impl-policy=USE-ARGUMENT-TYPE
        GetErrorStatus
          arg ErrorStatus: type=NvM_RequestResultType, direction=OUT, server-argument-impl-policy=USE-ARGUMENT-TYPE
        ReadBlock
          arg DstPtr: type=dtRef_VOID, direction=IN, server-argument-impl-policy=USE-ARGUMENT-TYPE
        SetDataIndex
          arg DataIndex: type=uint8, direction=IN, server-argument-impl-policy=USE-ARGUMENT-TYPE
        WriteBlock
          arg SrcPtr: type=dtRef_const_VOID, direction=IN, server-argument-impl-policy=USE-ARGUMENT-TYPE
      error E_NOT_OK: error-code=1
    NvSWC_NvMService_AC2_DS_Defs
      6 x operation, all with possible-error=NvSWC_NvMService_AC2_DS_Defs/E_NOT_OK:
        GetDataIndex
          arg DataIndex: type=uint8, direction=OUT, server-argument-impl-policy=USE-ARGUMENT-TYPE
        GetErrorStatus
          arg ErrorStatus: type=NvM_RequestResultType, direction=OUT, server-argument-impl-policy=USE-ARGUMENT-TYPE
        ReadBlock
          arg DstPtr: type=dtRef_VOID, direction=IN, server-argument-impl-policy=USE-ARGUMENT-TYPE
        RestoreBlockDefaults
          arg DstPtr: type=dtRef_VOID, direction=IN, server-argument-impl-policy=USE-ARGUMENT-TYPE
        SetDataIndex
          arg DataIndex: type=uint8, direction=IN, server-argument-impl-policy=USE-ARGUMENT-TYPE
        WriteBlock
          arg SrcPtr: type=dtRef_const_VOID, direction=IN, server-argument-impl-policy=USE-ARGUMENT-TYPE
      error E_NOT_OK: error-code=1
    NvSWC_NvMService_AC2_SRBS
      4 x operation, all with possible-error=NvSWC_NvMService_AC2_SRBS/E_NOT_OK:
        GetErrorStatus
          arg ErrorStatus: type=NvM_RequestResultType, direction=OUT, server-argument-impl-policy=USE-ARGUMENT-TYPE
        ReadBlock
          arg DstPtr: type=dtRef_VOID, direction=IN, server-argument-impl-policy=USE-ARGUMENT-TYPE
        SetRamBlockStatus
          arg RamBlockStatus: type=boolean, direction=IN, server-argument-impl-policy=USE-ARGUMENT-TYPE
        WriteBlock
          arg SrcPtr: type=dtRef_const_VOID, direction=IN, server-argument-impl-policy=USE-ARGUMENT-TYPE
      error E_NOT_OK: error-code=1
    NvSWC_NvMService_AC2_SRBS_Defs
      5 x operation, all with possible-error=NvSWC_NvMService_AC2_SRBS_Defs/E_NOT_OK:
        GetErrorStatus
          arg ErrorStatus: type=NvM_RequestResultType, direction=OUT, server-argument-impl-policy=USE-ARGUMENT-TYPE
        ReadBlock
          arg DstPtr: type=dtRef_VOID, direction=IN, server-argument-impl-policy=USE-ARGUMENT-TYPE
        RestoreBlockDefaults
          arg DstPtr: type=dtRef_VOID, direction=IN, server-argument-impl-policy=USE-ARGUMENT-TYPE
        SetRamBlockStatus
          arg RamBlockStatus: type=boolean, direction=IN, server-argument-impl-policy=USE-ARGUMENT-TYPE
        WriteBlock
          arg SrcPtr: type=dtRef_const_VOID, direction=IN, server-argument-impl-policy=USE-ARGUMENT-TYPE
      error E_NOT_OK: error-code=1
    NvSWC_NvMService_AC2_SRBS_DS
      6 x operation, all with possible-error=NvSWC_NvMService_AC2_SRBS_DS/E_NOT_OK:
        GetDataIndex
          arg DataIndex: type=uint8, direction=OUT, server-argument-impl-policy=USE-ARGUMENT-TYPE
        GetErrorStatus
          arg ErrorStatus: type=NvM_RequestResultType, direction=OUT, server-argument-impl-policy=USE-ARGUMENT-TYPE
        ReadBlock
          arg DstPtr: type=dtRef_VOID, direction=IN, server-argument-impl-policy=USE-ARGUMENT-TYPE
        SetDataIndex
          arg DataIndex: type=uint8, direction=IN, server-argument-impl-policy=USE-ARGUMENT-TYPE
        SetRamBlockStatus
          arg RamBlockStatus: type=boolean, direction=IN, server-argument-impl-policy=USE-ARGUMENT-TYPE
        WriteBlock
          arg SrcPtr: type=dtRef_const_VOID, direction=IN, server-argument-impl-policy=USE-ARGUMENT-TYPE
      error E_NOT_OK: error-code=1
    NvSWC_NvMService_AC2_SRBS_DS_Defs
      7 x operation, all with possible-error=NvSWC_NvMService_AC2_SRBS_DS_Defs/E_NOT_OK:
        GetDataIndex
          arg DataIndex: type=uint8, direction=OUT, server-argument-impl-policy=USE-ARGUMENT-TYPE
        GetErrorStatus
          arg ErrorStatus: type=NvM_RequestResultType, direction=OUT, server-argument-impl-policy=USE-ARGUMENT-TYPE
        ReadBlock
          arg DstPtr: type=dtRef_VOID, direction=IN, server-argument-impl-policy=USE-ARGUMENT-TYPE
        RestoreBlockDefaults
          arg DstPtr: type=dtRef_VOID, direction=IN, server-argument-impl-policy=USE-ARGUMENT-TYPE
        SetDataIndex
          arg DataIndex: type=uint8, direction=IN, server-argument-impl-policy=USE-ARGUMENT-TYPE
        SetRamBlockStatus
          arg RamBlockStatus: type=boolean, direction=IN, server-argument-impl-policy=USE-ARGUMENT-TYPE
        WriteBlock
          arg SrcPtr: type=dtRef_const_VOID, direction=IN, server-argument-impl-policy=USE-ARGUMENT-TYPE
      error E_NOT_OK: error-code=1
    NvSWC_NvMService_AC3
      5 x operation, all with possible-error=NvSWC_NvMService_AC3/E_NOT_OK:
        EraseBlock
        GetErrorStatus
          arg ErrorStatus: type=NvM_RequestResultType, direction=OUT, server-argument-impl-policy=USE-ARGUMENT-TYPE
        InvalidateNvBlock
        ReadBlock
          arg DstPtr: type=dtRef_VOID, direction=IN, server-argument-impl-policy=USE-ARGUMENT-TYPE
        WriteBlock
          arg SrcPtr: type=dtRef_const_VOID, direction=IN, server-argument-impl-policy=USE-ARGUMENT-TYPE
      error E_NOT_OK: error-code=1
    NvSWC_NvMService_AC3_Defs
      6 x operation, all with possible-error=NvSWC_NvMService_AC3_Defs/E_NOT_OK:
        EraseBlock
        GetErrorStatus
          arg ErrorStatus: type=NvM_RequestResultType, direction=OUT, server-argument-impl-policy=USE-ARGUMENT-TYPE
        InvalidateNvBlock
        ReadBlock
          arg DstPtr: type=dtRef_VOID, direction=IN, server-argument-impl-policy=USE-ARGUMENT-TYPE
        RestoreBlockDefaults
          arg DstPtr: type=dtRef_VOID, direction=IN, server-argument-impl-policy=USE-ARGUMENT-TYPE
        WriteBlock
          arg SrcPtr: type=dtRef_const_VOID, direction=IN, server-argument-impl-policy=USE-ARGUMENT-TYPE
      error E_NOT_OK: error-code=1
    NvSWC_NvMService_AC3_DS
      7 x operation, all with possible-error=NvSWC_NvMService_AC3_DS/E_NOT_OK:
        EraseBlock
        GetDataIndex
          arg DataIndex: type=uint8, direction=OUT, server-argument-impl-policy=USE-ARGUMENT-TYPE
        GetErrorStatus
          arg ErrorStatus: type=NvM_RequestResultType, direction=OUT, server-argument-impl-policy=USE-ARGUMENT-TYPE
        InvalidateNvBlock
        ReadBlock
          arg DstPtr: type=dtRef_VOID, direction=IN, server-argument-impl-policy=USE-ARGUMENT-TYPE
        SetDataIndex
          arg DataIndex: type=uint8, direction=IN, server-argument-impl-policy=USE-ARGUMENT-TYPE
        WriteBlock
          arg SrcPtr: type=dtRef_const_VOID, direction=IN, server-argument-impl-policy=USE-ARGUMENT-TYPE
      error E_NOT_OK: error-code=1
    NvSWC_NvMService_AC3_DS_Defs
      8 x operation, all with possible-error=NvSWC_NvMService_AC3_DS_Defs/E_NOT_OK:
        EraseBlock
        GetDataIndex
          arg DataIndex: type=uint8, direction=OUT, server-argument-impl-policy=USE-ARGUMENT-TYPE
        GetErrorStatus
          arg ErrorStatus: type=NvM_RequestResultType, direction=OUT, server-argument-impl-policy=USE-ARGUMENT-TYPE
        InvalidateNvBlock
        ReadBlock
          arg DstPtr: type=dtRef_VOID, direction=IN, server-argument-impl-policy=USE-ARGUMENT-TYPE
        RestoreBlockDefaults
          arg DstPtr: type=dtRef_VOID, direction=IN, server-argument-impl-policy=USE-ARGUMENT-TYPE
        SetDataIndex
          arg DataIndex: type=uint8, direction=IN, server-argument-impl-policy=USE-ARGUMENT-TYPE
        WriteBlock
          arg SrcPtr: type=dtRef_const_VOID, direction=IN, server-argument-impl-policy=USE-ARGUMENT-TYPE
      error E_NOT_OK: error-code=1
    NvSWC_NvMService_AC3_SRBS
      6 x operation, all with possible-error=NvSWC_NvMService_AC3_SRBS/E_NOT_OK:
        EraseBlock
        GetErrorStatus
          arg ErrorStatus: type=NvM_RequestResultType, direction=OUT, server-argument-impl-policy=USE-ARGUMENT-TYPE
        InvalidateNvBlock
        ReadBlock
          arg DstPtr: type=dtRef_VOID, direction=IN, server-argument-impl-policy=USE-ARGUMENT-TYPE
        SetRamBlockStatus
          arg RamBlockStatus: type=boolean, direction=IN, server-argument-impl-policy=USE-ARGUMENT-TYPE
        WriteBlock
          arg SrcPtr: type=dtRef_const_VOID, direction=IN, server-argument-impl-policy=USE-ARGUMENT-TYPE
      error E_NOT_OK: error-code=1
    NvSWC_NvMService_AC3_SRBS_Defs
      7 x operation, all with possible-error=NvSWC_NvMService_AC3_SRBS_Defs/E_NOT_OK:
        EraseBlock
        GetErrorStatus
          arg ErrorStatus: type=NvM_RequestResultType, direction=OUT, server-argument-impl-policy=USE-ARGUMENT-TYPE
        InvalidateNvBlock
        ReadBlock
          arg DstPtr: type=dtRef_VOID, direction=IN, server-argument-impl-policy=USE-ARGUMENT-TYPE
        RestoreBlockDefaults
          arg DstPtr: type=dtRef_VOID, direction=IN, server-argument-impl-policy=USE-ARGUMENT-TYPE
        SetRamBlockStatus
          arg RamBlockStatus: type=boolean, direction=IN, server-argument-impl-policy=USE-ARGUMENT-TYPE
        WriteBlock
          arg SrcPtr: type=dtRef_const_VOID, direction=IN, server-argument-impl-policy=USE-ARGUMENT-TYPE
      error E_NOT_OK: error-code=1
    NvSWC_NvMService_AC3_SRBS_DS
      8 x operation, all with possible-error=NvSWC_NvMService_AC3_SRBS_DS/E_NOT_OK:
        EraseBlock
        GetDataIndex
          arg DataIndex: type=uint8, direction=OUT, server-argument-impl-policy=USE-ARGUMENT-TYPE
        GetErrorStatus
          arg ErrorStatus: type=NvM_RequestResultType, direction=OUT, server-argument-impl-policy=USE-ARGUMENT-TYPE
        InvalidateNvBlock
        ReadBlock
          arg DstPtr: type=dtRef_VOID, direction=IN, server-argument-impl-policy=USE-ARGUMENT-TYPE
        SetDataIndex
          arg DataIndex: type=uint8, direction=IN, server-argument-impl-policy=USE-ARGUMENT-TYPE
        SetRamBlockStatus
          arg RamBlockStatus: type=boolean, direction=IN, server-argument-impl-policy=USE-ARGUMENT-TYPE
        WriteBlock
          arg SrcPtr: type=dtRef_const_VOID, direction=IN, server-argument-impl-policy=USE-ARGUMENT-TYPE
      error E_NOT_OK: error-code=1
    NvSWC_NvMService_AC3_SRBS_DS_Defs
      9 x operation, all with possible-error=NvSWC_NvMService_AC3_SRBS_DS_Defs/E_NOT_OK:
        EraseBlock
        GetDataIndex
          arg DataIndex: type=uint8, direction=OUT, server-argument-impl-policy=USE-ARGUMENT-TYPE
        GetErrorStatus
          arg ErrorStatus: type=NvM_RequestResultType, direction=OUT, server-argument-impl-policy=USE-ARGUMENT-TYPE
        InvalidateNvBlock
        ReadBlock
          arg DstPtr: type=dtRef_VOID, direction=IN, server-argument-impl-policy=USE-ARGUMENT-TYPE
        RestoreBlockDefaults
          arg DstPtr: type=dtRef_VOID, direction=IN, server-argument-impl-policy=USE-ARGUMENT-TYPE
        SetDataIndex
          arg DataIndex: type=uint8, direction=IN, server-argument-impl-policy=USE-ARGUMENT-TYPE
        SetRamBlockStatus
          arg RamBlockStatus: type=boolean, direction=IN, server-argument-impl-policy=USE-ARGUMENT-TYPE
        WriteBlock
          arg SrcPtr: type=dtRef_const_VOID, direction=IN, server-argument-impl-policy=USE-ARGUMENT-TYPE
      error E_NOT_OK: error-code=1
    NvSWC_NvMService_SRBS
      operation GetErrorStatus: possible-error=NvSWC_NvMService_SRBS/E_NOT_OK
        arg ErrorStatus: type=NvM_RequestResultType, direction=OUT, server-argument-impl-policy=USE-ARGUMENT-TYPE
      operation SetRamBlockStatus: possible-error=NvSWC_NvMService_SRBS/E_NOT_OK
        arg RamBlockStatus: type=boolean, direction=IN, server-argument-impl-policy=USE-ARGUMENT-TYPE
      error E_NOT_OK: error-code=1
package /PortInterfaces
  sender receiver interface PiLCSMCommand
    data DeCommand: sw-calibration-access=READ-ONLY, type=Test
  client server interface IoHwAb_ServiceType
    5 x operation, all with possible-error=[IoHwAb_ServiceType/E_NOT_OK, IoHwAb_ServiceType/E_NOT_OK]:
      IoHwAb_DioGetChannelVal
        arg s_Chn: type=IoHwAb_DioChannelType, direction=IN, server-argument-impl-policy=USE-ARGUMENT-TYPE
        arg pb_Val: type=boolean, direction=OUT, server-argument-impl-policy=USE-ARGUMENT-TYPE
      IoHwAb_DioSetChannelVal
        arg s_Chn: type=IoHwAb_DioChannelType, direction=IN, server-argument-impl-policy=USE-ARGUMENT-TYPE
        arg b_Val: type=boolean, direction=IN, server-argument-impl-policy=USE-ARGUMENT-TYPE
      IoHwAb_AdcConvert12BitValueTomv
        arg ChannelValue12Bit: type=AdcHwAb_ChannelValue12Bit, direction=IN, server-argument-impl-policy=USE-ARGUMENT-TYPE
        arg uw_AdcChannelValue_mV: type=AdcHwAb_ChannelValue_mV, direction=OUT, server-argument-impl-policy=USE-ARGUMENT-TYPE
      IoHwAb_AdcGetChannelValue
        arg AdcHwAbGroup: type=IoHwAb_AdcGroupType, direction=IN, server-argument-impl-policy=USE-ARGUMENT-TYPE
        arg Channel: type=IoHwAb_AdcChannelType, direction=IN, server-argument-impl-policy=USE-ARGUMENT-TYPE
        arg uw_AdcChannelValue: type=AdcHwAb_ChannelValue12Bit, direction=OUT, server-argument-impl-policy=USE-ARGUMENT-TYPE
      IoHwAb_AdcReadValues
    error E_NOT_OK: error-code=1
  4 x sender receiver interface:
    QCF_SafetyReaction
      data State: type=QCF_SafetyT
    QCF_RecoveryReaction
      data State: type=QCF_RecoveryT
    ComCtrl
      data ComState: type=ComState
    GetComState
      data State: type=ComState
  client server interface ErrorHandler
    operation ReportError: possible-error=[ErrorHandler/E_NOT_OK, ErrorHandler/E_NOT_OK]
      arg error_id: type=uint16, direction=IN, server-argument-impl-policy=USE-ARGUMENT-TYPE
      arg set: type=boolean, direction=IN, server-argument-impl-policy=USE-ARGUMENT-TYPE
    error E_NOT_OK: error-code=1
  client server interface DiagHandle
    operation SetEventSts
      arg EventId: type=Dem_EventIdType, direction=IN, server-argument-impl-policy=USE-ARGUMENT-TYPE
      arg EventStatus: type=Dem_EventStatusType, direction=IN, server-argument-impl-policy=USE-ARGUMENT-TYPE
    operation GetEventSts
      arg EventId: type=Dem_EventIdType, direction=IN, server-argument-impl-policy=USE-ARGUMENT-TYPE
      arg EventStatusExtended: type=Dem_UdsStatusByteType, direction=OUT, server-argument-impl-policy=USE-ARGUMENT-TYPE
  client server interface PerNvR
    operation WriteRequest: possible-error=[PerNvR/E_NOT_OK, PerNvR/E_NOT_OK]
      4 x arg, all with server-argument-impl-policy=USE-ARGUMENT-TYPE:
        NvPerBlockId: type=PerBlockIdType, direction=IN
        NvData: type=uint8, direction=INOUT
        NvSize: type=uint16, direction=IN
        NvWriteImmediately: type=boolean, direction=IN
    operation ReadRequest: possible-error=[PerNvR/E_NOT_OK, PerNvR/E_NOT_OK]
      4 x arg, all with server-argument-impl-policy=USE-ARGUMENT-TYPE:
        NvPerBlockId: type=PerBlockIdType, direction=IN
        NvData: type=uint8, direction=INOUT
        NvSize: type=uint16, direction=IN
        NvStatus: type=boolean, direction=IN
    error E_NOT_OK: error-code=1
  sender receiver interface Per_NvBlock_Notification_DSC
    data WriteComplete: type=uint8
  sender receiver interface Ydf_TestSR
    data TestSender1: type=uint8
    data TestSender2: type=uint64
  6 x client server interface:
    YDF_CSTest
      operation Element
        arg arg: type=uint8, direction=IN, server-argument-impl-policy=USE-ARGUMENT-TYPE
        arg arg_1: type=uint8, direction=OUT, server-argument-impl-policy=USE-ARGUMENT-TYPE
        arg arg_2: type=uint16, direction=INOUT, server-argument-impl-policy=USE-ARGUMENT-TYPE
    VBAT_PowerSupplyFunction
      operation D_VBAT_A_OFF
        arg IO_cmdTurnMode_LO: type=uint8, direction=IN, server-argument-impl-policy=USE-ARGUMENT-TYPE
      operation D_VBAT_B_OFF
        arg IO_cmdTurnMode_LO: type=uint8, direction=IN, server-argument-impl-policy=USE-ARGUMENT-TYPE
    LinModule
      12 x operation:
        LinA_Master_Send
          4 x arg, all with type=uint8, server-argument-impl-policy=USE-ARGUMENT-TYPE:
            Lin_valSendID_LO: direction=IN
            Lin_valLen_LO: direction=IN
            Lin_valData_LO: direction=OUT
            Lin_stCheckMode_LO: direction=IN
        LinB_Master_Send
          4 x arg, all with type=uint8, server-argument-impl-policy=USE-ARGUMENT-TYPE:
            Lin_valSendID_LO: direction=IN
            Lin_valLen_LO: direction=IN
            Lin_valData_LO: direction=OUT
            Lin_stCheckMode_LO: direction=IN
        LinC_Master_Send
          4 x arg, all with type=uint8, server-argument-impl-policy=USE-ARGUMENT-TYPE:
            Lin_valSendID_LO: direction=IN
            Lin_valLen_LO: direction=IN
            Lin_valData_LO: direction=OUT
            Lin_stCheckMode_LO: direction=IN
        LinA_Slave_Response
          4 x arg, all with server-argument-impl-policy=USE-ARGUMENT-TYPE:
            Lin_valRecID_LO: type=uint8, direction=IN
            Lin_valLen_LO: type=uint8, direction=IN
            Lin_stCheckMode_LO: type=uint8, direction=IN
            Lin_Rxdata_Lo: type=Lin_RxInfo, direction=OUT
        LinB_Slave_Response
          4 x arg, all with server-argument-impl-policy=USE-ARGUMENT-TYPE:
            Lin_valRecID_LO: type=uint8, direction=IN
            Lin_valLen_LO: type=uint8, direction=IN
            Lin_stCheckMode_LO: type=uint8, direction=IN
            Lin_Rxdata_Lo: type=Lin_RxInfo, direction=OUT
        LinC_Slave_Response
          4 x arg, all with server-argument-impl-policy=USE-ARGUMENT-TYPE:
            Lin_valRecID_LO: type=uint8, direction=IN
            Lin_valLen_LO: type=uint8, direction=IN
            Lin_stCheckMode_LO: type=uint8, direction=IN
            Lin_Rxdata_Lo: type=Lin_RxInfo, direction=OUT
        LinARec_GetResult
          4 x arg, all with server-argument-impl-policy=USE-ARGUMENT-TYPE:
            Lin_valRecID_LO: type=uint8, direction=IN
            Lin_valLen_LO: type=uint8, direction=IN
            Lin_stCheckMode_LO: type=uint8, direction=IN
            Lin_Rxdata: type=Lin_RxInfo, direction=OUT
        LinBRec_GetResult
          4 x arg, all with server-argument-impl-policy=USE-ARGUMENT-TYPE:
            Lin_valRecID_LO: type=uint8, direction=IN
            Lin_valLen_LO: type=uint8, direction=IN
            Lin_stCheckMode_LO: type=uint8, direction=IN
            Lin_Rxdata: type=Lin_RxInfo, direction=OUT
        LinCRec_GetResult
          4 x arg, all with server-argument-impl-policy=USE-ARGUMENT-TYPE:
            Lin_valRecID_LO: type=uint8, direction=IN
            Lin_valLen_LO: type=uint8, direction=IN
            Lin_stCheckMode_LO: type=uint8, direction=IN
            Lin_Rxdata: type=Lin_RxInfo, direction=OUT
        LinD_Master_Send
          4 x arg, all with type=uint8, server-argument-impl-policy=USE-ARGUMENT-TYPE:
            Lin_valSendID_LO: direction=IN
            Lin_valLen_LO: direction=IN
            Lin_valData_LO: direction=OUT
            Lin_stCheckMode_LO: direction=IN
        LinD_Slave_Response
          4 x arg, all with server-argument-impl-policy=USE-ARGUMENT-TYPE:
            Lin_valRecID_LO: type=uint8, direction=IN
            Lin_valLen_LO: type=uint8, direction=IN
            Lin_stCheckMode_LO: type=uint8, direction=IN
            Lin_Rxdata_LO: type=Lin_RxInfo, direction=OUT
        LinDRec_GetResult
          4 x arg, all with direction=IN, server-argument-impl-policy=USE-ARGUMENT-TYPE:
            Lin_valRecID_LO: type=uint8
            Lin_valLen_LO: type=uint8
            Lin_stCheckMode_LO: type=uint8
            Lin_Rxdata_LO: type=Lin_RxInfo
    HSoutFunction
      4 x operation:
        High_Side1_Function
          4 x arg, all with direction=IN, server-argument-impl-policy=USE-ARGUMENT-TYPE:
            IO_cmdTurnMode_LO: sw-calibration-access=READ-ONLY, type=uint8
            IO_cmdPWMMode_LO: type=uint8
            IO_valDutyRatio_LO: type=uint8
            IO_valFrequency_LO: type=uint32
        High_Side2_Function
          4 x arg, all with direction=IN, server-argument-impl-policy=USE-ARGUMENT-TYPE:
            IO_cmdTurnMode_LO: type=uint8
            IO_cmdPWMMode_LO: type=uint8
            IO_valDutyRatio_LO: type=uint8
            IO_valFrequency_LO: type=uint32
        High_Side3_Function
          4 x arg, all with direction=IN, server-argument-impl-policy=USE-ARGUMENT-TYPE:
            IO_cmdTurnMode_LO: type=uint8
            IO_cmdPWMMode_LO: type=uint8
            IO_valDutyRatio_LO: type=uint8
            IO_valFrequency_LO: type=uint32
        High_Side4_Function
          4 x arg, all with direction=IN, server-argument-impl-policy=USE-ARGUMENT-TYPE:
            IO_cmdTurnMode_LO: type=uint8
            IO_cmdPWMMode_LO: type=uint8
            IO_valDutyRatio_LO: type=uint8
            IO_valFrequency_LO: type=uint32
    Get_If
      17 x operation:
        Get_Ad_Result
          arg Ad_numchannel: type=uint8, direction=IN, server-argument-impl-policy=USE-ARGUMENT-TYPE
          arg Ad_valValue: type=AD_valResult, direction=OUT, server-argument-impl-policy=USE-ARGUMENT-TYPE
        Get_io_inResult
          arg io_numchannel: type=uint8, direction=IN, server-argument-impl-policy=USE-ARGUMENT-TYPE
          arg Dio_valValue: type=Dio_valInResult, direction=OUT, server-argument-impl-policy=USE-ARGUMENT-TYPE
        Get_BTS_OutResult
          arg BTS_numchannel: type=uint8, direction=IN, server-argument-impl-policy=USE-ARGUMENT-TYPE
          arg BTS_valOutValue: type=BTS7200_stSignal, direction=OUT, server-argument-impl-policy=USE-ARGUMENT-TYPE
        Get_CAN_ActiveInf
          arg CAN_ActiveInf: type=CAN_stActiveInf, direction=OUT, server-argument-impl-policy=USE-ARGUMENT-TYPE
        Icu_17_GtmCcu6_PWMIN_CH1
          arg Icu_PwmInCH1_Value: type=Icu_stResultInPin, direction=OUT, server-argument-impl-policy=USE-ARGUMENT-TYPE
        Icu_17_GtmCcu6_PWMIN_CH2
          arg Icu_PwmInCH2_Value: type=Icu_stResultInPin, direction=OUT, server-argument-impl-policy=USE-ARGUMENT-TYPE
        Icu_17_GtmCcu6_PWMIN_CH3
          arg Icu_PwmInCH3_Value: type=Icu_stResultInPin, direction=OUT, server-argument-impl-policy=USE-ARGUMENT-TYPE
        Icu_17_GtmCcu6_PWMIN_CH4
          arg Icu_PwmInCH4_Value: type=Icu_stResultInPin, direction=OUT, server-argument-impl-policy=USE-ARGUMENT-TYPE
        Icu_17_GtmCcu6_PWMIN_PWMSCB1
          arg Icu_PwmInSCB1: type=Icu_stResultInPin, direction=OUT, server-argument-impl-policy=USE-ARGUMENT-TYPE
        Icu_17_GtmCcu6_PWMIN_PWMSCB2
          arg Icu_PwmInSCB2: type=Icu_stResultInPin, direction=OUT, server-argument-impl-policy=USE-ARGUMENT-TYPE
        Icu_17_GtmCcu6_PWMIN_LAMPSCB1
          arg Icu_PwmIN_lampSCB1: type=Icu_stResultInPin, direction=OUT, server-argument-impl-policy=USE-ARGUMENT-TYPE
        Icu_17_GtmCcu6_PWMIN_LAMPSCB2
          arg Icu_PwmIN_lampSCB2: type=Icu_stResultInPin, direction=OUT, server-argument-impl-policy=USE-ARGUMENT-TYPE
        Get_Bottom_Ver
          arg VerAndTiMsg: type=Botom_stVerAndTiMsg, direction=OUT, server-argument-impl-policy=USE-ARGUMENT-TYPE
        Get_SentData
          arg Sent_numChannel: type=uint8, direction=IN, server-argument-impl-policy=USE-ARGUMENT-TYPE
          arg Sent_ValData: type=uint32, direction=OUT, server-argument-impl-policy=USE-ARGUMENT-TYPE
        Get_Level_OutResult
          arg Io_numchannel: type=uint8, direction=IN, server-argument-impl-policy=USE-ARGUMENT-TYPE
          arg Io_stOutStatus: type=Io_stOut, direction=OUT, server-argument-impl-policy=USE-ARGUMENT-TYPE
        Get_PwmOrLevel_OutResult
          arg Pwm_numchannel: type=uint8, direction=IN, server-argument-impl-policy=USE-ARGUMENT-TYPE
          arg Pwm_stOutStatus: type=Pwm_stOut, direction=OUT, server-argument-impl-policy=USE-ARGUMENT-TYPE
        Get_Motor_OutResult
          arg Motor_stOutStatus: type=TLEMotor_stSignal, direction=OUT, server-argument-impl-policy=USE-ARGUMENT-TYPE
    EEProm_Module
      operation Fee_WriteFunction
        4 x arg, all with server-argument-impl-policy=USE-ARGUMENT-TYPE:
          EE_numBlock: type=uint8, direction=IN
          EE_valWrBlockData: type=uint8, direction=OUT
          EE_valLength: type=uint16, direction=IN
          EE_valReturn: type=uint8, direction=OUT
      operation Fee_ReadFunction
        4 x arg, all with server-argument-impl-policy=USE-ARGUMENT-TYPE:
          EE_numBlock: type=uint8, direction=IN
          EE_valReadBlockData: type=uint8, direction=OUT
          EE_valLength: type=uint16, direction=IN
          EE_valReturn: type=uint8, direction=OUT
  8 x sender receiver interface:
    YDF_cmdSignalCtr
      data OutputCtr: type=boolean
    YDF_stSignalCmd
      data SignalCmd: type=boolean
    Ydf_vOutVoltage
      data OutVoltage: type=uint16
    YDF_stSignalStatus
      data SignalStatus: type=boolean
    Ydf_dPWMDuty
      data PWMDuty: type=uint8
    Ydf_frePWMfrequency
      data PWMfrequency: type=uint16
    YDF_stMotorCmd
      data MotorCmd: type=uint8
    YDF_cmdMotorCtr
      data MotorCtr: type=uint8
  client server interface LSoutFunction
    28 x operation:
      Lowout1_Function
        4 x arg, all with direction=IN, server-argument-impl-policy=USE-ARGUMENT-TYPE:
          IO_cmdTurnMode_LO: type=uint8
          IO_cmdPWMMode_LO: type=uint8
          IO_valDutyRatio_LO: type=uint8
          IO_valFrequency_LO: type=uint32
      Lowout2_Function
        4 x arg, all with direction=IN, server-argument-impl-policy=USE-ARGUMENT-TYPE:
          IO_cmdTurnMode_LO: type=uint8
          IO_cmdPWMMode_LO: type=uint8
          IO_valDutyRatio_LO: type=uint8
          IO_valFrequency_LO: type=uint32
      Lowout3_Function
        4 x arg, all with direction=IN, server-argument-impl-policy=USE-ARGUMENT-TYPE:
          IO_cmdTurnMode_LO: type=uint8
          IO_cmdPWMMode_LO: type=uint8
          IO_valDutyRatio_LO: type=uint8
          IO_valFrequency_LO: type=uint32
      Lowout4_Function
        4 x arg, all with direction=IN, server-argument-impl-policy=USE-ARGUMENT-TYPE:
          IO_cmdTurnMode_LO: type=uint8
          IO_cmdPWMMode_LO: type=uint8
          IO_valFrequency_LO: type=uint8
          IO_valDutyRatio_LO: type=uint32
      Lowout20_Function
        4 x arg, all with direction=IN, server-argument-impl-policy=USE-ARGUMENT-TYPE:
          IO_cmdTurnMode_LO: type=uint8
          IO_cmdPWMMode_LO: type=uint8
          IO_valDutyRatio_LO: type=uint8
          IO_valFrequency_LO: type=uint32
      Lowout22_Function
        4 x arg, all with direction=IN, server-argument-impl-policy=USE-ARGUMENT-TYPE:
          IO_cmdTurnMode_LO: type=uint8
          IO_cmdPWMMode_LO: type=uint8
          IO_valDutyRatio_LO: type=uint8
          IO_valFrequency_LO: type=uint32
      Lowout23_Function
        4 x arg, all with direction=IN, server-argument-impl-policy=USE-ARGUMENT-TYPE:
          IO_cmdTurnMode_LO: type=uint8
          IO_cmdPWMMode_LO: type=uint8
          IO_valDutyRatio_LO: type=uint8
          IO_valFrequency_LO: type=uint32
      Lowout24_Function
        4 x arg, all with direction=IN, server-argument-impl-policy=USE-ARGUMENT-TYPE:
          IO_cmdTurnMode_LO: type=uint8
          IO_cmdPWMMode_LO: type=uint8
          IO_valDutyRatio_LO: type=uint8
          IO_valFrequency_LO: type=uint32
      Lowout_Lamp1_Function
        4 x arg, all with direction=IN, server-argument-impl-policy=USE-ARGUMENT-TYPE:
          IO_cmdTurnMode_LO: type=uint8
          IO_cmdPWMMode_LO: type=uint8
          IO_valDutyRatio_LO: type=uint8
          IO_valFrequency_LO: type=uint32
      Lowout_Lamp2_Function
        4 x arg, all with direction=IN, server-argument-impl-policy=USE-ARGUMENT-TYPE:
          IO_cmdTurnMode_LO: type=uint8
          IO_cmdPWMMode_LO: type=uint8
          IO_valDutyRatio_LO: type=uint8
          IO_valFrequency_LO: type=uint32
      Lowout_PWMOUT1_Function
        4 x arg, all with direction=IN, server-argument-impl-policy=USE-ARGUMENT-TYPE:
          IO_cmdTurnMode_LO: type=uint8
          IO_cmdPWMMode_LO: type=uint8
          IO_valDutyRatio_LO: type=uint8
          IO_valFrequency_LO: type=uint32
      Lowout_PWMOUT2_Function
        4 x arg, all with direction=IN, server-argument-impl-policy=USE-ARGUMENT-TYPE:
          IO_cmdTurnMode_LO: type=uint8
          IO_cmdPWMMode_LO: type=uint8
          IO_valDutyRatio_LO: type=uint8
          IO_valFrequency_LO: type=uint32
      Lowout5_Function
        arg IO_cmdTurnMode_LO: type=uint8, direction=IN, server-argument-impl-policy=USE-ARGUMENT-TYPE
      Lowout6_Function
        arg IO_cmdTurnMode_LO: type=uint8, direction=IN, server-argument-impl-policy=USE-ARGUMENT-TYPE
      Lowout7_Function
        arg IO_cmdTurnMode_LO: type=uint8, direction=IN, server-argument-impl-policy=USE-ARGUMENT-TYPE
      Lowout8_Function
        arg IO_cmdTurnMode_LO: type=uint8, direction=IN, server-argument-impl-policy=USE-ARGUMENT-TYPE
      Lowout9_Function
        arg IO_cmdTurnMode_LO: type=uint8, direction=IN, server-argument-impl-policy=USE-ARGUMENT-TYPE
      Lowout10_Function
        arg IO_cmdTurnMode_LO: type=uint8, direction=IN, server-argument-impl-policy=USE-ARGUMENT-TYPE
      Lowout11_Function
        arg IO_cmdTurnMode_LO: type=uint8, direction=IN, server-argument-impl-policy=USE-ARGUMENT-TYPE
      Lowout12_Function
        arg IO_cmdTurnMode_LO: type=uint8, direction=IN, server-argument-impl-policy=USE-ARGUMENT-TYPE
      Lowout13_Function
        arg IO_cmdTurnMode_LO: type=uint8, direction=IN, server-argument-impl-policy=USE-ARGUMENT-TYPE
      Lowout14_Function
        arg IO_cmdTurnMode_LO: type=uint8, direction=IN, server-argument-impl-policy=USE-ARGUMENT-TYPE
      Lowout15_Function
        arg IO_cmdTurnMode_LO: type=uint8, direction=IN, server-argument-impl-policy=USE-ARGUMENT-TYPE
      Lowout16_Function
        arg IO_cmdTurnMode_LO: type=uint8, direction=IN, server-argument-impl-policy=USE-ARGUMENT-TYPE
      Lowout17_Function
        arg IO_cmdTurnMode_LO: type=uint8, direction=IN, server-argument-impl-policy=USE-ARGUMENT-TYPE
      Lowout18_Function
        arg IO_cmdTurnMode_LO: type=uint8, direction=IN, server-argument-impl-policy=USE-ARGUMENT-TYPE
      Lowout19_Function
        arg IO_cmdTurnMode_LO: type=uint8, direction=IN, server-argument-impl-policy=USE-ARGUMENT-TYPE
      Lowout21_Function
        arg IO_cmdTurnMode_LO: type=uint8, direction=IN, server-argument-impl-policy=USE-ARGUMENT-TYPE
  client server interface Motor_OUTPUT_Function
    operation App_Motor_OUTPUT_Function
      arg Io_stCtrMotorDrive: type=uint8, direction=IN, server-argument-impl-policy=USE-ARGUMENT-TYPE
  client server interface Set_Tsk_CpuSleepOrOff
    operation Set_Tsk_CpuSleepOrOff
      arg Tsk_stCpuG0Run: type=uint8, direction=IN, server-argument-impl-policy=USE-ARGUMENT-TYPE
      arg Tsk_stCpuPowerOff: type=uint8, direction=IN, server-argument-impl-policy=USE-ARGUMENT-TYPE
  4 x sender receiver interface:
    Boot_cmdJumpCmd
      data Cmd: type=uint8
    IOAbs
      6 x data:
        IOAbs_CC2ValueInfo: type=uint16
        IOAbs_BrakeSignal1Info: type=boolean
        IOAbs_BrakeSignal2Info: type=boolean
        IOAbs_AccPedal2ValueInfo: type=uint16
        IOAbs_AccPedal1ValueInfo: type=uint16
        IOAbs_KeyONInfo: type=boolean
    HWTest
      17 x data:
        HWTest_DCRelayEnableInfo: type=boolean
        HWTest_HVILOUTInfo: type=boolean
        HWTest_OBCEnableInfo: type=boolean
        HWTest_DCDCEnableInfo: type=boolean
        HWTest_AccPedal2RawValueInfo: type=uint16
        HWTest_T15eCtrlInfo: type=boolean
        HWTest_AccPedal1RawValueInfo: type=uint16
        HWTest_CalibrateSignalInfo: type=uint8
        HWTest_NVMSignalInfo: type=uint16
        HWTest_CC2SignalRawValueInfo: type=uint16
        HWTest_BrkSignal1SignalInfo: type=boolean
        HWTest_BrkSignal2SignalInfo: type=boolean
        HWTest_HVILINSignalInfo: type=boolean
        HWTest_AccPedal1SignalInfo: type=uint8
        HWTest_AccPedal2SignalInfo: type=uint8
        HWTest_KeyONInfo: type=boolean
        HWTest_T15eFeedBackInfo: type=boolean
    Atom_CAN_input
      6 x data, all with type=boolean:
        Comm_DCRelayCtrlInfo
        Comm_HVILOUTCtrlInfo
        Comm_OBCEnableCtrlInfo
        Comm_DCDCEnableCtrlInfo
        Comm_T15eEnableCtrlInfo
        Comm_ClearNVMRequestInfo
  nv data interface HWTest_NVMP
    nv-datas:
      data HWTest_NVMSignalInfo_NVM_P: type=uint16
  nv data interface HWTest_NVMR
    nv-datas:
      data HWTest_NVMSignalInfo_NVM_R: type=uint16
  sender receiver interface YDF_stDiagStatus
    data DiagStatus: type=uint8
  client server interface Ydf_SensorSupply_Funtion
    operation SensorSupply3_5v_OUT_Enable
      arg Cmd_TurnMode: type=boolean, direction=IN, server-argument-impl-policy=USE-ARGUMENT-TYPE
    operation SensorSupply4_5v_OUT_Enable
      arg Cmd_TurnMode: type=boolean, direction=IN, server-argument-impl-policy=USE-ARGUMENT-TYPE
  client server interface Ydf_LINComEn_Funtion
    operation LINB_OUT_Enable
      arg Cmd_TurnMode: type=boolean, direction=IN, server-argument-impl-policy=USE-ARGUMENT-TYPE
    operation LINC_OUT_Enable
      arg Cmd_TurnMode: type=boolean, direction=IN, server-argument-impl-policy=USE-ARGUMENT-TYPE
    operation LIND_OUT_Enable
      arg Cmd_TurnMode: type=boolean, direction=IN, server-argument-impl-policy=USE-ARGUMENT-TYPE
  sender receiver interface YDF_stUpdateStatus
    data DiagStatus: type=uint16
  nv data interface IF_CB_Diag_CBOpeningEvents
    nv-datas:
      data tec_CB_Diag_CBOpeningEvents: type=tec_CB_Diag_CBOpeningEvents_t
  794 x sender receiver interface:
    IF_ModMgmt_HvSts_Enum
      data tec_ModMgmt_HvSts_Enum: type=uint8
    IF_ComM_BMSBattIDc_A
      data tec_ComM_BMSBattIDc_A: type=float32
    IF_ComM_BMSBattDispSOC_pct
      data tec_ComM_BMSBattDispSOC_pct: type=float32
    IF_ComM_BMSBattRateCp_Ah
      data tec_ComM_BMSBattRateCp_Ah: type=float32
    IF_ErrMgmt_BMSComLost_Flg
      data tec_ErrMgmt_BMSComLost_Flg: type=boolean
    IF_VehMot_VehSpd_kph
      data tec_VehMot_VehSpd_kph: type=float32
    IF_VehMot_VehSpdVld_Flg
      data tec_VehMot_VehSpdVld_Flg: type=boolean
    IF_RngEstimn_StdDrvMilg_km
      data tec_RngEstimn_StdDrvMilg_km: type=uint16
    IF_RngEstimn_DynDrvMilg_km
      data tec_RngEstimn_DynDrvMilg_km: type=uint16
    IF_RngEstimn_BMSBattIDcIntgl_As
      data tec_RngEstimn_BMSBattIDcIntgl_As: type=uint32
    IF_RngEstimn_AccuMilg_m
      data tec_RngEstimn_AccuMilg_m: type=uint32
    BMS_BattCurr
      data BMS_BattCurr: type=BMS_BattCurr
    BMS_DisplaySOC
      data BMS_DisplaySOC: type=BMS_DisplaySOC
    BMS_RemainCapacity
      data BMS_RemainCapacity: type=BMS_RemainCapacity
    VCU_DisplayMileage
      data VCU_DisplayMileage: type=VCU_DisplayMileage
    CCS_OutputVoltage
      data CCS_OutputVoltage: type=CCS_OutputVoltage
    CEM_BatteryChargeRequireTimeout
      data CEM_BatteryChargeRequireTimeout: type=CEM_BatteryChargeRequireTimeout
    CHM_ProtocolVersion
      data CHM_ProtocolVersion: type=CHM_ProtocolVersion
    CML_OutputCurrentMax
      data CML_OutputCurrentMax: type=uint16
    IF_DCChrg_TxBSMStatusInfo
      data tec_IF_DCChrg_TxBSMStatusInfo: type=boolean
    BHM_AllowChargeVoltageMax
      data BHM_AllowChargeVoltageMax: type=BHM_AllowChargeVoltageMax
    IF_ComM_IVIDrvModSet_Enum
      data tec_ComM_IVIDrvModSet_Enum: type=uint8
    IF_ComM_IBSDecelReqAvl_Flg
      data tec_ComM_IBSDecelReqAvl_Flg: type=boolean
    IF_ComM_BMSInslaErrLvl_Enum
      data tec_ComM_BMSInslaErrLvl_Enum: type=uint8
    IF_ComM_BMSHVILSts_Flg
      data tec_ComM_BMSHVILSts_Flg: type=boolean
    IF_IOAbs_HVILPwmFrq_Hz
      data tec_IOAbs_HVILPwmFrq_Hz: type=uint8
    IF_ComM_BMSCellHiTempErr_Enum
      data tec_ComM_BMSCellHiTempErr_Enum: type=uint8
    IF_ComM_BMSErrLvl_Enum
      data tec_ComM_BMSErrLvl_Enum: type=uint8
    IF_ComM_MCUTempOvrSts_Enum
      data tec_ComM_MCUTempOvrSts_Enum: type=uint8
    IF_ComM_ErrResEPTCANBusOffInfo
      data tec_ComM_ErrResEPTCANBusOffInfo: type=boolean
    IF_ComM_ACUCrashOutpSts_Enum
      data tec_ComM_ACUCrashOutpSts_Enum: type=uint8
    IF_ComM_DCDCHvInpUDc_V
      data tec_ComM_DCDCHvInpUDc_V: type=float32
    IF_ComM_DCDCHvInpIDc_A
      data tec_ComM_DCDCHvInpIDc_A: type=float32
    IF_ComM_MCUUDc_V
      data tec_ComM_MCUUDc_V: type=float32
    IF_ComM_IVIRgnLvlSet_Enum
      data tec_ComM_IVIRgnLvlSet_Enum: type=uint8
    IF_ComM_MCUIDc_A
      data tec_ComM_MCUIDc_A: type=float32
    IF_ComM_OBCOutpUDc_V
      data tec_ComM_OBCOutpUDc_V: type=float32
    IF_ComM_OBCOutpIDc_A
      data tec_ComM_OBCOutpIDc_A: type=float32
    IF_ComM_BMSPTCUDc_V
      data tec_ComM_BMSPTCUDc_V: type=float32
    IF_ComM_BMSBattHeatIDc_A
      data tec_ComM_BMSBattHeatIDc_A: type=float32
    IF_ComM_EVCOMActPwrCns_Kw
      data tec_ComM_EVCOMActPwrCns_Kw: type=float32
    IF_ComM_APTCPwrCns_Kw
      data tec_ComM_APTCPwrCns_Kw: type=float32
    IF_ComM_HVCHUDc_V
      data tec_ComM_HVCHUDc_V: type=float32
    IF_ComM_HVCHIDc_A
      data tec_ComM_HVCHIDc_A: type=float32
    IF_ComM_BMSBattPckUDc_V
      data tec_ComM_BMSBattPckUDc_V: type=float32
    IF_ComM_BMSBattDchaIDc_A
      data tec_ComM_BMSBattDchaIDc_A: type=float32
    IF_ComM_BMSBattFbIDc_A
      data tec_ComM_BMSBattFbIDc_A: type=float32
    IF_ComM_TMSTotPwrReq_W
      data tec_ComM_TMSTotPwrReq_W: type=float32
    IF_ComM_BMSBattAllowChrgIDc_A
      data tec_ComM_BMSBattAllowChrgIDc_A: type=float32
    IF_ComM_IBSAebActv_Flg
      data tec_ComM_IBSAebActv_Flg: type=boolean
    IF_ComM_IBSAbpActv_Flg
      data tec_ComM_IBSAbpActv_Flg: type=boolean
    IF_ComM_IBSCdpActv_Flg
      data tec_ComM_IBSCdpActv_Flg: type=boolean
    IF_ComM_IBSRwuActv_Flg
      data tec_ComM_IBSRwuActv_Flg: type=boolean
    IF_ComM_OBCCCSts_Enum
      data tec_ComM_OBCCCSts_Enum: type=uint8
    IF_ComM_BSBattUDcHiDiag_Enum
      data tec_ComM_BSBattUDcHiDiag_Enum: type=uint8
    IF_IOAbs_KL15eFb_Flg
      data tec_IOAbs_KL15eFb_Flg: type=boolean
    IF_ComM_OBCChrgSts_Enum
      data tec_ComM_OBCChrgSts_Enum: type=uint8
    IF_ComM_DCDCWrkMod_Enum
      data tec_ComM_DCDCWrkMod_Enum: type=uint8
    IF_ComM_BMSSts_Enum
      data tec_ComM_BMSSts_Enum: type=uint8
    IF_ComM_MCUWrkMod_Enum
      data tec_ComM_MCUWrkMod_Enum: type=uint8
    IF_ComM_PEPSPwrMod_Enum
      data tec_ComM_PEPSPwrMod_Enum: type=uint8
    IF_ComM_SGWRemHvCtrlReq_Enum
      data tec_ComM_SGWRemHvCtrlReq_Enum: type=uint8
    IF_ComM_BMSRTCReq_Flg
      data tec_ComM_BMSRTCReq_Flg: type=boolean
    IF_ComM_BMSNegRlySts_Enum
      data tec_ComM_BMSNegRlySts_Enum: type=uint8
    IF_ComM_BMSPosRlySts_Enum
      data tec_ComM_BMSPosRlySts_Enum: type=uint8
    IF_ComM_PODDcPosRlySts_Enum
      data tec_ComM_PODDcPosRlySts_Enum: type=uint8
    IVI_DriveModeSet
      data IVI_DriveModeSet: type=IVI_DriveModeSet
    BMS_ErrorCellLowTemp
      data BMS_ErrorCellLowTemp: type=BMS_ErrorCellLowTemp
    MCU_TempStatus
      data MCU_TempStatus: type=MCU_TempStatus
    POD_OBC_OutputDCChargeCurrent
      data POD_OBC_OutputDCChargeCurrent: type=POD_OBC_OutputDCChargeCurrent
    POD_OBC_OutputDCChargeVoltage
      data POD_OBC_OutputDCChargeVoltage: type=POD_OBC_OutputDCChargeVoltage
    BMS_PTC_VoltageValue
      data BMS_PTC_VoltageValue: type=BMS_PTC_VoltageValue
    BMS_Heatcurrent
      data BMS_Heatcurrent: type=BMS_Heatcurrent
    EVCOM_CompActlPwrCnsmp
      data EVCOM_CompActlPwrCnsmp: type=EVCOM_CompActlPwrCnsmp
    TCU_HVCHHighVoltage
      data TCU_HVCHHighVoltage: type=TCU_HVCHHighVoltage
    TCU_HVCHHVDCCurrent
      data TCU_HVCHHVDCCurrent: type=TCU_HVCHHVDCCurrent
    BMS_PackVoltage
      data BMS_PackVoltage: type=BMS_PackVoltage
    BMS_DisChgCurr
      data BMS_DisChgCurr: type=BMS_DisChgCurr
    BMS_FeedbackCurr
      data BMS_FeedbackCurr: type=BMS_FeedbackCurr
    TCU_TMSTotoalPwrReq
      data TCU_TMSTotoalPwrReq: type=TCU_TMSTotoalPwrReq
    BMS_AllowChagCurrent
      data BMS_AllowChagCurrent: type=BMS_AllowChagCurrent
    POD_OBC_CCStatus
      data POD_OBC_CCStatus: type=POD_OBC_CCStatus
    POD_OBC_WorkMode
      data POD_OBC_WorkMode: type=POD_OBC_WorkMode
    POD_DCDC_WorkMode
      data POD_DCDC_WorkMode: type=POD_DCDC_WorkMode
    MCU_VCUWorkMode
      data MCU_VCUWorkMode: type=MCU_VCUWorkMode
    SGW_RemoteHVCtrlReq
      data SGW_RemoteHVCtrlReq: type=SGW_RemoteHVCtrlReq
    BMS_RTC_Request
      data BMS_RTC_Request: type=BMS_RTC_Request
    BMS_NegRelayStatus
      data BMS_NegRelayStatus: type=BMS_NegRelayStatus
    BMS_PosRelayStatus
      data BMS_PosRelayStatus: type=BMS_PosRelayStatus
    POD_DCPosRelayState
      data POD_DCPosRelayState: type=POD_DCPosRelayState
    BMS_ErrorHVIL
      data BMS_ErrorHVIL: type=BMS_ErrorHVIL
    POD_DCDC_HVInputCurrent
      data POD_DCDC_HVInputCurrent: type=POD_DCDC_HVInputCurrent
    POD_DCDC_HVInputVoltage
      data POD_DCDC_HVInputVoltage: type=POD_DCDC_HVInputVoltage
    IF_LvMgmt_WakeUpSrc_Enum
      data tec_LvMgmt_WakeUpSrc_Enum: type=uint8
    IF_LvMgmt_WakeUpReq_Flg
      data tec_LvMgmt_WakeUpReq_Flg: type=boolean
    IF_LvMgmt_SmtChrgScenario_Flg
      data tec_LvMgmt_SmtChrgScenario_Flg: type=boolean
    IF_LvMgmt_ECUsDiagDTC_Bus
      data tec_LvMgmt_ECUsDiagDTC_Bus: type=dt_LvMgmt_ECUsDiagDTC
    IF_LvMgmt_KL15eOffDTC_Bus
      data tec_LvMgmt_KL15eOffDTC_Bus: type=dt_LvMgmt_KL15eOffDTC
    IF_LvMgmt_KL15eOnDTC_Bus
      data tec_LvMgmt_KL15eOnDTC_Bus: type=dt_LvMgmt_KL15eOnDTC
    IF_LvMgmt_SleepReq_Flg
      data tec_LvMgmt_SleepReq_Flg: type=boolean
    IF_LvMgmt_SelfChkSts_Flg
      data tec_LvMgmt_SelfChkSts_Flg: type=boolean
    IF_LvMgmt_KL15ActSts_Flg
      data tec_LvMgmt_KL15ActSts_Flg: type=boolean
    IF_LvMgmt_KL15CtrlReq_Flg
      data tec_LvMgmt_KL15CtrlReq_Flg: type=boolean
    IF_LvMgmt_LvPwrDwn_Flg
      data tec_LvMgmt_LvPwrDwn_Flg: type=boolean
    IF_LvMgmt_StayInRun_Flg
      data tec_LvMgmt_StayInRun_Flg: type=boolean
    IF_LvMgmt_IBSBattUDcNorm_Flg
      data tec_LvMgmt_IBSBattUDcNorm_Flg: type=boolean
    IF_LvMgmt_IBSBattUDcHiDTC_Bus
      data tec_LvMgmt_IBSBattUDcHiDTC_Bus: type=dt_LvMgmt_IBSBattUDcHiDTC
    IF_LvMgmt_IBSBattUDcLoDTC_Bus
      data tec_LvMgmt_IBSBattUDcLoDTC_Bus: type=dt_LvMgmt_IBSBattUDcLoDTC
    IF_LvMgmt_IBSBattIDcHiDTC_Bus
      data tec_LvMgmt_IBSBattIDcHiDTC_Bus: type=dt_LvMgmt_IBSBattIDcHiDTC
    IF_LvMgmt_LvSysLoUdcDTC_Bus
      data tec_LvMgmt_LvSysLoUdcDTC_Bus: type=dt_LvMgmt_LvSysLoUdcDTC
    IF_LvMgmt_LvSysOvrUdcDTC_Bus
      data tec_LvMgmt_LvSysOvrUdcDTC_Bus: type=dt_LvMgmt_LvSysOvrUdcDTC
    IF_HvMgmt_DCDCWrkModActSts_Enum
      data tec_HvMgmt_DCDCWrkModActSts_Enum: type=uint8
    IF_HvMgmt_TCUWrkModActSts_Enum
      data tec_HvMgmt_TCUWrkModActSts_Enum: type=uint8
    IF_VehMot_VehStandStill_Flg
      data tec_VehMot_VehStandStill_Flg: type=boolean
    IF_ErrMgmt_Fobd2Hv_Flg
      data tec_ErrMgmt_Fobd2Hv_Flg: type=boolean
    IF_ErrMgmt_EmgyHvDwn_Flg
      data tec_ErrMgmt_EmgyHvDwn_Flg: type=boolean
    IF_ErrMgmt_HvDwn_Flg
      data tec_ErrMgmt_HvDwn_Flg: type=boolean
    IF_GearMgmt_ActGear_Enum
      data tec_GearMgmt_ActGear_Enum: type=uint8
    IF_ChrMgmt_PosRlyOpenReq_Flg
      data tec_ChrMgmt_PosRlyOpenReq_Flg: type=boolean
    IF_ChrMgmt_ReqHvRdy_Flg
      data tec_ChrMgmt_ReqHvRdy_Flg: type=boolean
    IF_ChrMgmt_ChrgSts_Enum
      data tec_ChrMgmt_ChrgSts_Enum: type=uint8
    IF_HvMgmt_MCURdyFltDTC_Bus
      data tec_HvMgmt_MCURdyFltDTC_Bus: type=dt_HvMgmt_MCURdyFltDTC
    IF_HvMgmt_ReqModBMS_Flg
      data tec_HvMgmt_ReqModBMS_Flg: type=boolean
    IF_HvMgmt_BMSWrkModActSts_Enum
      data tec_HvMgmt_BMSWrkModActSts_Enum: type=uint8
    IF_HvMgmt_BMSPosRlyCtrlReq_Flg
      data tec_HvMgmt_BMSPosRlyCtrlReq_Flg: type=boolean
    IF_HvMgmt_BMSNegRlyActSts_Enum
      data tec_HvMgmt_BMSNegRlyActSts_Enum: type=uint8
    IF_HvMgmt_BMSPosRlyActSts_Enum
      data tec_HvMgmt_BMSPosRlyActSts_Enum: type=uint8
    IF_HvMgmt_HvPwrOnReq_Flg
      data tec_HvMgmt_HvPwrOnReq_Flg: type=boolean
    IF_HvMgmt_HvPwrOffReq_Flg
      data tec_HvMgmt_HvPwrOffReq_Flg: type=boolean
    IF_HvMgmt_HvPwrOffReqChrgDwn_Flg
      data tec_HvMgmt_HvPwrOffReqChrgDwn_Flg: type=boolean
    IF_EgyMgmt_DCDCPwrCnsCalcn_Kw
      data tec_EgyMgmt_DCDCPwrCnsCalcn_Kw: type=float32
    IF_EgyMgmt_MCUPwrCnsCalcn_Kw
      data tec_EgyMgmt_MCUPwrCnsCalcn_Kw: type=float32
    IF_EgyMgmt_AvgMCUPwrCnsCalcn_Kw
      data tec_EgyMgmt_AvgMCUPwrCnsCalcn_Kw: type=float32
    IF_EgyMgmt_V2LPwrCnsCalcn_Kw
      data tec_EgyMgmt_V2LPwrCnsCalcn_Kw: type=float32
    IF_EgyMgmt_PackPTCPwrCnsCalcn_Kw
      data tec_EgyMgmt_PackPTCPwrCnsCalcn_Kw: type=float32
    IF_EgyMgmt_ACSysPwrCnsCalcn_Kw
      data tec_EgyMgmt_ACSysPwrCnsCalcn_Kw: type=float32
    IF_FctSftyMon_ActGear_Enum
      data tec_FctSftyMon_ActGear_Enum: type=uint8
    IF_EgyMgmt_PermtPckPTC_Flg
      data tec_EgyMgmt_PermtPckPTC_Flg: type=boolean
    IF_EgyMgmt_DCDCPwrLmt_Kw
      data tec_EgyMgmt_DCDCPwrLmt_Kw: type=float32
    IF_EgyMgmt_MCUDrvPwrLmt_Kw
      data tec_EgyMgmt_MCUDrvPwrLmt_Kw: type=float32
    IF_EgyMgmt_MCUFbPwrLmt_Kw
      data tec_EgyMgmt_MCUFbPwrLmt_Kw: type=float32
    IF_EgyMgmt_TCUPwrAllwd_W
      data tec_EgyMgmt_TCUPwrAllwd_W: type=float32
    IF_EgyMgmt_BMSTarThermLvl_Enum
      data tec_EgyMgmt_BMSTarThermLvl_Enum: type=uint8
    IF_EgyMgmt_EgyMgmtWarn_Enum
      data tec_EgyMgmt_EgyMgmtWarn_Enum: type=uint8
    IF_EgyMgmt_EgyMgmtWarnOne_Bus
      data tec_EgyMgmt_EgyMgmtWarnOne_Bus: type=dt_EgyMgmt_EgyMgmtWarnOne
    IF_EgyMgmt_EgyMgmtWarnTwo_Bus
      data tec_EgyMgmt_EgyMgmtWarnTwo_Bus: type=dt_EgyMgmt_EgyMgmtWarnTwo
    IF_ComM_MotActSpd_rpm
      data tec_ComM_MotActSpd_rpm: type=sint16
    IF_ComM_IBSVehSpd_kph
      data tec_ComM_IBSVehSpd_kph: type=float32
    IF_ComM_IBSVehSpdVld_Flg
      data tec_ComM_IBSVehSpdVld_Flg: type=boolean
    IF_ComM_IBSFRMovgDir_Enum
      data tec_ComM_IBSFRMovgDir_Enum: type=uint8
    IF_ComM_IBSFLMovgDir_Enum
      data tec_ComM_IBSFLMovgDir_Enum: type=uint8
    IF_ComM_IBSRRMovgDir_Enum
      data tec_ComM_IBSRRMovgDir_Enum: type=uint8
    IF_ComM_IBSRLMovgDir_Enum
      data tec_ComM_IBSRLMovgDir_Enum: type=uint8
    IF_ComM_MotActSpdVld_Flg
      data tec_ComM_MotActSpdVld_Flg: type=boolean
    IF_VehMot_VehDirDif_Flg
      data tec_VehMot_VehDirDif_Flg: type=boolean
    IF_VehMot_VehSpdABS_kph
      data tec_VehMot_VehSpdABS_kph: type=float32
    IF_VehMot_VehStdl_Flg
      data tec_VehMot_VehStdl_Flg: type=boolean
    IF_VehMot_VehDrvDir_Enum
      data tec_VehMot_VehDrvDir_Enum: type=uint8
    IF_ComM_YRSAx_mps2q
      data tec_ComM_YRSAx_mps2q: type=float32
    IF_ComM_YRSAxSts
      data tec_ComM_YRSAxSts: type=uint8
    IF_VehMot_VehSpdAcclr_mps2q
      data tec_VehMot_VehSpdAcclr_mps2q: type=float32
    IF_VehMot_RegenBrkLi_Flg
      data tec_VehMot_RegenBrkLi_Flg: type=boolean
    IF_VehMot_RegenBrkLiVld_Flg
      data tec_VehMot_RegenBrkLiVld_Flg: type=boolean
    IF_ChassisMgmt_AccrPedlPosn_pct
      data tec_ChassisMgmt_AccrPedlPosn_pct: type=float32
    IF_ChassisMgmt_AccrPedlVld_Flg
      data tec_ChassisMgmt_AccrPedlVld_Flg: type=boolean
    IF_ChassisMgmt_BrkSts_Flg
      data tec_ChassisMgmt_BrkSts_Flg: type=boolean
    IF_ChassisMgmt_BrkStsVld_Flg
      data tec_ChassisMgmt_BrkStsVld_Flg: type=boolean
    IF_VehMot_SlopGrd_pct
      data tec_VehMot_SlopGrd_pct: type=float32
    IF_TorqPahMgmt_EmacQstyMaxTq_Nm
      data tec_TorqPahMgmt_EmacQstyMaxTq_Nm: type=float32
    IF_TorqPahMgmt_EmacQstyMinTq_Nm
      data tec_TorqPahMgmt_EmacQstyMinTq_Nm: type=float32
    IF_ComM_MotActTq_Nm
      data tec_ComM_MotActTq_Nm: type=float32
    IF_VehMot_VehDragTq_Nm
      data tec_VehMot_VehDragTq_Nm: type=float32
    IF_VehMot_AcclrPrpMax_mps2q
      data tec_VehMot_AcclrPrpMax_mps2q: type=float32
    IF_VehMot_AcclrPrpMin_mps2q
      data tec_VehMot_AcclrPrpMin_mps2q: type=float32
    IF_VehMot_AcclrPrpCurr_mps2q
      data tec_VehMot_AcclrPrpCurr_mps2q: type=float32
    IF_VehMot_Acclr2Tq_Nm
      data tec_VehMot_Acclr2Tq_Nm: type=float32
    IF_OBCMgmt_S2CtrlReqAcStop_Enum
      data tec_OBCMgmt_S2CtrlReqAcStop_Enum: type=uint8
    IF_OBCMgmt_S2SwtCtrlSts_Enum
      data tec_OBCMgmt_S2SwtCtrlSts_Enum: type=uint8
    IF_OBCMgmt_S2SwtCtrlCmd_Enum
      data tec_OBCMgmt_S2SwtCtrlCmd_Enum: type=uint8
    IF_OBCMgmt_OBCInpUDcLoErr_Bus
      data tec_OBCMgmt_OBCInpUDcLoErr_Bus: type=dt_OBCMgmt_OBCInpUDcLoErr
    IF_OBCMgmt_S2SwtClsErr_Bus
      data tec_OBCMgmt_S2SwtClsErr_Bus: type=dt_OBCMgmt_S2SwtClsErr
    IF_OBCMgmt_OBCDchaStsErr_Bus
      data tec_OBCMgmt_OBCDchaStsErr_Bus: type=dt_OBCMgmt_OBCDchaStsErr
    IF_OBCMgmt_S2SwtOpenErr_Bus
      data tec_OBCMgmt_S2SwtOpenErr_Bus: type=dt_OBCMgmt_S2SwtOpenErr
    IF_OBCMgmt_CPStsJmpErr_Bus
      data tec_OBCMgmt_CPStsJmpErr_Bus: type=dt_OBCMgmt_CPStsJmpErr
    IF_OBCMgmt_AcChrgnSts_Enum
      data tec_OBCMgmt_AcChrgnSts_Enum: type=uint8
    IF_OBCMgmt_ElectcLockCtrlSts_Enum
      data tec_OBCMgmt_ElectcLockCtrlSts_Enum: type=uint8
    IF_ComM_S2SwtSts_Enum
      data tec_ComM_S2SwtSts_Enum: type=uint8
    IF_ComM_OBCInpUAc_V
      data tec_ComM_OBCInpUAc_V: type=float32
    IF_ComM_OBCCPSts_Enum
      data tec_ComM_OBCCPSts_Enum: type=uint8
    IF_ChrMgmt_PreheatSts_Enum
      data tec_ChrMgmt_PreheatSts_Enum: type=uint8
    IF_OBCMgmt_OBCCtrlReqAcStop_Enum
      data tec_OBCMgmt_OBCCtrlReqAcStop_Enum: type=uint8
    IF_OBCMgmt_OBCEnaCmd_Enum
      data tec_OBCMgmt_OBCEnaCmd_Enum: type=uint8
    IF_OBCMgmt_OBCChrgStsErr_Bus
      data tec_OBCMgmt_OBCChrgStsErr_Bus: type=dt_OBCMgmt_OBCChrgStsErr
    IF_OBCMgmt_OBCPreheatStsErr_Bus
      data tec_OBCMgmt_OBCPreheatStsErr_Bus: type=dt_OBCMgmt_OBCPreheatStsErr
    IF_OBCMgmt_OBCDiErr_Bus
      data tec_OBCMgmt_OBCDiErr_Bus: type=dt_OBCMgmt_OBCDiErr
    IF_ChrMgmt_OBCCtrlMdlSts_Enum
      data tec_ChrMgmt_OBCCtrlMdlSts_Enum: type=uint8
    IF_ChrMgmt_OBCEnaAllwd_Flg
      data tec_ChrMgmt_OBCEnaAllwd_Flg: type=boolean
    IF_ChrMgmt_KeepWrm_Flg
      data tec_ChrMgmt_KeepWrm_Flg: type=boolean
    IF_ComM_OBCCPPwmDuty_pct
      data tec_ComM_OBCCPPwmDuty_pct: type=uint8
    IF_ComM_OBCPrimSideTemp_C
      data tec_ComM_OBCPrimSideTemp_C: type=sint8
    IF_ComM_OBCSecySideTemp_C
      data tec_ComM_OBCSecySideTemp_C: type=sint8
    IF_OBCMgmt_ElectcLockCtrlCmd_Enum
      data tec_OBCMgmt_ElectcLockCtrlCmd_Enum: type=uint8
    IF_OBCMgmt_ElectcLockClsErr_Bus
      data tec_OBCMgmt_ElectcLockClsErr_Bus: type=dt_OBCMgmt_ElectcLockClsErr
    IF_OBCMgmt_ElectcLockOpenErr_Bus
      data tec_OBCMgmt_ElectcLockOpenErr_Bus: type=dt_OBCMgmt_ElectcLockOpenErr
    IF_OBCMgmt_MnyUnlckCmt_Enum
      data tec_OBCMgmt_MnyUnlckCmt_Enum: type=uint8
    IF_ComM_ElectcLockSts_Enum
      data tec_ComM_ElectcLockSts_Enum: type=uint8
    IF_ComM_BCMAntithftSts_Enum
      data tec_ComM_BCMAntithftSts_Enum: type=uint8
    IF_ComM_IVIReqElectcLock_Enum
      data tec_ComM_IVIReqElectcLock_Enum: type=uint8
    IF_OBCMgmt_ReqOBCIDc_A
      data tec_OBCMgmt_ReqOBCIDc_A: type=float32
    IF_OBCMgmt_OBCOutpCpbyIDc_A
      data tec_OBCMgmt_OBCOutpCpbyIDc_A: type=float32
    IF_ComM_OBCCCIDcLmt_A
      data tec_ComM_OBCCCIDcLmt_A: type=float32
    IF_ComM_OBCCPIDcLmt_A
      data tec_ComM_OBCCPIDcLmt_A: type=float32
    IF_ComM_BMSBattLnkUDc_V
      data tec_ComM_BMSBattLnkUDc_V: type=float32
    IF_ComM_OBCMaxAllwdIDc_A
      data tec_ComM_OBCMaxAllwdIDc_A: type=float32
    IF_ComM_AcChrgPha_Enum
      data tec_ComM_AcChrgPha_Enum: type=uint8
    IF_ErrMgmt_AcPause_Flg
      data tec_ErrMgmt_AcPause_Flg: type=boolean
    IF_ComM_BMSChrgSts_Enum
      data tec_ComM_BMSChrgSts_Enum: type=uint8
    IF_DCChrMgmt_DcChrgnMod_Enum
      data tec_DCChrMgmt_DcChrgnMod_Enum: type=uint8
    IF_ComM_BattChrgnModReq_Enum
      data tec_ComM_BattChrgnModReq_Enum: type=uint8
    IF_DCChrMgmt_DcChrgnSts_Enum
      data tec_DCChrMgmt_DcChrgnSts_Enum: type=uint8
    IF_DCChrMgmt_DcChrgnIDcReq_A
      data tec_DCChrMgmt_DcChrgnIDcReq_A: type=float32
    IF_DCChrMgmt_DCChrgnUDcReq_V
      data tec_DCChrMgmt_DcChrgnUDcReq_V: type=float32
    IF_ComM_CMLMaxOutpIDc_A
      data tec_ComM_CMLMaxOutpIDc_A: type=float32
    IF_ComM_BMSBattMaxChrgnUDc_V
      data tec_ComM_BMSBattMaxChrgnUDc_V: type=float32
    IF_ComM_DcInletATemp_C
      data tec_ComM_DcInletATemp_C: type=sint8
    IF_ComM_DcInletBTemp_C
      data tec_ComM_DcInletBTemp_C: type=sint8
    IF_ErrMgmt_DcPause_Flg
      data tec_ErrMgmt_DcPause_Flg: type=boolean
    IF_DCChrMgmt_DcSeqReqDcStop_Enum
      data tec_DCChrMgmt_DcSeqReqDcStop_Enum: type=uint8
    IF_DCChrMgmt_TxSts_Flg
      10 x data, all with type=boolean:
        tec_DCChrMgmt_TxBHMSts_Flg
        tec_DCChrMgmt_TxBRMSts_Flg
        tec_DCChrMgmt_TxBCPSts_Flg
        tec_DCChrMgmt_TxBROSts_Flg
        tec_DCChrMgmt_TxBCLSts_Flg
        tec_DCChrMgmt_TxBSTSts_Flg
        tec_DCChrMgmt_TxBCSSts_Flg
        tec_DCChrMgmt_TxBSMSts_Flg
        tec_DCChrMgmt_TxBEMSts_Flg
        tec_DCChrMgmt_TxBSDSts_Flg
    IF_DCChrMgmt_DCFCClsReq_Flg
      data tec_DCChrMgmt_DCFCClsReq_Flg: type=boolean
    IF_DCChrMgmt_BROPrepFinshd_Enum
      data tec_DCChrMgmt_BROPrepFinshd_Enum: type=uint8
    IF_DCChrMgmt_IRMeasSwtCtrl_Enum
      data tec_DCChrMgmt_IRMeasSwtCtrl_Enum: type=uint8
    IF_DCChrMgmt_IRMeasEnaErr_Bus
      data tec_DCChrMgmt_IRMeasEnaErr_Bus: type=dt_DCChrMgmt_IRMeasEnaErr
    IF_DCChrMgmt_IRMeasDiErr_Bus
      data tec_DCChrMgmt_IRMeasDiErr_Bus: type=dt_DCChrMgmt_IRMeasDiErr
    IF_ComM_RxSts_Flg
      8 x data, all with type=boolean:
        tec_ComM_RxCRMSts_Flg
        tec_ComM_RxCMLSts_Flg
        tec_ComM_RxCCSSts_Flg
        tec_ComM_RxCSDSts_Flg
        tec_ComM_RxCSTSts_Flg
        tec_ComM_RxCHMSts_Flg
        tec_ComM_RxCEMSts_Flg
        tec_ComM_RxCROSts_Flg
    IF_ComM_BMSIRDetnSts_Enum
      data tec_ComM_BMSIRDetnSts_Enum: type=uint8
    IF_DCChrMgmt_DcChrgrCpbyPassd_Flg
      data tec_DCChrMgmt_DcChrgrCpbyPassd_Flg: type=boolean
    IF_ChrMgmt_DcChrgCmplSts_Enum
      data tec_ChrMgmt_DcChrgCmplSts_Enum: type=uint8
    IF_ChrMgmt_VCUCalcdPODIDc_A
      data tec_ChrMgmt_VCUCalcdPODIDc_A: type=float32
    IF_DCChrMgmt_BEMTxReqSts_Enum
      data tec_DCChrMgmt_BEMTxReqSts_Enum: type=uint8
    IF_ChrMgmt_DcChrgAllwd_Flg
      data tec_ChrMgmt_DcChrgAllwd_Flg: type=boolean
    IF_HvMgmt_DCFCWrkModActSts_Enum
      data tec_HvMgmt_DCFCWrkModActSts_Enum: type=uint8
    IF_ComM_CROPrepRdy_Enum
      data tec_ComM_CROPrepRdy_Enum: type=uint8
    IF_ComM_CRMRecgRes_Enum
      data tec_ComM_CRMRecgRes_Enum: type=uint8
    IF_DCChrMgmt_ComMngReqDcStop_Enum
      data tec_DCChrMgmt_ComMngReqDcStop_Enum: type=uint8
    IF_DCChrMgmt_BCLReqDCChrgnIDc_A
      data tec_DCChrMgmt_BCLReqDCChrgnIDc_A: type=float32
    IF_DCChrMgmt_BCLReqDCChrgnUDc_V
      data tec_DCChrMgmt_BCLReqDCChrgnUDc_V: type=float32
    IF_DCChrMgmt_BCLDCChrgnMod_Enum
      data tec_DCChrMgmt_BCLDCChrgnMod_Enum: type=uint8
    IF_DCChrMgmt_BSMCellUDcErrSts_Enum
      data tec_DCChrMgmt_BSMCellUDcErrSts_Enum: type=uint8
    IF_DCChrMgmt_BSMSOCErrSts_Enum
      data tec_DCChrMgmt_BSMSOCErrSts_Enum: type=uint8
    IF_DCChrMgmt_BSMChrgnIDcErrSts_Enum
      data tec_DCChrMgmt_BSMChrgnIDcErrSts_Enum: type=uint8
    IF_DCChrMgmt_BSMBattTempHiErrSts_Enum
      data tec_DCChrMgmt_BSMBattTempHiErrSts_Enum: type=uint8
    IF_DCChrMgmt_BSMIRErrSts_Enum
      data tec_DCChrMgmt_BSMIRErrSts_Enum: type=uint8
    IF_DCChrMgmt_BSMOutpCnctErrSts_Enum
      data tec_DCChrMgmt_BSMOutpCnctErrSts_Enum: type=uint8
    IF_DCChrMgmt_BSMChrgAllwbl_Flg
      data tec_DCChrMgmt_BSMChrgAllwbl_Flg: type=boolean
    IF_DCChrMgmt_BSTRchTarSOC_Enum
      data tec_DCChrMgmt_BSTRchTarSOC_Enum: type=uint8
    IF_DCChrMgmt_BSTRchTarTotUDc_Enum
      data tec_DCChrMgmt_BSTRchTarTotUDc_Enum: type=uint8
    IF_DCChrMgmt_BSTRchTarCellUDc_Enum
      data tec_DCChrMgmt_BSTRchTarCellUDc_Enum: type=uint8
    IF_DCChrMgmt_BSTChrgrStopSts_Enum
      data tec_DCChrMgmt_BSTChrgrStopSts_Enum: type=uint8
    IF_DCChrMgmt_BSTIRErrStopSts_Enum
      data tec_DCChrMgmt_BSTIRErrStopSts_Enum: type=uint8
    IF_DCChrMgmt_BSTOutpCnctOvrTemp_Enum
      data tec_DCChrMgmt_BSTOutpCnctOvrTemp_Enum: type=uint8
    IF_DCChrMgmt_BSTBMSCnctOvrTemp_Enum
      data tec_DCChrMgmt_BSTBMSCnctOvrTemp_Enum: type=uint8
    IF_DCChrMgmt_BSTChrgCnctErrSts_Enum
      data tec_DCChrMgmt_BSTChrgCnctErrSts_Enum: type=uint8
    IF_DCChrMgmt_BSTBattOvrTempErr_Enum
      data tec_DCChrMgmt_BSTBattOvrTempErr_Enum: type=uint8
    IF_DCChrMgmt_BSTHvRlyErrSts_Enum
      data tec_DCChrMgmt_BSTHvRlyErrSts_Enum: type=uint8
    IF_DCChrMgmt_BSTChkCC2UDcErr_Enum
      data tec_DCChrMgmt_BSTChkCC2UDcErr_Enum: type=uint8
    IF_DCChrMgmt_BSTOtherErr_Enum
      data tec_DCChrMgmt_BSTOtherErr_Enum: type=uint8
    IF_DCChrMgmt_BSTIDcErrSts_Enum
      data tec_DCChrMgmt_BSTIDcErrSts_Enum: type=uint8
    IF_DCChrMgmt_BSTUDcErrSts_Enum
      data tec_DCChrMgmt_BSTUDcErrSts_Enum: type=uint8
    IF_DCChrMgmt_BSTChrgPrmErr_Enum
      data tec_DCChrMgmt_BSTChrgPrmErr_Enum: type=uint8
    IF_DCChrMgmt_BEMRxCRMTmt_Enum
      data tec_DCChrMgmt_BEMRxCRMTmt_Enum: type=uint8
    IF_DCChrMgmt_BEMRxCRMPrepdTmt_Enum
      data tec_DCChrMgmt_BEMRxCRMPrepdTmt_Enum: type=uint8
    IF_DCChrMgmt_BEMRxCMLTmt_Enum
      data tec_DCChrMgmt_BEMRxCMLTmt_Enum: type=uint8
    IF_DCChrMgmt_BEMRxCROTmt_Enum
      data tec_DCChrMgmt_BEMRxCROTmt_Enum: type=uint8
    IF_DCChrMgmt_BEMRxCCSTmt_Enum
      data tec_DCChrMgmt_BEMRxCCSTmt_Enum: type=uint8
    IF_DCChrMgmt_BEMRxCSTTmt_Enum
      data tec_DCChrMgmt_BEMRxCSTTmt_Enum: type=uint8
    IF_DCChrMgmt_BEMRxCSDTmt_Enum
      data tec_DCChrMgmt_BEMRxCSDTmt_Enum: type=uint8
    IF_DCChrMgmt_BEMRxCRMTmt_Bus
      data tec_DCChrMgmt_BEMRxCRMTmt_Bus: type=dt_DCChrMgmt_BEMRxCRMTmt
    IF_DCChrMgmt_BEMRxCRMPrepdTmt_Bus
      data tec_DCChrMgmt_BEMRxCRMPrepdTmt_Bus: type=dt_DCChrMgmt_BEMRxCRMPrepdTmt
    IF_DCChrMgmt_BEMRxCMLTmt_Bus
      data tec_DCChrMgmt_BEMRxCMLTmt_Bus: type=dt_DCChrMgmt_BEMRxCMLTmt
    IF_DCChrMgmt_BEMRxCROTmt_Bus
      data tec_DCChrMgmt_BEMRxCROTmt_Bus: type=dt_DCChrMgmt_BEMRxCROTmt
    IF_DCChrMgmt_BEMRxCROPrepdTmt_Bus
      data tec_DCChrMgmt_BEMRxCROPrepdTmt_Bus: type=dt_DCChrMgmt_BEMRxCROPrepdTmt
    IF_ComM_MCU01MsgErrInfo_Bus
      5 x data:
        tec_ComM_MCU01E2ETimeoutInfo_Bus: type=dt_ComM_MCU01E2ETimeoutInfo
        tec_ComM_MCU01TimeoutDTCInfo_Bus: type=dt_ComM_MCU01TimeoutDTCInfo
        tec_ComM_MCU01CRCInfo_Bus: type=dt_ComM_MCU01CRCInfo
        tec_ComM_MCU01CRCDTCInfo_Bus: type=dt_ComM_MCU01CRCDTCInfo
        tec_ComM_MCU01TimeoutInfo_Bus: type=dt_ComM_MCU01TimeoutInfo
    IF_ComM_IBSVCUMotCtrlMsgErrInfo_Bus
      5 x data:
        tec_ComM_IBSVCUMotCtrlE2ETimeoutInfo_Bus: type=dt_ComM_IBSVCUMotCtrlE2ETimeoutInfo
        tec_ComM_IBSVCUMotCtrlTimeoutDTCInfo_Bus: type=dt_ComM_IBSVCUMotCtrlTimeoutDTCInfo
        tec_ComM_IBSVCUMotCtrlCRCInfo_Bus: type=dt_ComM_IBSVCUMotCtrlCRCInfo
        tec_ComM_IBSVCUMotCtrlTimeoutInfo_Bus: type=dt_ComM_IBSVCUMotCtrlTimeoutInfo
        tec_ComM_IBSVCUMotCtrlCRCDTCInfo_Bus: type=dt_ComM_IBSVCUMotCtrlCRCDTCInfo
    IF_ComM_CANBusOffInfo_Bus
      6 x data:
        tec_ComM_CHCANBusOffDTCInfo_Bus: type=dt_ComM_CHCANBusOffDTCInfo
        tec_ComM_EPTCANBusOffDTCInfo_Bus: type=dt_ComM_EPTCANBusOffDTCInfo
        tec_ComM_CHCANBusOffInfo_Bus: type=dt_ComM_CHCANBusOffInfo
        tec_ComM_EPTCANBusOffInfo_Bus: type=dt_ComM_EPTCANBusOffInfo
        tec_ComM_DCCANBusOffInfo_Bus: type=dt_ComM_DCCANBusOffInfo
        tec_ComM_DCCANBusOffDTCInfo_Bus: type=dt_ComM_DCCANBusOffDTCInfo
    IF_ComM_IBSSts01MsgErrInfo_Bus
      4 x data:
        tec_ComM_IBSSts01E2ETimeoutInfo_Bus: type=dt_ComM_IBSSts01E2ETimeoutInfo
        tec_ComM_IBSSts01CRCInfo_Bus: type=dt_ComM_IBSSts01CRCInfo
        tec_ComM_IBSSts01TimeoutDTCInfo_Bus: type=dt_ComM_IBSSts01TimeoutDTCInfo
        tec_ComM_IBSSts01CRCDTCInfo_Bus: type=dt_ComM_IBSSts01CRCDTCInfo
    IF_ComM_BMSSts02MsgErrInfo_Bus
      data tec_ComM_BMSSts02TimeoutInfo_Bus: type=dt_ComM_BMSSts02TimeoutInfo
      data tec_ComM_BMSSts02TimeoutDTCInfo_Bus: type=dt_ComM_BMSSts02TimeoutDTCInfo
    IF_ComM_IBSSts02MsgErrInfo_Bus
      4 x data:
        tec_ComM_IBSSts02E2ETimeoutInfo_Bus: type=dt_ComM_IBSSts02E2ETimeoutInfo
        tec_ComM_IBSSts02TimeoutDTCInfo_Bus: type=dt_ComM_IBSSts02TimeoutDTCInfo
        tec_ComM_IBSSts02CRCDTCInfo_Bus: type=dt_ComM_IBSSts02CRCDTCInfo
        tec_ComM_IBSSts02CRCInfo_Bus: type=dt_ComM_IBSSts02CRCInfo
    IF_ComM_IBSSts03MsgErrInfo_Bus
      4 x data:
        tec_ComM_IBSSts03E2ETimeoutInfo_Bus: type=dt_ComM_IBSSts03E2ETimeoutInfo
        tec_ComM_IBSSts03TimeoutDTCInfo_Bus: type=dt_ComM_IBSSts03TimeoutDTCInfo
        tec_ComM_IBSSts03CRCDTCInfo_Bus: type=dt_ComM_IBSSts03CRCDTCInfo
        tec_ComM_IBSSts03CRCInfo_Bus: type=dt_ComM_IBSSts03CRCInfo
    IF_ComM_IBSSts05MsgErrInfo_Bus
      5 x data:
        tec_ComM_IBSSts05TimeoutInfo_Bus: type=dt_ComM_IBSSts05TimeoutInfo
        tec_ComM_IBSSts05TimeoutDTCInfo_Bus: type=dt_ComM_IBSSts05TimeoutDTCInfo
        tec_ComM_IBSSts05CRCDTCInfo_Bus: type=dt_ComM_IBSSts05CRCDTCInfo
        tec_ComM_IBSSts05E2ETimeoutInfo_Bus: type=dt_ComM_IBSSts05E2ETimeoutInfo
        tec_ComM_IBSSts05CRCInfo_Bus: type=dt_ComM_IBSSts05CRCInfo
    IF_ComM_IBSSts06MsgErrInfo_Bus
      data tec_ComM_IBSSts06TimeoutDTCInfo_Bus: type=dt_ComM_IBSSts06TimeoutDTCInfo
      data tec_ComM_IBSSts06CRCDTCInfo_Bus: type=dt_ComM_IBSSts06CRCDTCInfo
    IF_ComM_IBSTqMsgErrInfo_Bus
      4 x data:
        tec_ComM_IBSTqE2ETimeoutInfo_Bus: type=dt_ComM_IBSTqE2ETimeoutInfo
        tec_ComM_IBSTqCRCInfo_Bus: type=dt_ComM_IBSTqCRCInfo
        tec_ComM_IBSTqTimeoutDTCInfo_Bus: type=dt_ComM_IBSTqTimeoutDTCInfo
        tec_ComM_IBSTqCRCDTCInfo_Bus: type=dt_ComM_IBSTqCRCDTCInfo
    IF_ComM_IBSWhlSpd01MsgErrInfo_Bus
      data tec_ComM_IBSWhlSpd01TimeoutDTCInfo_Bus: type=dt_ComM_IBSWhlSpd01TimeoutInfo
      data tec_ComM_IBSWhlSpd01CRCDTCInfo_Bus: type=dt_ComM_IBSWhlSpd01CRCDTCInfo
    IF_ComM_IBSWhlSpd02MsgErrInfo_Bus
      data tec_ComM_IBSWhlSpd02TimeoutDTCInfo_Bus: type=dt_ComM_IBSWhlSpd02TimeoutInfo
      data tec_ComM_IBSWhlSpd02CRCDTCInfo_Bus: type=dt_ComM_IBSWhlSpd02CRCDTCInfo
    IF_ComM_IBSACCMsgErrInfo_Bus
      4 x data:
        tec_ComM_IBSACCE2ETimeoutInfo_Bus: type=dt_ComM_IBSACCE2ETimeoutInfo
        tec_ComM_IBSACCTimeoutDTCInfo_Bus: type=dt_ComM_IBSACCTimeoutDTCInfo
        tec_ComM_IBSACCCRCInfo_Bus: type=dt_ComM_IBSACCCRCInfo
        tec_ComM_IBSACCCRCDTCInfo_Bus: type=dt_ComM_IBSACCCRCDTCInfo
    IF_ComM_IVI01MsgErrInfo_Bus
      data tec_ComM_IVI01E2ETimeoutInfo_Bus: type=dt_ComM_IVI01E2ETimeoutInfo
      data tec_ComM_IVI01CRCInfo_Bus: type=dt_ComM_IVI01CRCInfo
    IF_ComM_PRNDMsgErrInfo_Bus
      5 x data:
        tec_ComM_PRNDE2ETimeoutInfo_Bus: type=dt_ComM_PRNDE2ETimeoutInfo
        tec_ComM_PRNDTimeoutDTCInfo_Bus: type=dt_ComM_PRNDTimeoutDTCInfo
        tec_ComM_PRNDCRCInfo_Bus: type=dt_ComM_PRNDCRCInfo
        tec_ComM_PRNDCRCDTCInfo_Bus: type=dt_ComM_PRNDCRCDTCInfo
        tec_ComM_PRNDTimeoutInfo_Bus: type=dt_ComM_PRNDTimeoutInfo
    IF_ComM_ACU01MsgErrInfo_Bus
      data tec_ComM_ACU01TimeoutDTCInfo_Bus: type=dt_ComM_ACU01TimeoutDTCInfo
      data tec_ComM_ACU01CRCDTCInfo_Bus: type=dt_ComM_ACU01CRCDTCInfo
    IF_ComM_ACU02MsgErrInfo_Bus
      data tec_ComM_ACU02TimeoutDTCInfo_Bus: type=dt_ComM_ACU02TimeoutDTCInfo
      data tec_ComM_ACU02CRCDTCInfo_Bus: type=dt_ComM_ACU02CRCDTCInfo
      data tec_ComM_ACU02TimeoutInfo_Bus: type=dt_ComM_ACU02TimeoutInfo
    IF_ComM_ADCUACC02MsgErrInfo_Bus
      data tec_ComM_ADCUACC02TimeoutInfo_Bus: type=dt_ComM_ADCUACC02TimeoutInfo
      data tec_ComM_ADCUACC02TimeoutDTCInfo_Bus: type=dt_ComM_ADCUACC02TimeoutDTCInfo
      data tec_ComM_ADCUACC02CRCDTCInfo_Bus: type=dt_ComM_ADCUACC02CRCDTCInfo
    IF_ComM_ACUInfoMsgErrInfo_Bus
      data tec_ComM_ACUInfoTimeoutInfo_Bus: type=dt_ComM_ACUInfoTimeoutInfo
      data tec_ComM_ACUInfoTimeoutDTCInfo_Bus: type=dt_ComM_ACUInfoTimeoutDTCInfo
      data tec_ComM_ACUInfoCRCDTCInfo_Bus: type=dt_ComM_ACUInfoCRCDTCInfo
    IF_ComM_IBSSts04MsgErrInfo_Bus
      4 x data:
        tec_ComM_IBSSts04E2ETimeoutInfo_Bus: type=dt_ComM_IBSSts04E2ETimeoutInfo
        tec_ComM_IBSSts04TimeoutDTCInfo_Bus: type=dt_ComM_IBSSts04TimeoutDTCInfo
        tec_ComM_IBSSts04CRCInfo_Bus: type=dt_ComM_IBSSts04CRCInfo
        tec_ComM_IBSSts04CRCDTCInfo_Bus: type=dt_ComM_IBSSts04CRCDTCInfo
    IF_ComM_ADCUBodyReqMsgErrInfo_Bus
      data tec_ComM_ADCUBodyReqTimeoutDTCInfo_Bus: type=dt_ComM_ADCUBodyReqTimeoutDTCInfo
      data tec_ComM_ADCUBodyReqCRCDTCInfo_Bus: type=dt_ComM_ADCUBodyReqCRCDTCInfo
    IF_ComM_APTCTCUMsgErrInfo_Bus
      data tec_ComM_APTCTCUTimeoutInfo_Bus: type=dt_ComM_APTCTCUTimeoutInfo
      data tec_ComM_APTCTCUTimeoutDTCInfo_Bus: type=dt_ComM_APTCTCUTimeoutDTCInfo
    IF_ComM_BCM06MsgErrInfo_Bus
      data tec_ComM_BCM06TimeoutInfo_Bus: type=dt_ComM_BCM06TimeoutInfo
      data tec_ComM_BCM06TimeoutDTCInfo_Bus: type=dt_ComM_BCM06TimeoutDTCInfo
      data tec_ComM_BCM06CRCDTCInfo_Bus: type=dt_ComM_BCM06CRCDTCInfo
    IF_ComM_DCMFL02MsgErrInfo_Bus
      data tec_ComM_DCMFL02TimeoutInfo_Bus: type=dt_ComM_DCMFL02TimeoutInfo
      data tec_ComM_DCMFL02TimeoutDTCInfo_Bus: type=dt_ComM_DCMFL02TimeoutDTCInfo
      data tec_ComM_DCMFL02CRCDTCInfo_Bus: type=dt_ComM_DCMFL02CRCDTCInfo
    IF_ComM_MCUFailrCodMsgErrInfo_Bus
      4 x data:
        tec_ComM_MCUFailrCodTimeoutDTCInfo_Bus: type=dt_ComM_MCUFailrCodTimeoutDTCInfo
        tec_ComM_MCUFailrCodCRCDTCInfo_Bus: type=dt_ComM_MCUFailrCodCRCDTCInfo
        tec_ComM_MCUFailrCodE2ETimeoutInfo_Bus: type=dt_ComM_MCUFailrCodE2ETimeoutInfo
        tec_ComM_MCUFailrCodCRCInfo_Bus: type=dt_ComM_MCUFailrCodCRCInfo
    IF_ComM_EVCOMSts01MsgErrInfo_Bus
      data tec_ComM_EVCOMSts01TimeoutInfo_Bus: type=dt_ComM_EVCOMSts01TimeoutInfo
      data tec_ComM_EVCOMSts01TimeoutDTCInfo_Bus: type=dt_ComM_EVCOMSts01TimeoutDTCInfo
    IF_ComM_PODDCDC01MsgErrInfo_Bus
      data tec_ComM_PODDCDC01TimeoutInfo_Bus: type=dt_ComM_PODDCDC01TimeoutInfo
      data tec_ComM_PODDCDC01TimeoutDTCInfo_Bus: type=dt_ComM_PODDCDC01TimeoutDTCInfo
    IF_ComM_PODOBCChrgStatMsgErrInfo_Bus
      data tec_ComM_PODOBCChrgStatTimeoutInfo_Bus: type=dt_ComM_PODOBCChrgStatTimeoutInfo
      data tec_ComM_PODOBCChrgStatTimeoutDTCInfo_Bus: type=dt_ComM_PODOBCChrgStatTimeoutDTCInfo
    IF_ComM_SGWPT01MsgErrInfo_Bus
      data tec_ComM_SGWPT01TimeoutInfo_Bus: type=dt_ComM_SGWPT01TimeoutInfo
      data tec_ComM_SGWPT01TimeoutDTCInfo_Bus: type=dt_ComM_SGWPT01TimeoutDTCInfo
    IF_ComM_SGWTimMsgErrInfo_Bus
      data tec_ComM_SGWTimTimeoutInfo_Bus: type=dt_ComM_SGWTimTimeoutInfo
      data tec_ComM_SGWTimTimeoutDTCInfo_Bus: type=dt_ComM_SGWTimTimeoutDTCInfo
    IF_ComM_TCU01MsgErrInfo_Bus
      data tec_ComM_TCU01TimeoutInfo_Bus: type=dt_ComM_TCU01TimeoutInfo
      data tec_ComM_TCU01TimeoutDTCInfo_Bus: type=dt_ComM_TCU01TimeoutDTCInfo
    IF_ComM_CGW01MsgErrInfo_Bus
      data tec_ComM_CGW01TimeoutInfo_Bus: type=dt_ComM_CGW01TimeoutInfo
      data tec_ComM_CGW01TimeoutDTCInfo_Bus: type=dt_ComM_CGW01TimeoutDTCInfo
      data tec_ComM_CGW01CRCDTCInfo_Bus: type=dt_ComM_CGW01CRCDTCInfo
    IF_ComM_BMSErrInfoTimeoutInfo_Bus
      data tec_ComM_BMSErrInfoTimeoutInfo_Bus: type=dt_ComM_BMSErrInfoTimeoutInfo
    IF_ComM_PODSts01TimeoutInfo_Bus
      data tec_ComM_PODSts01TimeoutInfo_Bus: type=dt_ComM_PODSts01TimeoutInfo
    IF_ComM_CBM03MsgErrInfo_Bus
      data tec_ComM_CBM03TimeoutInfo_Bus: type=dt_ComM_CBM03TimeoutInfo
      data tec_ComM_CBM03TimeoutDTCInfo_Bus: type=dt_ComM_CBM03TimeoutDTCInfo
    IF_ComM_MotMaxTq_Nm
      data tec_ComM_MotMaxTq_Nm: type=float32
    IF_ComM_MotMinTq_Nm
      data tec_ComM_MotMinTq_Nm: type=float32
    IF_ComM_MotActTqVld_Flg
      data tec_ComM_MotActTqVld_Flg: type=boolean
    IF_TorqPahMgmt_ReqMotDampSts_Enum
      data tec_TorqPahMgmt_ReqMotDampSts_Enum: type=uint8
    IF_TorqPahMgmt_DesMotTq_Nm
      data tec_TorqPahMgmt_DesMotTq_Nm: type=float32
    IF_TorqPahMgmt_MotActTq_Nm
      data tec_TorqPahMgmt_MotActTq_Nm: type=float32
    IF_TorqPahMgmt_MotActTqVld_Flg
      data tec_TorqPahMgmt_MotActTqVld_Flg: type=boolean
    IF_TorqPahMgmt_WhlActTq_Nm
      data tec_TorqPahMgmt_WhlActTq_Nm: type=float32
    IF_TorqPahMgmt_WhlActTqVld_Flg
      data tec_TorqPahMgmt_WhlActTqVld_Flg: type=boolean
    IF_ErrMgmt_VehErrLvl_Enum
      data tec_ErrMgmt_VehErrLvl_Enum: type=uint8
    IF_HvMgmt_MCUReqSts_Enum
      data tec_HvMgmt_MCUReqSts_Enum: type=uint8
    MCU_TrqAbsMax
      data MCU_TrqAbsMax: type=MCU_TrqAbsMax
    MCU_TrqAbsMin
      data MCU_TrqAbsMin: type=MCU_TrqAbsMin
    IF_ComM_SysIRVal_kOhm
      data tec_ComM_SysIRVal_kOhm: type=uint16
    IF_ComM_BMSBattUDc_V
      data tec_ComM_BMSBattUDc_V: type=float32
    IF_ComM_ApptChrgMdlSts_Enum
      data tec_ComM_ApptChrgMdlSts_Enum: type=uint8
    IF_ComM_SGWChrgCmd_Enum
      data tec_ComM_SGWChrgCmd_Enum: type=uint8
    IF_ComM_SGWMaxChrgSOCSet_Enum
      data tec_ComM_SGWMaxChrgSOCSet_Enum: type=uint8
    IF_ComM_SGWMinDchaSOCSet_Enum
      data tec_ComM_SGWMinDchaSOCSet_Enum: type=uint8
    IF_ComM_IVIDchaSwtSts_Enum
      data tec_ComM_IVIDchaSwtSts_Enum: type=uint8
    IF_ComM_IVIMaxChrgSOCSet_pct
      data tec_ComM_IVIMaxChrgSOCSet_pct: type=uint8
    IF_ComM_IVIMinDchaSOCSet_Enum
      data tec_ComM_IVIMinDchaSOCSet_Enum: type=uint8
    IF_ComM_IVIChrgCmd_Enum
      data tec_ComM_IVIChrgCmd_Enum: type=uint8
    IF_ComM_IBSEscOffSts_Enum
      data tec_ComM_IBSEscOffSts_Enum: type=uint8
    IF_ComM_IBSRLSpd_kph
      data tec_ComM_IBSRLSpd_kph: type=float32
    IF_ComM_IBSRRSpd_kph
      data tec_ComM_IBSRRSpd_kph: type=float32
    IF_ComM_IBSRLSpdVld_Flg
      data tec_ComM_IBSRLSpdVld_Flg: type=boolean
    IF_ComM_IBSRRSpdVld_Flg
      data tec_ComM_IBSRRSpdVld_Flg: type=boolean
    IF_ComM_EPBWrkSts_Enum
      data tec_ComM_EPBWrkSts_Enum: type=uint8
    IF_ComM_BMSWrkMod_Enum
      data tec_ComM_BMSWrkMod_Enum: type=uint8
    IF_ComM_ADCUAPSMod_Enum
      data tec_ComM_ADCUAPSMod_Enum: type=uint8
    IF_ComM_IBSTarGearReq_Enum
      data tec_ComM_IBSTarGearReq_Enum: type=uint8
    IF_ComM_IVIGearReq_Enum
      data tec_ComM_IVIGearReq_Enum: type=uint8
    IF_ComM_GearRNDBtnFltSts_Flg
      data tec_ComM_GearRNDBtnFltSts_Flg: type=boolean
    IF_ComM_GearPBtnFltSts_Flg
      data tec_ComM_GearPBtnFltSts_Flg: type=boolean
    IF_ComM_GearPBtn_Enum
      data tec_ComM_GearPBtn_Enum: type=uint8
    IF_ComM_GearRNDBtn_Enum
      data tec_ComM_GearRNDBtn_Enum: type=uint8
    IF_GearMgmt_TarGear_Enum
      data tec_GearMgmt_TarGear_Enum: type=uint8
    IF_GearMgmt_EPBReq_Enum
      data tec_GearMgmt_EPBReq_Enum: type=uint8
    IF_HvMgmt_ReqModBMS_Enum
      data tec_HvMgmt_ReqModBMS_Enum: type=uint8
    IF_HvMgmt_BMSPosRlyCtrlReq_Enum
      data tec_HvMgmt_BMSPosRlyCtrlReq_Enum: type=uint8
    IF_HvMgmt_DCFCReqSts_Flg
      data tec_HvMgmt_DCFCReqSts_Flg: type=boolean
    IF_ComM_IBSBrkSts_Enum
      data tec_ComM_IBSBrkSts_Enum: type=uint8
    IF_ComM_IBSRbsReqTq_Nm
      data tec_ComM_IBSRbsReqTq_Nm: type=float32
    IF_ComM_IBSRbsReqTqVld_Flg
      data tec_ComM_IBSRbsReqTqVld_Flg: type=boolean
    IF_ComM_IBSDecelReqAvl_Enum
      data tec_ComM_IBSDecelReqAvl_Enum: type=uint8
    IF_ComM_ADCUAccMod_Enum
      data tec_ComM_ADCUAccMod_Enum: type=uint8
    IF_ComM_IBSRbsSts_Enum
      data tec_ComM_IBSRbsSts_Enum: type=uint8
    IF_ComM_IBSVlcActv_Flg
      data tec_ComM_IBSVlcActv_Flg: type=boolean
    IF_ComM_IBSVlcReqTq_Nm
      data tec_ComM_IBSVlcReqTq_Nm: type=float32
    IF_ModMgmt_SysRdy_Flg
      data tec_ModMgmt_SysRdy_Flg: type=boolean
    IF_ModMgmt_ActDrvMod_Enum
      data tec_ModMgmt_ActDrvMod_Enum: type=uint8
    IF_ModMgmt_DrvModSwtWarn_Enum
      data tec_ModMgmt_DrvModSwtWarn_Enum: type=uint8
    IF_ModMgmt_ActRgnSts_Enum
      data tec_ModMgmt_ActRgnSts_Enum: type=uint8
    IF_ComM_IBSAvhSts_Enum
      data tec_ComM_IBSAvhSts_Enum: type=uint8
    IF_ChassisMgmt_BrkCmpWarn_Enum
      data tec_ChassisMgmt_BrkCmpWarn_Enum: type=uint8
    IF_ChassisMgmt_RgnTqCap_Nm
      data tec_ChassisMgmt_RgnTqCap_Nm: type=float32
    IF_ChassisMgmt_RgnTqCapVld_Flg
      data tec_ChassisMgmt_RgnTqCapVld_Flg: type=boolean
    IF_ChassisMgmt_AccrPedlDesTq_Nm
      data tec_ChassisMgmt_AccrPedlDesTq_Nm: type=float32
    IF_ChassisMgmt_IBSApsReqTqActv_Flg
      data tec_ChassisMgmt_IBSApsReqTqActv_Flg: type=boolean
    IF_ChassisMgmt_IBSApsReqTqAvl_Flg
      data tec_ChassisMgmt_IBSApsReqTqAvl_Flg: type=boolean
    IF_ChassisMgmt_DrvAsscCtrlOvrdSts_Flg
      data tec_ChassisMgmt_DrvAsscCtrlOvrdSts_Flg: type=boolean
    IF_ChassisMgmt_IBSVlcReqTqActv_Flg
      data tec_ChassisMgmt_IBSVlcReqTqActv_Flg: type=boolean
    IF_ChassisMgmt_IBSVlcReqTqAvl_Flg
      data tec_ChassisMgmt_IBSVlcReqTqAvl_Flg: type=boolean
    IF_ComM_IBSApsTqActv_Flg
      data tec_ComM_IBSApsTqActv_Flg: type=boolean
    IF_ComM_IBSPlgrPrs_Bar
      data tec_ComM_IBSPlgrPrs_Bar: type=float32
    IF_ChassisMgmt_VehDecelSpdSts_Flg
      data tec_ChassisMgmt_VehDecelSpdSts_Flg: type=boolean
    IF_ChassisMgmt_DesVehDecelSpd_mps2q
      data tec_ChassisMgmt_DesVehDecelSpd_mps2q: type=float32
    IF_ComM_IBSDtcActv_Flg
      data tec_ComM_IBSDtcActv_Flg: type=boolean
    IF_ComM_BattMaxTemp_C
      data tec_ComM_BMSBattMaxTemp_C: type=sint8
    IF_ComM_BMSRemnChrgTim_min
      data tec_ComM_BMSRemnChrgTim_min: type=uint16
    IF_ComM_ChrgnRchTarCellUDc_Enum
      data tec_ComM_ChrgnRchTarCellUDc_Enum: type=uint8
    IF_ComM_ChrgnRchTarTotUDc_Enum
      data tec_ComM_ChrgnRchTarTotUDc_Enum: type=uint8
    IF_ComM_AbortFltBMSTemp_Enum
      data tec_ComM_AbortFltBMSTemp_Enum: type=uint8
    IF_ComM_AbortFltBattTemp_Enum
      data tec_ComM_AbortFltBattTemp_Enum: type=uint8
    IF_ComM_AbortErrIDc_Enum
      data tec_ComM_AbortErrIDc_Enum: type=uint8
    IF_ComM_ChrgnRchSetVal_Enum
      data tec_ComM_ChrgnRchSetVal_Enum: type=uint8
    IF_ComM_AbortErrUDc_Enum
      data tec_ComM_AbortErrUDc_Enum: type=uint8
    IF_ComM_BMSChrgCmplSts_Enum
      data tec_ComM_BMSChrgCmplSts_Enum: type=uint8
    IF_ComM_BMSChrgReqSts_Enum
      data tec_ComM_BMSChrgReqSts_Enum: type=uint8
    IF_ComM_OBCInpIAc_A
      data tec_ComM_OBCInpIAc_A: type=float32
    IF_ComM_PODDCFCUDc_V
      data tec_ComM_PODDCFCUDc_V: type=float32
    IF_ComM_DcInletBSnsrSts_Enum
      data tec_ComM_DcInletBSnsrSts_Enum: type=uint8
    IF_ComM_DcInletASnsrSts_Enum
      data tec_ComM_DcInletASnsrSts_Enum: type=uint8
    IF_ComM_TCUHvPwrSts_Enum
      data tec_ComM_TCUHvPwrSts_Enum: type=uint8
    IF_ComM_BMSKeepWrmSts_Enum
      data tec_ComM_BMSKeepWrmSts_Enum: type=uint8
    IF_ComM_BMSKeepWrmReq_Enum
      data tec_ComM_BMSKeepWrmReq_Enum: type=uint8
    IF_ErrMgmt_DrvMotTempOvrLamp_Bus
      data tec_ErrMgmt_DrvMotTempOvrLamp_Bus: type=dt_ErrMgmt_DrvMotTempOvrLamp
    IF_ErrMgmt_HvBattTempOvrLamp_Bus
      data tec_ErrMgmt_HvBattTempOvrLamp_Bus: type=dt_ErrMgmt_HvBattTempOvrLamp
    IF_ErrMgmt_SysFailLamp_Enum
      data tec_ErrMgmt_SysFailLamp_Enum: type=uint8
    IF_ErrMgmt_DCDCFailLamp_Flg
      data tec_ErrMgmt_DCDCFailLamp_Flg: type=boolean
    IF_ErrMgmt_MCUFltLamp
      data tec_ErrMgmt_MCUFltLamp: type=uint8
    IF_ErrMgmt_HvBattFailLamp_Flg
      data tec_ErrMgmt_HvBattFailLamp_Flg: type=boolean
    IF_ErrMgmt_LimpHomeLamp_Flg
      data tec_ErrMgmt_LimpHomeLamp_Flg: type=boolean
    IF_ChrMgmt_PlugSts_Enum
      data tec_ChrMgmt_PlugSts_Enum: type=uint8
    IF_ChrMgmt_VCUDispChrgI_A
      data tec_ChrMgmt_VCUDispChrgI_A: type=float32
    IF_ChrMgmt_ChrgPwr_kW
      data tec_ChrMgmt_VCUDispChrgPwr_kW: type=float32
    IF_ChrMgmt_VCUDispChrgU_V
      data tec_ChrMgmt_VCUDispChrgU_V: type=float32
    IF_ChrMgmt_ChrgAbortRsn_Enum
      data tec_ChrMgmt_ChrgAbortRsn_Enum: type=uint8
    IF_ChrMrmt_DchaAbortRsn_Enum
      data tec_ChrMgmt_DchaAbortRsn_Enum: type=uint8
    IF_ChrMgmt_ChrgnRemnTim_min
      data tec_ChrgMgmt_ChrgnRemnTim_min: type=uint16
    IF_HvMgmt_HVConnFlt_Flg
      data tec_HvMgmt_HVConnFlt_Flg: type=boolean
    IF_GearMgmt_InvldGearSel_Enum
      data tec_GearMgmt_InvldGearSel_Enum: type=uint8
    PWT_ErrorLevel
      data PWT_ErrorLevel: type=PWT_ErrorLevel
    IF_ComM_IBSReqIncTqSts_Flg
      data tec_ComM_IBSReqIncTqSts_Flg: type=boolean
    IF_ComM_IBSReqRednTqSts_Flg
      data tec_ComM_IBSReqRednTqSts_Flg: type=boolean
    IF_ComM_IBSReqIncTq_Nm
      data tec_ComM_IBSReqIncTq_Nm: type=float32
    IF_ComM_IBSReqRednTq_Nm
      data tec_ComM_IBSReqRednTq_Nm: type=float32
    IF_ChassisMgmt_BrkSts_Enum
      data tec_ChassisMgmt_BrkSts_Enum: type=uint8
    VCU_Enable_DC_Relay
      data VCU_Enable_DC_Relay: type=VCU_Enable_DC_Relay
    VCU_EnableOBC
      data VCU_EnableOBC: type=VCU_EnableOBC
    VCU_OBC_ChargeCurrentCommand
      data VCU_OBC_ChargeCurrentCommand: type=VCU_OBC_ChargeCurrentCommand
    VCU_OBC_Control_of_em_lock
      data VCU_OBC_Control_of_em_lock: type=VCU_OBC_Control_of_em_lock
    VCU_OBC_Control_of_S2_SW
      data VCU_OBC_Control_of_S2_SW: type=VCU_OBC_Control_of_S2_SW
    IF_ComM_MinCellUDcErrSts_Enum
      data tec_ComM_MinCellUDcErrSts_Enum: type=uint8
    IF_ComM_MaxCellUDcErrSts_Enum
      data tec_ComM_MaxCellUDcErrSts_Enum: type=uint8
    IF_ComM_ChrgnIDcErrSts_Enum
      data tec_ComM_ChrgnIDcErrSts_Enum: type=uint8
    IF_ComM_BMSSOCErrHiSts_Enum
      data tec_ComM_BMSSOCHiErrSts_Enum: type=uint8
    IF_ComM_BMSSOCErrLoSts_Enum
      data tec_ComM_BMSSOCLoErrSts_Enum: type=uint8
    IF_ComM_BMSErrRlySts_Enum
      data tec_ComM_BMSErrRlySts_Enum: type=uint8
    IF_ComM_OBCErrLvl_Enum
      data tec_ComM_OBCErrLvl_Enum: type=uint8
    IF_ComM_DCDCErrLvl_Enum
      data tec_ComM_DCDCErrLvl_Enum: type=uint8
    IF_ChrMgmt_ChrgTarSOC_pct
      data tec_ChrMgmt_ChrgTarSOC_pct: type=uint8
    IF_ChrMgmt_DchaAbortSOC_pct
      data tec_ChrMgmt_DchaAbortSOC_pct: type=uint8
    BMS_ErrorCellHighTemp
      data BMS_ErrorCellHighTemp: type=BMS_ErrorCellHighTemp
    BMS_ErrorCellOverVolt
      data BMS_ErrorCellOverVolt: type=BMS_ErrorCellOverVolt
    BMS_ErrorCellUnderVolt
      data BMS_ErrorCellUnderVolt: type=BMS_ErrorCellUnderVolt
    BMS_ErrorChaCurrentOver
      data BMS_ErrorChaCurrentOver: type=BMS_ErrorChaCurrentOver
    BMS_ErrorHighSoc
      data BMS_ErrorHighSoc: type=BMS_ErrorHighSoc
    BMS_ErrorLowSoc
      data BMS_ErrorLowSoc: type=BMS_ErrorLowSoc
    BMS_ErrorRelay
      data BMS_ErrorRelay: type=BMS_ErrorRelay
    BCM_AntiTheftSts
      data BCM_AntiTheftSts: type=BCM_AntiTheftSts
    POD_OBC_FaultLevel
      data POD_OBC_FaultLevel: type=POD_OBC_FaultLevel
    POD_DCDC_FaultLevel
      data POD_DCDC_FaultLevel: type=POD_DCDC_FaultLevel
    BMS_KeepWarmRequest
      data BMS_KeepWarmRequest: type=BMS_KeepWarmRequest
    BMS_KeepWarmStatus
      data BMS_KeepWarmStatus: type=BMS_KeepWarmStatus
    VCU_ChargeEndReason
      data VCU_ChargeEndReason: type=VCU_ChargeEndReason
    VCU_DischargeEndReason
      data VCU_DischargeEndReason: type=VCU_DischargeEndReason
    VCU_HVConnectFault
      data VCU_HVConnectFault: type=VCU_HVConnectFault
    VCU_RemainChrgTime
      data VCU_RemainChrgTime: type=VCU_RemainChrgTime
    IF_ComM_IBSTcsActv_Flg
      data tec_ComM_IBSTcsActv_Flg: type=boolean
    IF_ComM_IBSVdcActv_Flg
      data tec_ComM_IBSVdcActv_Flg: type=boolean
    IF_ComM_IBSHdcSts_Enum
      data tec_ComM_IBSHdcSts_Enum: type=uint8
    IF_ComM_BMSSts01ErrInfo_Bus
      5 x data:
        tec_ComM_BMSSts01E2ETimeoutInfo_Bus: type=dt_ComM_BMSSts01E2ETimeoutInfo
        tec_ComM_BMSSts01TimeoutDTCInfo_Bus: type=dt_ComM_BMSSts01TimeoutDTCInfo
        tec_ComM_BMSSts01CRCInfo_Bus: type=dt_ComM_BMSSts01CRCInfo
        tec_ComM_BMSSts01CRCDTCInfo_Bus: type=dt_ComM_BMSSts01CRCDTCInfo
        tec_ComM_BMSSts01TimeoutInfo_Bus: type=dt_ComM_BMSSts01TimeoutInfo
    IF_ComM_CBMSysRdyReq_Enum
      data tec_ComM_CBMSysRdyReq_Enum: type=uint8
    IF_ComM_IBSVlcReqTqVld_Flg
      data tec_ComM_IBSVlcReqTqVld_Flg: type=boolean
    IF_ComM_IBSApsReqTq_Nm
      data tec_ComM_IBSApsReqTq_Nm: type=float32
    IF_ComM_IBSApsReqTqVld_Flg
      data tec_ComM_IBSApsReqTqVld_Flg: type=uint8
    IF_ChassisMgmt_AccrPedlPosnRaw_pct
      data tec_ChassisMgmt_AccrPedlPosnRaw_pct: type=float32
    IF_ComM_IVIEnaBrkCmpMod_Enum
      data tec_ComM_IVIEnaBrkCmpMod_Enum: type=uint8
    CBM_SystemReadyReq
      data CBM_SystemReadyReq: type=CBM_SystemReadyReq
    SGW_ChargeFormSet
      data SGW_ChargeFormSet: type=SGW_ChargeFormSet
    SGW_AppointChargeCmd
      data SGW_AppointChargeCmd: type=SGW_AppointChargeCmd
    SGW_MaxChrgSocSet
      data SGW_MaxChrgSocSet: type=SGW_MaxChrgSocSet
    SGW_V2LidisSet
      data SGW_V2LidisSet: type=SGW_V2LidisSet
    IVI_AppointChargeCmd
      data IVI_AppointChargeCmd: type=IVI_AppointChargeCmd
    IVI_DschrgOnOffSet
      data IVI_DschrgOnOffSet: type=IVI_DschrgOnOffSet
    IVI_LockACPlug
      data IVI_LockACPlug: type=IVI_LockACPlug
    IVI_MaxChrgSocSet
      data IVI_MaxChrgSocSet: type=IVI_MaxChrgSocSet
    IVI_V2LidisSet
      data IVI_V2LidisSet: type=IVI_V2LidisSet
    IVI_ForwardVmaxAllowed
      data IVI_ForwardVmaxAllowed: type=IVI_ForwardVmaxAllowed
    IVI_ForwardVmaxlimitSw
      data IVI_ForwardVmaxlimitSw: type=IVI_ForwardVmaxlimitSw
    VCU_DCDCPowerLimit
      data VCU_DCDCPowerLimit: type=VCU_DCDCPowerLimit
    VCU_TCUPowerAllowed
      data VCU_TCUPowerAllowed: type=VCU_TCUPowerAllowed
    BMS_MaxCellTemp
      data BMS_MaxCellTemp: type=BMS_MaxCellTemp
    BMS_MinCellTemp
      data BMS_MinCellTemp: type=BMS_MinCellTemp
    BMS_RemChagTime
      data BMS_RemChagTime: type=BMS_RemChagTime
    BMS_MaxChagVoltage
      data BMS_MaxChagVoltage: type=BMS_MaxChagVoltage
    BMS_AbortAchivesetValue
      data BMS_AbortAchivesetValue: type=BMS_AbortAchivesetValue
    BMS_AbortAchiveSingleVolt
      data BMS_AbortAchiveSingleVolt: type=BMS_AbortAchiveSingleVolt
    BMS_AbortAchiveTotalVolt
      data BMS_AbortAchiveTotalVolt: type=BMS_AbortAchiveTotalVolt
    BMS_AbortErrorCurrent
      data BMS_AbortErrorCurrent: type=BMS_AbortErrorCurrent
    BMS_AbortErrorVoltage
      data BMS_AbortErrorVoltage: type=BMS_AbortErrorVoltage
    BMS_AbortFaultBatteryTemp
      data BMS_AbortFaultBatteryTemp: type=BMS_AbortFaultBatteryTemp
    BMS_AbortFaultBMSTemp
      data BMS_AbortFaultBMSTemp: type=BMS_AbortFaultBMSTemp
    BMS_DCChgMode
      data BMS_DCChgMode: type=BMS_DCChgMode
    BMS_ChagComplete
      data BMS_ChagComplete: type=BMS_ChagComplete
    BMS_ChargeRequest
      data BMS_ChargeRequest: type=BMS_ChargeRequest
    BMS_LinkVoltage
      data BMS_LinkVoltage: type=BMS_LinkVoltage
    POD_OBC_CPCurrentLimit
      data POD_OBC_CPCurrentLimit: type=POD_OBC_CPCurrentLimit
    POD_OBC_CPDuty
      data POD_OBC_CPDuty: type=POD_OBC_CPDuty
    POD_OBC_EMLockState
      data POD_OBC_EMLockState: type=POD_OBC_EMLockState
    POD_OBC_ChargCapacibility
      data POD_OBC_ChargCapacibility: type=POD_OBC_ChargCapacibility
    POD_OBC_OBCMaxPermOutpCrrt
      data POD_OBC_OBCMaxPermOutpCrrt: type=POD_OBC_OBCMaxPermOutpCrrt
    POD_OBC_S2State
      data POD_OBC_S2State: type=POD_OBC_S2State
    POD_OBC_InputACCurrent_R
      data POD_OBC_InputACCurrent_R: type=POD_OBC_InputACCurrent_R
    POD_OBC_InputACVoltage_R
      data POD_OBC_InputACVoltage_R: type=POD_OBC_InputACVoltage_R
    POD_DCFCVoltage
      data POD_DCFCVoltage: type=POD_DCFCVoltage
    POD_DCInletTempA
      data POD_DCInletTempA: type=POD_DCInletTempA
    POD_DCInletTempB
      data POD_DCInletTempB: type=POD_DCInletTempB
    POD_DCPortInletTempAValid
      data POD_DCPortInletTempAValid: type=POD_DCPortInletTempAValid
    POD_DCPortInletTempBValid
      data POD_DCPortInletTempBValid: type=POD_DCPortInletTempBValid
    VCU_MCUPower
      data VCU_MCUPower: type=VCU_MCUPower
    VCU_PermitPackPTC
      data VCU_PermitPackPTC: type=VCU_PermitPackPTC
    TCU_HVPwrState
      data TCU_HVPwrState: type=TCU_HVPwrState
    TCU_TMSFaultLevel
      data TCU_TMSFaultLevel: type=TCU_TMSFaultLevel
    VCU_ForwardVmaxlimitStatus
      data VCU_ForwardVmaxlimitStatus: type=VCU_ForwardVmaxlimitStatus
    VCU_BrakeCompensateStatus
      data VCU_BrakeCompensateStatus: type=VCU_BrakeCompensateStatus
    VCU_ChargeEnergy
      data VCU_ChargeEnergy: type=VCU_ChargeEnergy
    VCU_ChargeProcessComment
      data VCU_ChargeProcessComment: type=VCU_ChargeProcessComment
    VCU_ChargeTime
      data VCU_ChargeTime: type=VCU_ChargeTime
    VCU_DCFCCurrent
      data VCU_DCFCCurrent: type=VCU_DCFCCurrent
    VCU_EnergyV2L
      data VCU_EnergyV2L: type=VCU_EnergyV2L
    VCU_ManuallyUnlockComment
      data VCU_ManuallyUnlockComment: type=VCU_ManuallyUnlockComment
    VCU_MaximumOutputCurrent
      data VCU_MaximumOutputCurrent: type=VCU_MaximumOutputCurrent
    VCU_MaximumOutputVoltage
      data VCU_MaximumOutputVoltage: type=VCU_MaximumOutputVoltage
    VCU_MemoryChargeFault
      data VCU_MemoryChargeFault: type=VCU_MemoryChargeFault
    VCU_MinimumOutputCurrent
      data VCU_MinimumOutputCurrent: type=VCU_MinimumOutputCurrent
    VCU_MinimumOutputVoltage
      data VCU_MinimumOutputVoltage: type=VCU_MinimumOutputVoltage
    VCU_RequestedModeDCDC
      data VCU_RequestedModeDCDC: type=VCU_RequestedModeDCDC
    VCU_RequestedModeTCU
      data VCU_RequestedModeTCU: type=VCU_RequestedModeTCU
    VCU_VoltageDemandLV
      data VCU_VoltageDemandLV: type=VCU_VoltageDemandLV
    VCU_Display_voltage
      data VCU_Display_voltage: type=VCU_Display_voltage
    VCU_IsoMeasurementSwitch
      data VCU_IsoMeasurementSwitch: type=VCU_IsoMeasurementSwitch
    BMS_RatCapacity
      data BMS_RatCapacity: type=BMS_RatCapacity
    IF_FctSftyMon_AccrPedlTqOverFltInfo_Bus
      data tec_FctSftyMon_AccrPedlTqOverFltInfo_Bus: type=dt_FctSftyMon_AccrPedlTqOverFltInfo
    IF_FctSftyMon_CrpCtrlTqOverFltInfo_Bus
      data tec_FctSftyMon_CrpCtrlTqOverFltInfo_Bus: type=dt_FctSftyMon_CrpCtrlTqOverFltInfo
    IF_FctSftyMon_DesVehDecelSpdOverFltInfo_Bus
      data tec_FctSftyMon_DesVehDecelSpdOverFltInfo_Bus: type=dt_FctSftyMon_DesVehDecelSpdOverFltInfo
    IF_ComM_IVIFwdMaxVehSpdLmtSwt_Enum
      data tec_ComM_IVIFwdMaxVehSpdLmtSwt_Enum: type=uint8
    IF_ComM_IVIFwdVehSpdAllwd_Enum
      data tec_ComM_IVIFwdVehSpdAllwd_Enum: type=uint8
    SGW_TimeInfoSecond
      data SGW_TimeInfoSecond: type=SGW_TimeInfoSecond
    IF_ComM_BattMinTemp_C
      data tec_ComM_BMSBattMinTemp_C: type=sint8
    IF_ComM_BCMImmoSts_Flg
      data tec_ComM_BCMImmoSts_Flg: type=boolean
    IF_ComM_TCUErrLvl_Enum
      data tec_ComM_TCUErrLvl_Enum: type=uint8
    IF_ComM_MCUErrLvl_Enum
      data tec_ComM_MCUErrLvl_Enum: type=uint8
    IF_TorqPahMgmt_FwdMaxVehSpd_Enum
      data tec_TorqPahMgmt_FwdMaxVehSpd_Enum: type=uint8
    IF_TorqPahMgmt_FwdMaxSpdSts_Flg
      data tec_TorqPahMgmt_FwdMaxSpdSts_Flg: type=boolean
    IF_ChrMgmt_ChrgProcCmt_Enum
      data tec_ChrMgmt_ChrgProcCmt_Enum: type=uint8
    IF_ChrMgmt_ChrgMemFlt_Flg
      data tec_ChrMgmt_ChrgMemFlt_Flg: type=boolean
    IF_ChrMgmt_OBCSideSngDchaEgy_kWh
      data tec_ChrMgmt_OBCSideSngDchaEgy_kWh: type=float32
    IF_DCChrMgmt_MaxChrgIDc_A
      data tec_DCChrMgmt_MaxChrgIDc_A: type=float32
    IF_DCChrMgmt_MaxChrgUDc_V
      data tec_DCChrMgmt_MaxChrgUDc_V: type=float32
    IF_DCChrMgmt_MinChrgIDc_A
      data tec_DCChrMgmt_MinChrgIDc_A: type=float32
    IF_DCChrMgmt_MinChrgUDc_V
      data tec_DCChrMgmt_MinChrgUDc_V: type=float32
    IF_ChrMgmt_SngChrgEgy_kWh
      data tec_ChrMgmt_SngChrgEgy_kWh: type=float32
    IF_ChrMgmt_ChrgTim_min
      data tec_ChrMgmt_ChrgTim_min: type=uint16
    IF_HvMgmt_ReqDCDCMod_Enum
      data tec_HvMgmt_ReqDCDCMod_Enum: type=uint8
    IF_HvMgmt_DCDCDmdLvUDc_V
      data tec_HvMgmt_DCDCDmdLvUDc_V: type=float32
    IF_HvMgmt_ReqTCUMod_Enum
      data tec_HvMgmt_ReqTCUMod_Enum: type=uint8
    IF_ChassisMgmt_BrkCmpSts_Enum
      data tec_ChassisMgmt_BrkCmpSts_Enum: type=uint8
    IF_ErrMgmt_InslaFlt_Bus
      data tec_ErrMgmt_InslaFlt_Bus: type=dt_ErrMgmt_InslaFlt
    IF_ErrMgmt_VehHVIL_Bus
      data tec_ErrMgmt_VehHVIL_Bus: type=dt_ErrMgmt_VehHVIL
    IF_ComM_ComDTCFailr
      21 x data, all with type=boolean:
        tec_ComM_CHIBSComDTCFailr_Flg
        tec_ComM_ACUComDTCFailr_Flg
        tec_ComM_ADCUComDTCFailr_Flg
        tec_ComM_TCUComDTCFailr_Flg
        tec_ComM_MCUComDTCFailr_Flg
        tec_ComM_BMSComDTCFailr_Flg
        tec_ComM_IVIComDTCFailr_Flg
        tec_ComM_DCDCComDTCFailr_Flg
        tec_ComM_PRNDComDTCFailr_Flg
        tec_ComM_BCMComDTCFailr_Flg
        tec_ComM_SGWComDTCFailr_Flg
        tec_ComM_CGWComDTCFailr_Flg
        tec_ComM_APTCComDTCFailr_Flg
        tec_ComM_EVCOMComDTCFailr_Flg
        tec_ComM_EPTIBSComDTCFailr_Flg
        tec_ComM_OBCComDTCFailr_Flg
        tec_ComM_DCMFLComDTCFailr_Flg
        tec_ComM_DCMFRComDTCFailr_Flg
        tec_ComM_DCMRLComDTCFailr_Flg
        tec_ComM_DCMRRComDTCFailr_Flg
        tec_ComM_SGWCHComDTCFailr_Flg
    IF_ComM_NodComFailr
      22 x data, all with type=boolean:
        tec_ComM_BMSNodComFailr_Flg
        tec_ComM_DCMNodComFailr_Flg
        tec_ComM_EPTIBSNodComFailr_Flg
        tec_ComM_EVCOMNodComFailr_Flg
        tec_ComM_MCUNodComFailr_Flg
        tec_ComM_CHIBSNodComFailr_Flg
        tec_ComM_OBCNodComFailr_Flg
        tec_ComM_DCDCNodComFailr_Flg
        tec_ComM_IVINodComFailr_Flg
        tec_ComM_PRNDNodComFailr_Flg
        tec_ComM_BCMNodComFailr_Flg
        tec_ComM_TCUNodComFailr_Flg
        tec_ComM_CGWNodComFailr_Flg
        tec_ComM_SGWNodComFailr_Flg
        tec_ComM_ACUNodComFailr_Flg
        tec_ComM_ADCUNodComFailr_Flg
        tec_ComM_APTCNodComFailr_Flg
        tec_ComM_DCMFLNodComFailr_Flg
        tec_ComM_DCMFRNodComFailr_Flg
        tec_ComM_DCMRLNodComFailr_Flg
        tec_ComM_DCMRRNodComFailr_Flg
        tec_ComM_SGWCHNodComFailr_Flg
    IF_OBCMgmt_OBCInpUDcLoErrDTC_Bus
      data tec_OBCMgmt_OBCInpUDcLoErrDTC_Bus: type=dt_OBCMgmt_OBCInpUDcLoErrDTC
    IF_OBCMgmt_S2SwtClsErrDTC_Bus
      data tec_OBCMgmt_S2SwtClsErrDTC_Bus: type=dt_OBCMgmt_S2SwtClsErrDTC
    IF_OBCMgmt_S2SwtOpenErrDTC_Bus
      data tec_OBCMgmt_S2SwtOpenErrDTC_Bus: type=dt_OBCMgmt_S2SwtOpenErrDTC
    IF_OBCMgmt_CPStsJmpErrDTC_Bus
      data tec_OBCMgmt_CPStsJmpErrDTC_Bus: type=dt_OBCMgmt_CPStsJmpErrDTC
    IF_OBCMgmt_OBCChrgStsErrDTC_Bus
      data tec_OBCMgmt_OBCChrgStsErrDTC_Bus: type=dt_OBCMgmt_OBCChrgStsErrDTC
    IF_OBCMgmt_OBCPreheatStsErrDTC_Bus
      data tec_OBCMgmt_OBCPreheatStsErrDTC_Bus: type=dt_OBCMgmt_OBCPreheatStsErrDTC
    IF_OBCMgmt_OBCDchaStsErrDTC_Bus
      data tec_OBCMgmt_OBCDchaStsErrDTC_Bus: type=dt_OBCMgmt_OBCDchaStsErrDTC
    IF_OBCMgmt_OBCDiErrDTC_Bus
      data tec_OBCMgmt_OBCDiErrDTC_Bus: type=dt_OBCMgmt_OBCDiErrDTC
    IF_OBCMgmt_ElectcLockClsErrDTC_Bus
      data tec_OBCMgmt_ElectcLockClsErrDTC_Bus: type=dt_OBCMgmt_ElectcLockClsErrDTC
    IF_OBCMgmt_ElectcLockOpenErrDTC_Bus
      data tec_OBCMgmt_ElectcLockOpenErrDTC_Bus: type=dt_OBCMgmt_ElectcLockOpenErrDTC
    IF_ChrMgmt_ReqLvActv_Flg
      data tec_ChrMgmt_ReqLvActv_Flg: type=boolean
    IF_ChrMgmt_ChrgStsJmpErr_Bus
      data tec_ChrMgmt_ChrgStsJmpErr_Bus: type=dt_ChrMgmt_ChrgStsJmpErr
    IF_ChrMgmt_CC2UDcErr_Bus
      data tec_ChrMgmt_CC2UDcErr_Bus: type=dt_ChrMgmt_CC2UDcErr
    IF_ChrMgmt_ChrgStsJmpDTC_Bus
      data tec_ChrMgmt_ChrgStsJmpErrDTC_Bus: type=dt_ChrMgmt_ChrgStsJmpErrDTC
    IF_ChrMgmt_CC2UDcDTC_Bus
      data tec_ChrMgmt_CC2UDcErrDTC_Bus: type=dt_ChrMgmt_CC2UDcDTC
    IF_ChgMrmt_DchaAbortRsn_Enum
      data tec_ChrMgmt_DchaAbortRsn_Enum: type=uint8
    IF_IOAbs_CC2SigUDc_mV
      data tec_IOAbs_CC2SigUDc_mV: type=uint16
    IF_ChrMgmt_KeepWrmTim_min
      data tec_ChrMgmt_KeepWrmTim_min: type=uint16
    IF_ComM_UDSHVOffReq_Flg
      data tec_ComM_UDSHVOffReq_Flg: type=boolean
    IF_ErrMgmt_AcStop_Flg
      data tec_ErrMgmt_AcStop_Flg: type=boolean
    IF_ErrMgmt_DcStop_Flg
      data tec_ErrMgmt_DcStop_Flg: type=boolean
    IF_ErrMgmt_V2LStop_Flg
      data tec_ErrMgmt_V2LStop_Flg: type=boolean
    IF_GearMgmt_UnCfmdActGear_Enum
      data tec_GearMgmt_UnCfmdActGear_Enum: type=uint8
    IF_FctSftyMon_ActGearCfmFail_Bus
      data tec_FctSftyMon_ActGearCfmFail_Bus: type=dt_FctSftyMon_ActGearCfmFail
    IF_FctSftyMon_FUSATarGear_Enum
      data tec_FctSftyMon_FUSATarGear_Enum: type=uint8
    IF_FctSftyMon_ActGearCfmFail_Flg
      data tec_FctSftyMon_ActGearCfmFail_Flg: type=boolean
    IF_ChassisMgmt_CrpCtrlDesTq_Nm
      data tec_ChassisMgmt_CrpCtrlDesTq_Nm: type=float32
    IF_IOAbs_AccrPedlMaiRaw_mV
      data tec_IOAbs_AccrPedlMaiRaw_mV: type=uint16
    IF_IOAbs_AccrPedlRdnRaw_mV
      data tec_IOAbs_AccrPedlRdnRaw_mV: type=uint16
    IF_ChassisMgmt_LimpHomeSts_Flg
      data tec_ChassisMgmt_LimpHomeSts_Flg: type=boolean
    IF_ChassisMgmt_AccrPedlURaw1HiDTC_Bus
      data tec_ChassisMgmt_AccrPedlURaw1HiDTC_Bus: type=dt_ChassisMgmt_AccrPedlURaw1Hi
    IF_ChassisMgmt_AccrPedlURaw1LoDTC_Bus
      data tec_ChassisMgmt_AccrPedlURaw1LoDTC_Bus: type=dt_ChassisMgmt_AccrPedlURaw1Lo
    IF_ChassisMgmt_AccrPedlURaw2HiDTC_Bus
      data tec_ChassisMgmt_AccrPedlURaw2HiDTC_Bus: type=dt_ChassisMgmt_AccrPedlURaw2Hi
    IF_ChassisMgmt_AccrPedlURaw2LoDTC_Bus
      data tec_ChassisMgmt_AccrPedlURaw2LoDTC_Bus: type=dt_ChassisMgmt_AccrPedlURaw2Lo
    IF_ChassisMgmt_AccrPedlURawArnbl_Bus
      data tec_ChassisMgmt_AccrPedlURawArnbl_Bus: type=dt_ChassisMgmt_AccrPedlURawArnbl
    IF_ChassisMgmt_AccrPedlURawDifDTC_Bus
      data tec_ChassisMgmt_AccrPedlURawDifDTC_Bus: type=dt_ChassisMgmt_AccrPedlURawDif
    IF_ChassisMgmt_AccrPedlURawDifAndSngAbnrl_Bus
      data tec_ChassisMgmt_AccrPedlURawDifAndSngAbnrl_Bus: type=dt_ChassisMgmt_AccrPedlURawDifAndSngAbnrl
    IF_ComM_IBSRbsReqTqVld_Enum
      data tec_ComM_IBSRbsReqTqVld_Enum: type=uint8
    IF_ModMgmt_SptModWarnLoSOC_Bus
      data tec_ModMgmt_SptModWarnLoSOC_Bus: type=dt_ModMgmt_SptModWarnLoSOC
    IF_ModMgmt_OnePedlWarnHiSpd_Bus
      data tec_ModMgmt_OnePedlWarnHiSpd_Bus: type=dt_ModMgmt_OnePedlWarnHiSpd
    IF_ModMgmt_OnePedlWarnVehFaild_Bus
      data tec_ModMgmt_OnePedlWarnVehFaild_Bus: type=dt_ModMgmt_OnePedlWarnVehFaild
    IF_HvMgmt_MCUWrkModActSts_Enum
      data tec_HvMgmt_MCUWrkModActSts_Enum: type=uint8
    IF_ModMgmt_ReqSleep_Flg
      data tec_ModMgmt_ReqSleep_Flg: type=boolean
    IF_ComM_BMSBattRemnCp_Ah
      data tec_ComM_BMSBattRemnCp_Ah: type=float32
    IF_TorqPahMgmt_MaxVehSpdLmtTq_Nm
      data tec_TorqPahMgmt_MaxVehSpdLmtTq_Nm: type=float32
    IF_TorqPahMgmt_MaxVehSpdLmtTqSts_Flg
      data tec_TorqPahMgmt_MaxVehSpdLmtTqSts_Flg: type=boolean
    IF_ChassisMgmt_DrvDmdHiPrio_Flg
      data tec_ChassisMgmt_DrvDmdHiPrio_Flg: type=boolean
    IF_ChassisMgmt_DrvCoorDesTq_Nm
      data tec_ChassisMgmt_DrvCoorrDesTq_Nm: type=float32
    IF_TorqPahMgmt_DesLpFildTq_Nm
      data tec_TorqPahMgmt_DesLpFildTq_Nm: type=float32
    IF_TorqPahMgmt_DesFildTq_Nm
      data tec_TorqPahMgmt_DesFildTq_Nm: type=float32
    IF_ChassisMgmt_IBSDesIncTq_Nm
      data tec_ChassisMgmt_IBSDesIncTq_Nm: type=float32
    IF_ChassisMgmt_IBSDesRednTq_Nm
      data tec_ChassisMgmt_IBSDesRednTq_Nm: type=float32
    IF_ChassisMgmt_IBSIntvIncTqActv_Flg
      data tec_ChassisMgmt_IBSIntvIncTqActv_Flg: type=boolean
    IF_ChassisMgmt_IBSIntvRednTqActv_Flg
      data tec_ChassisMgmt_IBSIntvRednTqActv_Flg: type=boolean
    IF_TorqPahMgmt_DesCoorrTq_Nm
      data tec_TorqPahMgmt_DesCoorrTq_Nm: type=float32
    IF_HvMgmt_MCUReqTorqZero_Flg
      data tec_HvMgmt_MCUReqTorqZero_Flg: type=boolean
    IF_GearMgmt_TarGearPInhbTq_Flg
      data tec_GearMgmt_TarGearPInhbTq_Flg: type=boolean
    IF_TorqPahMgmt_TramProtdLimMaxTq_Nm
      data tec_TorqPahMgmt_TramProtdLmtMaxTq_Nm: type=float32
    IF_TorqPahMgmt_TramProtdLimMinTq_Nm
      data tec_TorqPahMgmt_TramProtdLmtMinTq_Nm: type=float32
    IF_TorqPahMgmt_EmacDynMaxTq_Nm
      data tec_TorqPahMgmt_EmacDynMaxTq_Nm: type=float32
    IF_TorqPahMgmt_EmacDynMinTq_Nm
      data tec_TorqPahMgmt_EmacDynMinTq_Nm: type=float32
    IF_TorqPhMgmt_EmacQstyMaxTq_Nm
      data tec_TorqPahMgmt_EmacQstyMaxTq_Nm: type=float32
    IF_TorqPhMgmt_EmacQstyMinTq_Nm
      data tec_TorqPahMgmt_EmacQstyMinTq_Nm: type=float32
    IF_ErrMgmt_TorqCtrlErr_Bus
      data tec_ErrMgmt_TorqCtrlErr_Bus: type=dt_ErrMgmt_TorqCtrlErr
    IF_LvMgmt_WakeUpRsn_Enum
      data tec_LvMgmt_WakeUpRsn_Enum: type=uint8
    IF_ComM_BSBattSOC_pct
      data tec_ComM_BSBattSOC_pct: type=float32
    IF_IOAbs_BSBattUDc_V
      data tec_IOAbs_BSBattUDc_V: type=float32
    IF_ComM_BSBattUDcLoDiag_Enum
      data tec_ComM_BSBattUDcLoDiag_Enum: type=uint8
    IF_ComM_BSBattIDcHiDiag_Enum
      data tec_ComM_BSBattIDcHiDiag_Enum: type=uint8
    IF_LvMgmt_BSBattUDcHiDTC_Bus
      data tec_LvMgmt_BSBattUDcHiDTC_Bus: type=dt_LvMgmt_BSBattUDcHiDTC
    IF_LvMgmt_BSBattUDcLoDTC_Bus
      data tec_LvMgmt_BSBattUDcLoDTC_Bus: type=dt_LvMgmt_BSBattUDcLoDTC
    IF_LvMgmt_BSBattIDcHiDTC_Bus
      data tec_LvMgmt_BSBattIDcHiDTC_Bus: type=dt_LvMgmt_BSBattIDcHiDTC
    IF_LvMgmt_BSBattUDcNorm_Flg
      data tec_LvMgmt_BSBattUDcNorm_Flg: type=boolean
    IF_LvMgmt_LvPwrOffReq_Flg
      data tec_LvMgmt_LvPwrOffReq_Flg: type=boolean
    IF_HvMgmt_MCURdyFlt_Flg
      data tec_HvMgmt_MCURdyFlt_Flg: type=boolean
    IF_HvMgmt_BMSRlyClsDTCOne_Bus
      data tec_HvMgmt_BMSRlyClsDTCOne_Bus: type=dt_HvMgmt_BMSRlyClsDTCOne
    IF_HvMgmt_BMSRlyClsDTCTwo_Bus
      data tec_HvMgmt_BMSRlyClsDTCTwo_Bus: type=dt_HvMgmt_BMSRlyClsDTCTwo
    IF_HvMgmt_BMSRlyClsDTC_Bus
      data tec_HvMgmt_BMSRlyClsDTC_Bus: type=dt_HvMgmt_BMSRlyClsDTC
    IF_HvMgmt_BMSRlyOpenDTC_Bus
      data tec_HvMgmt_BMSRlyOpenDTC_Bus: type=dt_HvMgmt_BMSRlyOpenDTC
    IF_HvMgmt_PreheatPosRlyOpenDTC_Bus
      data tec_HvMgmt_PreheatPosRlyOpenDTC_Bus: type=dt_HvMgmt_PreheatPosRlyOpenDTC
    IF_HvMgmt_PreheatPosRlyClsDTC_Bus
      data tec_HvMgmt_PreheatPosRlyClsDTC_Bus: type=dt_HvMgmt_PreheatPosRlyClsDTC
    IF_HvMgmt_DCFCRlyClsDTC_Bus
      data tec_HvMgmt_DCFCRlyClsDTC_Bus: type=dt_HvMgmt_DCFCRlyClsDTC
    IF_HvMgmt_MCURdyFltDTCOne_Bus
      data tec_HvMgmt_MCURdyFltDTCOne_Bus: type=dt_HvMgmt_MCURdyFltDTCOne
    IF_HvMgmt_MCURdyFltDTCTwo_Bus
      data tec_HvMgmt_MCURdyFltDTCTwo_Bus: type=dt_HvMgmt_MCURdyFltDTCTwo
    IF_HvMgmt_MCUEnaFltDTC_Bus
      data tec_HvMgmt_MCUEnaFltDTC_Bus: type=dt_HvMgmt_MCUEnaFltDTC
    IF_HvMgmt_MCUClsFltDTC_Bus
      data tec_HvMgmt_MCUClsFltDTC_Bus: type=dt_HvMgmt_MCUClsFltDTC
    IF_ChrMgmt_PreheatPODDiReq_Flg
      data tec_ChrMgmt_PreheatPODDiReq_Flg: type=boolean
    IF_HvMgmt_DCDCStopFltDTC_Bus
      data tec_HvMgmt_DCDCStopFltDTC_Bus: type=dt_HvMgmt_DCDCStopFltDTC
    IF_HvMgmt_DCDCEnaFltDTC_Bus
      data tec_HvMgmt_DCDCEnaFltDTC_Bus: type=dt_HvMgmt_DCDCEnaFltDTC
    IF_HvMgmt_TCUStopFltDTC_Bus
      data tec_HvMgmt_TCUStopFltDTC_Bus: type=dt_HvMgmt_TCUStopFltDTC
    IF_HvMgmt_TCUEnaFltDTC_Bus
      data tec_HvMgmt_TCUEnaFltDTC_Bus: type=dt_HvMgmt_TCUEnaFltDTC
    IF_ComM_OBCSide1OvrTempFlt_Flg
      data tec_ComM_OBCSide1OvrTempFlt_Flg: type=boolean
    IF_ComM_OBCSide2OvrTempFlt_Flg
      data tec_ComM_OBCSide2OvrTempFlt_Flg: type=boolean
    IF_ComM_DCDCSide2OvrTempFlt_Flg
      data tec_ComM_DCDCSide2OvrTempFlt_Flg: type=boolean
    IF_ErrMgmt_BMSPreCdn_Flg
      data tec_ErrMgmt_BMSPreCdn_Flg: type=boolean
    IF_ErrMgmt_HVILPwmFrq_Hz
      data tec_ErrMgmt_HVILPwmFrq_Hz: type=uint8
    IF_ErrMgmt_VCUHVILDTC_Bus
      data tec_ErrMgmt_VCUHVILDTC_Bus: type=dt_ErrMgmt_VCUHVILDTC
    IF_ErrMgmt_VCUHVILErr_Flg
      data tec_ErrMgmt_VCUHVILErr_Flg: type=boolean
    IF_ChassisMgmt_BrkPedlFlt_Flg
      data tec_ChassisMgmt_BrkPedlFlt_Flg: type=boolean
    IF_ErrMgmt_GrdtZeroTq_Flg
      data tec_ErrMgmt_GrdtZeroTq_Flg: type=boolean
    IF_ErrMgmt_DlyGrdtZeroTq_Flg
      data tec_ErrMgmt_DlyGrdtZeroTq_Flg: type=boolean
    IF_ErrMgmt_ImdtZeroTq_Flg
      data tec_ErrMgmt_ImdtZeroTq_Flg: type=boolean
    IF_ErrMgmt_VehSpdLimErrLv6_Flg
      data tec_ErrMgmt_VehSpdLimErrLv6_Flg: type=boolean
    IF_ErrMgmt_VehSpdLimErrLv5_Flg
      data tec_ErrMgmt_VehSpdLimErrLv5_Flg: type=boolean
    IF_ErrMgmt_FobdEgyRcov_Flg
      data tec_ErrMgmt_FobdEgyRcov_Flg: type=boolean
    IF_ErrMgmt_DlyHvDwn_Flg
      data tec_ErrMgmt_DlyHvDwn_Flg: type=boolean
    IF_FctSftyMon_AccrPedlTqOverFltDTCInfo_Bus
      data tec_FctSftyMon_AccrPedlTqOverFltDTCInfo_Bus: type=dt_FctSftyMon_AccrPedlTqOverFltDTCInfo
    IF_FctSftyMon_CrpCtrlTqOverFltDTCInfo_Bus
      data tec_FctSftyMon_CrpCtrlTqOverFltDTCInfo_Bus: type=dt_FctSftyMon_CrpCtrlTqOverFltDTCInfo
    IF_FctSftyMon_DesVehDecelSpdOverFltDTCInfo_Bus
      data tec_FctSftyMon_DesVehDecelSpdOverFltDTCInfo_Bus: type=dt_FctSftyMon_DesVehDecelSpdOverFltDTCInfo
    IF_ComM_IBSBrkStsVld_Flg
      data tec_ComM_IBSBrkStsVld_Flg: type=boolean
    IF_ChassisMgmt_BrkRgnActv_Flg
      data tec_ChassisMgmt_BrkRgnActv_Flg: type=boolean
    IF_ChassisMgmt_BrkRgnTq_Nm
      data tec_ChassisMgmt_BrkRgnTq_Nm: type=float32
    IF_ChassisMgmt_BrkCmpDecelReqActv_Flg
      data tec_ChassisMgmt_BrkCmpDecelReqActv_Flg: type=boolean
    IF_ChassisMgmt_CoastCtrlTq_Nm
      data tec_ChassisMgmt_CoastCtrlDesTq_Nm: type=float32
    IF_ChassisMgmt_DrvAsscCtrlDesTq_Nm
      data tec_ChassisMgmt_DrvAsscCtrlDesTq_Nm: type=float32
    IF_ChassisMgmt_VehStbCtrlTqAvl_Flg
      data tec_ChassisMgmt_VehStbCtrlTqAvl_Flg: type=boolean
    IF_ChassisMgmt_IBSIntvIncTq_Nm
      data tec_ChassisMgmt_IBSDesIncTq_Nm: type=float32
    IF_ChassisMgmt_IBSIntvRednTq_Nm
      data tec_ChassisMgmt_IBSDesDecTq_Nm: type=float32
    IF_ChassisMgmt_CoastCtrlDesTq_Nm
      data tec_ChassisMgmt_CoastCtrlDesTq_Nm: type=float32
    IF_ChassisMgmt_CoastCtrlActv_Flg
      data tec_ChassisMgmt_CoastCtrlActv_Flg: type=boolean
    IF_ChassisMgmt_DrvCoorrDesTq_Nm
      data tec_ChassisMgmt_DrvCoorrDesTq_Nm: type=float32
    IF_ChrMgmt_PreheatIRChkErr_Bus
      data tec_ChrMgmt_PreheatIRChkErr_Bus: type=dt_ChrMgmt_PreheatIRChkErr
    IF_ChrMgmt_AcPreheatUDcCtrlErr_Bus
      data tec_ChrMgmt_AcPreheatUDcCtrlErr_Bus: type=dt_ChrMgmt_AcPreheatUDcCtrlErr
    IF_ChrMgmt_DcPreheatUDcCtrlErr_Bus
      data tec_ChrMgmt_DcPreheatUDcCtrlErr_Bus: type=dt_ChrMgmt_DcPreheatUDcCtrlErr
    IF_ChrMgmt_PreheatIRChkErrDTC_Bus
      data tec_ChrMgmt_PreheatIRChkErrDTC_Bus: type=dt_ChrMgmt_PreheatIRChkErrDTC
    IF_ChrMgmt_AcPreheatUDcCtrlErrDTC_Bus
      data tec_ChrMgmt_AcPreheatUDcCtrlErrDTC_Bus: type=dt_ChrMgmt_AcPreheatUDcCtrlErrDTC
    IF_ChrMgmt_DcPreheatUDcCtrlErrDTC_Bus
      data tec_ChrMgmt_DcPreheatUDcCtrlErrDTC_Bus: type=dt_ChrMgmt_DcPreheatUDcCtrlErrDTC
    IF_DCChrMgmt_IRMeasEnaErrDTC_Bus
      data tec_DCChrMgmt_IRMeasEnaErrDTC_Bus: type=dt_DCChrMgmt_IRMeasEnaErrDTC
    IF_DCChrMgmt_IRMeasDiErrDTC_Bus
      data tec_DCChrMgmt_IRMeasDiErrDTC_Bus: type=dt_DCChrMgmt_IRMeasDiErrDTC
    IF_DCChrMgmt_DcPortTempErrLvl2_Bus
      data tec_DCChrMgmt_DcPortTempErrLvl2_Bus: type=dt_DCChrMgmt_DcPortTempErrLvl2
    IF_DCChrMgmt_DcPortTempSnsrErr_Bus
      data tec_DCChrMgmt_DcPortTempSnsrErr_Bus: type=dt_DCChrMgmt_DcPortTempSnsrErr
    IF_ChrMgmt_VCUCalcdPODInitIDc_A
      data tec_ChrMgmt_VCUCalcdPODInitIDc_A: type=float32
    IF_ChrMgmt_PODSideSngChrgEgy_kWh
      data tec_ChrMgmt_PODSideSngChrgEgy_kWh: type=float32
    IF_ChrMgmt_BattSideSngChrgEgy_kWh
      data tec_ChrMgmt_BattSideSngChrgEgy_kWh: type=float32
    IF_ChrMgmt_DcChrgrSideSngChrgEgy_kWh
      data tec_ChrMgmt_DcChrgrSideSngChrgEgy_kWh: type=float32
    IF_ChrMgmt_OBCSideSngChrgEgy_kWh
      data tec_ChrMgmt_OBCSideSngChrgEgy_kWh: type=float32
    IF_ComM_CCSOutpUDc_V
      data tec_ComM_CCSOutpUDc_V: type=float32
    IF_ComM_CCSOutpIDc_A
      data tec_ComM_CCSOutpIDc_A: type=float32
    IF_ChrgMgmt_ChrgnRemnTim_min
      data tec_ChrgMgmt_ChrgnRemnTim_min: type=uint16
    IF_DCChrMgmt_DcPortTempErrLvl1_Bus
      data tec_DCChrMgmt_DcPortTempErrLvl1_Bus: type=dt_DCChrMgmt_DcPortTempErrLvl1
    IF_DCChrMgmt_DcChrgStrt_Flg
      data tec_DCChrMgmt_DcChrgStrt_Flg: type=boolean
    IF_DCChrMgmt_BEMRxCCSTmt_Bus
      data tec_DCChrMgmt_BEMRxCCSTmt_Bus: type=dt_DCChrMgmt_BEMRxCCSTmt
    IF_DCChrMgmt_BEMRxCSTTmt_Bus
      data tec_DCChrMgmt_BEMRxCSTTmt_Bus: type=dt_DCChrMgmt_BEMRxCSTTmt
    IF_DCChrMgmt_BEMRxCSDTmt_Bus
      data tec_DCChrMgmt_BEMRxCSDTmt_Bus: type=dt_DCChrMgmt_BEMRxCSDTmt
    IF_DCChrMgmt_BEMRxCRMTmtDTC_Bus
      data tec_DCChrMgmt_BEMRxCRMTmtDTC_Bus: type=dt_DCChrMgmt_BEMRxCRMTmtDTC
    IF_DCChrMgmt_BEMRxCRMPrepdTmtDTC_Bus
      data tec_DCChrMgmt_BEMRxCRMPrepdTmtDTC_Bus: type=dt_DCChrMgmt_BEMRxCRMPrepdTmtDTC
    IF_DCChrMgmt_BEMRxCMLTmtDTC_Bus
      data tec_DCChrMgmt_BEMRxCMLTmtDTC_Bus: type=dt_DCChrMgmt_BEMRxCMLTmtDTC
    IF_DCChrMgmt_BEMRxCROTmtDTC_Bus
      data tec_DCChrMgmt_BEMRxCROTmtDTC_Bus: type=dt_DCChrMgmt_BEMRxCROTmtDTC
    IF_DCChrMgmt_BEMRxCROPrepdTmtDTC_Bus
      data tec_DCChrMgmt_BEMRxCROPrepdTmtDTC_Bus: type=dt_DCChrMgmt_BEMRxCROPrepdTmtDTC
    IF_DCChrMgmt_BEMRxCCSTmtDTC_Bus
      data tec_DCChrMgmt_BEMRxCCSTmtDTC_Bus: type=dt_DCChrMgmt_BEMRxCCSTmtDTC
    IF_DCChrMgmt_BEMRxCSTTmtDTC_Bus
      data tec_DCChrMgmt_BEMRxCSTTmtDTC_Bus: type=dt_DCChrMgmt_BEMRxCSTTmtDTC
    IF_DCChrMgmt_BEMRxCSDTmtDTC_Bus
      data tec_DCChrMgmt_BEMRxCSDTmtDTC_Bus: type=dt_DCChrMgmt_BEMRxCSDTmtDTC
    IF_DCChrMgmt_DcPortTempErrLvl1DTC_Bus
      data tec_DCChrMgmt_DcPortTempErrLvl1DTC_Bus: type=dt_DCChrMgmt_DcPortTempErrLvl1DTC
    IF_DCChrMgmt_DcPortTempErrLvl2DTC_Bus
      data tec_DCChrMgmt_DcPortTempErrLvl2DTC_Bus: type=dt_DCChrMgmt_DcPortTempErrLvl2DTC
    IF_DCChrMgmt_DcPortTempSnsrErrDTC_Bus
      data tec_DCChrMgmt_DcPortTempSnsrErrDTC_Bus: type=dt_DCChrMgmt_DcPortTempSnsrErrDTC
    IF_ComM_CMLMaxOutpUDc_V
      data tec_ComM_CMLMaxOutpUDc_V: type=float32
    IF_ComM_CMLMinOutpUDc_V
      data tec_ComM_CMLMinOutpUDc_V: type=float32
    IF_ComM_CMLMinOutpIDc_A
      data tec_ComM_CMLMinOutpIDc_A: type=float32
    IF_GearMgmt_WakeUpFinish_Flg
      data tec_GearMgmt_WakeUpFinish_Flg: type=boolean
    IF_GearMgmt_EPBReqCmpl_Flg
      data tec_GearMgmt_EPBReqCmpl_Flg: type=boolean
    IF_GearMgmt_ADASEPBPrkReq_Flg
      data tec_GearMgmt_ADASEPBPrkReq_Flg: type=boolean
    IF_GearMgmt_ManualEPBRelsReq_Flg
      data tec_GearMgmt_ManualEPBRelsReq_Flg: type=boolean
    IF_GearMgmt_ADASGearShift_Enum
      data tec_GearMgmt_ADASGearShift_Enum: type=uint8
    IF_GearMgmt_ManualEPBPrkReq_Flg
      data tec_GearMgmt_ManualEPBPrkReq_Flg: type=boolean
    IF_GearMgmt_BrkNotPress_Flg
      data tec_GearMgmt_BrkNotPress_Flg: type=boolean
    IF_GearMgmt_SpdTooHigh2D_Flg
      data tec_GearMgmt_SpdTooHigh2D_Flg: type=boolean
    IF_GearMgmt_SpdTooHigh2R_Flg
      data tec_GearMgmt_SpdTooHigh2R_Flg: type=boolean
    IF_GearMgmt_SpdTooHigh2N_Flg
      data tec_GearMgmt_SpdTooHigh2N_Flg: type=boolean
    IF_GearMgmt_SpdTooHigh2P_Flg
      data tec_GearMgmt_SpdTooHigh2P_Flg: type=boolean
    IF_GearMgmt_AcclrTooLrg_Flg
      data tec_GearMgmt_AcclrTooLrg_Flg: type=boolean
    IF_GearMgmt_ChrgInDetdErr_Flg
      data tec_GearMgmt_ChrgInDetdErr_Flg: type=boolean
    IF_GearMgmt_PRNDFail_Flg
      data tec_GearMgmt_PRNDFail_Flg: type=boolean
    IF_GearMgmt_VehNotRdy_Flg
      data tec_GearMgmt_VehNotRdy_Flg: type=boolean
    IF_GearMgmt_SWPFail_Flg
      data tec_GearMgmt_SWPFail_Flg: type=boolean
    IF_GearMgmt_FltDetd_Flg
      data tec_GearMgmt_FltDetd_Flg: type=boolean
    IF_GearMgmt_ManGearShift_Enum
      data tec_GearMgmt_ManGearShift_Enum: type=uint8
    IF_GearMgmt_TarGearShift_Enum
      data tec_GearMgmt_ManualGearTar_Enum: type=uint8
    IF_GearMgmt_ADASGearTar_Enum
      data tec_GearMgmt_ADASGearTar_Enum: type=uint8
    IF_GearMgmt_AutoPEPBPrkWait_Flg
      data tec_GearMgmt_AutoPEPBPrkWait_Flg: type=boolean
    IF_GearMgmt_ADASGearShiftWait_Enum
      data tec_GearMgmt_ADASGearShiftWait_Enum: type=uint8
    IF_GearMgmt_ManGearShiftWait_Enum
      data tec_GearMgmt_ManGearShiftWait_Enum: type=uint8
    IF_GearMgmt_ChrgInPlug_Flg
      data tec_GearMgmt_ChrgInPlug_Flg: type=boolean
    IF_GearMgmt_AutoNReq_Flg
      data tec_GearMgmt_AutoNReq_Flg: type=boolean
    IF_GearMgmt_AutoPEPBPrkReq_Flg
      data tec_GearMgmt_AutoPEPBPrkReq_Flg: type=boolean
    IF_GearMgmt_AutoPGearTar_Enum
      data tec_GearMgmt_AutoPGearTar_Enum: type=uint8
    IF_GearMgmt_AutoNGearTar_Enum
      data tec_GearMgmt_AutoNGearTar_Enum: type=uint8
    IF_GearMgmt_AutoPInN_Flg
      data tec_GearMgmt_AutoPInN_Flg: type=boolean
    IF_GearMgmt_ADASEPBRelsReq_Flg
      data tec_GearMgmt_ADASEPBRelsReq_Flg: type=boolean
    IF_GearMgmt_WakeUpEPBPrkReq_Flg
      data tec_GearMgmt_WakeUpEPBPrkReq_Flg: type=boolean
    IF_GearMgmt_EPBPrkReqFail_Flg
      data tec_GearMgmt_EPBPrkReqFail_Flg: type=boolean
    IF_GearMgmt_EPBRelsReqFail_Flg
      data tec_GearMgmt_EPBRelsReqFail_Flg: type=boolean
    IF_GearMgmt_AllowOutP_Flg
      data tec_GearMgmt_AllowOutP_Flg: type=boolean
    IF_GearMgmt_Allow2P_Flg
      data tec_GearMgmt_Allow2P_Flg: type=boolean
    IF_GearMgmt_EPBReqTar_Enum
      data tec_GearMgmt_EPBReqTar_Enum: type=uint8
    BRO_BMSChargeReady
      data BRO_BMSChargeReady: type=BRO_BMSChargeReady
    BCL_ChargeMode
      data BCL_ChargeMode: type=BCL_ChargeMode
    BCL_CurrentRequire
      data BCL_CurrentRequire: type=BCL_CurrentRequire
    BCL_VolltageRequire
      data BCL_VolltageRequire: type=BCL_VolltageRequire
    BSM_BatteryCurrentState
      data BSM_BatteryCurrentState: type=BSM_BatteryCurrentState
    BSM_BatteryOutpuConnectorState
      data BSM_BatteryOutpuConnectorState: type=BSM_BatteryOutpuConnectorState
    BSM_BatteryTempState
      data BSM_BatteryTempState: type=BSM_BatteryTempState
    BSM_BatteryVoltageState
      data BSM_BatteryVoltageState: type=BSM_BatteryVoltageState
    BSM_ChargeEnable
      data BSM_ChargeEnable: type=BSM_ChargeEnable
    BSM_InsulationState
      data BSM_InsulationState: type=BSM_InsulationState
    BSM_SOC
      data BSM_SOC: type=BSM_SOC
    BST_AbortAchiveSingleVolt
      data BST_AbortAchiveSingleVolt: type=BST_AbortAchiveSingleVolt
    BST_AbortAchiveSOC
      data BST_AbortAchiveSOC: type=BST_AbortAchiveSOC
    BST_AbortAchiveTotalVolt
      data BST_AbortAchiveTotalVolt: type=BST_AbortAchiveTotalVolt
    BST_Abortdet2Voltexception
      data BST_Abortdet2Voltexception: type=BST_Abortdet2Voltexception
    BST_AbortErrorCurrent
      data BST_AbortErrorCurrent: type=BST_AbortErrorCurrent
    BST_AbortErrorVoltage
      data BST_AbortErrorVoltage: type=BST_AbortErrorVoltage
    BST_AbortFaultBatteryTemp
      data BST_AbortFaultBatteryTemp: type=BST_AbortFaultBatteryTemp
    BST_AbortFaultBMSTemp
      data BST_AbortFaultBMSTemp: type=BST_AbortFaultBMSTemp
    BST_AbortFaultConnector
      data BST_AbortFaultConnector: type=BST_AbortFaultConnector
    BST_AbortFaultConnectorTemp
      data BST_AbortFaultConnectorTemp: type=BST_AbortFaultConnectorTemp
    BST_AbortFaultInsulation
      data BST_AbortFaultInsulation: type=BST_AbortFaultInsulation
    BST_AbortFaultOther
      data BST_AbortFaultOther: type=BST_AbortFaultOther
    BST_AbortHVrelayfault
      data BST_AbortHVrelayfault: type=BST_AbortHVrelayfault
    BST_Abortmanoperate
      data BST_Abortmanoperate: type=BST_Abortmanoperate
    BEM_ChargeAbortTimeout
      data BEM_ChargeAbortTimeout: type=BEM_ChargeAbortTimeout
    BEM_ChargeFinishTimeout
      data BEM_ChargeFinishTimeout: type=BEM_ChargeFinishTimeout
    BEM_ChargerIdTimeout0
      data BEM_ChargerIdTimeout0: type=BEM_ChargerIdTimeout0
    BEM_ChargerIdTimeout1
      data BEM_ChargerIdTimeout1: type=BEM_ChargerIdTimeout1
    BEM_ChargeStateTimeout
      data BEM_ChargeStateTimeout: type=BEM_ChargeStateTimeout
    BEM_ChargeStatisticsTimeout
      data BEM_ChargeStatisticsTimeout: type=BEM_ChargeStatisticsTimeout
    BEM_TimesyncOrPowerTimeout
      data BEM_TimesyncOrPowerTimeout: type=BEM_TimesyncOrPowerTimeout
    CML_OutputCurrentMin
      data CML_OutputCurrentMin: type=uint16
    CML_OutputVoltageMin
      data CML_OutputVoltageMin: type=uint16
    CML_OutpuVoltageMax
      data CML_OutpuVoltageMax: type=uint16
    CRM_RecognitionResult
      data CRM_RecognitionResult: type=CRM_RecognitionResult
    CRO_ChargerReady
      data CRO_ChargerReady: type=CRO_ChargerReady
    CST_AbortAchiveCondition
      data CST_AbortAchiveCondition: type=CST_AbortAchiveCondition
    CSD_ChargerNo
      data CSD_ChargerNo: type=CSD_ChargerNo
