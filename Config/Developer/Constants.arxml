AUTOSAR XML (schema 00046)
package /Constants
  33 x constant specification:
    QCF_SAFETY_REAC_DEFAULT: value-spec=255
    QCF_RECOVERY_REAC_DEFAULT: value-spec=255
    COM_STATE_DEFAULT: value-spec=255
    TorqPahMgmt_DftFwdMaxSpdGearD_CFG: value-spec=170
    TorqPahMgmt_DftFwdMaxSpdGearR_CFG: value-spec=50
    TorqPahMgmt_GrdtMaxVehSpdNeg_CFG: value-spec=200
    TorqPahMgmt_GrdtMaxVehSpdPos_CFG: value-spec=200
    TorqPahMgmt_MaxVehSpdLmPidKiTqMax_CFG: value-spec=300
    TorqPahMgmt_MaxVehSpdLmPidKiTqMin_CFG: value-spec=-300
    TorqPahMgmt_MaxVehSpdLmPidKpTqMax_CFG: value-spec=300
    TorqPahMgmt_MaxVehSpdLmPidKpTqMin_CFG: value-spec=-300
    TorqPahMgmt_MaxVehSpdLmtFbTqX_MAP: value-spec=[0, 20, 30, 40, 50, 60, 70, 80, 90, 100, 110, 120, 130, 140, 150, 160, 170, 180]
    HvMgmt_BMSBattEnaSOC_CFG: value-spec=20  # Smart charging Determines the battery SOC in high-voltage scenarios
    HvMgmt_BMSBattReqChrgSOCTmr_CFG: value-spec=650  # Time to determine whether the battery SOC meets the requirements in the high-voltage scenario of intelligent charging
    HvMgmt_BMSHvOnCnt_CFG: value-spec=1  # Determine the number of times HV is used in the scenario of intelligent charging
    HvMgmt_BMSMgmtDTZero_CFG: value-spec=0  # Set the time of the BMS DTC reset condition to 0
    HvMgmt_BMSMgmtMTZero_CFG: value-spec=0  # Set the time of the BMS DTC set condition to 0
    HvMgmt_BMSRlyClsDTCEnaSetTim_CFG: value-spec=1500  # BMS relay closed fault DTC enable condition time setting
    HvMgmt_BMSRlyClsDTCSetTimOne_CFG: value-spec=2000  # BMS relay closed fault DTC set condition one time setting
    HvMgmt_BMSRlyClsDTCSetTimTwo_CFG: value-spec=100  # BMS relay closed fault DTC set condition two time setting
    HvMgmt_BMSRlyOpenDTCEnaSetTim_CFG: value-spec=1500  # BMS relay opened fault DTC enable condition time setting
    HvMgmt_BMSRlyOpenDTCResetTim_CFG: value-spec=1000  # BMS relay opened fault DTC reset condition time setting
    HvMgmt_BMSRlyOpenDTCSetTim_CFG: value-spec=300  # BMS relay opened fault DTC set condition time setting
    HvMgmt_BSBattChrgEndSOC_CFG: value-spec=90  # Low voltage battery charging cut-off SOC
    HvMgmt_BSBattReqChrgSOC_CFG: value-spec=75  # SOC judgment of low-voltage battery charging request
    HvMgmt_BSBattReqChrgSOCTmr_CFG: value-spec=500  # Determine the SOC time for charging a low-voltage battery
    HvMgmt_PreheatPosRlyClsDTCEnaSetTim_CFG: value-spec=1500  # Setting time of enabling condition of BMS relay closed fault DTC in Preheating condition
    HvMgmt_PreheatPosRlyClsDTCSetTim_CFG: value-spec=600  # Setting time of setting condition of BMS relay closed fault DTC in Preheating condition
    HvMgmt_PreheatPosRlyOpenDTCEnaSetTim_CFG: value-spec=1500  # Setting time of enabling condition of BMS relay opened fault DTC in Preheating condition
    HvMgmt_PreheatPosRlyOpenDTCSetTim_CFG: value-spec=600  # Setting time of setting condition of BMS relay opened fault DTC in Preheating condition
    HvMgmt_PwrOnFailedTmr_CFG: value-spec=10000  # Determine the timeout period of high voltage power-on failure
    HvMgmt_SmtPwrCompTmr_CFG: value-spec=18000000  # After the intelligent wake up, the high voltage is used to determine the timeout period for the DCDC to enter Buck
    HvMgmt_SmtPwrKeepTmr_CFG: value-spec=1800000  # After the intelligent wake up, the high voltage determines that the low-voltage battery does not increase by 1% of the timeout period
