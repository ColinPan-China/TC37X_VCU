[part 3 of 3: package /EndToEndProtections]
AUTOSAR XML (schema 00046)
package /EndToEndProtections
  end to end protection set EndToEndProtectionSet
    36 x end to end protection:
      ECU_Composition_SG_VCU_IBS_01_SigGroup_SG_VCU_IBS_01_SigGroup_1: end-to-end-profile={category=PROFILE_01, data-ids=148, data-id-mode=0, data-length=64, max-delta-counter-init=2, crc-offset=0, counter-offset=8, max-no-new-or-repeated-data=14, sync-counter-init=1, data-id-nibble-offset=0}, end-to-end-protection-variable-prototype=EcuSwComposition.SG_VCU_IBS_01_SigGroup.SG_VCU_IBS_01_SigGroup
      ECU_Composition_SG_VCU_BMS_SigGroup_SG_VCU_BMS_SigGroup: end-to-end-profile={category=PROFILE_01, data-ids=209, data-id-mode=0, data-length=64, max-delta-counter-init=2, crc-offset=0, counter-offset=8, max-no-new-or-repeated-data=14, sync-counter-init=1, data-id-nibble-offset=0}, end-to-end-protection-variable-prototype=EcuSwComposition.SG_VCU_BMS_SigGroup.SG_VCU_BMS_SigGroup
      ECU_Composition_SG_VCU_AccPedal_SigGroup_SG_VCU_AccPedal_SigGroup: end-to-end-profile={category=PROFILE_01, data-ids=210, data-id-mode=0, data-length=64, max-delta-counter-init=2, crc-offset=0, counter-offset=8, max-no-new-or-repeated-data=14, sync-counter-init=1, data-id-nibble-offset=0}, end-to-end-protection-variable-prototype=EcuSwComposition.SG_VCU_AccPedal_SigGroup.SG_VCU_AccPedal_SigGroup
      ECU_Composition_SG_VCU_Chassis_01_SigGroup_SG_VCU_Chassis_01_SigGroup_1: end-to-end-profile={category=PROFILE_01, data-ids=211, data-id-mode=0, data-length=64, max-delta-counter-init=2, crc-offset=0, counter-offset=8, max-no-new-or-repeated-data=14, sync-counter-init=1, data-id-nibble-offset=0}, end-to-end-protection-variable-prototype=EcuSwComposition.SG_VCU_Chassis_01_SigGroup.SG_VCU_Chassis_01_SigGroup
      ECU_Composition_SG_VCU_HMIsignals_02_SigGroup_SG_VCU_HMIsignals_02_SigGroup: end-to-end-profile={category=PROFILE_01, data-ids=792, data-id-mode=0, data-length=64, max-delta-counter-init=2, crc-offset=0, counter-offset=8, max-no-new-or-repeated-data=14, sync-counter-init=1, data-id-nibble-offset=0}, end-to-end-protection-variable-prototype=EcuSwComposition.SG_VCU_HMIsignals_02_SigGroup.SG_VCU_HMIsignals_02_SigGroup
      ECU_Composition_SG_IBS_Torque_SigGroup_SG_IBS_Torque_SigGroup: end-to-end-profile={category=PROFILE_01, data-ids=185, data-id-mode=0, data-length=64, max-delta-counter-init=2, crc-offset=0, counter-offset=8, max-no-new-or-repeated-data=14, sync-counter-init=1, data-id-nibble-offset=0}, end-to-end-protection-variable-prototype=receiver=EcuSwComposition.SG_IBS_Torque_SigGroup.SG_IBS_Torque_SigGroup
      ECU_Composition_SG_ADCU_DA_SigGroup_SG_ADCU_DA_SigGroup_1: end-to-end-profile={category=PROFILE_01, data-ids=230, data-id-mode=0, data-length=64, max-delta-counter-init=2, crc-offset=0, counter-offset=8, max-no-new-or-repeated-data=14, sync-counter-init=1, data-id-nibble-offset=0}, end-to-end-protection-variable-prototype=receiver=EcuSwComposition.SG_ADCU_DA_SigGroup.SG_ADCU_DA_SigGroup
      ECU_Composition_SG_ACU_01_SigGroup_SG_ACU_01_SigGroup_1: end-to-end-profile={category=PROFILE_01, data-ids=245, data-id-mode=0, data-length=64, max-delta-counter-init=2, crc-offset=0, counter-offset=8, max-no-new-or-repeated-data=14, sync-counter-init=1, data-id-nibble-offset=0}, end-to-end-protection-variable-prototype=receiver=EcuSwComposition.SG_ACU_01_SigGroup.SG_ACU_01_SigGroup
      ECU_Composition_SG_ACU_02_SigGroup_SG_ACU_02_SigGroup_1: end-to-end-profile={category=PROFILE_01, data-ids=246, data-id-mode=0, data-length=64, max-delta-counter-init=2, crc-offset=0, counter-offset=8, max-no-new-or-repeated-data=14, sync-counter-init=1, data-id-nibble-offset=0}, end-to-end-protection-variable-prototype=receiver=EcuSwComposition.SG_ACU_02_SigGroup.SG_ACU_02_SigGroup
      ECU_Composition_SG_PRND_SigGroup_SG_PRND_SigGroup_1: end-to-end-profile={category=PROFILE_01, data-ids=584, data-id-mode=0, data-length=64, max-delta-counter-init=2, crc-offset=0, counter-offset=8, max-no-new-or-repeated-data=14, sync-counter-init=1, data-id-nibble-offset=0}, end-to-end-protection-variable-prototype=receiver=EcuSwComposition.SG_PRND_SigGroup.SG_PRND_SigGroup
      ECU_Composition_SG_MCU_FailureCode_SigGroup_SG_MCU_FailureCode_SigGroup_1: end-to-end-profile={category=PROFILE_01, data-ids=595, data-id-mode=0, data-length=64, max-delta-counter-init=2, crc-offset=0, counter-offset=8, max-no-new-or-repeated-data=14, sync-counter-init=1, data-id-nibble-offset=0}, end-to-end-protection-variable-prototype=receiver=EcuSwComposition.SG_MCU_FailureCode_SigGroup.SG_MCU_FailureCode_SigGroup
      ECU_Composition_SG_CGW_01_SigGroup_SG_CGW_01_SigGroup: end-to-end-profile={category=PROFILE_01, data-ids=632, data-id-mode=0, data-length=64, max-delta-counter-init=2, crc-offset=0, counter-offset=8, max-no-new-or-repeated-data=14, sync-counter-init=1, data-id-nibble-offset=0}, end-to-end-protection-variable-prototype=receiver=EcuSwComposition.SG_CGW_01_SigGroup.SG_CGW_01_SigGroup
      ECU_Composition_SG_IBS_VCU_MotorControl_SigGroup_SG_IBS_VCU_MotorControl_SigGroup: end-to-end-profile={category=PROFILE_01, data-ids=144, data-id-mode=0, data-length=64, max-delta-counter-init=2, crc-offset=0, counter-offset=8, max-no-new-or-repeated-data=14, sync-counter-init=1, data-id-nibble-offset=0}, end-to-end-protection-variable-prototype=receiver=EcuSwComposition.SG_IBS_VCU_MotorControl_SigGroup.SG_IBS_VCU_MotorControl_SigGroup
      ECU_Composition_SG_VCU_HMIsignals_01_SigGroup_SG_VCU_HMIsignals_01_SigGroup_1: end-to-end-profile={category=PROFILE_01, data-ids=791, data-id-mode=0, data-length=64, max-delta-counter-init=2, crc-offset=0, counter-offset=8, max-no-new-or-repeated-data=14, sync-counter-init=1, data-id-nibble-offset=0}, end-to-end-protection-variable-prototype=EcuSwComposition.SG_VCU_HMIsignals_01_SigGroup.SG_VCU_HMIsignals_01_SigGroup
      ECU_Composition_SG_MCU_01_SigGroup_SG_MCU_01_SigGroup: end-to-end-profile={category=PROFILE_01, data-ids=152, data-id-mode=0, data-length=64, max-delta-counter-init=2, crc-offset=0, counter-offset=8, max-no-new-or-repeated-data=14, sync-counter-init=1, data-id-nibble-offset=0}, end-to-end-protection-variable-prototype=receiver=EcuSwComposition.SG_MCU_01_SigGroup.SG_MCU_01_SigGroup
      ECU_Composition_SG_VCU_MCU_03_SigGroup_SG_VCU_MCU_03_SigGroup: end-to-end-profile={category=PROFILE_01, data-ids=149, data-id-mode=0, data-length=64, max-delta-counter-init=2, crc-offset=0, counter-offset=8, max-no-new-or-repeated-data=14, sync-counter-init=1, data-id-nibble-offset=0}, end-to-end-protection-variable-prototype=EcuSwComposition.SG_VCU_MCU_03_SigGroup.SG_VCU_MCU_03_SigGroup
      ECU_Composition_SG_ACU_info_SigGroup_1_SG_ACU_info_SigGroup: end-to-end-profile={category=PROFILE_01, data-ids=151, data-id-mode=0, data-length=64, max-delta-counter-init=2, crc-offset=0, counter-offset=8, max-no-new-or-repeated-data=14, sync-counter-init=1, data-id-nibble-offset=0}, end-to-end-protection-variable-prototype=receiver=EcuSwComposition.SG_ACU_info_SigGroup_1.SG_ACU_info_SigGroup
      ECU_Composition_SG_ADCU_ACC_02_SigGroup_1_SG_ADCU_ACC_02_SigGroup: end-to-end-profile={category=PROFILE_01, data-ids=224, data-id-mode=0, data-length=64, max-delta-counter-init=2, crc-offset=0, counter-offset=8, max-no-new-or-repeated-data=14, sync-counter-init=1, data-id-nibble-offset=0}, end-to-end-protection-variable-prototype=receiver=EcuSwComposition.SG_ADCU_ACC_02_SigGroup_1.SG_ADCU_ACC_02_SigGroup
      ECU_Composition_SG_ADCU_APS_01_SigGroup_1_SG_ADCU_APS_01_SigGroup: end-to-end-profile={category=PROFILE_01, data-ids=228, data-id-mode=0, data-length=64, max-delta-counter-init=2, crc-offset=0, counter-offset=8, max-no-new-or-repeated-data=14, sync-counter-init=1, data-id-nibble-offset=0}, end-to-end-protection-variable-prototype=receiver=EcuSwComposition.SG_ADCU_APS_01_SigGroup_1.SG_ADCU_APS_01_SigGroup
      ECU_Composition_SG_BCM_05_SigGroup_1_SG_BCM_05_SigGroup: end-to-end-profile={category=PROFILE_01, data-ids=826, data-id-mode=0, data-length=64, max-delta-counter-init=2, crc-offset=0, counter-offset=8, max-no-new-or-repeated-data=14, sync-counter-init=1, data-id-nibble-offset=0}, end-to-end-protection-variable-prototype=receiver=EcuSwComposition.SG_BCM_05_SigGroup_1.SG_BCM_05_SigGroup
      ECU_Composition_SG_BCM_06_SigGroup_1_SG_BCM_06_SigGroup: end-to-end-profile={category=PROFILE_01, data-ids=625, data-id-mode=0, data-length=64, max-delta-counter-init=2, crc-offset=0, counter-offset=8, max-no-new-or-repeated-data=14, sync-counter-init=1, data-id-nibble-offset=0}, end-to-end-protection-variable-prototype=receiver=EcuSwComposition.SG_BCM_06_SigGroup_1.SG_BCM_06_SigGroup
      ECU_Composition_SG_ADCU_AEB_01_SigGroup_SG_ADCU_AEB_01_SigGroup: end-to-end-profile={category=PROFILE_01, data-ids=226, data-id-mode=0, data-length=64, max-delta-counter-init=2, crc-offset=0, counter-offset=8, max-no-new-or-repeated-data=14, sync-counter-init=1, data-id-nibble-offset=0}, end-to-end-protection-variable-prototype=receiver=EcuSwComposition.SG_ADCU_AEB_01_SigGroup.SG_ADCU_AEB_01_SigGroup
      ECU_Composition_SG_BMS_status_01_SigGroup_1_SG_BMS_status_01_SigGroup: end-to-end-profile={category=PROFILE_01, data-ids=193, data-id-mode=0, data-length=64, max-delta-counter-init=2, crc-offset=0, counter-offset=8, max-no-new-or-repeated-data=14, sync-counter-init=1, data-id-nibble-offset=0}, end-to-end-protection-variable-prototype=receiver=EcuSwComposition.SG_BMS_status_01_SigGroup_1.SG_BMS_status_01_SigGroup
      ECU_Composition_SG_DCM_FL_02_SigGroup_1_SG_DCM_FL_02_SigGroup: end-to-end-profile={category=PROFILE_01, data-ids=650, data-id-mode=0, data-length=64, max-delta-counter-init=2, crc-offset=0, counter-offset=8, max-no-new-or-repeated-data=14, sync-counter-init=1, data-id-nibble-offset=0}, end-to-end-protection-variable-prototype=receiver=EcuSwComposition.SG_DCM_FL_02_SigGroup_1.SG_DCM_FL_02_SigGroup
      ECU_Composition_SG_IBS_APS_SigGroup_1_SG_IBS_APS_SigGroup: end-to-end-profile={category=PROFILE_01, data-ids=183, data-id-mode=0, data-length=64, max-delta-counter-init=2, crc-offset=0, counter-offset=8, max-no-new-or-repeated-data=14, sync-counter-init=1, data-id-nibble-offset=0}, end-to-end-protection-variable-prototype=receiver=EcuSwComposition.SG_IBS_APS_SigGroup_1.SG_IBS_APS_SigGroup
      ECU_Composition_SG_IBS_Status_02_SigGroup_1_SG_IBS_Status_02_SigGroup: end-to-end-profile={category=PROFILE_01, data-ids=179, data-id-mode=0, data-length=64, max-delta-counter-init=2, crc-offset=0, counter-offset=8, max-no-new-or-repeated-data=14, sync-counter-init=1, data-id-nibble-offset=0}, end-to-end-protection-variable-prototype=receiver=EcuSwComposition.SG_IBS_Status_02_SigGroup_1.SG_IBS_Status_02_SigGroup
      ECU_Composition_SG_IBS_Status_03_SigGroup_1_SG_IBS_Status_03_SigGroup: end-to-end-profile={category=PROFILE_01, data-ids=180, data-id-mode=0, data-length=64, max-delta-counter-init=2, crc-offset=0, counter-offset=8, max-no-new-or-repeated-data=14, sync-counter-init=1, data-id-nibble-offset=0}, end-to-end-protection-variable-prototype=receiver=EcuSwComposition.SG_IBS_Status_03_SigGroup_1.SG_IBS_Status_03_SigGroup
      ECU_Composition_SG_IBS_Status_04_SigGroup_1_SG_IBS_Status_04_SigGroup: end-to-end-profile={category=PROFILE_01, data-ids=186, data-id-mode=0, data-length=64, max-delta-counter-init=2, crc-offset=0, counter-offset=8, max-no-new-or-repeated-data=14, sync-counter-init=1, data-id-nibble-offset=0}, end-to-end-protection-variable-prototype=receiver=EcuSwComposition.SG_IBS_Status_04_SigGroup_1.SG_IBS_Status_04_SigGroup
      ECU_Composition_SG_IBS_Status_05_SigGroup_1_SG_IBS_Status_05_SigGroup: end-to-end-profile={category=PROFILE_01, data-ids=187, data-id-mode=0, data-length=64, max-delta-counter-init=2, crc-offset=0, counter-offset=8, max-no-new-or-repeated-data=14, sync-counter-init=1, data-id-nibble-offset=0}, end-to-end-protection-variable-prototype=receiver=EcuSwComposition.SG_IBS_Status_05_SigGroup_1.SG_IBS_Status_05_SigGroup
      ECU_Composition_SG_IBS_Status_06_SigGroup_1_SG_IBS_Status_06_SigGroup: end-to-end-profile={category=PROFILE_01, data-ids=188, data-id-mode=0, data-length=64, max-delta-counter-init=2, crc-offset=0, counter-offset=8, max-no-new-or-repeated-data=14, sync-counter-init=1, data-id-nibble-offset=0}, end-to-end-protection-variable-prototype=receiver=EcuSwComposition.SG_IBS_Status_06_SigGroup_1.SG_IBS_Status_06_SigGroup
      ECU_Composition_SG_IBS_WheelSpeed_01_SigGroup_1_SG_IBS_WheelSpeed_01_SigGroup: end-to-end-profile={category=PROFILE_01, data-ids=176, data-id-mode=0, data-length=64, max-delta-counter-init=2, crc-offset=0, counter-offset=8, max-no-new-or-repeated-data=14, sync-counter-init=1, data-id-nibble-offset=0}, end-to-end-protection-variable-prototype=receiver=EcuSwComposition.SG_IBS_WheelSpeed_01_SigGroup_1.SG_IBS_WheelSpeed_01_SigGroup
      ECU_Composition_SG_IBS_WheelSpeed_02_SigGroup_1_SG_IBS_WheelSpeed_02_SigGroup: end-to-end-profile={category=PROFILE_01, data-ids=177, data-id-mode=0, data-length=64, max-delta-counter-init=2, crc-offset=0, counter-offset=8, max-no-new-or-repeated-data=14, sync-counter-init=1, data-id-nibble-offset=0}, end-to-end-protection-variable-prototype=receiver=EcuSwComposition.SG_IBS_WheelSpeed_02_SigGroup_1.SG_IBS_WheelSpeed_02_SigGroup
      ECU_Composition_SG_IBS_ACC_SigGroup_SG_IBS_ACC_SigGroup: end-to-end-profile={category=PROFILE_01, data-ids=184, data-id-mode=0, data-length=64, max-delta-counter-init=2, crc-offset=0, counter-offset=8, max-no-new-or-repeated-data=14, sync-counter-init=1, data-id-nibble-offset=0}, end-to-end-protection-variable-prototype=receiver=EcuSwComposition.SG_IBS_ACC_SigGroup
      ECU_Composition_SG_IBS_Status_01_SigGroup_SG_IBS_Status_01_SigGroup: end-to-end-profile={category=PROFILE_01, data-ids=178, data-id-mode=0, data-length=64, max-delta-counter-init=2, crc-offset=0, counter-offset=8, max-no-new-or-repeated-data=14, sync-counter-init=1, data-id-nibble-offset=0}, end-to-end-protection-variable-prototype=receiver=EcuSwComposition.SG_IBS_Status_01_SigGroup.SG_IBS_Status_01_SigGroup
      ECU_Composition_SG_IBS_ACC_SigGroup_1_SG_IBS_ACC_SigGroup: end-to-end-profile={category=PROFILE_01, data-ids=184, data-id-mode=0, data-length=64, max-delta-counter-init=2, crc-offset=0, counter-offset=8, max-no-new-or-repeated-data=14, sync-counter-init=1, data-id-nibble-offset=0}, end-to-end-protection-variable-prototype=receiver=EcuSwComposition.SG_IBS_ACC_SigGroup_1.SG_IBS_ACC_SigGroup
      ECU_Composition_SG_EPS_CONV_SigGroup_SG_EPS_CONV_SigGroup: end-to-end-profile={category=PROFILE_01, data-ids=240, data-id-mode=0, data-length=64, max-delta-counter-init=2, crc-offset=0, counter-offset=8, max-no-new-or-repeated-data=14, sync-counter-init=1, data-id-nibble-offset=0}, end-to-end-protection-variable-prototype=receiver=EcuSwComposition.SG_EPS_CONV_SigGroup.SG_EPS_CONV_SigGroup
