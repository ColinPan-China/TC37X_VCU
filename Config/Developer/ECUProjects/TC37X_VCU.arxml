AUTOSAR XML (schema 00046)
package /VehicleProject
  system System
    root-software-compositions:
      root sw composition prototype EcuSwComposition: software-composition=ECU_Composition
package /ECUCompositionTypes
  composition sw component type ECU_Composition
    component SWC1: type=SWC1
    component PowerMng_SWC: type=PowerMng_SWC
package /EndToEndProtections
  end to end protection set EndToEndProtectionSet
