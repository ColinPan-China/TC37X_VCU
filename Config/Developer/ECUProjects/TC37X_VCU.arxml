[part 1 of 2: package /VehicleProject]
AUTOSAR XML (schema 00046)
package /VehicleProject
  system System
    system mapping System_MPPNG
      data-mappings:
        sender-receiver-to-signal-mapping={data-element=BRO_BMSChargeReady.BRO_BMSChargeReady, system-signal=BRO_BMSChargeReady}
        sender-receiver-to-signal-mapping={data-element=BSM_BatteryCurrentState.BSM_BatteryCurrentState, system-signal=BSM_BatteryCurrentState}
        sender-receiver-to-signal-mapping={data-element=BSM_BatteryOutpuConnectorState.BSM_BatteryOutpuConnectorState, system-signal=BSM_BatteryOutpuConnectorState}
        sender-receiver-to-signal-mapping={data-element=BSM_BatteryTempState.BSM_BatteryTempState, system-signal=BSM_BatteryTempState}
        sender-receiver-to-signal-mapping={data-element=BSM_BatteryVoltageState.BSM_BatteryVoltageState, system-signal=BSM_BatteryVoltageState}
        sender-receiver-to-signal-mapping={data-element=BSM_ChargeEnable.BSM_ChargeEnable, system-signal=BSM_ChargeEnable}
        sender-receiver-to-signal-mapping={data-element=BSM_InsulationState.BSM_InsulationState, system-signal=BSM_InsulationState}
        sender-receiver-to-signal-mapping={data-element=BSM_SOC.BSM_SOC, system-signal=BSM_SOC}
        sender-receiver-to-signal-mapping={data-element=BST_AbortAchiveSingleVolt.BST_AbortAchiveSingleVolt, system-signal=BST_AbortAchiveSingleVolt}
        sender-receiver-to-signal-mapping={data-element=BST_AbortAchiveSOC.BST_AbortAchiveSOC, system-signal=BST_AbortAchiveSOC}
        sender-receiver-to-signal-mapping={data-element=BST_AbortAchiveTotalVolt.BST_AbortAchiveTotalVolt, system-signal=BST_AbortAchiveTotalVolt}
        sender-receiver-to-signal-mapping={data-element=BST_Abortdet2Voltexception.BST_Abortdet2Voltexception, system-signal=BST_Abortdet2Voltexception}
        sender-receiver-to-signal-mapping={data-element=BST_AbortErrorCurrent.BST_AbortErrorCurrent, system-signal=BST_AbortErrorCurrent}
        sender-receiver-to-signal-mapping={data-element=BST_AbortErrorVoltage.BST_AbortErrorVoltage, system-signal=BST_AbortErrorVoltage}
        sender-receiver-to-signal-mapping={data-element=BST_AbortFaultBatteryTemp.BST_AbortFaultBatteryTemp, system-signal=BST_AbortFaultBatteryTemp}
        sender-receiver-to-signal-mapping={data-element=BST_AbortFaultBMSTemp.BST_AbortFaultBMSTemp, system-signal=BST_AbortFaultBMSTemp}
        sender-receiver-to-signal-mapping={data-element=BST_AbortFaultConnector.BST_AbortFaultConnector, system-signal=BST_AbortFaultConnector}
        sender-receiver-to-signal-mapping={data-element=BST_AbortFaultConnectorTemp.BST_AbortFaultConnectorTemp, system-signal=BST_AbortFaultConnectorTemp}
        sender-receiver-to-signal-mapping={data-element=BST_AbortFaultInsulation.BST_AbortFaultInsulation, system-signal=BST_AbortFaultInsulation}
        sender-receiver-to-signal-mapping={data-element=BST_AbortFaultOther.BST_AbortFaultOther, system-signal=BST_AbortFaultOther}
        sender-receiver-to-signal-mapping={data-element=BST_AbortHVrelayfault.BST_AbortHVrelayfault, system-signal=BST_AbortHVrelayfault}
        sender-receiver-to-signal-mapping={data-element=BST_Abortmanoperate.BST_Abortmanoperate, system-signal=BST_Abortmanoperate}
        sender-receiver-to-signal-mapping={data-element=BEM_ChargeAbortTimeout.BEM_ChargeAbortTimeout, system-signal=BEM_ChargeAbortTimeout}
        sender-receiver-to-signal-mapping={data-element=BEM_ChargeFinishTimeout.BEM_ChargeFinishTimeout, system-signal=BEM_ChargeFinishTimeout}
        sender-receiver-to-signal-mapping={data-element=BEM_ChargerIdTimeout0.BEM_ChargerIdTimeout0, system-signal=BEM_ChargerIdTimeout0}
        sender-receiver-to-signal-mapping={data-element=BEM_ChargerIdTimeout1.BEM_ChargerIdTimeout1, system-signal=BEM_ChargerIdTimeout1}
        sender-receiver-to-signal-mapping={data-element=BEM_ChargeStateTimeout.BEM_ChargeStateTimeout, system-signal=BEM_ChargeStateTimeout}
        sender-receiver-to-signal-mapping={data-element=BEM_ChargeStatisticsTimeout.BEM_ChargeStatisticsTimeout, system-signal=BEM_ChargeStatisticsTimeout}
        sender-receiver-to-signal-mapping={data-element=BEM_TimesyncOrPowerTimeout.BEM_TimesyncOrPowerTimeout, system-signal=BEM_TimesyncOrPowerTimeout}
        sender-receiver-to-signal-mapping={data-element=CML_OutputCurrentMin.CML_OutputCurrentMin, system-signal=CML_OutputCurrentMin}
        sender-receiver-to-signal-mapping={data-element=CML_OutputVoltageMin.CML_OutputVoltageMin, system-signal=CML_OutputVoltageMin}
        sender-receiver-to-signal-mapping={data-element=CML_OutpuVoltageMax.CML_OutpuVoltageMax, system-signal=CML_OutpuVoltageMax}
        sender-receiver-to-signal-mapping={data-element=CRM_RecognitionResult.CRM_RecognitionResult, system-signal=CRM_RecognitionResult}
        sender-receiver-to-signal-mapping={data-element=CRO_ChargerReady.CRO_ChargerReady, system-signal=CRO_ChargerReady}
        sender-receiver-to-signal-mapping={data-element=CST_AbortAchiveCondition.CST_AbortAchiveCondition, system-signal=CST_AbortAchiveCondition}
        sender-receiver-to-signal-mapping={data-element=CSD_ChargerNo.CSD_ChargerNo, system-signal=CSD_ChargerNo}
        sender-receiver-to-signal-mapping={data-element=BHM_AllowChargeVoltageMax.BHM_AllowChargeVoltageMax, system-signal=BHM_AllowChargeVoltageMax}
        sender-receiver-to-signal-mapping={data-element=CEM_BatteryChargeRequireTimeout.CEM_BatteryChargeRequireTimeout, system-signal=CEM_BatteryChargeRequireTimeout}
        sender-receiver-to-signal-mapping={data-element=CML_OutputCurrentMax.CML_OutputCurrentMax, system-signal=CML_OutputCurrentMax}
        sender-receiver-to-signal-mapping={data-element=CCS_OutputVoltage.CCS_OutputVoltage, system-signal=CCS_OutputVoltage}
        sender-receiver-to-signal-mapping={data-element=CHM_ProtocolVersion.CHM_ProtocolVersion, system-signal=CHM_ProtocolVersion}
        sender-receiver-to-signal-mapping={data-element=BCP_AllowChargeVoltageMax.BCP_AllowChargeVoltageMax, system-signal=BCP_AllowChargeVoltageMax}
        sender-receiver-to-signal-mapping={data-element=BCP_AllowTempMax.BCP_AllowTempMax, system-signal=BCP_AllowTempMax}
        sender-receiver-to-signal-mapping={data-element=BCP_BatteryChargeVoltageMax.BCP_BatteryChargeVoltageMax, system-signal=BCP_BatteryChargeVoltageMax}
        sender-receiver-to-signal-mapping={data-element=BCP_BatteryNominalEnergy.BCP_BatteryNominalEnergy, system-signal=BCP_BatteryNominalEnergy}
        sender-receiver-to-signal-mapping={data-element=BCP_BatteryTotalVoltage.BCP_BatteryTotalVoltage, system-signal=BCP_BatteryTotalVoltage}
        sender-receiver-to-signal-mapping={data-element=BCP_ChargeCurrentMax.BCP_ChargeCurrentMax, system-signal=BCP_ChargeCurrentMax}
        sender-receiver-to-signal-mapping={data-element=BCP_SOC.BCP_SOC, system-signal=BCP_SOC}
        sender-receiver-to-signal-mapping={data-element=BCS_BatteryVoltMax.BCS_BatteryVoltMax, system-signal=BCS_BatteryVoltMax}
        sender-receiver-to-signal-mapping={data-element=BCS_BatteryVoltMaxGroup.BCS_BatteryVoltMaxGroup, system-signal=BCS_BatteryVoltMaxGroup}
        sender-receiver-to-signal-mapping={data-element=BCS_ChargeCurrentMeasure.BCS_ChargeCurrentMeasure, system-signal=BCS_ChargeCurrentMeasure}
        sender-receiver-to-signal-mapping={data-element=BCS_ChargeVoltageMeasure.BCS_ChargeVoltageMeasure, system-signal=BCS_ChargeVoltageMeasure}
        sender-receiver-to-signal-mapping={data-element=BCS_EstimatedTimeRemaining.BCS_EstimatedTimeRemaining, system-signal=BCS_EstimatedTimeRemaining}
        sender-receiver-to-signal-mapping={data-element=BCS_SOC.BCS_SOC, system-signal=BCS_SOC}
        sender-receiver-to-signal-mapping={data-element=BRM_BatteryChargeTimes.BRM_BatteryChargeTimes, system-signal=BRM_BatteryChargeTimes}
        sender-receiver-to-signal-mapping={data-element=BRM_BatteryProductDay.BRM_BatteryProductDay, system-signal=BRM_BatteryProductDay}
        sender-receiver-to-signal-mapping={data-element=BRM_BatteryProductMonth.BRM_BatteryProductMonth, system-signal=BRM_BatteryProductMonth}
        sender-receiver-to-signal-mapping={data-element=BRM_BatteryProductYear.BRM_BatteryProductYear, system-signal=BRM_BatteryProductYear}
        sender-receiver-to-signal-mapping={data-element=BRM_BatteryProperty.BRM_BatteryProperty, system-signal=BRM_BatteryProperty}
        sender-receiver-to-signal-mapping={data-element=BRM_BatterySN.BRM_BatterySN, system-signal=BRM_BatterySN}
        sender-receiver-to-signal-mapping={data-element=BRM_BatterySystemRatedCapacity.BRM_BatterySystemRatedCapacity, system-signal=BRM_BatterySystemRatedCapacity}
        sender-receiver-to-signal-mapping={data-element=BRM_BatterySystemRatedVoltage.BRM_BatterySystemRatedVoltage, system-signal=BRM_BatterySystemRatedVoltage}
        sender-receiver-to-signal-mapping={data-element=BRM_BatteryType.BRM_BatteryType, system-signal=BRM_BatteryType}
        sender-receiver-to-signal-mapping={data-element=BRM_Manufacturer.BRM_Manufacturer, system-signal=BRM_Manufacturer}
        sender-receiver-to-signal-mapping={data-element=BRM_ProtocolVersion.BRM_ProtocolVersion, system-signal=BRM_ProtocolVersion}
        sender-receiver-to-signal-mapping={data-element=BRM_VehicleIdByte1_8.BRM_VehicleIdByte1_8, system-signal=BRM_VehicleIdByte1_8}
        sender-receiver-to-signal-mapping={data-element=BRM_VehicleIdByte17.BRM_VehicleIdByte17, system-signal=BRM_VehicleIdByte17}
        sender-receiver-to-signal-mapping={data-element=BRM_VehicleIdByte9_16.BRM_VehicleIdByte9_16, system-signal=BRM_VehicleIdByte9_16}
        sender-receiver-to-signal-mapping={data-element=BSD_AbortSOC.BSD_AbortSOC, system-signal=BSD_AbortSOC}
        sender-receiver-to-signal-mapping={data-element=BSD_BatteryTempMax.BSD_BatteryTempMax, system-signal=BSD_BatteryTempMax}
        sender-receiver-to-signal-mapping={data-element=BSD_BatteryTempMin.BSD_BatteryTempMin, system-signal=BSD_BatteryTempMin}
        sender-receiver-to-signal-mapping={data-element=BSD_BatteryVoltageMax.BSD_BatteryVoltageMax, system-signal=BSD_BatteryVoltageMax}
        sender-receiver-to-signal-mapping={data-element=BSD_BatteryVoltageMin.BSD_BatteryVoltageMin, system-signal=BSD_BatteryVoltageMin}
        sender-receiver-to-signal-mapping={data-element=BSM_BatteryTempMax.BSM_BatteryTempMax, system-signal=BSM_BatteryTempMax}
        sender-receiver-to-signal-mapping={data-element=BSM_BatteryTempMaxNo.BSM_BatteryTempMaxNo, system-signal=BSM_BatteryTempMaxNo}
        sender-receiver-to-signal-mapping={data-element=BSM_BatteryTempMin.BSM_BatteryTempMin, system-signal=BSM_BatteryTempMin}
        sender-receiver-to-signal-mapping={data-element=BSM_BatteryTempMinNo.BSM_BatteryTempMinNo, system-signal=BSM_BatteryTempMinNo}
        sender-receiver-to-signal-mapping={data-element=BSM_BatteryVoltageMaxNo.BSM_BatteryVoltageMaxNo, system-signal=BSM_BatteryVoltageMaxNo}
        sender-receiver-to-signal-mapping={data-element=CTS_Year.CTS_Year, system-signal=CTS_Year}
        sender-receiver-to-signal-mapping={data-element=CCS_OutputCurrent.CCS_OutputCurrent, system-signal=CCS_OutputCurrent}
        sender-receiver-to-signal-mapping={data-element=BCL_ChargeMode.BCL_ChargeMode, system-signal=BCL_ChargeMode}
        sender-receiver-to-signal-mapping={data-element=BCL_CurrentRequire.BCL_CurrentRequire, system-signal=BCL_CurrentRequire}
        sender-receiver-to-signal-mapping={data-element=BCL_VolltageRequire.BCL_VolltageRequire, system-signal=BCL_VolltageRequire}
        sender-receiver-to-signal-mapping={data-element=FRC_Vl_OV.FRC_Vl_OV, system-signal=FRC_Vl_OV}
        sender-receiver-to-signal-mapping={data-element=FRC_Vl_UV.FRC_Vl_UV, system-signal=FRC_Vl_UV}
        sender-receiver-to-signal-mapping={data-element=FRC_ComFtonNet.FRC_ComFtonNet, system-signal=FRC_ComFtonNet}
        sender-receiver-to-signal-group-mapping={data-element=SG_SGW_PT_01_SigGroup.SG_SGW_PT_01_SigGroup, signal-group=SG_SGW_PT_01_SigGroup, type-mapping=sender-rec-record-type-mapping=record-element-mappings=[{implementation-record-element=IVI_LockACPlug, system-signal=IVI_LockACPlug}, {implementation-record-element=IVI_ForwardVmaxlimitSw, system-signal=IVI_ForwardVmaxlimitSw}, {implementation-record-element=IVI_LV_LimitPop, system-signal=IVI_LV_LimitPop}, {implementation-record-element=IVI_AppointChargeCmd, system-signal=IVI_AppointChargeCmd}]}
        sender-receiver-to-signal-group-mapping={data-element=SG_POD_DCDC_02_SigGroup.SG_POD_DCDC_02_SigGroup, signal-group=SG_POD_DCDC_02_SigGroup, type-mapping=sender-rec-record-type-mapping=record-element-mappings=[{implementation-record-element=POD_DCDC_FaultLevel, system-signal=POD_DCDC_FaultLevel}, {implementation-record-element=POD_DCDC_Side2Overtempfault, system-signal=POD_DCDC_Side2Overtempfault}]}
        sender-receiver-to-signal-group-mapping={data-element=SG_SGW_Time_SigGroup.SG_SGW_Time_SigGroup, signal-group=SG_SGW_Time_SigGroup, type-mapping=sender-rec-record-type-mapping=record-element-mappings=[{implementation-record-element=SGW_TimeInfoMinute, system-signal=SGW_TimeInfoMinute}, {implementation-record-element=SGW_TimeValid, system-signal=SGW_TimeValid}, {implementation-record-element=SGW_TimeInfoYear, system-signal=SGW_TimeInfoYear}, {implementation-record-element=SGW_TimeInfoSecond, system-signal=SGW_TimeInfoSecond}, {implementation-record-element=SGW_TimeInfoHour, system-signal=SGW_TimeInfoHour}, {implementation-record-element=SGW_TimeInfoMonth, system-signal=SGW_TimeInfoMonth}, {implementation-record-element=SGW_TimeInfoDay, system-signal=SGW_TimeInfoDay}]}
        sender-receiver-to-signal-group-mapping={data-element=SG_CGW_01_SigGroup.SG_CGW_01_SigGroup, signal-group=SG_CGW_01_SigGroup, type-mapping=sender-rec-record-type-mapping=record-element-mappings=[{implementation-record-element=Checksum_278, system-signal=Checksum_278}, {implementation-record-element=MessageCounter_278, system-signal=MessageCounter_278}, {implementation-record-element=CGW_VehicleState, system-signal=CGW_VehicleState}]}
        sender-receiver-to-signal-group-mapping={data-element=SG_IBS_VCU_MotorControl_SigGroup.SG_IBS_VCU_MotorControl_SigGroup, signal-group=SG_IBS_VCU_MotorControl_SigGroup, type-mapping=sender-rec-record-type-mapping=record-element-mappings=[{implementation-record-element=MessageCounter_090, system-signal=MessageCounter_090}, {implementation-record-element=IBS_WLTorqueIncrReq, system-signal=IBS_WLTorqueIncrReq}, {implementation-record-element=IBS_WLTorqueRedReqSts, system-signal=IBS_WLTorqueRedReqSts}, {implementation-record-element=IBS_WLTorqueRedReq, system-signal=IBS_WLTorqueRedReq}, {implementation-record-element=Checksum_090, system-signal=Checksum_090}, {implementation-record-element=IBS_WLTorqueIncrReqSts, system-signal=IBS_WLTorqueIncrReqSts}]}
        sender-receiver-to-signal-group-mapping={data-element=SG_SGW_04_SigGroup.SG_SGW_04_SigGroup, signal-group=SG_SGW_04_SigGroup, type-mapping=sender-rec-record-type-mapping=sender-rec-record-element-mapping{implementation-record-element=SGW_RemoteHVCtrlReq, system-signal=SGW_RemoteHVCtrlReq}}
        sender-receiver-to-signal-group-mapping={data-element=SG_PRND_SigGroup.SG_PRND_SigGroup, signal-group=SG_PRND_SigGroup, type-mapping=sender-rec-record-type-mapping=record-element-mappings=[{implementation-record-element=MessageCounter_248, system-signal=MessageCounter_248}, {implementation-record-element=PRND_Pbutton, system-signal=PRND_Pbutton}, {implementation-record-element=PRND_RNDbutton_FaultSts, system-signal=PRND_RNDbutton_FaultSts}, {implementation-record-element=PRND_Pbutton_FaultSts, system-signal=PRND_Pbutton_FaultSts}, {implementation-record-element=PRND_RNDbutton, system-signal=PRND_RNDbutton}, {implementation-record-element=Checksum_248, system-signal=Checksum_248}]}
        sender-receiver-to-signal-group-mapping={data-element=SG_DCM_FR_SigGroup.SG_DCM_FR_SigGroup, signal-group=SG_DCM_FR_SigGroup, type-mapping=sender-rec-record-type-mapping=sender-rec-record-element-mapping{implementation-record-element=DCM_FR_DoorFRSts, system-signal=DCM_FR_DoorFRSts}}
        sender-receiver-to-signal-group-mapping={data-element=SG_CGW_VIN3VER_SigGroup.SG_CGW_VIN3VER_SigGroup, signal-group=SG_CGW_VIN3VER_SigGroup, type-mapping=sender-rec-record-type-mapping=record-element-mappings=[{implementation-record-element=CGW_VIN16, system-signal=CGW_VIN16}, {implementation-record-element=CGW_VERSION2, system-signal=CGW_VERSION2}, {implementation-record-element=CGW_VERSION1, system-signal=CGW_VERSION1}]}
        sender-receiver-to-signal-group-mapping={data-element=SG_BMS_ErrorInfo_SigGroup.SG_BMS_ErrorInfo_SigGroup, signal-group=SG_BMS_ErrorInfo_SigGroup, type-mapping=sender-rec-record-type-mapping=record-element-mappings=[{implementation-record-element=BMS_ThermalRunawayFault, system-signal=BMS_ThermalRunawayFault}, {implementation-record-element=BMS_ErrorCellUnderVolt, system-signal=BMS_ErrorCellUnderVolt}, {implementation-record-element=BMS_ErrorCellLowTemp, system-signal=BMS_ErrorCellLowTemp}, {implementation-record-element=BMS_ErrorHighSoc, system-signal=BMS_ErrorHighSoc}, {implementation-record-element=BMS_ErrorCellHighTemp, system-signal=BMS_ErrorCellHighTemp}, {implementation-record-element=BMS_ErrorChaCurrentOver, system-signal=BMS_ErrorChaCurrentOver}, {implementation-record-element=BMS_ErrorLowSoc, system-signal=BMS_ErrorLowSoc}, {implementation-record-element=BMS_ErrorCellOverVolt, system-signal=BMS_ErrorCellOverVolt}, {implementation-record-element=BMS_ErrorRelay, system-signal=BMS_ErrorRelay}, {implementation-record-element=BMS_ErrorPreChaFailed, system-signal=BMS_ErrorPreChaFailed}]}
        sender-receiver-to-signal-group-mapping={data-element=SG_CGW_VIN2_SigGroup.SG_CGW_VIN2_SigGroup, signal-group=SG_CGW_VIN2_SigGroup, type-mapping=sender-rec-record-type-mapping=record-element-mappings=[{implementation-record-element=CGW_VIN15, system-signal=CGW_VIN15}, {implementation-record-element=CGW_VIN9, system-signal=CGW_VIN9}, {implementation-record-element=CGW_VIN12, system-signal=CGW_VIN12}, {implementation-record-element=CGW_VIN13, system-signal=CGW_VIN13}, {implementation-record-element=CGW_VIN11, system-signal=CGW_VIN11}, {implementation-record-element=CGW_VIN10, system-signal=CGW_VIN10}, {implementation-record-element=CGW_VIN14, system-signal=CGW_VIN14}, {implementation-record-element=CGW_VIN8, system-signal=CGW_VIN8}]}
        sender-receiver-to-signal-group-mapping={data-element=SG_BMS_status_02_SigGroup.SG_BMS_status_02_SigGroup, signal-group=SG_BMS_status_02_SigGroup, type-mapping=sender-rec-record-type-mapping=record-element-mappings=[{implementation-record-element=BMS_BattVolt, system-signal=BMS_BattVolt}, {implementation-record-element=BMS_BattCurr, system-signal=BMS_BattCurr}, {implementation-record-element=BMS_Heatcurrent, system-signal=BMS_Heatcurrent}]}
        sender-receiver-to-signal-group-mapping={data-element=SG_SGW_17_SigGroup.SG_SGW_17_SigGroup, signal-group=SG_SGW_17_SigGroup, type-mapping=sender-rec-record-type-mapping=sender-rec-record-element-mapping{implementation-record-element=SGW_BLESystemReadyReq, system-signal=SGW_BLESystemReadyReq}}
        sender-receiver-to-signal-group-mapping={data-element=SG_BMS_PRO_SigGroup.SG_BMS_PRO_SigGroup, signal-group=SG_BMS_PRO_SigGroup, type-mapping=sender-rec-record-type-mapping=record-element-mappings=[{implementation-record-element=BMS_BatProDatMonth, system-signal=BMS_BatProDatMonth}, {implementation-record-element=BMS_BatProDatDay, system-signal=BMS_BatProDatDay}, {implementation-record-element=BMS_BatProDatYear, system-signal=BMS_BatProDatYear}]}
        sender-receiver-to-signal-group-mapping={data-element=SG_ACU_01_SigGroup.SG_ACU_01_SigGroup, signal-group=SG_ACU_01_SigGroup, type-mapping=sender-rec-record-type-mapping=record-element-mappings=[{implementation-record-element=Checksum_0F5, system-signal=Checksum_0F5}, {implementation-record-element=ACU_YawRate, system-signal=ACU_YawRate}, {implementation-record-element=ACU_YawRateStatus, system-signal=ACU_YawRateStatus}, {implementation-record-element=MessageCounter_0F5, system-signal=MessageCounter_0F5}]}
        sender-receiver-to-signal-group-mapping={data-element=SG_ADCU_DA_SigGroup.SG_ADCU_DA_SigGroup, signal-group=SG_ADCU_DA_SigGroup, type-mapping=sender-rec-record-type-mapping=record-element-mappings=[{implementation-record-element=Checksum_0E6, system-signal=Checksum_0E6}, {implementation-record-element=MessageCounter_0E6, system-signal=MessageCounter_0E6}, {implementation-record-element=ADCU_DA_Mode, system-signal=ADCU_DA_Mode}]}
        sender-receiver-to-signal-group-mapping={data-element=SG_POD_Status_02_SigGroup.SG_POD_Status_02_SigGroup, signal-group=SG_POD_Status_02_SigGroup, type-mapping=sender-rec-record-type-mapping=record-element-mappings=[{implementation-record-element=POD_DCPortInletTempAValid, system-signal=POD_DCPortInletTempAValid}, {implementation-record-element=POD_DCPosRelayState, system-signal=POD_DCPosRelayState}, {implementation-record-element=POD_DCPortInletTempBValid, system-signal=POD_DCPortInletTempBValid}]}
        sender-receiver-to-signal-group-mapping={data-element=SG_CGW_VIN1_SigGroup.SG_CGW_VIN1_SigGroup, signal-group=SG_CGW_VIN1_SigGroup, type-mapping=sender-rec-record-type-mapping=record-element-mappings=[{implementation-record-element=CGW_VIN2, system-signal=CGW_VIN2}, {implementation-record-element=CGW_VIN4, system-signal=CGW_VIN4}, {implementation-record-element=CGW_VIN6, system-signal=CGW_VIN6}, {implementation-record-element=CGW_VIN0, system-signal=CGW_VIN0}, {implementation-record-element=CGW_VIN3, system-signal=CGW_VIN3}, {implementation-record-element=CGW_VIN5, system-signal=CGW_VIN5}, {implementation-record-element=CGW_VIN1, system-signal=CGW_VIN1}, {implementation-record-element=CGW_VIN7, system-signal=CGW_VIN7}]}
        sender-receiver-to-signal-group-mapping={data-element=SG_IVI_01_SigGroup.SG_IVI_01_SigGroup, signal-group=SG_IVI_01_SigGroup, type-mapping=sender-rec-record-type-mapping=sender-rec-record-element-mapping{implementation-record-element=IVI_GearRequest, system-signal=IVI_GearRequest}}
        sender-receiver-to-signal-group-mapping={data-element=SG_MCU_02_SigGroup.SG_MCU_02_SigGroup, signal-group=SG_MCU_02_SigGroup, type-mapping=sender-rec-record-type-mapping=record-element-mappings=[{implementation-record-element=MCU_BDmpCActv, system-signal=MCU_BDmpCActv}, {implementation-record-element=MCU_VCUWorkMode, system-signal=MCU_VCUWorkMode}]}
        sender-receiver-to-signal-group-mapping={data-element=SG_MCU_Temperature_02_SigGroup.SG_MCU_Temperature_02_SigGroup, signal-group=SG_MCU_Temperature_02_SigGroup, type-mapping=sender-rec-record-type-mapping=sender-rec-record-element-mapping{implementation-record-element=MCU_TempStatus, system-signal=MCU_TempStatus}}
        sender-receiver-to-signal-group-mapping={data-element=SG_BMS_Charge_01_SigGroup.SG_BMS_Charge_01_SigGroup, signal-group=SG_BMS_Charge_01_SigGroup, type-mapping=sender-rec-record-type-mapping=record-element-mappings=[{implementation-record-element=BMS_RemChagTime, system-signal=BMS_RemChagTime}, {implementation-record-element=BMS_AllowChagCurrent, system-signal=BMS_AllowChagCurrent}, {implementation-record-element=BMS_MaxChagVoltage, system-signal=BMS_MaxChagVoltage}]}
        sender-receiver-to-signal-group-mapping={data-element=SG_CGW_02_SigGroup.SG_CGW_02_SigGroup, signal-group=SG_CGW_02_SigGroup, type-mapping=sender-rec-record-type-mapping=record-element-mappings=[{implementation-record-element=CGW_IVISts, system-signal=CGW_IVISts}, {implementation-record-element=CGW_CGWSts, system-signal=CGW_CGWSts}, {implementation-record-element=CGW_DCM_RRSts, system-signal=CGW_DCM_RRSts}, {implementation-record-element=CGW_DCM_FLSts, system-signal=CGW_DCM_FLSts}, {implementation-record-element=CGW_DCM_FRSts, system-signal=CGW_DCM_FRSts}, {implementation-record-element=CGW_PRNDSts, system-signal=CGW_PRNDSts}, {implementation-record-element=CGW_SCU_RSts, system-signal=CGW_SCU_RSts}, {implementation-record-element=CGW_SGWSts, system-signal=CGW_SGWSts}, {implementation-record-element=CGW_VCUSts, system-signal=CGW_VCUSts}, {implementation-record-element=CGW_BCMSts, system-signal=CGW_BCMSts}, {implementation-record-element=CGW_SWPSts, system-signal=CGW_SWPSts}, {implementation-record-element=CGW_ADCUSts, system-signal=CGW_ADCUSts}, {implementation-record-element=CGW_HOD_HeatingSts, system-signal=CGW_HOD_HeatingSts}, {implementation-record-element=CGW_BMSSts, system-signal=CGW_BMSSts}, {implementation-record-element=CGW_CBMSts, system-signal=CGW_CBMSts}, {implementation-record-element=CGW_SCU_LSts, system-signal=CGW_SCU_LSts}, {implementation-record-element=CGW_DCM_RLSts, system-signal=CGW_DCM_RLSts}, {implementation-record-element=CGW_MFP_FCSts, system-signal=CGW_MFP_FCSts}, {implementation-record-element=CGW_HLLSts, system-signal=CGW_HLLSts}, {implementation-record-element=CGW_MFP_RCSts, system-signal=CGW_MFP_RCSts}, {implementation-record-element=CGW_SwichesSts, system-signal=CGW_SwichesSts}, {implementation-record-element=CGW_HLRSts, system-signal=CGW_HLRSts}]}
        sender-receiver-to-signal-group-mapping={data-element=SG_POD_OBC_STATUS_02_SigGroup.SG_POD_OBC_STATUS_02_SigGroup, signal-group=SG_POD_OBC_STATUS_02_SigGroup, type-mapping=sender-rec-record-type-mapping=record-element-mappings=[{implementation-record-element=POD_OBC_OutputDCChargeCurrent, system-signal=POD_OBC_OutputDCChargeCurrent}, {implementation-record-element=POD_OBC_ChrgOutpPwrAvl, system-signal=POD_OBC_ChrgOutpPwrAvl}, {implementation-record-element=POD_OBC_OutputDCChargeVoltage, system-signal=POD_OBC_OutputDCChargeVoltage}]}
        sender-receiver-to-signal-group-mapping={data-element=SG_BMS_TCU_SigGroup.SG_BMS_TCU_SigGroup, signal-group=SG_BMS_TCU_SigGroup, type-mapping=sender-rec-record-type-mapping=record-element-mappings=[{implementation-record-element=BMS_RTC_Request, system-signal=BMS_RTC_Request}, {implementation-record-element=BMS_AllowCellTemperature, system-signal=BMS_AllowCellTemperature}, {implementation-record-element=BMS_KeepWarmStatus, system-signal=BMS_KeepWarmStatus}, {implementation-record-element=BMS_KeepWarmRequest, system-signal=BMS_KeepWarmRequest}]}
        sender-receiver-to-signal-group-mapping={data-element=SG_ADCU_APS_02_SigGroup.SG_ADCU_APS_02_SigGroup, signal-group=SG_ADCU_APS_02_SigGroup, type-mapping=sender-rec-record-type-mapping=sender-rec-record-element-mapping{implementation-record-element=ADCU_RemoteParkingMode, system-signal=ADCU_RemoteParkingMode}}
        sender-receiver-to-signal-group-mapping={data-element=SG_MCU_FailureCode_SigGroup.SG_MCU_FailureCode_SigGroup, signal-group=SG_MCU_FailureCode_SigGroup, type-mapping=sender-rec-record-type-mapping=record-element-mappings=[{implementation-record-element=MessageCounter_253, system-signal=MessageCounter_253}, {implementation-record-element=MCU_FaultLevel, system-signal=MCU_FaultLevel}, {implementation-record-element=Checksum_253, system-signal=Checksum_253}]}
        sender-receiver-to-signal-group-mapping={data-element=SG_IVI_OdometerInfor_SigGroup.SG_IVI_OdometerInfor_SigGroup, signal-group=SG_IVI_OdometerInfor_SigGroup, type-mapping=sender-rec-record-type-mapping=sender-rec-record-element-mapping{implementation-record-element=IVI_OdometerInfor, system-signal=IVI_OdometerInfor}}
        sender-receiver-to-signal-group-mapping={data-element=SG_DCM_RL_SigGroup.SG_DCM_RL_SigGroup, signal-group=SG_DCM_RL_SigGroup, type-mapping=sender-rec-record-type-mapping=sender-rec-record-element-mapping{implementation-record-element=DCM_RL_DoorRLSts, system-signal=DCM_RL_DoorRLSts}}
        sender-receiver-to-signal-group-mapping={data-element=SG_MCU_Temperature_01_SigGroup.SG_MCU_Temperature_01_SigGroup, signal-group=SG_MCU_Temperature_01_SigGroup, type-mapping=sender-rec-record-type-mapping=sender-rec-record-element-mapping{implementation-record-element=MCU_IGBTTempMax, system-signal=MCU_IGBTTempMax}}
        sender-receiver-to-signal-group-mapping={data-element=SG_POD_DCDC_01_SigGroup.SG_POD_DCDC_01_SigGroup, signal-group=SG_POD_DCDC_01_SigGroup, type-mapping=sender-rec-record-type-mapping=record-element-mappings=[{implementation-record-element=POD_DCDC_WorkMode, system-signal=POD_DCDC_WorkMode}, {implementation-record-element=POD_DCDC_HVInputVoltage, system-signal=POD_DCDC_HVInputVoltage}, {implementation-record-element=POD_DCDC_HVInputCurrent, system-signal=POD_DCDC_HVInputCurrent}]}
        sender-receiver-to-signal-group-mapping={data-element=SG_BMS_BatInfor_02_SigGroup.SG_BMS_BatInfor_02_SigGroup, signal-group=SG_BMS_BatInfor_02_SigGroup, type-mapping=sender-rec-record-type-mapping=sender-rec-record-element-mapping{implementation-record-element=BMS_BatSupName, system-signal=BMS_BatSupName}}
        sender-receiver-to-signal-group-mapping={data-element=SG_BMS_status_03_SigGroup.SG_BMS_status_03_SigGroup, signal-group=SG_BMS_status_03_SigGroup, type-mapping=sender-rec-record-type-mapping=record-element-mappings=[{implementation-record-element=BMS_DisplaySOC, system-signal=BMS_DisplaySOC}, {implementation-record-element=BMS_LinkVoltage, system-signal=BMS_LinkVoltage}, {implementation-record-element=BMS_PackVoltage, system-signal=BMS_PackVoltage}]}
        sender-receiver-to-signal-group-mapping={data-element=SG_DCM_FR_02_SigGroup.SG_DCM_FR_02_SigGroup, signal-group=SG_DCM_FR_02_SigGroup, type-mapping=sender-rec-record-type-mapping=record-element-mappings=[{implementation-record-element=DCM_FR_AmbientTemperature, system-signal=DCM_FR_AmbientTemperature}, {implementation-record-element=DCM_FR_AmbientTemperatureValid, system-signal=DCM_FR_AmbientTemperatureValid}]}
        sender-receiver-to-signal-group-mapping={data-element=SG_IBS_Torque_SigGroup.SG_IBS_Torque_SigGroup, signal-group=SG_IBS_Torque_SigGroup, type-mapping=sender-rec-record-type-mapping=record-element-mappings=[{implementation-record-element=IBS_WLTorqueRBSReq, system-signal=IBS_WLTorqueRBSReq}, {implementation-record-element=Checksum_0B9, system-signal=Checksum_0B9}, {implementation-record-element=IBS_RBSStatus, system-signal=IBS_RBSStatus}, {implementation-record-element=IBS_WLTorqueAPSReqValid, system-signal=IBS_WLTorqueAPSReqValid}, {implementation-record-element=MessageCounter_0B9, system-signal=MessageCounter_0B9}, {implementation-record-element=IBS_WLTorqueAPSReq, system-signal=IBS_WLTorqueAPSReq}, {implementation-record-element=IBS_TargetGearReq, system-signal=IBS_TargetGearReq}, {implementation-record-element=IBS_VCU_DecelerationReqActive, system-signal=IBS_VCU_DecelerationReqActive}, {implementation-record-element=IBS_WLTorqueRBSReqValid, system-signal=IBS_WLTorqueRBSReqValid}]}
        sender-receiver-to-signal-group-mapping={data-element=SG_POD_OBC_CHRGSTATION_SigGroup.SG_POD_OBC_CHRGSTATION_SigGroup, signal-group=SG_POD_OBC_CHRGSTATION_SigGroup, type-mapping=sender-rec-record-type-mapping=record-element-mappings=[{implementation-record-element=POD_OBC_ChargCapacibility, system-signal=POD_OBC_ChargCapacibility}, {implementation-record-element=POD_OBC_WorkMode, system-signal=POD_OBC_WorkMode}, {implementation-record-element=POD_OBC_EMLockState, system-signal=POD_OBC_EMLockState}, {implementation-record-element=POD_OBC_CCCurrentLimit, system-signal=POD_OBC_CCCurrentLimit}, {implementation-record-element=POD_OBC_CPCurrentLimit, system-signal=POD_OBC_CPCurrentLimit}, {implementation-record-element=POD_OBC_S2State, system-signal=POD_OBC_S2State}, {implementation-record-element=POD_OBC_CCStatus, system-signal=POD_OBC_CCStatus}, {implementation-record-element=POD_OBC_CPDuty, system-signal=POD_OBC_CPDuty}, {implementation-record-element=POD_OBC_CPStatus, system-signal=POD_OBC_CPStatus}, {implementation-record-element=POD_OBC_OBCMaxPermOutpCrrt, system-signal=POD_OBC_OBCMaxPermOutpCrrt}]}
        sender-receiver-to-signal-group-mapping={data-element=SG_POD_OBC_STATUS_03_SigGroup.SG_POD_OBC_STATUS_03_SigGroup, signal-group=SG_POD_OBC_STATUS_03_SigGroup, type-mapping=sender-rec-record-type-mapping=record-element-mappings=[{implementation-record-element=POD_OBC_Side2Overtempfault, system-signal=POD_OBC_Side2Overtempfault}, {implementation-record-element=POD_OBC_FaultLevel, system-signal=POD_OBC_FaultLevel}, {implementation-record-element=POD_OBC_SecondarySideTemp, system-signal=POD_OBC_SecondarySideTemp}, {implementation-record-element=POD_OBC_Side1Overtempfault, system-signal=POD_OBC_Side1Overtempfault}, {implementation-record-element=POD_OBC_PrimarySideTemp, system-signal=POD_OBC_PrimarySideTemp}]}
        sender-receiver-to-signal-group-mapping={data-element=SG_POD_OBC_STATUS_04_SigGroup.SG_POD_OBC_STATUS_04_SigGroup, signal-group=SG_POD_OBC_STATUS_04_SigGroup, type-mapping=sender-rec-record-type-mapping=record-element-mappings=[{implementation-record-element=POD_OBC_InputACVoltage_R, system-signal=POD_OBC_InputACVoltage_R}, {implementation-record-element=POD_OBC_InputACCurrent_S, system-signal=POD_OBC_InputACCurrent_S}, {implementation-record-element=POD_OBC_InputACCurrent_T, system-signal=POD_OBC_InputACCurrent_T}, {implementation-record-element=POD_OBC_InputACVoltage_S, system-signal=POD_OBC_InputACVoltage_S}, {implementation-record-element=POD_OBC_InputACCurrent_R, system-signal=POD_OBC_InputACCurrent_R}, {implementation-record-element=POD_OBC_InputACVoltage_T, system-signal=POD_OBC_InputACVoltage_T}]}
        sender-receiver-to-signal-group-mapping={data-element=SG_ACU_02_SigGroup.SG_ACU_02_SigGroup, signal-group=SG_ACU_02_SigGroup, type-mapping=sender-rec-record-type-mapping=record-element-mappings=[{implementation-record-element=ACU_LatA, system-signal=ACU_LatA}, {implementation-record-element=ACU_LatAStatus, system-signal=ACU_LatAStatus}, {implementation-record-element=ACU_LgtAStatus, system-signal=ACU_LgtAStatus}, {implementation-record-element=Checksum_0F6, system-signal=Checksum_0F6}, {implementation-record-element=MessageCounter_0F6, system-signal=MessageCounter_0F6}, {implementation-record-element=ACU_LgtA, system-signal=ACU_LgtA}]}
        sender-receiver-to-signal-group-mapping={data-element=SG_POD_Status_01_SigGroup.SG_POD_Status_01_SigGroup, signal-group=SG_POD_Status_01_SigGroup, type-mapping=sender-rec-record-type-mapping=record-element-mappings=[{implementation-record-element=POD_DCInletTempA, system-signal=POD_DCInletTempA}, {implementation-record-element=POD_DCInletTempB, system-signal=POD_DCInletTempB}, {implementation-record-element=POD_DCFCVoltage, system-signal=POD_DCFCVoltage}]}
        sender-receiver-to-signal-group-mapping={data-element=SG_BMS_VersionInfor_SigGroup.SG_BMS_VersionInfor_SigGroup, signal-group=SG_BMS_VersionInfor_SigGroup, type-mapping=sender-rec-record-type-mapping=record-element-mappings=[{implementation-record-element=BMS_BatProRights, system-signal=BMS_BatProRights}, {implementation-record-element=BMS_ComVersion, system-signal=BMS_ComVersion}]}
        sender-receiver-to-signal-group-mapping={data-element=SG_BMS_BatInfor_01_SigGroup.SG_BMS_BatInfor_01_SigGroup, signal-group=SG_BMS_BatInfor_01_SigGroup, type-mapping=sender-rec-record-type-mapping=record-element-mappings=[{implementation-record-element=BMS_CellNumbers, system-signal=BMS_CellNumbers}, {implementation-record-element=BMS_RatCapacity, system-signal=BMS_RatCapacity}, {implementation-record-element=BMS_RatEnergy, system-signal=BMS_RatEnergy}, {implementation-record-element=BMS_RatBatVoltage, system-signal=BMS_RatBatVoltage}, {implementation-record-element=BMS_BatType, system-signal=BMS_BatType}]}
        sender-receiver-to-signal-group-mapping={data-element=SG_MCU_DeratingStatus_SigGroup.SG_MCU_DeratingStatus_SigGroup, signal-group=SG_MCU_DeratingStatus_SigGroup, type-mapping=sender-rec-record-type-mapping=record-element-mappings=[{implementation-record-element=MCU_TrqAbsMin, system-signal=MCU_TrqAbsMin}, {implementation-record-element=MCU_TrqAbsMax, system-signal=MCU_TrqAbsMax}]}
        sender-receiver-to-signal-group-mapping={data-element=SG_SGW_VCU_01_SigGroup.SG_SGW_VCU_01_SigGroup, signal-group=SG_SGW_VCU_01_SigGroup, type-mapping=sender-rec-record-type-mapping=record-element-mappings=[{implementation-record-element=IVI_ForwardVmaxAllowed, system-signal=IVI_ForwardVmaxAllowed}, {implementation-record-element=IVI_MaxChrgSocSet, system-signal=IVI_MaxChrgSocSet}, {implementation-record-element=IVI_DschrgOnOffSet, system-signal=IVI_DschrgOnOffSet}, {implementation-record-element=IVI_V2LidisSet, system-signal=IVI_V2LidisSet}, {implementation-record-element=IVI_DriveModeSet, system-signal=IVI_DriveModeSet}]}
        sender-receiver-to-signal-group-mapping={data-element=SG_SGW_IBS_01_SigGroup.SG_SGW_IBS_01_SigGroup, signal-group=SG_SGW_IBS_01_SigGroup, type-mapping=sender-rec-record-type-mapping=record-element-mappings=[{implementation-record-element=IVI_CRLevelSet, system-signal=IVI_CRLevelSet}, {implementation-record-element=IVI_BrakeCompensateCmd, system-signal=IVI_BrakeCompensateCmd}]}
        sender-receiver-to-signal-group-mapping={data-element=SG_DCM_RR_SigGroup.SG_DCM_RR_SigGroup, signal-group=SG_DCM_RR_SigGroup, type-mapping=sender-rec-record-type-mapping=sender-rec-record-element-mapping{implementation-record-element=DCM_RR_DoorRRSts, system-signal=DCM_RR_DoorRRSts}}
        sender-receiver-to-signal-group-mapping={data-element=SG_BMS_DIRelayState_SigGroup.SG_BMS_DIRelayState_SigGroup, signal-group=SG_BMS_DIRelayState_SigGroup, type-mapping=sender-rec-record-type-mapping=record-element-mappings=[{implementation-record-element=BMS_PTC_VoltageValue, system-signal=BMS_PTC_VoltageValue}, {implementation-record-element=BMS_PosRelayStatus, system-signal=BMS_PosRelayStatus}, {implementation-record-element=BMS_NegRelayStatus, system-signal=BMS_NegRelayStatus}, {implementation-record-element=BMS_PTCRelayStatus, system-signal=BMS_PTCRelayStatus}, {implementation-record-element=BMS_PreRelayStatus, system-signal=BMS_PreRelayStatus}]}
        sender-receiver-to-signal-group-mapping={data-element=SG_TCU_02_SigGroup.SG_TCU_02_SigGroup, signal-group=SG_TCU_02_SigGroup, type-mapping=sender-rec-record-type-mapping=record-element-mappings=[{implementation-record-element=TCU_HVCHHVDCCurrent, system-signal=TCU_HVCHHVDCCurrent}, {implementation-record-element=TCU_HVCHHighVoltage, system-signal=TCU_HVCHHighVoltage}]}
        sender-receiver-to-signal-group-mapping={data-element=SG_SGW_16_SigGroup.SG_SGW_16_SigGroup, signal-group=SG_SGW_16_SigGroup, type-mapping=sender-rec-record-type-mapping=sender-rec-record-element-mapping{implementation-record-element=IVI_VrState, system-signal=IVI_VrState}}
        sender-receiver-to-signal-group-mapping={data-element=SG_APTC_TCU_SigGroup.SG_APTC_TCU_SigGroup, signal-group=SG_APTC_TCU_SigGroup, type-mapping=sender-rec-record-type-mapping=sender-rec-record-element-mapping{implementation-record-element=APTC_PowerConsumption, system-signal=APTC_PowerConsumption}}
        sender-receiver-to-signal-group-mapping={data-element=SG_TCU_01_SigGroup.SG_TCU_01_SigGroup, signal-group=SG_TCU_01_SigGroup, type-mapping=sender-rec-record-type-mapping=record-element-mappings=[{implementation-record-element=TCU_TMSTotoalPwrReq, system-signal=TCU_TMSTotoalPwrReq}, {implementation-record-element=TCU_TMSTotalPwrCnsmp, system-signal=TCU_TMSTotalPwrCnsmp}, {implementation-record-element=TCU_HVPwrState, system-signal=TCU_HVPwrState}, {implementation-record-element=TCU_TMSFaultLevel, system-signal=TCU_TMSFaultLevel}]}
        sender-receiver-to-signal-group-mapping={data-element=SG_BMS_BatInfor_03_SigGroup.SG_BMS_BatInfor_03_SigGroup, signal-group=SG_BMS_BatInfor_03_SigGroup, type-mapping=sender-rec-record-type-mapping=sender-rec-record-element-mapping{implementation-record-element=BMS_RemainCapacity, system-signal=BMS_RemainCapacity}}
        sender-receiver-to-signal-group-mapping={data-element=SG_BMS_Charge_03_SigGroup.SG_BMS_Charge_03_SigGroup, signal-group=SG_BMS_Charge_03_SigGroup, type-mapping=sender-rec-record-type-mapping=record-element-mappings=[{implementation-record-element=BMS_SingChgkwh, system-signal=BMS_SingChgkwh}, {implementation-record-element=BMS_BatChagSum, system-signal=BMS_BatChagSum}, {implementation-record-element=BMS_SumChgkwh, system-signal=BMS_SumChgkwh}]}
        sender-receiver-to-signal-group-mapping={data-element=SG_BMS_Charge_02_SigGroup.SG_BMS_Charge_02_SigGroup, signal-group=SG_BMS_Charge_02_SigGroup, type-mapping=sender-rec-record-type-mapping=record-element-mappings=[{implementation-record-element=BMS_AbortAchiveSingleVolt, system-signal=BMS_AbortAchiveSingleVolt}, {implementation-record-element=BMS_AbortAchivesetValue, system-signal=BMS_AbortAchivesetValue}, {implementation-record-element=BMS_AbortFaultBatteryTemp, system-signal=BMS_AbortFaultBatteryTemp}, {implementation-record-element=BMS_DCChgMode, system-signal=BMS_DCChgMode}, {implementation-record-element=BMS_AbortAchiveTotalVolt, system-signal=BMS_AbortAchiveTotalVolt}, {implementation-record-element=BMS_ChargeRequest, system-signal=BMS_ChargeRequest}, {implementation-record-element=BMS_AbortErrorVoltage, system-signal=BMS_AbortErrorVoltage}, {implementation-record-element=BMS_AbortFaultBMSTemp, system-signal=BMS_AbortFaultBMSTemp}, {implementation-record-element=BMS_AbortErrorCurrent, system-signal=BMS_AbortErrorCurrent}, {implementation-record-element=BMS_ChagComplete, system-signal=BMS_ChagComplete}]}
        sender-receiver-to-signal-group-mapping={data-element=SG_EVCOM_State_01_SigGroup.SG_EVCOM_State_01_SigGroup, signal-group=SG_EVCOM_State_01_SigGroup, type-mapping=sender-rec-record-type-mapping=record-element-mappings=[{implementation-record-element=EVCOM_CompActlPwrCnsmp, system-signal=EVCOM_CompActlPwrCnsmp}, {implementation-record-element=EVCOM_CompActlCnsmpCur, system-signal=EVCOM_CompActlCnsmpCur}]}
        sender-receiver-to-signal-group-mapping={data-element=SG_VCU_HMIsignals_02_SigGroup.SG_VCU_HMIsignals_02_SigGroup, signal-group=SG_VCU_HMIsignals_02_SigGroup, type-mapping=sender-rec-record-type-mapping=record-element-mappings=[{implementation-record-element=VCU_DischargeEndSoc, system-signal=VCU_DischargeEndSoc}, {implementation-record-element=VCU_MCU_FaultLampReq, system-signal=VCU_MCU_FaultLampReq}, {implementation-record-element=VCU_Display_Cur, system-signal=VCU_Display_Cur}, {implementation-record-element=VCU_SystemReady, system-signal=VCU_SystemReady}, {implementation-record-element=Checksum_318, system-signal=Checksum_318}, {implementation-record-element=VCU_ForwardVmaxAllowed, system-signal=VCU_ForwardVmaxAllowed}, {implementation-record-element=MessageCounter_318, system-signal=MessageCounter_318}, {implementation-record-element=VCU_Display_Power, system-signal=VCU_Display_Power}, {implementation-record-element=VCU_maxChargeSOC, system-signal=VCU_maxChargeSOC}]}
        sender-receiver-to-signal-group-mapping={data-element=SG_VCU_TCU_SigGroup.SG_VCU_TCU_SigGroup, signal-group=SG_VCU_TCU_SigGroup, type-mapping=sender-rec-record-type-mapping=record-element-mappings=[{implementation-record-element=VCU_RequestedModeTCU, system-signal=VCU_RequestedModeTCU}, {implementation-record-element=VCU_TCUPowerAllowed, system-signal=VCU_TCUPowerAllowed}]}
        sender-receiver-to-signal-group-mapping={data-element=SG_VCU_IBS_01_SigGroup.SG_VCU_IBS_01_SigGroup, signal-group=SG_VCU_IBS_01_SigGroup, type-mapping=sender-rec-record-type-mapping=record-element-mappings=[{implementation-record-element=VCU_OPStandstillReq, system-signal=VCU_OPStandstillReq}, {implementation-record-element=MessageCounter_094, system-signal=MessageCounter_094}, {implementation-record-element=VCU_WheelTrqACT, system-signal=VCU_WheelTrqACT}, {implementation-record-element=VCU_MotorActualTorque, system-signal=VCU_MotorActualTorque}, {implementation-record-element=Checksum_094, system-signal=Checksum_094}, {implementation-record-element=VCU_MotorActualTorqueValid, system-signal=VCU_MotorActualTorqueValid}, {implementation-record-element=VCU_WheelTrqACTValid, system-signal=VCU_WheelTrqACTValid}]}
        sender-receiver-to-signal-group-mapping={data-element=SG_VCU_03_SigGroup.SG_VCU_03_SigGroup, signal-group=SG_VCU_03_SigGroup, type-mapping=sender-rec-record-type-mapping=record-element-mappings=[{implementation-record-element=VCU_BrakeCompensateStatus, system-signal=VCU_BrakeCompensateStatus}, {implementation-record-element=VCU_EnergyV2L, system-signal=VCU_EnergyV2L}, {implementation-record-element=VCU_DCFCCurrent, system-signal=VCU_DCFCCurrent}, {implementation-record-element=VCU_MemoryChargeFault, system-signal=VCU_MemoryChargeFault}, {implementation-record-element=VCU_ChargeProcessComment, system-signal=VCU_ChargeProcessComment}]}
        sender-receiver-to-signal-group-mapping={data-element=SG_VCU_BMS_SigGroup.SG_VCU_BMS_SigGroup, signal-group=SG_VCU_BMS_SigGroup, type-mapping=sender-rec-record-type-mapping=record-element-mappings=[{implementation-record-element=VCU_RequestedModeBMS, system-signal=VCU_RequestedModeBMS}, {implementation-record-element=VCU_BMSTargetThermLevel, system-signal=VCU_BMSTargetThermLevel}, {implementation-record-element=VCU_LimitLevel, system-signal=VCU_LimitLevel}, {implementation-record-element=VCU_IsoMeasurementSwitch, system-signal=VCU_IsoMeasurementSwitch}, {implementation-record-element=MessageCounter_0D1, system-signal=MessageCounter_0D1}, {implementation-record-element=VCU_ChargeStatus, system-signal=VCU_ChargeStatus}, {implementation-record-element=VCU_DrvModSwitchWarn, system-signal=VCU_DrvModSwitchWarn}, {implementation-record-element=Checksum_0D1, system-signal=Checksum_0D1}, {implementation-record-element=VCU_BMS_Control_of_PosRelay, system-signal=VCU_BMS_Control_of_PosRelay}, {implementation-record-element=VCU_RegenBrakeLightRequest, system-signal=VCU_RegenBrakeLightRequest}, {implementation-record-element=VCU_RegenBrakeLightReqVld, system-signal=VCU_RegenBrakeLightReqVld}, {implementation-record-element=VCU_ActDriveMode, system-signal=VCU_ActDriveMode}, {implementation-record-element=VCU_HVStatus, system-signal=VCU_HVStatus}]}
        sender-receiver-to-signal-group-mapping={data-element=SG_VCU_DiagInfor_SigGroup.SG_VCU_DiagInfor_SigGroup, signal-group=SG_VCU_DiagInfor_SigGroup, type-mapping=sender-rec-record-type-mapping=sender-rec-record-element-mapping{implementation-record-element=VCU_DTC_Number, system-signal=VCU_DTC_Number}}
        sender-receiver-to-signal-group-mapping={data-element=SG_VCU_05_SigGroup.SG_VCU_05_SigGroup, signal-group=SG_VCU_05_SigGroup, type-mapping=sender-rec-record-type-mapping=record-element-mappings=[{implementation-record-element=VCU_MaximumOutputVoltage, system-signal=VCU_MaximumOutputVoltage}, {implementation-record-element=VCU_MaximumOutputCurrent, system-signal=VCU_MaximumOutputCurrent}, {implementation-record-element=VCU_MinimumOutputCurrent, system-signal=VCU_MinimumOutputCurrent}, {implementation-record-element=VCU_MinimumOutputVoltage, system-signal=VCU_MinimumOutputVoltage}]}
        sender-receiver-to-signal-group-mapping={data-element=SG_VCU_Chassis_01_SigGroup.SG_VCU_Chassis_01_SigGroup, signal-group=SG_VCU_Chassis_01_SigGroup, type-mapping=sender-rec-record-type-mapping=record-element-mappings=[{implementation-record-element=VCU_DecelerationReqactive, system-signal=VCU_DecelerationReqactive}, {implementation-record-element=VCU_BrakeCompensateWarn, system-signal=VCU_BrakeCompensateWarn}, {implementation-record-element=VCU_TorqueRequestAvailable, system-signal=VCU_TorqueRequestAvailable}, {implementation-record-element=VCU_ADASOverride, system-signal=VCU_ADASOverride}, {implementation-record-element=VCU_DriverTorqueRequest, system-signal=VCU_DriverTorqueRequest}, {implementation-record-element=Checksum_0D3, system-signal=Checksum_0D3}, {implementation-record-element=VCU_DecelerationReq, system-signal=VCU_DecelerationReq}, {implementation-record-element=VCU_APSTorqueRequestActive, system-signal=VCU_APSTorqueRequestActive}, {implementation-record-element=VCU_RegStatus, system-signal=VCU_RegStatus}, {implementation-record-element=VCU_APSTorqueRequestAvailable, system-signal=VCU_APSTorqueRequestAvailable}, {implementation-record-element=VCU_EnergyManagementWarn, system-signal=VCU_EnergyManagementWarn}, {implementation-record-element=VCU_RegenTorqueCap, system-signal=VCU_RegenTorqueCap}, {implementation-record-element=VCU_TorqueRequestActive, system-signal=VCU_TorqueRequestActive}, {implementation-record-element=VCU_RegenTorqueCapValid, system-signal=VCU_RegenTorqueCapValid}, {implementation-record-element=MessageCounter_0D3, system-signal=MessageCounter_0D3}]}
        sender-receiver-to-signal-group-mapping={data-element=SG_VCU_MCU_02_SigGroup.SG_VCU_MCU_02_SigGroup, signal-group=SG_VCU_MCU_02_SigGroup, type-mapping=sender-rec-record-type-mapping=record-element-mappings=[{implementation-record-element=VCU_MCUActHeatPwr, system-signal=VCU_MCUActHeatPwr}, {implementation-record-element=VCU_MotorSpdReq, system-signal=VCU_MotorSpdReq}, {implementation-record-element=VCU_MaxSpdLimit, system-signal=VCU_MaxSpdLimit}]}
        sender-receiver-to-signal-group-mapping={data-element=SG_VCU_SynReq_01_SigGroup.SG_VCU_SynReq_01_SigGroup, signal-group=SG_VCU_SynReq_01_SigGroup, type-mapping=sender-rec-record-type-mapping=sender-rec-record-element-mapping{implementation-record-element=VCU_SynRequest, system-signal=VCU_SynRequest}}
        sender-receiver-to-signal-group-mapping={data-element=SG_VCU_MCU_05_SigGroup.SG_VCU_MCU_05_SigGroup, signal-group=SG_VCU_MCU_05_SigGroup, type-mapping=sender-rec-record-type-mapping=record-element-mappings=[{implementation-record-element=VCU_MaxTorqueGradient, system-signal=VCU_MaxTorqueGradient}, {implementation-record-element=VCU_SpdLimitActTorque, system-signal=VCU_SpdLimitActTorque}, {implementation-record-element=VCU_CreepTorque, system-signal=VCU_CreepTorque}, {implementation-record-element=VCU_MinTorqueLimit, system-signal=VCU_MinTorqueLimit}, {implementation-record-element=VCU_MaxTorqueLimit, system-signal=VCU_MaxTorqueLimit}]}
        sender-receiver-to-signal-group-mapping={data-element=SG_VCU_POD_SigGroup.SG_VCU_POD_SigGroup, signal-group=SG_VCU_POD_SigGroup, type-mapping=sender-rec-record-type-mapping=record-element-mappings=[{implementation-record-element=VCU_OBC_Control_of_em_lock, system-signal=VCU_OBC_Control_of_em_lock}, {implementation-record-element=VCU_OBC_ChargeCurrentCommand, system-signal=VCU_OBC_ChargeCurrentCommand}, {implementation-record-element=VCU_Enable_DC_Relay, system-signal=VCU_Enable_DC_Relay}, {implementation-record-element=VCU_OBC_Control_of_S2_SW, system-signal=VCU_OBC_Control_of_S2_SW}, {implementation-record-element=VCU_EnableOBC, system-signal=VCU_EnableOBC}]}
        sender-receiver-to-signal-group-mapping={data-element=SG_VCU_06_SigGroup.SG_VCU_06_SigGroup, signal-group=SG_VCU_06_SigGroup, type-mapping=sender-rec-record-type-mapping=record-element-mappings=[{implementation-record-element=VCU_DisChgPowerLimit, system-signal=VCU_DisChgPowerLimit}, {implementation-record-element=VCU_ChargeEnergy, system-signal=VCU_ChargeEnergy}, {implementation-record-element=VCU_PermitPackPTC, system-signal=VCU_PermitPackPTC}, {implementation-record-element=VCU_MCUPower, system-signal=VCU_MCUPower}, {implementation-record-element=VCU_DisplayMileage, system-signal=VCU_DisplayMileage}, {implementation-record-element=VCU_ChargeTime, system-signal=VCU_ChargeTime}]}
        sender-receiver-to-signal-group-mapping={data-element=SG_VCU_02_SigGroup.SG_VCU_02_SigGroup, signal-group=SG_VCU_02_SigGroup, type-mapping=sender-rec-record-type-mapping=record-element-mappings=[{implementation-record-element=VCU_WakeUpStatus, system-signal=VCU_WakeUpStatus}, {implementation-record-element=VCU_BS_IndicatorSts, system-signal=VCU_BS_IndicatorSts}, {implementation-record-element=VCU_BS_LV_Batt, system-signal=VCU_BS_LV_Batt}, {implementation-record-element=VCU_BS_Current, system-signal=VCU_BS_Current}, {implementation-record-element=VCU_BS_IBSBatSOC, system-signal=VCU_BS_IBSBatSOC}]}
        sender-receiver-to-signal-group-mapping={data-element=SG_VCU_04_SigGroup.SG_VCU_04_SigGroup, signal-group=SG_VCU_04_SigGroup, type-mapping=sender-rec-record-type-mapping=record-element-mappings=[{implementation-record-element=VCU_ManuallyUnlockComment, system-signal=VCU_ManuallyUnlockComment}, {implementation-record-element=VCU_ForwardVmaxlimitStatus, system-signal=VCU_ForwardVmaxlimitStatus}]}
        sender-receiver-to-signal-group-mapping={data-element=SG_VCU_PlugInChrgInfo_SigGroup.SG_VCU_PlugInChrgInfo_SigGroup, signal-group=SG_VCU_PlugInChrgInfo_SigGroup, type-mapping=sender-rec-record-type-mapping=record-element-mappings=[{implementation-record-element=VCU_ChargeEndReason, system-signal=VCU_ChargeEndReason}, {implementation-record-element=VCU_DischargeEndReason, system-signal=VCU_DischargeEndReason}, {implementation-record-element=VCU_HVConnectFault, system-signal=VCU_HVConnectFault}, {implementation-record-element=VCU_RemainChrgTime, system-signal=VCU_RemainChrgTime}]}
        sender-receiver-to-signal-group-mapping={data-element=SG_VCU_DCDC_SigGroup.SG_VCU_DCDC_SigGroup, signal-group=SG_VCU_DCDC_SigGroup, type-mapping=sender-rec-record-type-mapping=record-element-mappings=[{implementation-record-element=VCU_DCDCPowerLimit, system-signal=VCU_DCDCPowerLimit}, {implementation-record-element=VCU_VoltageDemandLV, system-signal=VCU_VoltageDemandLV}, {implementation-record-element=VCU_RequestedModeDCDC, system-signal=VCU_RequestedModeDCDC}]}
        sender-receiver-to-signal-group-mapping={data-element=SG_VCU_AccPedal_SigGroup.SG_VCU_AccPedal_SigGroup, signal-group=SG_VCU_AccPedal_SigGroup, type-mapping=sender-rec-record-type-mapping=record-element-mappings=[{implementation-record-element=VCU_VirtualACPedalValid, system-signal=VCU_VirtualACPedalValid}, {implementation-record-element=VCU_VLCTorqueRequestAvailable, system-signal=VCU_VLCTorqueRequestAvailable}, {implementation-record-element=VCU_TargetGear, system-signal=VCU_TargetGear}, {implementation-record-element=VCU_Kickdown, system-signal=VCU_Kickdown}, {implementation-record-element=VCU_VLCTorqueRequestActive, system-signal=VCU_VLCTorqueRequestActive}, {implementation-record-element=VCU_VehicleSpeedValid, system-signal=VCU_VehicleSpeedValid}, {implementation-record-element=Checksum_0D2, system-signal=Checksum_0D2}, {implementation-record-element=VCU_EPBReq, system-signal=VCU_EPBReq}, {implementation-record-element=MessageCounter_0D2, system-signal=MessageCounter_0D2}, {implementation-record-element=VCU_VehicleSpeed, system-signal=VCU_VehicleSpeed}, {implementation-record-element=VCU_AccelerationPedal, system-signal=VCU_AccelerationPedal}, {implementation-record-element=VCU_VirtualACPedal, system-signal=VCU_VirtualACPedal}, {implementation-record-element=VCU_AccelerationPedalValid, system-signal=VCU_AccelerationPedalValid}]}
        sender-receiver-to-signal-group-mapping={data-element=SG_VCU_HMIsignals_01_SigGroup.SG_VCU_HMIsignals_01_SigGroup, signal-group=SG_VCU_HMIsignals_01_SigGroup, type-mapping=sender-rec-record-type-mapping=record-element-mappings=[{implementation-record-element=Checksum_317, system-signal=Checksum_317}, {implementation-record-element=VCU_CriSysFailure, system-signal=VCU_CriSysFailure}, {implementation-record-element=VCU_ReachLimitStd, system-signal=VCU_ReachLimitStd}, {implementation-record-element=VCU_InvldGearSel, system-signal=VCU_InvldGearSel}, {implementation-record-element=VCU_PlugStatus, system-signal=VCU_PlugStatus}, {implementation-record-element=VCU_HVBatOvrTemp, system-signal=VCU_HVBatOvrTemp}, {implementation-record-element=VCU_HVInsulResFault, system-signal=VCU_HVInsulResFault}, {implementation-record-element=VCU_HVILError, system-signal=VCU_HVILError}, {implementation-record-element=VCU_DriveMotOvrTemp, system-signal=VCU_DriveMotOvrTemp}, {implementation-record-element=VCU_HVBatCriFail, system-signal=VCU_HVBatCriFail}, {implementation-record-element=VCU_DCDCFail, system-signal=VCU_DCDCFail}, {implementation-record-element=VCU_MileagelowRemind, system-signal=VCU_MileagelowRemind}, {implementation-record-element=VCU_LimpHome, system-signal=VCU_LimpHome}, {implementation-record-element=MessageCounter_317, system-signal=MessageCounter_317}]}
        sender-receiver-to-signal-group-mapping={data-element=SG_MCU_01_SigGroup.SG_MCU_01_SigGroup, signal-group=SG_MCU_01_SigGroup, type-mapping=sender-rec-record-type-mapping=record-element-mappings=[{implementation-record-element=MCU_IsCurr, system-signal=MCU_IsCurr}, {implementation-record-element=MCU_ActTrqValid, system-signal=MCU_ActTrqValid}, {implementation-record-element=MessageCounter_098, system-signal=MessageCounter_098}, {implementation-record-element=MCU_ActualSpeedValid, system-signal=MCU_ActualSpeedValid}, {implementation-record-element=Checksum_098, system-signal=Checksum_098}, {implementation-record-element=MCU_ActualSpeed, system-signal=MCU_ActualSpeed}, {implementation-record-element=MCU_ActualTorque, system-signal=MCU_ActualTorque}, {implementation-record-element=MCU_UdcCurr, system-signal=MCU_UdcCurr}]}
        sender-receiver-to-signal-group-mapping={data-element=SG_VCU_MCU_03_SigGroup.SG_VCU_MCU_03_SigGroup, signal-group=SG_VCU_MCU_03_SigGroup, type-mapping=sender-rec-record-type-mapping=record-element-mappings=[{implementation-record-element=Checksum_095, system-signal=Checksum_095}, {implementation-record-element=MessageCounter_095, system-signal=MessageCounter_095}, {implementation-record-element=VCU_PWTErrorLevel, system-signal=VCU_PWTErrorLevel}, {implementation-record-element=VCU_RequestedModeMCU, system-signal=VCU_RequestedModeMCU}, {implementation-record-element=VCU_BrakepedalStatus, system-signal=VCU_BrakepedalStatus}, {implementation-record-element=VCU_MCUSurgeDamperState, system-signal=VCU_MCUSurgeDamperState}, {implementation-record-element=VCU_ActualGear, system-signal=VCU_ActualGear}, {implementation-record-element=VCU_TCSActive, system-signal=VCU_TCSActive}, {implementation-record-element=VCU_MCUDesiredTorque, system-signal=VCU_MCUDesiredTorque}, {implementation-record-element=VCU_TrqThresholdDampgCtl, system-signal=VCU_TrqThresholdDampgCtl}, {implementation-record-element=VCU_KL15eOn, system-signal=VCU_KL15eOn}]}
        sender-receiver-to-signal-group-mapping={data-element=SG_SGW_FVSynchronization_01_SigGrou_1.SG_SGW_FVSynchronization_01_SigGrou, signal-group=SG_SGW_FVSynchronization_01_SigGrou, type-mapping=sender-rec-record-type-mapping=sender-rec-record-element-mapping{implementation-record-element=SGW_TripCounter, system-signal=SGW_TripCounter}}
        sender-receiver-to-signal-group-mapping={data-element=SG_ACU_info_SigGroup_1.SG_ACU_info_SigGroup, signal-group=SG_ACU_info_SigGroup, type-mapping=sender-rec-record-type-mapping=record-element-mappings=[{implementation-record-element=ACU_DriverWarningLampSts, system-signal=ACU_DriverWarningLampSts}, {implementation-record-element=ACU_RRSeatBeltStatusValid, system-signal=ACU_RRSeatBeltStatusValid}, {implementation-record-element=ACU_PassengerWarningLampSts, system-signal=ACU_PassengerWarningLampSts}, {implementation-record-element=ACU_PassengerSeatBeltSts, system-signal=ACU_PassengerSeatBeltSts}, {implementation-record-element=ACU_CrashOutputStsValid, system-signal=ACU_CrashOutputStsValid}, {implementation-record-element=ACU_SecondLeftSts, system-signal=ACU_SecondLeftSts}, {implementation-record-element=ACU_SecondRightSeatBeltSts, system-signal=ACU_SecondRightSeatBeltSts}, {implementation-record-element=Checksum_097, system-signal=Checksum_097}, {implementation-record-element=ACU_RLSeatBeltStatusValid, system-signal=ACU_RLSeatBeltStatusValid}, {implementation-record-element=MessageCounter_097, system-signal=MessageCounter_097}, {implementation-record-element=ACU_PassengerSeatBeltStsValid, system-signal=ACU_PassengerSeatBeltStsValid}, {implementation-record-element=ACU_WarningLampSts, system-signal=ACU_WarningLampSts}, {implementation-record-element=ACU_DriverSeatBeltSts, system-signal=ACU_DriverSeatBeltSts}, {implementation-record-element=ACU_SecondRightSts, system-signal=ACU_SecondRightSts}, {implementation-record-element=ACU_PassengerAirbagSts, system-signal=ACU_PassengerAirbagSts}, {implementation-record-element=ACU_CrashOutputSts, system-signal=ACU_CrashOutputSts}, {implementation-record-element=ACU_SecondLeftSeatBeltSts, system-signal=ACU_SecondLeftSeatBeltSts}, {implementation-record-element=ACU_DriverSeatBeltStsValid, system-signal=ACU_DriverSeatBeltStsValid}, {implementation-record-element=ACU_PassengerSts, system-signal=ACU_PassengerSts}]}
        sender-receiver-to-signal-group-mapping={data-element=SG_ADCU_ACC_02_SigGroup_1.SG_ADCU_ACC_02_SigGroup, signal-group=SG_ADCU_ACC_02_SigGroup, type-mapping=sender-rec-record-type-mapping=record-element-mappings=[{implementation-record-element=ADCU_ACCDA_HandsOFF_Warning, system-signal=ADCU_ACCDA_HandsOFF_Warning}, {implementation-record-element=ADCU_ACC_Mode, system-signal=ADCU_ACC_Mode}, {implementation-record-element=ADCU_ACCDA_SYS_Failure, system-signal=ADCU_ACCDA_SYS_Failure}, {implementation-record-element=MessageCounter_0E0, system-signal=MessageCounter_0E0}, {implementation-record-element=Checksum_0E0, system-signal=Checksum_0E0}]}
        sender-receiver-to-signal-group-mapping={data-element=SG_ADCU_APS_01_SigGroup_1.SG_ADCU_APS_01_SigGroup, signal-group=SG_ADCU_APS_01_SigGroup, type-mapping=sender-rec-record-type-mapping=record-element-mappings=[{implementation-record-element=ADCU_APSCrlReq, system-signal=ADCU_APSCrlReq}, {implementation-record-element=ADCU_APSCrlTypReq, system-signal=ADCU_APSCrlTypReq}, {implementation-record-element=ADCU_TargetGear, system-signal=ADCU_TargetGear}, {implementation-record-element=ADCU_APSComfBrkReq, system-signal=ADCU_APSComfBrkReq}, {implementation-record-element=ADCU_Parking_Mode, system-signal=ADCU_Parking_Mode}, {implementation-record-element=ADCU_Parking_CtrlSts, system-signal=ADCU_Parking_CtrlSts}, {implementation-record-element=Checksum_0E4, system-signal=Checksum_0E4}, {implementation-record-element=ADCU_APSDistanceStop, system-signal=ADCU_APSDistanceStop}, {implementation-record-element=ADCU_APS_Stop_Req, system-signal=ADCU_APS_Stop_Req}, {implementation-record-element=MessageCounter_0E4, system-signal=MessageCounter_0E4}, {implementation-record-element=ADCU_APSMaxSpeedReq, system-signal=ADCU_APSMaxSpeedReq}, {implementation-record-element=ADCU_APSCrlModeReq, system-signal=ADCU_APSCrlModeReq}]}
        sender-receiver-to-signal-group-mapping={data-element=SG_BCM_05_SigGroup_1.SG_BCM_05_SigGroup, signal-group=SG_BCM_05_SigGroup, type-mapping=sender-rec-record-type-mapping=record-element-mappings=[{implementation-record-element=BCM_KeyNotInCarRemind, system-signal=BCM_KeyNotInCarRemind}, {implementation-record-element=BCM_RLSeatBeltRemindReq, system-signal=BCM_RLSeatBeltRemindReq}, {implementation-record-element=BCM_GearTimesSts, system-signal=BCM_GearTimesSts}, {implementation-record-element=BCM_WelLightshowOnOffSts, system-signal=BCM_WelLightshowOnOffSts}, {implementation-record-element=BCM_FRSeatBeltRemindReq, system-signal=BCM_FRSeatBeltRemindReq}, {implementation-record-element=BCM_WiperServiceSts, system-signal=BCM_WiperServiceSts}, {implementation-record-element=BCM_FLSeatBeltRemindReq, system-signal=BCM_FLSeatBeltRemindReq}, {implementation-record-element=BCM_FrontWiperModeSts, system-signal=BCM_FrontWiperModeSts}, {implementation-record-element=BCM_PuddleLiReq, system-signal=BCM_PuddleLiReq}, {implementation-record-element=Checksum_33A, system-signal=Checksum_33A}, {implementation-record-element=BCM_WiperWorkingSts, system-signal=BCM_WiperWorkingSts}, {implementation-record-element=BCM_RRSeatBeltRemindReq, system-signal=BCM_RRSeatBeltRemindReq}, {implementation-record-element=BCM_ChrgFlapLockSts, system-signal=BCM_ChrgFlapLockSts}, {implementation-record-element=MessageCounter_33A, system-signal=MessageCounter_33A}, {implementation-record-element=BCM_AutoCloseWinFunSts, system-signal=BCM_AutoCloseWinFunSts}, {implementation-record-element=BCM_DomeLampBrightSts, system-signal=BCM_DomeLampBrightSts}, {implementation-record-element=BCM_DomeLampAutoSts, system-signal=BCM_DomeLampAutoSts}]}
        sender-receiver-to-signal-group-mapping={data-element=SG_BCM_06_SigGroup_1.SG_BCM_06_SigGroup, signal-group=SG_BCM_06_SigGroup, type-mapping=sender-rec-record-type-mapping=record-element-mappings=[{implementation-record-element=checksum_271, system-signal=checksum_271}, {implementation-record-element=BCM_PepsPowerMode, system-signal=BCM_PepsPowerMode}, {implementation-record-element=BCM_PowerOffDisplayReq, system-signal=BCM_PowerOffDisplayReq}, {implementation-record-element=MessageCounter_271, system-signal=MessageCounter_271}]}
        sender-receiver-to-signal-group-mapping={data-element=SG_ADCU_AEB_01_SigGroup.SG_ADCU_AEB_01_SigGroup, signal-group=SG_ADCU_AEB_01_SigGroup, type-mapping=sender-rec-record-type-mapping=record-element-mappings=[{implementation-record-element=ADCU_AEBReq, system-signal=ADCU_AEBReq}, {implementation-record-element=ADCU_AEB_Stop_Req, system-signal=ADCU_AEB_Stop_Req}, {implementation-record-element=ADCU_AEB_AWB_Req, system-signal=ADCU_AEB_AWB_Req}, {implementation-record-element=MessageCounter_0E2, system-signal=MessageCounter_0E2}, {implementation-record-element=ADCU_AEB_State, system-signal=ADCU_AEB_State}, {implementation-record-element=Checksum_0E2, system-signal=Checksum_0E2}, {implementation-record-element=ADCU_AEBWarningSts, system-signal=ADCU_AEBWarningSts}, {implementation-record-element=ADCU_FCW_State, system-signal=ADCU_FCW_State}, {implementation-record-element=ADCU_AEB_AWB_Level, system-signal=ADCU_AEB_AWB_Level}, {implementation-record-element=ADCU_AEB_Decel_Cmd, system-signal=ADCU_AEB_Decel_Cmd}, {implementation-record-element=ADCU_AEB_Prefill_CMD, system-signal=ADCU_AEB_Prefill_CMD}]}
        sender-receiver-to-signal-group-mapping={data-element=SG_BMS_CellTemp_SigGroup_1.SG_BMS_CellTemp_SigGroup, signal-group=SG_BMS_CellTemp_SigGroup, type-mapping=sender-rec-record-type-mapping=record-element-mappings=[{implementation-record-element=BMS_MinCellTempNO, system-signal=BMS_MinCellTempNO}, {implementation-record-element=BMS_MinCellTempModuleNO, system-signal=BMS_MinCellTempModuleNO}, {implementation-record-element=BMS_MaxCellTempNO, system-signal=BMS_MaxCellTempNO}, {implementation-record-element=BMS_AverageCellTemp, system-signal=BMS_AverageCellTemp}, {implementation-record-element=BMS_MinCellTemp, system-signal=BMS_MinCellTemp}, {implementation-record-element=BMS_MaxCellTemp, system-signal=BMS_MaxCellTemp}]}
        sender-receiver-to-signal-group-mapping={data-element=SG_BMS_CellVoltage_SigGroup_1.SG_BMS_CellVoltage_SigGroup, signal-group=SG_BMS_CellVoltage_SigGroup, type-mapping=sender-rec-record-type-mapping=record-element-mappings=[{implementation-record-element=BMS_MaxCellVoltageModuleNO, system-signal=BMS_MaxCellVoltageModuleNO}, {implementation-record-element=BMS_MaxCellVoltage, system-signal=BMS_MaxCellVoltage}, {implementation-record-element=BMS_MaxCellVoltageNO, system-signal=BMS_MaxCellVoltageNO}, {implementation-record-element=BMS_MinCellVoltage, system-signal=BMS_MinCellVoltage}]}
        sender-receiver-to-signal-group-mapping={data-element=SG_BMS_status_01_SigGroup_1.SG_BMS_status_01_SigGroup, signal-group=SG_BMS_status_01_SigGroup, type-mapping=sender-rec-record-type-mapping=record-element-mappings=[{implementation-record-element=Checksum_0C1, system-signal=Checksum_0C1}, {implementation-record-element=BMS_SOH, system-signal=BMS_SOH}, {implementation-record-element=BMS_InsulationDetectionStatus, system-signal=BMS_InsulationDetectionStatus}, {implementation-record-element=BMS_ErrorLevel, system-signal=BMS_ErrorLevel}, {implementation-record-element=BMS_HVinterlockState, system-signal=BMS_HVinterlockState}, {implementation-record-element=BMS_WorkMode, system-signal=BMS_WorkMode}, {implementation-record-element=BMS_ThrmlRunawayFault, system-signal=BMS_ThrmlRunawayFault}, {implementation-record-element=BMS_RunHeatStatus, system-signal=BMS_RunHeatStatus}, {implementation-record-element=BMS_ChargeStatus, system-signal=BMS_ChargeStatus}, {implementation-record-element=BMS_SysRegInsulationValue, system-signal=BMS_SysRegInsulationValue}, {implementation-record-element=BMS_PreCharge, system-signal=BMS_PreCharge}, {implementation-record-element=BMS_ErrorIsolationSingleLow, system-signal=BMS_ErrorIsolationSingleLow}, {implementation-record-element=MessageCounter_0C1, system-signal=MessageCounter_0C1}, {implementation-record-element=BMS_BalancingStatus, system-signal=BMS_BalancingStatus}]}
        sender-receiver-to-signal-group-mapping={data-element=SG_DCM_FL_02_SigGroup_1.SG_DCM_FL_02_SigGroup, signal-group=SG_DCM_FL_02_SigGroup, type-mapping=sender-rec-record-type-mapping=record-element-mappings=[{implementation-record-element=DCM_FL_RLWndSwA, system-signal=DCM_FL_RLWndSwA}, {implementation-record-element=DCM_FL_DoorFLSts, system-signal=DCM_FL_DoorFLSts}, {implementation-record-element=DCM_FL_MirrorFold_UnfoldSts, system-signal=DCM_FL_MirrorFold_UnfoldSts}, {implementation-record-element=DCM_FL_LeftMirrorHorizontalPos, system-signal=DCM_FL_LeftMirrorHorizontalPos}, {implementation-record-element=DCM_FL_MirrorAutoTurnDownSts, system-signal=DCM_FL_MirrorAutoTurnDownSts}, {implementation-record-element=DCM_FL_RRWndSwA, system-signal=DCM_FL_RRWndSwA}, {implementation-record-element=MessageCounter_28A, system-signal=MessageCounter_28A}, {implementation-record-element=DCM_FL_FRWndSwA, system-signal=DCM_FL_FRWndSwA}, {implementation-record-element=DCM_FL_RearmirrorHeatingSts, system-signal=DCM_FL_RearmirrorHeatingSts}, {implementation-record-element=DCM_FL_LeftMirrorVerticalPos, system-signal=DCM_FL_LeftMirrorVerticalPos}, {implementation-record-element=Checksum_28A, system-signal=Checksum_28A}, {implementation-record-element=DCM_FL_MirrorAutoFoldUnfoldSts, system-signal=DCM_FL_MirrorAutoFoldUnfoldSts}]}
        sender-receiver-to-signal-group-mapping={data-element=SG_IBS_APS_SigGroup_1.SG_IBS_APS_SigGroup, signal-group=SG_IBS_APS_SigGroup, type-mapping=sender-rec-record-type-mapping=record-element-mappings=[{implementation-record-element=MessageCounter_0B7, system-signal=MessageCounter_0B7}, {implementation-record-element=IBS_BrakeTypEcho, system-signal=IBS_BrakeTypEcho}, {implementation-record-element=IBS_APSTrqReqActive, system-signal=IBS_APSTrqReqActive}, {implementation-record-element=IBS_APSComfortAvl, system-signal=IBS_APSComfortAvl}, {implementation-record-element=IBS_APS_Avl, system-signal=IBS_APS_Avl}, {implementation-record-element=Checksum_0B7, system-signal=Checksum_0B7}, {implementation-record-element=IBS_APSEmergenyAvl, system-signal=IBS_APSEmergenyAvl}, {implementation-record-element=IBS_APSCrlReqEcho, system-signal=IBS_APSCrlReqEcho}, {implementation-record-element=IBS_APSModeEcho, system-signal=IBS_APSModeEcho}]}
        sender-receiver-to-signal-group-mapping={data-element=SG_IBS_Status_02_SigGroup_1.SG_IBS_Status_02_SigGroup, signal-group=SG_IBS_Status_02_SigGroup, type-mapping=sender-rec-record-type-mapping=record-element-mappings=[{implementation-record-element=IBS_BrakeLightRequest, system-signal=IBS_BrakeLightRequest}, {implementation-record-element=IBS_AWBActive, system-signal=IBS_AWBActive}, {implementation-record-element=IBS_HHCActive, system-signal=IBS_HHCActive}, {implementation-record-element=IBS_HazWarnReq, system-signal=IBS_HazWarnReq}, {implementation-record-element=IBS_HDCAvailable, system-signal=IBS_HDCAvailable}, {implementation-record-element=IBS_EPBFailureLamp, system-signal=IBS_EPBFailureLamp}, {implementation-record-element=IBS_AWBAvailable, system-signal=IBS_AWBAvailable}, {implementation-record-element=IBS_EPBFunctionLamp, system-signal=IBS_EPBFunctionLamp}, {implementation-record-element=IBS_TCSActive, system-signal=IBS_TCSActive}, {implementation-record-element=IBS_AEBAvailable, system-signal=IBS_AEBAvailable}, {implementation-record-element=Checksum_0B3, system-signal=Checksum_0B3}, {implementation-record-element=IBS_EPBControllerSts, system-signal=IBS_EPBControllerSts}, {implementation-record-element=MessageCounter_0B3, system-signal=MessageCounter_0B3}, {implementation-record-element=IBS_AVHAvailable, system-signal=IBS_AVHAvailable}, {implementation-record-element=IBS_EPBworkingSts, system-signal=IBS_EPBworkingSts}, {implementation-record-element=IBS_HHCAvailable, system-signal=IBS_HHCAvailable}, {implementation-record-element=IBS_VDCActive, system-signal=IBS_VDCActive}, {implementation-record-element=IBS_AEBActive, system-signal=IBS_AEBActive}]}
        sender-receiver-to-signal-group-mapping={data-element=SG_IBS_Status_03_SigGroup_1.SG_IBS_Status_03_SigGroup, signal-group=SG_IBS_Status_03_SigGroup, type-mapping=sender-rec-record-type-mapping=record-element-mappings=[{implementation-record-element=IBS_ABPActive, system-signal=IBS_ABPActive}, {implementation-record-element=IBS_VCU_DecelerationRequest_Available, system-signal=IBS_VCU_DecelerationRequest_Available}, {implementation-record-element=IBS_TCSFault, system-signal=IBS_TCSFault}, {implementation-record-element=IBS_ABSActive, system-signal=IBS_ABSActive}, {implementation-record-element=IBS_EBDActive, system-signal=IBS_EBDActive}, {implementation-record-element=IBS_DTCFault, system-signal=IBS_DTCFault}, {implementation-record-element=MessageCounter_0B4, system-signal=MessageCounter_0B4}, {implementation-record-element=IBS_SystemStatus, system-signal=IBS_SystemStatus}, {implementation-record-element=IBS_ABSFault, system-signal=IBS_ABSFault}, {implementation-record-element=IBS_VehicleSpeedValid, system-signal=IBS_VehicleSpeedValid}, {implementation-record-element=Checksum_0B4, system-signal=Checksum_0B4}, {implementation-record-element=IBS_VDCFault, system-signal=IBS_VDCFault}, {implementation-record-element=IBS_EPBTextdisplay, system-signal=IBS_EPBTextdisplay}, {implementation-record-element=IBS_EBDFault, system-signal=IBS_EBDFault}, {implementation-record-element=IBS_ABPAvailable, system-signal=IBS_ABPAvailable}, {implementation-record-element=IBS_VehicleSpeed, system-signal=IBS_VehicleSpeed}]}
        sender-receiver-to-signal-group-mapping={data-element=SG_IBS_Status_04_SigGroup_1.SG_IBS_Status_04_SigGroup, signal-group=SG_IBS_Status_04_SigGroup, type-mapping=sender-rec-record-type-mapping=record-element-mappings=[{implementation-record-element=IBS_DTCActive, system-signal=IBS_DTCActive}, {implementation-record-element=IBS_CDPAvailable, system-signal=IBS_CDPAvailable}, {implementation-record-element=IBS_CDPActive, system-signal=IBS_CDPActive}, {implementation-record-element=MessageCounter_0BA, system-signal=MessageCounter_0BA}, {implementation-record-element=Checksum_0BA, system-signal=Checksum_0BA}]}
        sender-receiver-to-signal-group-mapping={data-element=SG_IBS_Status_05_SigGroup_1.SG_IBS_Status_05_SigGroup, signal-group=SG_IBS_Status_05_SigGroup, type-mapping=sender-rec-record-type-mapping=record-element-mappings=[{implementation-record-element=Checksum_0BB, system-signal=Checksum_0BB}, {implementation-record-element=MessageCounter_0BB, system-signal=MessageCounter_0BB}, {implementation-record-element=IBS_SUBEPBFailureStatus, system-signal=IBS_SUBEPBFailureStatus}, {implementation-record-element=IBS_SUBEPBworkingSts, system-signal=IBS_SUBEPBworkingSts}, {implementation-record-element=IBS_SUBEPBControllerSts, system-signal=IBS_SUBEPBControllerSts}]}
        sender-receiver-to-signal-group-mapping={data-element=SG_IBS_Status_06_SigGroup_1.SG_IBS_Status_06_SigGroup, signal-group=SG_IBS_Status_06_SigGroup, type-mapping=sender-rec-record-type-mapping=record-element-mappings=[{implementation-record-element=IBS_HDCSts, system-signal=IBS_HDCSts}, {implementation-record-element=IBS_RWUAvailable, system-signal=IBS_RWUAvailable}, {implementation-record-element=IBS_BrakeFluidWarning, system-signal=IBS_BrakeFluidWarning}, {implementation-record-element=IBS_TPMS_ResetSts, system-signal=IBS_TPMS_ResetSts}, {implementation-record-element=IBS_RWUActive, system-signal=IBS_RWUActive}, {implementation-record-element=IBS_RollerbenchMode, system-signal=IBS_RollerbenchMode}, {implementation-record-element=IBS_TireWarnFrntLe, system-signal=IBS_TireWarnFrntLe}, {implementation-record-element=IBS_MaintenaceMode, system-signal=IBS_MaintenaceMode}, {implementation-record-element=IBS_EPBFailureStatus, system-signal=IBS_EPBFailureStatus}, {implementation-record-element=IBS_TireWarnFrntRi, system-signal=IBS_TireWarnFrntRi}, {implementation-record-element=MessageCounter_0BC, system-signal=MessageCounter_0BC}, {implementation-record-element=IBS_TireMonSysSts, system-signal=IBS_TireMonSysSts}, {implementation-record-element=IBS_TireWarnReRi, system-signal=IBS_TireWarnReRi}, {implementation-record-element=Checksum_0BC, system-signal=Checksum_0BC}, {implementation-record-element=IBS_TireWarnReLe, system-signal=IBS_TireWarnReLe}, {implementation-record-element=IBS_FactoryMode, system-signal=IBS_FactoryMode}, {implementation-record-element=IBS_ESCOffSts, system-signal=IBS_ESCOffSts}, {implementation-record-element=IBS_ESClampdisplay, system-signal=IBS_ESClampdisplay}, {implementation-record-element=IBS_AVHSts, system-signal=IBS_AVHSts}, {implementation-record-element=IBS_HBAActive, system-signal=IBS_HBAActive}]}
        sender-receiver-to-signal-group-mapping={data-element=SG_IBS_WheelSpeed_01_SigGroup_1.SG_IBS_WheelSpeed_01_SigGroup, signal-group=SG_IBS_WheelSpeed_01_SigGroup, type-mapping=sender-rec-record-type-mapping=record-element-mappings=[{implementation-record-element=IBS_FRWheelSpeed, system-signal=IBS_FRWheelSpeed}, {implementation-record-element=IBS_FRWheelSpeed_Fault, system-signal=IBS_FRWheelSpeed_Fault}, {implementation-record-element=IBS_FLMovingDirection, system-signal=IBS_FLMovingDirection}, {implementation-record-element=IBS_FLWheelPulseCounter, system-signal=IBS_FLWheelPulseCounter}, {implementation-record-element=Checksum_0B0, system-signal=Checksum_0B0}, {implementation-record-element=IBS_FLWheelSpeed_Fault, system-signal=IBS_FLWheelSpeed_Fault}, {implementation-record-element=IBS_FLWheelSpeed, system-signal=IBS_FLWheelSpeed}, {implementation-record-element=MessageCounter_0B0, system-signal=MessageCounter_0B0}, {implementation-record-element=IBS_FRMovingDirection, system-signal=IBS_FRMovingDirection}, {implementation-record-element=IBS_FRWheelPulseCounter, system-signal=IBS_FRWheelPulseCounter}]}
        sender-receiver-to-signal-group-mapping={data-element=SG_IBS_WheelSpeed_02_SigGroup_1.SG_IBS_WheelSpeed_02_SigGroup, signal-group=SG_IBS_WheelSpeed_02_SigGroup, type-mapping=sender-rec-record-type-mapping=record-element-mappings=[{implementation-record-element=IBS_RRWheelSpeed_Fault, system-signal=IBS_RRWheelSpeed_Fault}, {implementation-record-element=Checksum_0B1, system-signal=Checksum_0B1}, {implementation-record-element=IBS_RLWheelSpeed, system-signal=IBS_RLWheelSpeed}, {implementation-record-element=IBS_RRWheelSpeed, system-signal=IBS_RRWheelSpeed}, {implementation-record-element=MessageCounter_0B1, system-signal=MessageCounter_0B1}, {implementation-record-element=IBS_RLWheelPulseCounter, system-signal=IBS_RLWheelPulseCounter}, {implementation-record-element=IBS_RLWheelSpeed_Fault, system-signal=IBS_RLWheelSpeed_Fault}, {implementation-record-element=IBS_RLMovingDirection, system-signal=IBS_RLMovingDirection}, {implementation-record-element=IBS_RRWheelPulseCounter, system-signal=IBS_RRWheelPulseCounter}, {implementation-record-element=IBS_RRMovingDirection, system-signal=IBS_RRMovingDirection}]}
        sender-receiver-to-signal-group-mapping={data-element=SG_SGW_01_SigGroup_1.SG_SGW_01_SigGroup, signal-group=SG_SGW_01_SigGroup, type-mapping=sender-rec-record-type-mapping=record-element-mappings=[{implementation-record-element=SGW_AppointChargeCmd, system-signal=SGW_AppointChargeCmd}, {implementation-record-element=SGW_ChargeFormSet, system-signal=SGW_ChargeFormSet}, {implementation-record-element=SGW_TimingChargeSwitchStatus, system-signal=SGW_TimingChargeSwitchStatus}, {implementation-record-element=SGW_DschrgOnOffSet, system-signal=SGW_DschrgOnOffSet}, {implementation-record-element=SGW_LockACPlug, system-signal=SGW_LockACPlug}]}
        sender-receiver-to-signal-group-mapping={data-element=SG_BMS_status_04_SigGroup.SG_BMS_status_04_SigGroup, signal-group=SG_BMS_status_04_SigGroup, type-mapping=sender-rec-record-type-mapping=record-element-mappings=[{implementation-record-element=BMS_FeedbackCurr, system-signal=BMS_FeedbackCurr}, {implementation-record-element=BMS_DisChgCurr, system-signal=BMS_DisChgCurr}]}
        sender-receiver-to-signal-group-mapping={data-element=SG_IBS_Status_01_SigGroup.SG_IBS_Status_01_SigGroup, signal-group=SG_IBS_Status_01_SigGroup, type-mapping=sender-rec-record-type-mapping=record-element-mappings=[{implementation-record-element=IBS_BrakePushrodStroke, system-signal=IBS_BrakePushrodStroke}, {implementation-record-element=Checksum_0B2, system-signal=Checksum_0B2}, {implementation-record-element=IBS_MasterCylinderPressure, system-signal=IBS_MasterCylinderPressure}, {implementation-record-element=IBS_BrakePedalStatusValid, system-signal=IBS_BrakePedalStatusValid}, {implementation-record-element=MessageCounter_0B2, system-signal=MessageCounter_0B2}, {implementation-record-element=IBS_PlungerPressure, system-signal=IBS_PlungerPressure}, {implementation-record-element=IBS_BrakePedalStatus, system-signal=IBS_BrakePedalStatus}]}
        sender-receiver-to-signal-group-mapping={data-element=SG_IBS_ACC_SigGroup_1.SG_IBS_ACC_SigGroup, signal-group=SG_IBS_ACC_SigGroup, type-mapping=sender-rec-record-type-mapping=record-element-mappings=[{implementation-record-element=MessageCounter_0B8, system-signal=MessageCounter_0B8}, {implementation-record-element=IBS_VehicleStandstill_Valid, system-signal=IBS_VehicleStandstill_Valid}, {implementation-record-element=IBS_VehicleStandstill, system-signal=IBS_VehicleStandstill}, {implementation-record-element=IBS_WLTorqueVLCReq, system-signal=IBS_WLTorqueVLCReq}, {implementation-record-element=IBS_VlcActive, system-signal=IBS_VlcActive}, {implementation-record-element=IBS_CddAvailable, system-signal=IBS_CddAvailable}, {implementation-record-element=IBS_VlcError, system-signal=IBS_VlcError}, {implementation-record-element=IBS_VlcAvalible, system-signal=IBS_VlcAvalible}, {implementation-record-element=Checksum_0B8, system-signal=Checksum_0B8}, {implementation-record-element=IBS_WLTorqueVLCReqValid, system-signal=IBS_WLTorqueVLCReqValid}, {implementation-record-element=IBS_CddActive, system-signal=IBS_CddActive}, {implementation-record-element=IBS_CddError, system-signal=IBS_CddError}]}
        sender-receiver-to-signal-mapping={data-element=VCU_IBS_EBDFault_LIN00.VCU_IBS_EBDFault_LIN, system-signal=VCU_IBS_EBDFault}
        sender-receiver-to-signal-mapping={data-element=VCU_IBS_RollerbenchMode_LIN00.VCU_IBS_RollerbenchMode_LIN, system-signal=VCU_IBS_RollerbenchMode}
        sender-receiver-to-signal-mapping={data-element=VCU_BCM_FLSeatBeltRemindReq_LIN00.VCU_BCM_FLSeatBeltRemindReq_LIN, system-signal=VCU_BCM_FLSeatBeltRemindReq}
        sender-receiver-to-signal-mapping={data-element=VCU_DCM_RR_DoorRRSts_LIN00.VCU_DCM_RR_DoorRRSts_LIN, system-signal=VCU_DCM_RR_DoorRRSts}
        sender-receiver-to-signal-mapping={data-element=VCU_DCM_FL_DoorFLSts_LIN00.VCU_DCM_FL_DoorFLSts_LIN, system-signal=VCU_DCM_FL_DoorFLSts}
        sender-receiver-to-signal-mapping={data-element=VCU_BCM_RLSeatBeltRemindReq_LIN00.VCU_BCM_RLSeatBeltRemindReq_LIN, system-signal=VCU_BCM_RLSeatBeltRemindReq}
        sender-receiver-to-signal-mapping={data-element=VCU_ACU_DriverWarningLampSts_LIN00.VCU_ACU_DriverWarningLampSts_LIN, system-signal=VCU_ACU_DriverWarningLampSts}
        sender-receiver-to-signal-mapping={data-element=VCU_ACU_PassengerWarningLampSts_LIN00.VCU_ACU_PassengerWarningLampSts_LIN, system-signal=VCU_ACU_PassengerWarningLampSts}
        sender-receiver-to-signal-mapping={data-element=VCU_ACU_PassengerAirbagSts_LIN00.VCU_ACU_PassengerAirbagSts_LIN, system-signal=VCU_ACU_PassengerAirbagSts}
        sender-receiver-to-signal-mapping={data-element=VCU_DCDCFail_LIN_LIN00.VCU_DCDCFail_LIN_LIN, system-signal=VCU_DCDCFail_LIN}
        sender-receiver-to-signal-mapping={data-element=VCU_HVBatCriFail_LIN_LIN00.VCU_HVBatCriFail_LIN_LIN, system-signal=VCU_HVBatCriFail_LIN}
        sender-receiver-to-signal-mapping={data-element=VCU_DCM_FR_DoorFRSts_LIN00.VCU_DCM_FR_DoorFRSts_LIN, system-signal=VCU_DCM_FR_DoorFRSts}
        sender-receiver-to-signal-mapping={data-element=VCU_BCM_FRSeatBeltRemindReq_LIN00.VCU_BCM_FRSeatBeltRemindReq_LIN, system-signal=VCU_BCM_FRSeatBeltRemindReq}
        sender-receiver-to-signal-mapping={data-element=VCU_HVBatOvrTemp_LIN_LIN00.VCU_HVBatOvrTemp_LIN_LIN, system-signal=VCU_HVBatOvrTemp_LIN}
        sender-receiver-to-signal-mapping={data-element=VCU_DCM_RL_DoorRLSts_LIN00.VCU_DCM_RL_DoorRLSts_LIN, system-signal=VCU_DCM_RL_DoorRLSts}
        sender-receiver-to-signal-mapping={data-element=VCU_IBS_BrakeFluidWarning_LIN00.VCU_IBS_BrakeFluidWarning_LIN, system-signal=VCU_IBS_BrakeFluidWarning}
        sender-receiver-to-signal-mapping={data-element=VCU_CGW_VehicleState_LIN00.VCU_CGW_VehicleState_LIN, system-signal=VCU_CGW_VehicleState}
        sender-receiver-to-signal-mapping={data-element=VCU_IBS_SystemStatus_LIN00.VCU_IBS_SystemStatus_LIN, system-signal=VCU_IBS_SystemStatus}
        sender-receiver-to-signal-mapping={data-element=VCU_BCM_RRSeatBeltRemindReq_LIN00.VCU_BCM_RRSeatBeltRemindReq_LIN, system-signal=VCU_BCM_RRSeatBeltRemindReq}
        sender-receiver-to-signal-mapping={data-element=VCU_IVI_VrState_LIN00.VCU_IVI_VrState_LIN, system-signal=VCU_IVI_VrState}
        sender-receiver-to-signal-mapping={data-element=VCU_ACU_WarningLampSts_LIN00.VCU_ACU_WarningLampSts_LIN, system-signal=VCU_ACU_WarningLampSts}
        sender-receiver-to-signal-mapping={data-element=VCU_DriveMotOvrTemp_LIN_LIN00.VCU_DriveMotOvrTemp_LIN_LIN, system-signal=VCU_DriveMotOvrTemp_LIN}
        sender-receiver-to-signal-mapping={data-element=VCU_IVI_BulbCheckStsLIN01.VCU_IVI_BulbCheckStsLIN01, system-signal=VCU_IVI_BulbCheckSts}
        sender-receiver-to-signal-mapping={data-element=Resp_Error_LIN01.Resp_Error_LIN01, system-signal=Resp_Error}
        sender-receiver-to-signal-mapping={data-element=SOH_LIN01.SOH_LIN01, system-signal=SOH}
        sender-receiver-to-signal-mapping={data-element=I_BATT_LIN01.I_BATT_LIN01, system-signal=I_BATT}
        sender-receiver-to-signal-mapping={data-element=U_BATT_LIN01.U_BATT_LIN01, system-signal=U_BATT}
        sender-receiver-to-signal-mapping={data-element=IBATT_QUIESCENT_LIN01.IBATT_QUIESCENT_LIN01, system-signal=IBATT_QUIESCENT}
        sender-receiver-to-signal-mapping={data-element=I_RANGE_LIN01.I_RANGE_LIN01, system-signal=I_RANGE}
        sender-receiver-to-signal-mapping={data-element=SOC_LIN01.SOC_LIN01, system-signal=SOC}
        sender-receiver-to-signal-mapping={data-element=T_BATT_LIN01.T_BATT_LIN01, system-signal=T_BATT}
        sender-receiver-to-signal-mapping={data-element=ChargeCurrWU_Ena_LIN01.ChargeCurrWU_Ena_LIN01, system-signal=ChargeCurrWU_Ena}
        sender-receiver-to-signal-mapping={data-element=SOCWU_Ena_LIN01.SOCWU_Ena_LIN01, system-signal=SOCWU_Ena}
        sender-receiver-to-signal-mapping={data-element=DisChargeCurrWU_Treshold_LIN01.DisChargeCurrWU_Treshold_LIN01, system-signal=DisChargeCurrWU_Treshold}
        sender-receiver-to-signal-mapping={data-element=SOCWU_Treshold_LIN01.SOCWU_Treshold_LIN01, system-signal=SOCWU_Treshold}
        sender-receiver-to-signal-mapping={data-element=DisChargeCurrWU_Ena_LIN01.DisChargeCurrWU_Ena_LIN01, system-signal=DisChargeCurrWU_Ena}
        sender-receiver-to-signal-mapping={data-element=ChargeCurrWU_Treshold_LIN01.ChargeCurrWU_Treshold_LIN01, system-signal=ChargeCurrWU_Treshold}
        sender-receiver-to-signal-mapping={data-element=SOF_V2_LIN01.SOF_V2_LIN01, system-signal=SOF_V2}
        sender-receiver-to-signal-mapping={data-element=SOF_V1_LIN01.SOF_V1_LIN01, system-signal=SOF_V1}
        sender-receiver-to-signal-group-mapping={data-element=SG_IVI_03_SigGroup.SG_IVI_03_SigGroup, signal-group=SG_IVI_03_SigGroup, type-mapping=sender-rec-record-type-mapping=record-element-mappings=[{implementation-record-element=Checksum_0F9, system-signal=Checksum_0F9}, {implementation-record-element=MessageCounter_0F9, system-signal=MessageCounter_0F9}, {implementation-record-element=IVI_SFIabnormalSts, system-signal=IVI_SFIabnormalSts}, {implementation-record-element=IVI_BulbCheckSts, system-signal=IVI_BulbCheckSts}, {implementation-record-element=IVI_SFIDippedBeamSet, system-signal=IVI_SFIDippedBeamSet}]}
        sender-receiver-to-signal-group-mapping={data-element=SG_VCU_HMIsignals_03_SigGroup.SG_VCU_HMIsignals_03_SigGroup, signal-group=SG_VCU_HMIsignals_03_SigGroup, type-mapping=sender-rec-record-type-mapping=record-element-mappings=[{implementation-record-element=VCU_Display_voltage, system-signal=VCU_Display_voltage}, {implementation-record-element=VCU_BS_HCurrent, system-signal=VCU_BS_HCurrent}, {implementation-record-element=VCU_BS_QuiescentCurrent, system-signal=VCU_BS_QuiescentCurrent}]}
        sender-receiver-to-signal-mapping={data-element=BST_AbortChargparameter.BST_AbortChargparameter, system-signal=BST_AbortChargparameter}
        sender-receiver-to-signal-group-mapping={data-element=SG_EPS_CONV_SigGroup.SG_EPS_CONV_SigGroup, signal-group=SG_EPS_CONV_SigGroup, type-mapping=sender-rec-record-type-mapping=record-element-mappings=[{implementation-record-element=EPS_ModeChangeEnable, system-signal=EPS_ModeChangeEnable}, {implementation-record-element=EPS_ModeFb, system-signal=EPS_ModeFb}, {implementation-record-element=Checksum_0F0, system-signal=Checksum_0F0}, {implementation-record-element=EPS_TorsionBarTorqueValid, system-signal=EPS_TorsionBarTorqueValid}, {implementation-record-element=EPS_TorsionBarTorque, system-signal=EPS_TorsionBarTorque}, {implementation-record-element=MessageCounter_0F0, system-signal=MessageCounter_0F0}, {implementation-record-element=EPS_WarningLamp, system-signal=EPS_WarningLamp}, {implementation-record-element=EPS_SteeringGearAngleValid, system-signal=EPS_SteeringGearAngleValid}, {implementation-record-element=EPS_SteeringGearAngleSpdValid, system-signal=EPS_SteeringGearAngleSpdValid}, {implementation-record-element=EPS_SteeringGearAngleSpd, system-signal=EPS_SteeringGearAngleSpd}, {implementation-record-element=EPS_SteeringGearAngle, system-signal=EPS_SteeringGearAngle}]}
    root-software-compositions:
      root sw composition prototype EcuSwComposition: software-composition=ECU_Composition
