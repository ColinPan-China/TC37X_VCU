[part 3 of 3: packages /ECU to /Signal]
AUTOSAR XML (schema 00048)
package /ECU
  ecu instance VCU: associated-com-i-pdu-group=[VCU_oATOM_CANFD_Matrix_CH_V600_202502_Rx, VCU_oATOM_CANFD_Matrix_CH_V600_202502_Tx, VCU_oLIN00_Rx, VCU_oLIN00_Tx, VCU_oLIN01_Rx, VCU_oLIN01_Tx, VCU_oTC37X_VCU_CAN00_Rx, VCU_oTC37X_VCU_CAN00_Tx, VCU_oTC37X_VCU_CAN01_Rx, VCU_oTC37X_VCU_CAN01_Tx, VCU_oTC37X_VCU_CAN03_Rx, VCU_oTC37X_VCU_CAN03_Tx, VCU_oTC37X_VCU_CAN12_Rx, VCU_oTC37X_VCU_CAN12_Tx]
    5 x can communication controller:
      CT_ATOM_CANFD_Matrix_CH_V600_202502
      CT_TC37X_VCU_CAN00
      CT_TC37X_VCU_CAN01
      CT_TC37X_VCU_CAN03
      CT_TC37X_VCU_CAN12
    lin master CT_LIN00: protocol-version=LIN21, time-base=0.005, time-base-jitter=0.0001
    lin master CT_LIN01: protocol-version=LIN21, time-base=0.005, time-base-jitter=0.0001
    can communication connector CN_ATOM_CANFD_Matrix_CH_V600_202502: comm-controller=CT_ATOM_CANFD_Matrix_CH_V600_202502
    can communication connector CN_TC37X_VCU_CAN00: comm-controller=CT_TC37X_VCU_CAN00
    can communication connector CN_TC37X_VCU_CAN01: comm-controller=CT_TC37X_VCU_CAN01
    can communication connector CN_TC37X_VCU_CAN03: comm-controller=CT_TC37X_VCU_CAN03
    can communication connector CN_TC37X_VCU_CAN12: comm-controller=CT_TC37X_VCU_CAN12
    lin communication connector CN_LIN00: comm-controller=CT_LIN00
    lin communication connector CN_LIN01: comm-controller=CT_LIN01
package /Gateway
  gateway VCU: ecu=VCU
package /IPDUGroup
  14 x i signal i pdu group:
    VCU_oATOM_CANFD_Matrix_CH_V600_202502_Rx: communication-direction=IN
      i-signal-i-pdus:
        ACU_01_oATOM_CANFD_Matrix_CH_V600_202502
        ACU_02_oATOM_CANFD_Matrix_CH_V600_202502
        ACU_info_oATOM_CANFD_Matrix_CH_V600_202502
        ADCU_ACC_02_oATOM_CANFD_Matrix_CH_V600_202502
        ADCU_AEB_01_oATOM_CANFD_Matrix_CH_V600_202502
        ADCU_APS_01_oATOM_CANFD_Matrix_CH_V600_202502
        ADCU_APS_02_oATOM_CANFD_Matrix_CH_V600_202502
        ADCU_DA_oATOM_CANFD_Matrix_CH_V600_202502
        IBS_ACC_oATOM_CANFD_Matrix_CH_V600_202502
        IBS_APS_oATOM_CANFD_Matrix_CH_V600_202502
        IBS_Status_{01..04}_oATOM_CANFD_Matrix_CH_V600_202502
        IBS_Status_06_oATOM_CANFD_Matrix_CH_V600_202502
        IBS_Torque_oATOM_CANFD_Matrix_CH_V600_202502
        IBS_VCU_MotorControl_oATOM_CANFD_Matrix_CH_V600_202502
        IBS_WheelSpeed_01_oATOM_CANFD_Matrix_CH_V600_202502
        IBS_WheelSpeed_02_oATOM_CANFD_Matrix_CH_V600_202502
        SGW_17_oATOM_CANFD_Matrix_CH_V600_202502
    VCU_oATOM_CANFD_Matrix_CH_V600_202502_Tx: communication-direction=OUT
      i-signal-i-pdus:
        VCU_{02..04}_oATOM_CANFD_Matrix_CH_V600_202502
        VCU_AccPedal_oATOM_CANFD_Matrix_CH_V600_202502
        VCU_BMS_oATOM_CANFD_Matrix_CH_V600_202502
        VCU_Chassis_01_oATOM_CANFD_Matrix_CH_V600_202502
        VCU_HMIsignals_01_oATOM_CANFD_Matrix_CH_V600_202502
        VCU_HMIsignals_02_oATOM_CANFD_Matrix_CH_V600_202502
        VCU_IBS_01_oATOM_CANFD_Matrix_CH_V600_202502
        VCU_MCU_03_oATOM_CANFD_Matrix_CH_V600_202502
        VCU_PlugInChrgInfo_oATOM_CANFD_Matrix_CH_V600_202502
    VCU_oLIN00_Rx: communication-direction=IN
      i-signal-i-pdus:
        EXV_1_VCU_oLIN00
        EXV_2_VCU_oLIN00
        EXV2_Status_oLIN00
        HVCH_Rsp01_oLIN00
        HVCH_Rsp02_oLIN00
        PMP2_Sts_oLIN00
        PMP3_Sts_oLIN00
        SVA_VCU_STD_oLIN00
    VCU_oLIN00_Tx: communication-direction=OUT, i-signal-i-pdus=[EDCU_EXV2_oLIN00, PMP_Cmd_oLIN00, TCU_HVCH_Cmd_oLIN00, VCU_EXV_1_oLIN00, VCU_EXV_2_oLIN00, VCU_SVA_CMD_oLIN00]
    VCU_oLIN01_Rx: communication-direction=IN, i-signal-i-pdus=[Vcu_Lin0_RxMsg1_oLIN01, Vcu_Lin0_RxMsg2_oLIN01]
    VCU_oLIN01_Tx: communication-direction=OUT, i-signal-i-pdus=[Vcu_Lin0_TxMsg1_oLIN01, Vcu_Lin0_TxMsg2_oLIN01]
    VCU_oTC37X_VCU_CAN00_Rx: communication-direction=IN, i-signal-i-pdus=[VcuRxMsg1_oTC37X_VCU_CAN00, VcuRxMsg2_oTC37X_VCU_CAN00]
    VCU_oTC37X_VCU_CAN00_Tx: communication-direction=OUT
      i-signal-i-pdus:
        VcuTxIoMsg{1..8}_oTC37X_VCU_CAN00
        VcuTxMsg1_oTC37X_VCU_CAN00
        VcuTxMsg2_oTC37X_VCU_CAN00
    VCU_oTC37X_VCU_CAN01_Rx: communication-direction=IN, i-signal-i-pdus=[VcuRxMsg3_oTC37X_VCU_CAN01, VcuRxMsg4_oTC37X_VCU_CAN01]
    VCU_oTC37X_VCU_CAN01_Tx: communication-direction=OUT
      i-signal-i-pdus:
        VcuAdcTxG0Msg0_oTC37X_VCU_CAN01
        VcuAdcTxG0Msg1_oTC37X_VCU_CAN01
        VcuAdcTxG1Msg0_oTC37X_VCU_CAN01
        VcuAdcTxG1Msg1_oTC37X_VCU_CAN01
        VcuAdcTxG2Msg0_oTC37X_VCU_CAN01
        VcuAdcTxG2Msg1_oTC37X_VCU_CAN01
        VcuAdcTxG3Msg0_oTC37X_VCU_CAN01
        VcuAdcTxG3Msg1_oTC37X_VCU_CAN01
        VcuAdcTxG8Msg{0..3}_oTC37X_VCU_CAN01
    VCU_oTC37X_VCU_CAN03_Rx: communication-direction=IN, i-signal-i-pdus=[VcuCan03RxMsg1_oTC37X_VCU_CAN03, VcuCan03RxMsg2_oTC37X_VCU_CAN03]
    VCU_oTC37X_VCU_CAN03_Tx: communication-direction=OUT, i-signal-i-pdus=[VcuCan03TxMsg1_oTC37X_VCU_CAN03, VcuCan03TxMsg2_oTC37X_VCU_CAN03]
    VCU_oTC37X_VCU_CAN12_Rx: communication-direction=IN, i-signal-i-pdus=[VcuCan12RxMsg3_oTC37X_VCU_CAN12, VcuCan12RxMsg4_oTC37X_VCU_CAN12]
    VCU_oTC37X_VCU_CAN12_Tx: communication-direction=OUT, i-signal-i-pdus=[VcuCan12TxMsg1_oTC37X_VCU_CAN12, VcuCan12TxMsg2_oTC37X_VCU_CAN12]
package /PDU
  dcm i pdu MasterReq_ERV_oLIN00: length=8, diag-pdu-type=DIAG-REQUEST
  dcm i pdu MasterReq_EXV_1_oLIN00: length=8, diag-pdu-type=DIAG-REQUEST
  dcm i pdu MasterReq_EXV_2_oLIN00: length=8, diag-pdu-type=DIAG-REQUEST
  dcm i pdu MasterReq_GWM_oLIN01: length=8, diag-pdu-type=DIAG-REQUEST
  dcm i pdu MasterReq_HVCH_oLIN00: length=8, diag-pdu-type=DIAG-REQUEST
  dcm i pdu MasterReq_oLIN00: length=8, diag-pdu-type=DIAG-REQUEST
  dcm i pdu MasterReq_oLIN01: length=8, diag-pdu-type=DIAG-REQUEST
  dcm i pdu MasterReq_PMP_1_oLIN00: length=8, diag-pdu-type=DIAG-REQUEST
  dcm i pdu MasterReq_PMP_2_oLIN00: length=8, diag-pdu-type=DIAG-REQUEST
  dcm i pdu MasterReq_SVA_oLIN00: length=8, diag-pdu-type=DIAG-REQUEST
  dcm i pdu SlaveResp_ERV_oLIN00: length=8, diag-pdu-type=DIAG-RESPONSE
  dcm i pdu SlaveResp_EXV_1_oLIN00: length=8, diag-pdu-type=DIAG-RESPONSE
  dcm i pdu SlaveResp_EXV_2_oLIN00: length=8, diag-pdu-type=DIAG-RESPONSE
  dcm i pdu SlaveResp_GWM_oLIN01: length=8, diag-pdu-type=DIAG-RESPONSE
  dcm i pdu SlaveResp_HVCH_oLIN00: length=8, diag-pdu-type=DIAG-RESPONSE
  dcm i pdu SlaveResp_PMP_1_oLIN00: length=8, diag-pdu-type=DIAG-RESPONSE
  dcm i pdu SlaveResp_PMP_2_oLIN00: length=8, diag-pdu-type=DIAG-RESPONSE
  dcm i pdu SlaveResp_SVA_oLIN00: length=8, diag-pdu-type=DIAG-RESPONSE
  dcm i pdu Vcu_Uds_Func_Request_oTC37X_VCU_CAN00: length=7, diag-pdu-type=DIAG-REQUEST
  dcm i pdu Vcu_Uds_Phy_Request_oTC37X_VCU_CAN00: length=8, diag-pdu-type=DIAG-REQUEST
  dcm i pdu Vcu_Uds_Response_oTC37X_VCU_CAN00: length=8, diag-pdu-type=DIAG-RESPONSE
package /ISignal
  31 x i signal group:
    SG_ACU_01_SigGroup_oACU_01_oATOM_CANFD_Matrix_CH_V600_202502: i-signal=[ACU_YawRate_oACU_01_oATOM_CANFD_Matrix_CH_V600_202502, ACU_YawRateStatus_oACU_01_oATOM_CANFD_Matrix_CH_V600_202502, Checksum_0F5_oACU_01_oATOM_CANFD_Matrix_CH_V600_202502, MessageCounter_0F5_oACU_01_oATOM_CANFD_Matrix_CH_V600_202502], system-signal-group=SG_ACU_01_SigGroup
    SG_ACU_02_SigGroup_oACU_02_oATOM_CANFD_Matrix_CH_V600_202502: i-signal=[ACU_LatA_oACU_02_oATOM_CANFD_Matrix_CH_V600_202502, ACU_LatAStatus_oACU_02_oATOM_CANFD_Matrix_CH_V600_202502, ACU_LgtA_oACU_02_oATOM_CANFD_Matrix_CH_V600_202502, ACU_LgtAStatus_oACU_02_oATOM_CANFD_Matrix_CH_V600_202502, Checksum_0F6_oACU_02_oATOM_CANFD_Matrix_CH_V600_202502, MessageCounter_0F6_oACU_02_oATOM_CANFD_Matrix_CH_V600_202502], system-signal-group=SG_ACU_02_SigGroup
    SG_ACU_info_SigGroup_oACU_info_oATOM_CANFD_Matrix_CH_V600_202502: i-signal=[ACU_CrashOutputSts_oACU_info_oATOM_CANFD_Matrix_CH_V600_202502, ACU_CrashOutputStsValid_oACU_info_oATOM_CANFD_Matrix_CH_V600_202502, ACU_DriverSeatBeltSts_oACU_info_oATOM_CANFD_Matrix_CH_V600_202502, ACU_DriverSeatBeltStsValid_oACU_info_oATOM_CANFD_Matrix_CH_V600_202502, ACU_DriverWarningLampSts_oACU_info_oATOM_CANFD_Matrix_CH_V600_202502, ACU_PassengerAirbagSts_oACU_info_oATOM_CANFD_Matrix_CH_V600_202502, ACU_PassengerSeatBeltSts_oACU_info_oATOM_CANFD_Matrix_CH_V600_202502, ACU_PassengerSeatBeltStsValid_oACU_info_oATOM_CANFD_Matrix_CH_V600_202502, ACU_PassengerSts_oACU_info_oATOM_CANFD_Matrix_CH_V600_202502, ACU_PassengerWarningLampSts_oACU_info_oATOM_CANFD_Matrix_CH_V600_202502, ACU_RLSeatBeltStatusValid_oACU_info_oATOM_CANFD_Matrix_CH_V600_202502, ACU_RRSeatBeltStatusValid_oACU_info_oATOM_CANFD_Matrix_CH_V600_202502, ACU_SecondLeftSeatBeltSts_oACU_info_oATOM_CANFD_Matrix_CH_V600_202502, ACU_SecondLeftSts_oACU_info_oATOM_CANFD_Matrix_CH_V600_202502, ACU_SecondRightSeatBeltSts_oACU_info_oATOM_CANFD_Matrix_CH_V600_202502, ACU_SecondRightSts_oACU_info_oATOM_CANFD_Matrix_CH_V600_202502, ACU_WarningLampSts_oACU_info_oATOM_CANFD_Matrix_CH_V600_202502, Checksum_097_oACU_info_oATOM_CANFD_Matrix_CH_V600_202502, MessageCounter_097_oACU_info_oATOM_CANFD_Matrix_CH_V600_202502], system-signal-group=SG_ACU_info_SigGroup
    SG_ADCU_ACC_02_SigGroup_oADCU_ACC_02_oATOM_CANFD_Matrix_CH_V600_202502: i-signal=[ADCU_ACC_Mode_oADCU_ACC_02_oATOM_CANFD_Matrix_CH_V600_202502, ADCU_ACCDA_HandsOFF_Warning_oADCU_ACC_02_oATOM_CANFD_Matrix_CH_V600_202502, ADCU_ACCDA_SYS_Failure_oADCU_ACC_02_oATOM_CANFD_Matrix_CH_V600_202502, Checksum_0E0_oADCU_ACC_02_oATOM_CANFD_Matrix_CH_V600_202502, MessageCounter_0E0_oADCU_ACC_02_oATOM_CANFD_Matrix_CH_V600_202502], system-signal-group=SG_ADCU_ACC_02_SigGroup
    SG_ADCU_AEB_01_SigGroup_oADCU_AEB_01_oATOM_CANFD_Matrix_CH_V600_202502: i-signal=[ADCU_AEB_AWB_Level_oADCU_AEB_01_oATOM_CANFD_Matrix_CH_V600_202502, ADCU_AEB_AWB_Req_oADCU_AEB_01_oATOM_CANFD_Matrix_CH_V600_202502, ADCU_AEB_Decel_Cmd_oADCU_AEB_01_oATOM_CANFD_Matrix_CH_V600_202502, ADCU_AEB_Prefill_CMD_oADCU_AEB_01_oATOM_CANFD_Matrix_CH_V600_202502, ADCU_AEB_State_oADCU_AEB_01_oATOM_CANFD_Matrix_CH_V600_202502, ADCU_AEB_Stop_Req_oADCU_AEB_01_oATOM_CANFD_Matrix_CH_V600_202502, ADCU_AEBReq_oADCU_AEB_01_oATOM_CANFD_Matrix_CH_V600_202502, ADCU_AEBWarningSts_oADCU_AEB_01_oATOM_CANFD_Matrix_CH_V600_202502, ADCU_FCW_State_oADCU_AEB_01_oATOM_CANFD_Matrix_CH_V600_202502, Checksum_0E2_oADCU_AEB_01_oATOM_CANFD_Matrix_CH_V600_202502, MessageCounter_0E2_oADCU_AEB_01_oATOM_CANFD_Matrix_CH_V600_202502], system-signal-group=SG_ADCU_AEB_01_SigGroup
    SG_ADCU_APS_01_SigGroup_oADCU_APS_01_oATOM_CANFD_Matrix_CH_V600_202502: i-signal=[ADCU_APS_Stop_Req_oADCU_APS_01_oATOM_CANFD_Matrix_CH_V600_202502, ADCU_APSComfBrkReq_oADCU_APS_01_oATOM_CANFD_Matrix_CH_V600_202502, ADCU_APSCrlModeReq_oADCU_APS_01_oATOM_CANFD_Matrix_CH_V600_202502, ADCU_APSCrlReq_oADCU_APS_01_oATOM_CANFD_Matrix_CH_V600_202502, ADCU_APSCrlTypReq_oADCU_APS_01_oATOM_CANFD_Matrix_CH_V600_202502, ADCU_APSDistanceStop_oADCU_APS_01_oATOM_CANFD_Matrix_CH_V600_202502, ADCU_APSMaxSpeedReq_oADCU_APS_01_oATOM_CANFD_Matrix_CH_V600_202502, ADCU_Parking_CtrlSts_oADCU_APS_01_oATOM_CANFD_Matrix_CH_V600_202502, ADCU_Parking_Mode_oADCU_APS_01_oATOM_CANFD_Matrix_CH_V600_202502, ADCU_TargetGear_oADCU_APS_01_oATOM_CANFD_Matrix_CH_V600_202502, Checksum_0E4_oADCU_APS_01_oATOM_CANFD_Matrix_CH_V600_202502, MessageCounter_0E4_oADCU_APS_01_oATOM_CANFD_Matrix_CH_V600_202502], system-signal-group=SG_ADCU_APS_01_SigGroup
    SG_ADCU_APS_02_SigGroup_oADCU_APS_02_oATOM_CANFD_Matrix_CH_V600_202502: i-signal=ADCU_RemoteParkingMode_oADCU_APS_02_oATOM_CANFD_Matrix_CH_V600_202502, system-signal-group=SG_ADCU_APS_02_SigGroup
    SG_ADCU_DA_SigGroup_oADCU_DA_oATOM_CANFD_Matrix_CH_V600_202502: i-signal=[ADCU_DA_Mode_oADCU_DA_oATOM_CANFD_Matrix_CH_V600_202502, Checksum_0E6_oADCU_DA_oATOM_CANFD_Matrix_CH_V600_202502, MessageCounter_0E6_oADCU_DA_oATOM_CANFD_Matrix_CH_V600_202502], system-signal-group=SG_ADCU_DA_SigGroup
    SG_IBS_ACC_SigGroup_oIBS_ACC_oATOM_CANFD_Matrix_CH_V600_202502: i-signal=[Checksum_0B8_oIBS_ACC_oATOM_CANFD_Matrix_CH_V600_202502, IBS_CddActive_oIBS_ACC_oATOM_CANFD_Matrix_CH_V600_202502, IBS_CddAvailable_oIBS_ACC_oATOM_CANFD_Matrix_CH_V600_202502, IBS_CddError_oIBS_ACC_oATOM_CANFD_Matrix_CH_V600_202502, IBS_VehicleStandstill_oIBS_ACC_oATOM_CANFD_Matrix_CH_V600_202502, IBS_VehicleStandstill_Valid_oIBS_ACC_oATOM_CANFD_Matrix_CH_V600_202502, IBS_VlcActive_oIBS_ACC_oATOM_CANFD_Matrix_CH_V600_202502, IBS_VlcAvalible_oIBS_ACC_oATOM_CANFD_Matrix_CH_V600_202502, IBS_VlcError_oIBS_ACC_oATOM_CANFD_Matrix_CH_V600_202502, IBS_WLTorqueVLCReq_oIBS_ACC_oATOM_CANFD_Matrix_CH_V600_202502, IBS_WLTorqueVLCReqValid_oIBS_ACC_oATOM_CANFD_Matrix_CH_V600_202502, MessageCounter_0B8_oIBS_ACC_oATOM_CANFD_Matrix_CH_V600_202502], system-signal-group=SG_IBS_ACC_SigGroup
    SG_IBS_APS_SigGroup_oIBS_APS_oATOM_CANFD_Matrix_CH_V600_202502: i-signal=[Checksum_0B7_oIBS_APS_oATOM_CANFD_Matrix_CH_V600_202502, IBS_APS_Avl_oIBS_APS_oATOM_CANFD_Matrix_CH_V600_202502, IBS_APSComfortAvl_oIBS_APS_oATOM_CANFD_Matrix_CH_V600_202502, IBS_APSCrlReqEcho_oIBS_APS_oATOM_CANFD_Matrix_CH_V600_202502, IBS_APSEmergenyAvl_oIBS_APS_oATOM_CANFD_Matrix_CH_V600_202502, IBS_APSModeEcho_oIBS_APS_oATOM_CANFD_Matrix_CH_V600_202502, IBS_APSTrqReqActive_oIBS_APS_oATOM_CANFD_Matrix_CH_V600_202502, IBS_BrakeTypEcho_oIBS_APS_oATOM_CANFD_Matrix_CH_V600_202502, MessageCounter_0B7_oIBS_APS_oATOM_CANFD_Matrix_CH_V600_202502], system-signal-group=SG_IBS_APS_SigGroup
    SG_IBS_Status_01_SigGroup_oIBS_Status_01_oATOM_CANFD_Matrix_CH_V600_202502: i-signal=[Checksum_0B2_oIBS_Status_01_oATOM_CANFD_Matrix_CH_V600_202502, IBS_BrakePedalStatus_oIBS_Status_01_oATOM_CANFD_Matrix_CH_V600_202502, IBS_BrakePedalStatusValid_oIBS_Status_01_oATOM_CANFD_Matrix_CH_V600_202502, IBS_BrakePushrodStroke_oIBS_Status_01_oATOM_CANFD_Matrix_CH_V600_202502, IBS_MasterCylinderPressure_oIBS_Status_01_oATOM_CANFD_Matrix_CH_V600_202502, IBS_PlungerPressure_oIBS_Status_01_oATOM_CANFD_Matrix_CH_V600_202502, MessageCounter_0B2_oIBS_Status_01_oATOM_CANFD_Matrix_CH_V600_202502], system-signal-group=SG_IBS_Status_01_SigGroup
    SG_IBS_Status_02_SigGroup_oIBS_Status_02_oATOM_CANFD_Matrix_CH_V600_202502: i-signal=[Checksum_0B3_oIBS_Status_02_oATOM_CANFD_Matrix_CH_V600_202502, IBS_AEBActive_oIBS_Status_02_oATOM_CANFD_Matrix_CH_V600_202502, IBS_AEBAvailable_oIBS_Status_02_oATOM_CANFD_Matrix_CH_V600_202502, IBS_AVHAvailable_oIBS_Status_02_oATOM_CANFD_Matrix_CH_V600_202502, IBS_AWBActive_oIBS_Status_02_oATOM_CANFD_Matrix_CH_V600_202502, IBS_AWBAvailable_oIBS_Status_02_oATOM_CANFD_Matrix_CH_V600_202502, IBS_BrakeLightRequest_oIBS_Status_02_oATOM_CANFD_Matrix_CH_V600_202502, IBS_EPBControllerSts_oIBS_Status_02_oATOM_CANFD_Matrix_CH_V600_202502, IBS_EPBFailureLamp_oIBS_Status_02_oATOM_CANFD_Matrix_CH_V600_202502, IBS_EPBFunctionLamp_oIBS_Status_02_oATOM_CANFD_Matrix_CH_V600_202502, IBS_EPBworkingSts_oIBS_Status_02_oATOM_CANFD_Matrix_CH_V600_202502, IBS_HazWarnReq_oIBS_Status_02_oATOM_CANFD_Matrix_CH_V600_202502, IBS_HDCAvailable_oIBS_Status_02_oATOM_CANFD_Matrix_CH_V600_202502, IBS_HHCActive_oIBS_Status_02_oATOM_CANFD_Matrix_CH_V600_202502, IBS_HHCAvailable_oIBS_Status_02_oATOM_CANFD_Matrix_CH_V600_202502, IBS_TCSActive_oIBS_Status_02_oATOM_CANFD_Matrix_CH_V600_202502, IBS_VDCActive_oIBS_Status_02_oATOM_CANFD_Matrix_CH_V600_202502, MessageCounter_0B3_oIBS_Status_02_oATOM_CANFD_Matrix_CH_V600_202502], system-signal-group=SG_IBS_Status_02_SigGroup
    SG_IBS_Status_03_SigGroup_oIBS_Status_03_oATOM_CANFD_Matrix_CH_V600_202502: i-signal=[Checksum_0B4_oIBS_Status_03_oATOM_CANFD_Matrix_CH_V600_202502, IBS_ABPActive_oIBS_Status_03_oATOM_CANFD_Matrix_CH_V600_202502, IBS_ABPAvailable_oIBS_Status_03_oATOM_CANFD_Matrix_CH_V600_202502, IBS_ABSActive_oIBS_Status_03_oATOM_CANFD_Matrix_CH_V600_202502, IBS_ABSFault_oIBS_Status_03_oATOM_CANFD_Matrix_CH_V600_202502, IBS_DTCFault_oIBS_Status_03_oATOM_CANFD_Matrix_CH_V600_202502, IBS_EBDActive_oIBS_Status_03_oATOM_CANFD_Matrix_CH_V600_202502, IBS_EBDFault_oIBS_Status_03_oATOM_CANFD_Matrix_CH_V600_202502, IBS_EPBTextdisplay_oIBS_Status_03_oATOM_CANFD_Matrix_CH_V600_202502, IBS_SystemStatus_oIBS_Status_03_oATOM_CANFD_Matrix_CH_V600_202502, IBS_TCSFault_oIBS_Status_03_oATOM_CANFD_Matrix_CH_V600_202502, IBS_VCU_DecelerationRequest_Available_oIBS_Status_03_oATOM_CANFD_Matrix_CH_V600_202502, IBS_VDCFault_oIBS_Status_03_oATOM_CANFD_Matrix_CH_V600_202502, IBS_VehicleSpeed_oIBS_Status_03_oATOM_CANFD_Matrix_CH_V600_202502, IBS_VehicleSpeedValid_oIBS_Status_03_oATOM_CANFD_Matrix_CH_V600_202502, MessageCounter_0B4_oIBS_Status_03_oATOM_CANFD_Matrix_CH_V600_202502], system-signal-group=SG_IBS_Status_03_SigGroup
    SG_IBS_Status_04_SigGroup_oIBS_Status_04_oATOM_CANFD_Matrix_CH_V600_202502: i-signal=[Checksum_0BA_oIBS_Status_04_oATOM_CANFD_Matrix_CH_V600_202502, IBS_CDPActive_oIBS_Status_04_oATOM_CANFD_Matrix_CH_V600_202502, IBS_CDPAvailable_oIBS_Status_04_oATOM_CANFD_Matrix_CH_V600_202502, IBS_DTCActive_oIBS_Status_04_oATOM_CANFD_Matrix_CH_V600_202502, MessageCounter_0BA_oIBS_Status_04_oATOM_CANFD_Matrix_CH_V600_202502], system-signal-group=SG_IBS_Status_04_SigGroup
    SG_IBS_Status_06_SigGroup_oIBS_Status_06_oATOM_CANFD_Matrix_CH_V600_202502: i-signal=[Checksum_0BC_oIBS_Status_06_oATOM_CANFD_Matrix_CH_V600_202502, IBS_AVHSts_oIBS_Status_06_oATOM_CANFD_Matrix_CH_V600_202502, IBS_BrakeFluidWarning_oIBS_Status_06_oATOM_CANFD_Matrix_CH_V600_202502, IBS_EPBFailureStatus_oIBS_Status_06_oATOM_CANFD_Matrix_CH_V600_202502, IBS_ESClampdisplay_oIBS_Status_06_oATOM_CANFD_Matrix_CH_V600_202502, IBS_ESCOffSts_oIBS_Status_06_oATOM_CANFD_Matrix_CH_V600_202502, IBS_FactoryMode_oIBS_Status_06_oATOM_CANFD_Matrix_CH_V600_202502, IBS_HBAActive_oIBS_Status_06_oATOM_CANFD_Matrix_CH_V600_202502, IBS_HDCSts_oIBS_Status_06_oATOM_CANFD_Matrix_CH_V600_202502, IBS_MaintenaceMode_oIBS_Status_06_oATOM_CANFD_Matrix_CH_V600_202502, IBS_RollerbenchMode_oIBS_Status_06_oATOM_CANFD_Matrix_CH_V600_202502, IBS_RWUActive_oIBS_Status_06_oATOM_CANFD_Matrix_CH_V600_202502, IBS_RWUAvailable_oIBS_Status_06_oATOM_CANFD_Matrix_CH_V600_202502, IBS_TireMonSysSts_oIBS_Status_06_oATOM_CANFD_Matrix_CH_V600_202502, IBS_TireWarnFrntLe_oIBS_Status_06_oATOM_CANFD_Matrix_CH_V600_202502, IBS_TireWarnFrntRi_oIBS_Status_06_oATOM_CANFD_Matrix_CH_V600_202502, IBS_TireWarnReLe_oIBS_Status_06_oATOM_CANFD_Matrix_CH_V600_202502, IBS_TireWarnReRi_oIBS_Status_06_oATOM_CANFD_Matrix_CH_V600_202502, IBS_TPMS_ResetSts_oIBS_Status_06_oATOM_CANFD_Matrix_CH_V600_202502, MessageCounter_0BC_oIBS_Status_06_oATOM_CANFD_Matrix_CH_V600_202502], system-signal-group=SG_IBS_Status_06_SigGroup
    SG_IBS_Torque_SigGroup_oIBS_Torque_oATOM_CANFD_Matrix_CH_V600_202502: i-signal=[Checksum_0B9_oIBS_Torque_oATOM_CANFD_Matrix_CH_V600_202502, IBS_RBSStatus_oIBS_Torque_oATOM_CANFD_Matrix_CH_V600_202502, IBS_TargetGearReq_oIBS_Torque_oATOM_CANFD_Matrix_CH_V600_202502, IBS_VCU_DecelerationReqActive_oIBS_Torque_oATOM_CANFD_Matrix_CH_V600_202502, IBS_WLTorqueAPSReq_oIBS_Torque_oATOM_CANFD_Matrix_CH_V600_202502, IBS_WLTorqueAPSReqValid_oIBS_Torque_oATOM_CANFD_Matrix_CH_V600_202502, IBS_WLTorqueRBSReq_oIBS_Torque_oATOM_CANFD_Matrix_CH_V600_202502, IBS_WLTorqueRBSReqValid_oIBS_Torque_oATOM_CANFD_Matrix_CH_V600_202502, MessageCounter_0B9_oIBS_Torque_oATOM_CANFD_Matrix_CH_V600_202502], system-signal-group=SG_IBS_Torque_SigGroup
    SG_IBS_VCU_MotorControl_SigGroup_oIBS_VCU_MotorControl_oATOM_CANFD_Matrix_CH_V600_202502: i-signal=[Checksum_090_oIBS_VCU_MotorControl_oATOM_CANFD_Matrix_CH_V600_202502, IBS_WLTorqueIncrReq_oIBS_VCU_MotorControl_oATOM_CANFD_Matrix_CH_V600_202502, IBS_WLTorqueIncrReqSts_oIBS_VCU_MotorControl_oATOM_CANFD_Matrix_CH_V600_202502, IBS_WLTorqueRedReq_oIBS_VCU_MotorControl_oATOM_CANFD_Matrix_CH_V600_202502, IBS_WLTorqueRedReqSts_oIBS_VCU_MotorControl_oATOM_CANFD_Matrix_CH_V600_202502, MessageCounter_090_oIBS_VCU_MotorControl_oATOM_CANFD_Matrix_CH_V600_202502], system-signal-group=SG_IBS_VCU_MotorControl_SigGroup
    SG_IBS_WheelSpeed_01_SigGroup_oIBS_WheelSpeed_01_oATOM_CANFD_Matrix_CH_V600_202502: i-signal=[Checksum_0B0_oIBS_WheelSpeed_01_oATOM_CANFD_Matrix_CH_V600_202502, IBS_FLMovingDirection_oIBS_WheelSpeed_01_oATOM_CANFD_Matrix_CH_V600_202502, IBS_FLWheelPulseCounter_oIBS_WheelSpeed_01_oATOM_CANFD_Matrix_CH_V600_202502, IBS_FLWheelSpeed_oIBS_WheelSpeed_01_oATOM_CANFD_Matrix_CH_V600_202502, IBS_FLWheelSpeed_Fault_oIBS_WheelSpeed_01_oATOM_CANFD_Matrix_CH_V600_202502, IBS_FRMovingDirection_oIBS_WheelSpeed_01_oATOM_CANFD_Matrix_CH_V600_202502, IBS_FRWheelPulseCounter_oIBS_WheelSpeed_01_oATOM_CANFD_Matrix_CH_V600_202502, IBS_FRWheelSpeed_oIBS_WheelSpeed_01_oATOM_CANFD_Matrix_CH_V600_202502, IBS_FRWheelSpeed_Fault_oIBS_WheelSpeed_01_oATOM_CANFD_Matrix_CH_V600_202502, MessageCounter_0B0_oIBS_WheelSpeed_01_oATOM_CANFD_Matrix_CH_V600_202502], system-signal-group=SG_IBS_WheelSpeed_01_SigGroup
    SG_IBS_WheelSpeed_02_SigGroup_oIBS_WheelSpeed_02_oATOM_CANFD_Matrix_CH_V600_202502: i-signal=[Checksum_0B1_oIBS_WheelSpeed_02_oATOM_CANFD_Matrix_CH_V600_202502, IBS_RLMovingDirection_oIBS_WheelSpeed_02_oATOM_CANFD_Matrix_CH_V600_202502, IBS_RLWheelPulseCounter_oIBS_WheelSpeed_02_oATOM_CANFD_Matrix_CH_V600_202502, IBS_RLWheelSpeed_oIBS_WheelSpeed_02_oATOM_CANFD_Matrix_CH_V600_202502, IBS_RLWheelSpeed_Fault_oIBS_WheelSpeed_02_oATOM_CANFD_Matrix_CH_V600_202502, IBS_RRMovingDirection_oIBS_WheelSpeed_02_oATOM_CANFD_Matrix_CH_V600_202502, IBS_RRWheelPulseCounter_oIBS_WheelSpeed_02_oATOM_CANFD_Matrix_CH_V600_202502, IBS_RRWheelSpeed_oIBS_WheelSpeed_02_oATOM_CANFD_Matrix_CH_V600_202502, IBS_RRWheelSpeed_Fault_oIBS_WheelSpeed_02_oATOM_CANFD_Matrix_CH_V600_202502, MessageCounter_0B1_oIBS_WheelSpeed_02_oATOM_CANFD_Matrix_CH_V600_202502], system-signal-group=SG_IBS_WheelSpeed_02_SigGroup
    SG_SGW_17_SigGroup_oSGW_17_oATOM_CANFD_Matrix_CH_V600_202502: i-signal=SGW_BLESystemReadyReq_oSGW_17_oATOM_CANFD_Matrix_CH_V600_202502, system-signal-group=SG_SGW_17_SigGroup
    SG_VCU_02_SigGroup_oVCU_02_oATOM_CANFD_Matrix_CH_V600_202502: i-signal=[VCU_BS_Current_oVCU_02_oATOM_CANFD_Matrix_CH_V600_202502, VCU_BS_IBSBatSOC_oVCU_02_oATOM_CANFD_Matrix_CH_V600_202502, VCU_BS_IndicatorSts_oVCU_02_oATOM_CANFD_Matrix_CH_V600_202502, VCU_BS_LV_Batt_oVCU_02_oATOM_CANFD_Matrix_CH_V600_202502, VCU_WakeUpStatus_oVCU_02_oATOM_CANFD_Matrix_CH_V600_202502], system-signal-group=SG_VCU_02_SigGroup
    SG_VCU_03_SigGroup_oVCU_03_oATOM_CANFD_Matrix_CH_V600_202502: i-signal=[VCU_BrakeCompensateStatus_oVCU_03_oATOM_CANFD_Matrix_CH_V600_202502, VCU_ChargeProcessComment_oVCU_03_oATOM_CANFD_Matrix_CH_V600_202502, VCU_DCFCCurrent_oVCU_03_oATOM_CANFD_Matrix_CH_V600_202502, VCU_EnergyV2L_oVCU_03_oATOM_CANFD_Matrix_CH_V600_202502, VCU_MemoryChargeFault_oVCU_03_oATOM_CANFD_Matrix_CH_V600_202502], system-signal-group=SG_VCU_03_SigGroup
    SG_VCU_04_SigGroup_oVCU_04_oATOM_CANFD_Matrix_CH_V600_202502: i-signal=[VCU_ForwardVmaxlimitStatus_oVCU_04_oATOM_CANFD_Matrix_CH_V600_202502, VCU_ManuallyUnlockComment_oVCU_04_oATOM_CANFD_Matrix_CH_V600_202502], system-signal-group=SG_VCU_04_SigGroup
    SG_VCU_AccPedal_SigGroup_oVCU_AccPedal_oATOM_CANFD_Matrix_CH_V600_202502: i-signal=[Checksum_0D2_oVCU_AccPedal_oATOM_CANFD_Matrix_CH_V600_202502, MessageCounter_0D2_oVCU_AccPedal_oATOM_CANFD_Matrix_CH_V600_202502, VCU_AccelerationPedal_oVCU_AccPedal_oATOM_CANFD_Matrix_CH_V600_202502, VCU_AccelerationPedalValid_oVCU_AccPedal_oATOM_CANFD_Matrix_CH_V600_202502, VCU_EPBReq_oVCU_AccPedal_oATOM_CANFD_Matrix_CH_V600_202502, VCU_Kickdown_oVCU_AccPedal_oATOM_CANFD_Matrix_CH_V600_202502, VCU_TargetGear_oVCU_AccPedal_oATOM_CANFD_Matrix_CH_V600_202502, VCU_VehicleSpeed_oVCU_AccPedal_oATOM_CANFD_Matrix_CH_V600_202502, VCU_VehicleSpeedValid_oVCU_AccPedal_oATOM_CANFD_Matrix_CH_V600_202502, VCU_VirtualACPedal_oVCU_AccPedal_oATOM_CANFD_Matrix_CH_V600_202502, VCU_VirtualACPedalValid_oVCU_AccPedal_oATOM_CANFD_Matrix_CH_V600_202502, VCU_VLCTorqueRequestActive_oVCU_AccPedal_oATOM_CANFD_Matrix_CH_V600_202502, VCU_VLCTorqueRequestAvailable_oVCU_AccPedal_oATOM_CANFD_Matrix_CH_V600_202502], system-signal-group=SG_VCU_AccPedal_SigGroup
    SG_VCU_BMS_SigGroup_oVCU_BMS_oATOM_CANFD_Matrix_CH_V600_202502: i-signal=[Checksum_0D1_oVCU_BMS_oATOM_CANFD_Matrix_CH_V600_202502, MessageCounter_0D1_oVCU_BMS_oATOM_CANFD_Matrix_CH_V600_202502, VCU_ActDriveMode_oVCU_BMS_oATOM_CANFD_Matrix_CH_V600_202502, VCU_BMS_Control_of_PosRelay_oVCU_BMS_oATOM_CANFD_Matrix_CH_V600_202502, VCU_BMSTargetThermLevel_oVCU_BMS_oATOM_CANFD_Matrix_CH_V600_202502, VCU_ChargeStatus_oVCU_BMS_oATOM_CANFD_Matrix_CH_V600_202502, VCU_DrvModSwitchWarn_oVCU_BMS_oATOM_CANFD_Matrix_CH_V600_202502, VCU_HVStatus_oVCU_BMS_oATOM_CANFD_Matrix_CH_V600_202502, VCU_IsoMeasurementSwitch_oVCU_BMS_oATOM_CANFD_Matrix_CH_V600_202502, VCU_LimitLevel_oVCU_BMS_oATOM_CANFD_Matrix_CH_V600_202502, VCU_RegenBrakeLightRequest_oVCU_BMS_oATOM_CANFD_Matrix_CH_V600_202502, VCU_RegenBrakeLightReqVld_oVCU_BMS_oATOM_CANFD_Matrix_CH_V600_202502, VCU_RequestedModeBMS_oVCU_BMS_oATOM_CANFD_Matrix_CH_V600_202502], system-signal-group=SG_VCU_BMS_SigGroup
    SG_VCU_Chassis_01_SigGroup_oVCU_Chassis_01_oATOM_CANFD_Matrix_CH_V600_202502: i-signal=[Checksum_0D3_oVCU_Chassis_01_oATOM_CANFD_Matrix_CH_V600_202502, MessageCounter_0D3_oVCU_Chassis_01_oATOM_CANFD_Matrix_CH_V600_202502, VCU_ADASOverride_oVCU_Chassis_01_oATOM_CANFD_Matrix_CH_V600_202502, VCU_APSTorqueRequestActive_oVCU_Chassis_01_oATOM_CANFD_Matrix_CH_V600_202502, VCU_APSTorqueRequestAvailable_oVCU_Chassis_01_oATOM_CANFD_Matrix_CH_V600_202502, VCU_BrakeCompensateWarn_oVCU_Chassis_01_oATOM_CANFD_Matrix_CH_V600_202502, VCU_DecelerationReq_oVCU_Chassis_01_oATOM_CANFD_Matrix_CH_V600_202502, VCU_DecelerationReqactive_oVCU_Chassis_01_oATOM_CANFD_Matrix_CH_V600_202502, VCU_DriverTorqueRequest_oVCU_Chassis_01_oATOM_CANFD_Matrix_CH_V600_202502, VCU_EnergyManagementWarn_oVCU_Chassis_01_oATOM_CANFD_Matrix_CH_V600_202502, VCU_RegenTorqueCap_oVCU_Chassis_01_oATOM_CANFD_Matrix_CH_V600_202502, VCU_RegenTorqueCapValid_oVCU_Chassis_01_oATOM_CANFD_Matrix_CH_V600_202502, VCU_RegStatus_oVCU_Chassis_01_oATOM_CANFD_Matrix_CH_V600_202502, VCU_TorqueRequestActive_oVCU_Chassis_01_oATOM_CANFD_Matrix_CH_V600_202502, VCU_TorqueRequestAvailable_oVCU_Chassis_01_oATOM_CANFD_Matrix_CH_V600_202502], system-signal-group=SG_VCU_Chassis_01_SigGroup
    SG_VCU_HMIsignals_01_SigGroup_oVCU_HMIsignals_01_oATOM_CANFD_Matrix_CH_V600_202502: i-signal=[Checksum_317_oVCU_HMIsignals_01_oATOM_CANFD_Matrix_CH_V600_202502, MessageCounter_317_oVCU_HMIsignals_01_oATOM_CANFD_Matrix_CH_V600_202502, VCU_CriSysFailure_oVCU_HMIsignals_01_oATOM_CANFD_Matrix_CH_V600_202502, VCU_DCDCFail_oVCU_HMIsignals_01_oATOM_CANFD_Matrix_CH_V600_202502, VCU_DriveMotOvrTemp_oVCU_HMIsignals_01_oATOM_CANFD_Matrix_CH_V600_202502, VCU_HVBatCriFail_oVCU_HMIsignals_01_oATOM_CANFD_Matrix_CH_V600_202502, VCU_HVBatOvrTemp_oVCU_HMIsignals_01_oATOM_CANFD_Matrix_CH_V600_202502, VCU_HVILError_oVCU_HMIsignals_01_oATOM_CANFD_Matrix_CH_V600_202502, VCU_HVInsulResFault_oVCU_HMIsignals_01_oATOM_CANFD_Matrix_CH_V600_202502, VCU_InvldGearSel_oVCU_HMIsignals_01_oATOM_CANFD_Matrix_CH_V600_202502, VCU_LimpHome_oVCU_HMIsignals_01_oATOM_CANFD_Matrix_CH_V600_202502, VCU_MileagelowRemind_oVCU_HMIsignals_01_oATOM_CANFD_Matrix_CH_V600_202502, VCU_PlugStatus_oVCU_HMIsignals_01_oATOM_CANFD_Matrix_CH_V600_202502, VCU_ReachLimitStd_oVCU_HMIsignals_01_oATOM_CANFD_Matrix_CH_V600_202502], system-signal-group=SG_VCU_HMIsignals_01_SigGroup
    SG_VCU_HMIsignals_02_SigGroup_oVCU_HMIsignals_02_oATOM_CANFD_Matrix_CH_V600_202502: i-signal=[Checksum_318_oVCU_HMIsignals_02_oATOM_CANFD_Matrix_CH_V600_202502, MessageCounter_318_oVCU_HMIsignals_02_oATOM_CANFD_Matrix_CH_V600_202502, VCU_DischargeEndSoc_oVCU_HMIsignals_02_oATOM_CANFD_Matrix_CH_V600_202502, VCU_Display_Cur_oVCU_HMIsignals_02_oATOM_CANFD_Matrix_CH_V600_202502, VCU_Display_Power_oVCU_HMIsignals_02_oATOM_CANFD_Matrix_CH_V600_202502, VCU_ForwardVmaxAllowed_oVCU_HMIsignals_02_oATOM_CANFD_Matrix_CH_V600_202502, VCU_maxChargeSOC_oVCU_HMIsignals_02_oATOM_CANFD_Matrix_CH_V600_202502, VCU_MCU_FaultLampReq_oVCU_HMIsignals_02_oATOM_CANFD_Matrix_CH_V600_202502, VCU_SystemReady_oVCU_HMIsignals_02_oATOM_CANFD_Matrix_CH_V600_202502], system-signal-group=SG_VCU_HMIsignals_02_SigGroup
    SG_VCU_IBS_01_SigGroup_oVCU_IBS_01_oATOM_CANFD_Matrix_CH_V600_202502: i-signal=[Checksum_094_oVCU_IBS_01_oATOM_CANFD_Matrix_CH_V600_202502, MessageCounter_094_oVCU_IBS_01_oATOM_CANFD_Matrix_CH_V600_202502, VCU_MotorActualTorque_oVCU_IBS_01_oATOM_CANFD_Matrix_CH_V600_202502, VCU_MotorActualTorqueValid_oVCU_IBS_01_oATOM_CANFD_Matrix_CH_V600_202502, VCU_OPStandstillReq_oVCU_IBS_01_oATOM_CANFD_Matrix_CH_V600_202502, VCU_WheelTrqACT_oVCU_IBS_01_oATOM_CANFD_Matrix_CH_V600_202502, VCU_WheelTrqACTValid_oVCU_IBS_01_oATOM_CANFD_Matrix_CH_V600_202502], system-signal-group=SG_VCU_IBS_01_SigGroup
    SG_VCU_MCU_03_SigGroup_oVCU_MCU_03_oATOM_CANFD_Matrix_CH_V600_202502: i-signal=[Checksum_095_oVCU_MCU_03_oATOM_CANFD_Matrix_CH_V600_202502, MessageCounter_095_oVCU_MCU_03_oATOM_CANFD_Matrix_CH_V600_202502, VCU_ActualGear_oVCU_MCU_03_oATOM_CANFD_Matrix_CH_V600_202502, VCU_BrakepedalStatus_oVCU_MCU_03_oATOM_CANFD_Matrix_CH_V600_202502, VCU_KL15eOn_oVCU_MCU_03_oATOM_CANFD_Matrix_CH_V600_202502, VCU_MCUDesiredTorque_oVCU_MCU_03_oATOM_CANFD_Matrix_CH_V600_202502, VCU_MCUSurgeDamperState_oVCU_MCU_03_oATOM_CANFD_Matrix_CH_V600_202502, VCU_PWTErrorLevel_oVCU_MCU_03_oATOM_CANFD_Matrix_CH_V600_202502, VCU_RequestedModeMCU_oVCU_MCU_03_oATOM_CANFD_Matrix_CH_V600_202502, VCU_TCSActive_oVCU_MCU_03_oATOM_CANFD_Matrix_CH_V600_202502, VCU_TrqThresholdDampgCtl_oVCU_MCU_03_oATOM_CANFD_Matrix_CH_V600_202502], system-signal-group=SG_VCU_MCU_03_SigGroup
    SG_VCU_PlugInChrgInfo_SigGroup_oVCU_PlugInChrgInfo_oATOM_CANFD_Matrix_CH_V600_202502: i-signal=[VCU_ChargeEndReason_oVCU_PlugInChrgInfo_oATOM_CANFD_Matrix_CH_V600_202502, VCU_DischargeEndReason_oVCU_PlugInChrgInfo_oATOM_CANFD_Matrix_CH_V600_202502, VCU_HVConnectFault_oVCU_PlugInChrgInfo_oATOM_CANFD_Matrix_CH_V600_202502, VCU_RemainChrgTime_oVCU_PlugInChrgInfo_oATOM_CANFD_Matrix_CH_V600_202502], system-signal-group=SG_VCU_PlugInChrgInfo_SigGroup
package /DataType/Unit
  20 x unit:
    U_A: display-name=A
    U_BAR: display-name=BAR
    U_C: display-name=¡ãC
    U_celsius: display-name=celsius
    U_cm: display-name=cm
    U_Degree: display-name=Degree
    U_degreesYs: display-name=degrees/s
    U_kmYh: display-name=km/h
    U_kW: display-name=kW
    U_KW: display-name=KW
    U_kWh: display-name=kWh
    U_min: display-name=min
    U_mm: display-name=mm
    U_mV: display-name=mV
    U_mYsX2: display-name=m/s^2
    U_Nm: display-name=Nm
    U_p: display-name=%
    U_percent: display-name=percent
    U_SED: display-name=SED
    U_V: display-name=V
package /Signal
  4 x system signal:
    SGW_BLEChrgFlaplockCtrlReq: compu {0=Cx0_No_Request (No Request), 1=Cx1_Unlock, 2=Cx2_Lock, 3=Cx3_Reserved}, range raw 0..3  # Bluetooth key charging flap lock control command
    SGW_BLEPowerModeReq: compu {0=Cx0_No_Request (No Request), 1=Cx1_Request_Power_OFF (Request Power OFF), 2=Cx2_Request_Power_ON (Request Power ON), 3=Cx3_Reserve}, range raw 0..3  # CBM request Power ON
    SGW_BLETailgateCtrlReq: compu {0=Cx0_No_Request (No Request), 1=Cx1_Unlock, 2=Cx2_Lock, 3=Cx3_Reserved}, range raw 0..3  # Bluetoot control back door command
    SGW_KeyLowBatWarning: compu {0=Cx0_NO_WARNING, 1=Cx1_WARNING}, range raw 0..1  # Fob battery low warning.
