[part 1 of 3: packages /VehicleProject to /TP]
AUTOSAR XML (schema 00048)
standard types defined: boolean, sint16, uint16, uint8
package /VehicleProject
  system System
package /NM
  nm config NmConfig: can-nm-cluster-coupling=coupled-cluster=[ATOM_CANFD_Matrix_CH_V600_202502_CAN, TC37X_VCU_CAN00_CAN, TC37X_VCU_CAN01_CAN, TC37X_VCU_CAN03_CAN, TC37X_VCU_CAN12_CAN]
    5 x can nm cluster, all with nm-msg-cycle-time=0.5, nm-network-timeout=2, nm-repeat-message-time=1.5, nm-user-data-length=6, nm-wait-bus-sleep-time=2:
      ATOM_CANFD_Matrix_CH_V600_202502_CAN: communication-cluster=ATOM_CANFD_Matrix_CH_V600_202502, nm-channel-id=4
        7 x can nm node, all with nm-node-id=28, nm-msg-cycle-offset=0, nm-msg-reduced-time=0.32, nm-range-config={lower-can-id=1280, upper-can-id=1407}:
          ACU: nm-if-ecu=ACU_CAN, nm-passive-mode-enabled=true
          ADCU_CH: nm-if-ecu=ADCU_CH_CAN, nm-passive-mode-enabled=true, rx-nm-pdu=NM_VCU_oATOM_CANFD_Matrix_CH_V600_202502
          AVAS: nm-if-ecu=AVAS_CAN, nm-passive-mode-enabled=true
          CGW_CH: nm-if-ecu=CGW_CH_CAN, rx-nm-pdu=NM_VCU_oATOM_CANFD_Matrix_CH_V600_202502, tx-nm-pdu=NM_CGW_oATOM_CANFD_Matrix_CH_V600_202502
          EPS: nm-if-ecu=EPS_CAN, nm-passive-mode-enabled=true
          IBS_CH: nm-if-ecu=IBS_CH_CAN, nm-passive-mode-enabled=true
          VCU: controller=CT_ATOM_CANFD_Matrix_CH_V600_202502, nm-if-ecu=VCU_CAN, rx-nm-pdu=NM_CGW_oATOM_CANFD_Matrix_CH_V600_202502, tx-nm-pdu=NM_VCU_oATOM_CANFD_Matrix_CH_V600_202502
      TC37X_VCU_CAN00_CAN: communication-cluster=TC37X_VCU_CAN00, nm-channel-id=0
        can nm node GWM: nm-if-ecu=GWM_CAN, nm-node-id=28, rx-nm-pdu=VCU_Tx_51Ch_NM_oTC37X_VCU_CAN00, tx-nm-pdu=VCU_Rx_500h_NM_oTC37X_VCU_CAN00, nm-msg-cycle-offset=0, nm-msg-reduced-time=0.32, nm-range-config={lower-can-id=1024, upper-can-id=1151}
        can nm node Tester: nm-if-ecu=Tester_CAN, nm-node-id=28, nm-passive-mode-enabled=true, nm-msg-cycle-offset=0, nm-msg-reduced-time=0.32, nm-range-config={lower-can-id=1024, upper-can-id=1151}
        can nm node VCU: controller=CT_TC37X_VCU_CAN00, nm-if-ecu=VCU_CAN, nm-node-id=28, rx-nm-pdu=VCU_Rx_500h_NM_oTC37X_VCU_CAN00, tx-nm-pdu=VCU_Tx_51Ch_NM_oTC37X_VCU_CAN00, nm-msg-cycle-offset=0, nm-msg-reduced-time=0.32, nm-range-config={lower-can-id=1024, upper-can-id=1151}
      TC37X_VCU_CAN01_CAN: communication-cluster=TC37X_VCU_CAN01, nm-channel-id=1
        can nm node GWM: nm-if-ecu=GWM_CAN, nm-node-id=28, rx-nm-pdu=VCU_Tx_51Ch_NM_oTC37X_VCU_CAN01, tx-nm-pdu=VCU_Rx_500h_NM_oTC37X_VCU_CAN01, nm-msg-cycle-offset=0, nm-msg-reduced-time=0.32, nm-range-config={lower-can-id=1024, upper-can-id=1151}
        can nm node Tester: nm-if-ecu=Tester_CAN, nm-node-id=28, nm-passive-mode-enabled=true, nm-msg-cycle-offset=0, nm-msg-reduced-time=0.32, nm-range-config={lower-can-id=1024, upper-can-id=1151}
        can nm node VCU: controller=CT_TC37X_VCU_CAN01, nm-if-ecu=VCU_CAN, nm-node-id=28, rx-nm-pdu=VCU_Rx_500h_NM_oTC37X_VCU_CAN01, tx-nm-pdu=VCU_Tx_51Ch_NM_oTC37X_VCU_CAN01, nm-msg-cycle-offset=0, nm-msg-reduced-time=0.32, nm-range-config={lower-can-id=1024, upper-can-id=1151}
      TC37X_VCU_CAN03_CAN: communication-cluster=TC37X_VCU_CAN03, nm-channel-id=3
        can nm node GWM: nm-if-ecu=GWM_CAN, nm-node-id=28, rx-nm-pdu=VCU_Tx_51Ch_NM_oTC37X_VCU_CAN03, tx-nm-pdu=VCU_Rx_500h_NM_oTC37X_VCU_CAN03, nm-msg-cycle-offset=0, nm-msg-reduced-time=0.32, nm-range-config={lower-can-id=1024, upper-can-id=1151}
        can nm node Tester: nm-if-ecu=Tester_CAN, nm-node-id=28, nm-passive-mode-enabled=true, nm-msg-cycle-offset=0, nm-msg-reduced-time=0.32, nm-range-config={lower-can-id=1024, upper-can-id=1151}
        can nm node VCU: controller=CT_TC37X_VCU_CAN03, nm-if-ecu=VCU_CAN, nm-node-id=28, rx-nm-pdu=VCU_Rx_500h_NM_oTC37X_VCU_CAN03, tx-nm-pdu=VCU_Tx_51Ch_NM_oTC37X_VCU_CAN03, nm-msg-cycle-offset=0, nm-msg-reduced-time=0.32, nm-range-config={lower-can-id=1024, upper-can-id=1151}
      TC37X_VCU_CAN12_CAN: communication-cluster=TC37X_VCU_CAN12, nm-channel-id=2
        can nm node GWM: nm-if-ecu=GWM_CAN, nm-node-id=28, rx-nm-pdu=VCU_Tx_51Ch_NM_oTC37X_VCU_CAN12, tx-nm-pdu=VCU_Rx_500h_NM_oTC37X_VCU_CAN12, nm-msg-cycle-offset=0, nm-msg-reduced-time=0.32, nm-range-config={lower-can-id=1024, upper-can-id=1151}
        can nm node Tester: nm-if-ecu=Tester_CAN, nm-node-id=28, nm-passive-mode-enabled=true, nm-msg-cycle-offset=0, nm-msg-reduced-time=0.32, nm-range-config={lower-can-id=1024, upper-can-id=1151}
        can nm node VCU: controller=CT_TC37X_VCU_CAN12, nm-if-ecu=VCU_CAN, nm-node-id=28, rx-nm-pdu=VCU_Rx_500h_NM_oTC37X_VCU_CAN12, tx-nm-pdu=VCU_Tx_51Ch_NM_oTC37X_VCU_CAN12, nm-msg-cycle-offset=0, nm-msg-reduced-time=0.32, nm-range-config={lower-can-id=1024, upper-can-id=1151}
    nm-if-ecus:
      9 x nm ecu, all with nm-node-id-enabled=true, nm-user-data-enabled=true:
        ACU_CAN: nm-passive-mode-enabled=true
        ADCU_CH_CAN: nm-passive-mode-enabled=true
        AVAS_CAN: nm-passive-mode-enabled=true
        CGW_CH_CAN
        EPS_CAN: nm-passive-mode-enabled=true
        GWM_CAN
        IBS_CH_CAN: nm-passive-mode-enabled=true
        Tester_CAN: nm-passive-mode-enabled=true
        VCU_CAN: ecu-instance=VCU
package /TP
  can tp config ATOM_CANFD_Matrix_CH_V600_202502_CAN: communication-cluster=ATOM_CANFD_Matrix_CH_V600_202502, can-tp-ecu{cycle-time-main-function=0.005, ecu-instance=VCU}
    can tp node TN_VCU: connector=CN_ATOM_CANFD_Matrix_CH_V600_202502
  can tp config TC37X_VCU_CAN00_CAN: communication-cluster=TC37X_VCU_CAN00, can-tp-ecu{cycle-time-main-function=0.005, ecu-instance=VCU}
    can tp channel TPCH: channel-id=0, channel-mode=FULL-DUPLEX-MODE
    can-tp-connection addressing-format=STANDARD, can-tp-channel=TPCH, data-pdu=Vcu_Uds_Func_Request_Tp_oTC37X_VCU_CAN00, receiver=TC37X_VCU_CAN00_CAN/TN_VCU, ta-type=FUNCTIONAL, tp-sdu=Vcu_Uds_Func_Request_oTC37X_VCU_CAN00, transmitter=TN_Tester:
      ident Vcu_Uds_Func_Request_oTN_Tester
    can-tp-connection addressing-format=STANDARD, can-tp-channel=TPCH, data-pdu=Vcu_Uds_Phy_Request_Tp_oTC37X_VCU_CAN00, flow-control-pdu=Vcu_Uds_Response_Tp_oTC37X_VCU_CAN00, receiver=TC37X_VCU_CAN00_CAN/TN_VCU, ta-type=PHYSICAL, tp-sdu=Vcu_Uds_Phy_Request_oTC37X_VCU_CAN00, transmitter=TN_Tester:
      ident Vcu_Uds_Phy_Request_oTN_VCU
    can-tp-connection addressing-format=STANDARD, can-tp-channel=TPCH, data-pdu=Vcu_Uds_Response_Tp_oTC37X_VCU_CAN00, flow-control-pdu=Vcu_Uds_Phy_Request_Tp_oTC37X_VCU_CAN00, receiver=TN_Tester, ta-type=PHYSICAL, tp-sdu=Vcu_Uds_Response_oTC37X_VCU_CAN00, transmitter=TC37X_VCU_CAN00_CAN/TN_VCU:
      ident Vcu_Uds_Response_oTN_VCU
    can tp node TN_Tester
    can tp node TN_VCU: connector=CN_TC37X_VCU_CAN00
  lin tp config LIN00: communication-cluster=LIN00
    8 x tp address:
      TA_0x005B: tp-address=91
      TA_0x0062: tp-address=98
      TA_0x0063: tp-address=99
      TA_0x0064: tp-address=100
      TA_0x0065: tp-address=101
      TA_0x0074: tp-address=116
      TA_0x0075: tp-address=117
      TA_0x007E: tp-address=126
    tp-connections:
      data-pdu=MasterReq_Tp_oLIN00, lin-tp-n-sdu=MasterReq_oLIN00, multicast=LIN00/TA_0x007E, receiver=[TN_0x005B_HVCH, TN_0x0062_ERV, TN_0x0063_EXV_1, TN_0x0064_EXV_2, TN_0x0065_SVA, TN_0x0074_PMP_1, TN_0x0075_PMP_2], transmitter=LIN00/TN_Master
      data-pdu=SlaveResp_Tp_oLIN00, flow-control=MasterReq_Tp_oLIN00, lin-tp-n-sdu=SlaveResp_HVCH_oLIN00, receiver=LIN00/TN_Master, transmitter=TN_0x005B_HVCH
      data-pdu=SlaveResp_Tp_oLIN00, flow-control=MasterReq_Tp_oLIN00, lin-tp-n-sdu=SlaveResp_ERV_oLIN00, receiver=LIN00/TN_Master, transmitter=TN_0x0062_ERV
      data-pdu=SlaveResp_Tp_oLIN00, flow-control=MasterReq_Tp_oLIN00, lin-tp-n-sdu=SlaveResp_EXV_1_oLIN00, receiver=LIN00/TN_Master, transmitter=TN_0x0063_EXV_1
      data-pdu=SlaveResp_Tp_oLIN00, flow-control=MasterReq_Tp_oLIN00, lin-tp-n-sdu=SlaveResp_EXV_2_oLIN00, receiver=LIN00/TN_Master, transmitter=TN_0x0064_EXV_2
      data-pdu=SlaveResp_Tp_oLIN00, flow-control=MasterReq_Tp_oLIN00, lin-tp-n-sdu=SlaveResp_SVA_oLIN00, receiver=LIN00/TN_Master, transmitter=TN_0x0065_SVA
      data-pdu=SlaveResp_Tp_oLIN00, flow-control=MasterReq_Tp_oLIN00, lin-tp-n-sdu=SlaveResp_PMP_1_oLIN00, receiver=LIN00/TN_Master, transmitter=TN_0x0074_PMP_1
      data-pdu=SlaveResp_Tp_oLIN00, flow-control=MasterReq_Tp_oLIN00, lin-tp-n-sdu=SlaveResp_PMP_2_oLIN00, receiver=LIN00/TN_Master, transmitter=TN_0x0075_PMP_2
      data-pdu=MasterReq_Tp_oLIN00, flow-control=SlaveResp_Tp_oLIN00, lin-tp-n-sdu=MasterReq_HVCH_oLIN00, receiver=TN_0x005B_HVCH, transmitter=LIN00/TN_Master
      data-pdu=MasterReq_Tp_oLIN00, flow-control=SlaveResp_Tp_oLIN00, lin-tp-n-sdu=MasterReq_ERV_oLIN00, receiver=TN_0x0062_ERV, transmitter=LIN00/TN_Master
      data-pdu=MasterReq_Tp_oLIN00, flow-control=SlaveResp_Tp_oLIN00, lin-tp-n-sdu=MasterReq_EXV_1_oLIN00, receiver=TN_0x0063_EXV_1, transmitter=LIN00/TN_Master
      data-pdu=MasterReq_Tp_oLIN00, flow-control=SlaveResp_Tp_oLIN00, lin-tp-n-sdu=MasterReq_EXV_2_oLIN00, receiver=TN_0x0064_EXV_2, transmitter=LIN00/TN_Master
      data-pdu=MasterReq_Tp_oLIN00, flow-control=SlaveResp_Tp_oLIN00, lin-tp-n-sdu=MasterReq_SVA_oLIN00, receiver=TN_0x0065_SVA, transmitter=LIN00/TN_Master
      data-pdu=MasterReq_Tp_oLIN00, flow-control=SlaveResp_Tp_oLIN00, lin-tp-n-sdu=MasterReq_PMP_1_oLIN00, receiver=TN_0x0074_PMP_1, transmitter=LIN00/TN_Master
      data-pdu=MasterReq_Tp_oLIN00, flow-control=SlaveResp_Tp_oLIN00, lin-tp-n-sdu=MasterReq_PMP_2_oLIN00, receiver=TN_0x0075_PMP_2, transmitter=LIN00/TN_Master
    8 x lin tp node:
      TN_0x005B_HVCH: tp-address=TA_0x005B
      TN_0x0062_ERV: tp-address=TA_0x0062
      TN_0x0063_EXV_1: tp-address=TA_0x0063
      TN_0x0064_EXV_2: tp-address=TA_0x0064
      TN_0x0065_SVA: tp-address=TA_0x0065
      TN_0x0074_PMP_1: tp-address=TA_0x0074
      TN_0x0075_PMP_2: tp-address=TA_0x0075
      TN_Master: connector=CN_LIN00
  lin tp config LIN01: communication-cluster=LIN01
    tp address TA_0x0052: tp-address=82
    tp address TA_0x007E: tp-address=126
    tp-connections:
      data-pdu=MasterReq_Tp_oLIN01, lin-tp-n-sdu=MasterReq_oLIN01, multicast=LIN01/TA_0x007E, receiver=TN_0x0052_GWM, transmitter=LIN01/TN_Master
      data-pdu=SlaveResp_Tp_oLIN01, flow-control=MasterReq_Tp_oLIN01, lin-tp-n-sdu=SlaveResp_GWM_oLIN01, receiver=LIN01/TN_Master, transmitter=TN_0x0052_GWM
      data-pdu=MasterReq_Tp_oLIN01, flow-control=SlaveResp_Tp_oLIN01, lin-tp-n-sdu=MasterReq_GWM_oLIN01, receiver=TN_0x0052_GWM, transmitter=LIN01/TN_Master
    lin tp node TN_0x0052_GWM: tp-address=TA_0x0052
    lin tp node TN_Master: connector=CN_LIN01
