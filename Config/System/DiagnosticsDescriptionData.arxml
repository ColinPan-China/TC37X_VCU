AUTOSAR XML (schema 00048)
package /InitialEcuC
  ecuc value collection InitialEcuC: ecuc-values=[Dcm, Dem]
  module config Dcm: module-description=Dcm_Impl
    DcmConfigSet
      DcmGeneral: DcmResetToFblAfterSessionFinalResponseEnabled=false
      DcmDsd
        DcmDsdServiceTable
          15 x DcmDsdService:
            DiagSessionControl: DcmDsdSidTabServiceId=16, DcmDsdSidTabSubfuncAvail=true
              3 x DcmDsdSubService:
                Default: DcmDsdSubServiceId=1
                Programming: DcmDsdSubServiceId=2
                Extended: DcmDsdSubServiceId=3
            EcuReset: DcmDsdSidTabServiceId=17, DcmDsdSidTabSubfuncAvail=true
              Hard (DcmDsdSubService): DcmDsdSubServiceId=1
              Soft (DcmDsdSubService): DcmDsdSubServiceId=3
            ClearDiagInfo: DcmDsdSidTabServiceId=20, DcmDsdSidTabSubfuncAvail=false
            ReadDtcInfo: DcmDsdSidTabServiceId=25, DcmDsdSidTabSubfuncAvail=true
              14 x DcmDsdSubService:
                RNODTCBSM: DcmDsdSubServiceId=1
                RDTCBSM: DcmDsdSubServiceId=2
                RDTCSSI: DcmDsdSubServiceId=3
                RDTCSSBDTC: DcmDsdSubServiceId=4
                RDTCEDRBDN: DcmDsdSubServiceId=6
                RNODTCBSMR: DcmDsdSubServiceId=7
                RDTCBSMR: DcmDsdSubServiceId=8
                RSIODTC: DcmDsdSubServiceId=9
                RSUPDTC: DcmDsdSubServiceId=10
                RFTFDTC: DcmDsdSubServiceId=11
                RFCDTC: DcmDsdSubServiceId=12
                RMRTFDTC: DcmDsdSubServiceId=13
                RMRCDTC: DcmDsdSubServiceId=14
                RDTCFDC: DcmDsdSubServiceId=20
            ReadDataById: DcmDsdSidTabServiceId=34, DcmDsdSidTabSubfuncAvail=false
            ReadMemoryByAddress: DcmDsdSidTabServiceId=35, DcmDsdSidTabSubfuncAvail=false
            SecurityAccess: DcmDsdSidTabServiceId=39, DcmDsdSidTabSubfuncAvail=true, DcmDsdSidTabSessionLevelRef=DcmDspSession/Programming, DcmDsdSidTabSessionLevelRef=DcmDspSession/Extended
              4 x DcmDsdSubService, all with DcmDsdSubServiceSessionLevelRef=DcmDspSession/Programming, DcmDsdSubServiceSessionLevelRef=DcmDspSession/Extended:
                SeedLevel1_Request: DcmDsdSubServiceId=1
                KeyLevel1_Send: DcmDsdSubServiceId=2
                requestSeed_Request: DcmDsdSubServiceId=3
                sendKey_Send: DcmDsdSubServiceId=4
            CommunicationControl: DcmDsdSidTabServiceId=40, DcmDsdSidTabSubfuncAvail=true, DcmDsdSidTabSessionLevelRef=DcmDspSession/Programming, DcmDsdSidTabSessionLevelRef=DcmDspSession/Extended
              4 x DcmDsdSubService, all with DcmDsdSubServiceSessionLevelRef=DcmDspSession/Programming, DcmDsdSubServiceSessionLevelRef=DcmDspSession/Extended:
                EnableRxAndTx: DcmDsdSubServiceId=0
                EnableRxAndDisableTx: DcmDsdSubServiceId=1
                DisableRxAndEnableTx: DcmDsdSubServiceId=2
                DisableRxAndTx: DcmDsdSubServiceId=3
            DynamicallyDefineDataId: DcmDsdSidTabServiceId=44, DcmDsdSidTabSubfuncAvail=true
              3 x DcmDsdSubService:
                DynDefById: DcmDsdSubServiceId=1
                DynDefByAddr: DcmDsdSubServiceId=2
                DynDefClr: DcmDsdSubServiceId=3
            WriteDataById: DcmDsdSidTabServiceId=46, DcmDsdSidTabSubfuncAvail=false
            IoControlById: DcmDsdSidTabServiceId=47, DcmDsdSidTabSubfuncAvail=false, DcmDsdSidTabSessionLevelRef=DcmDspSession/Extended
            RoutineControl: DcmDsdSidTabServiceId=49, DcmDsdSidTabSubfuncAvail=true, DcmDsdSidTabSessionLevelRef=DcmDspSession/Programming, DcmDsdSidTabSessionLevelRef=DcmDspSession/Extended
            WriteMemoryByAddress: DcmDsdSidTabServiceId=61, DcmDsdSidTabSubfuncAvail=false
            TesterPresent: DcmDsdSidTabServiceId=62, DcmDsdSidTabSubfuncAvail=true
              TesterPresent (DcmDsdSubService): DcmDsdSubServiceId=0
            ControlDtcSetting: DcmDsdSidTabServiceId=133, DcmDsdSidTabSubfuncAvail=true
              Enable (DcmDsdSubService): DcmDsdSubServiceId=1
              Disable (DcmDsdSubService): DcmDsdSubServiceId=2
      DcmDsp: DcmDspMaxDidToRead=5
        DevelopmentData_OperatingSystemVersion (DcmDspData): DcmDspDataSize=16, DcmDspDataType=UINT16, DcmDspDataInfoRef=DataInfo_DevelopmentData_OperatingSystemVersion
        DataInfo_DevelopmentData_OperatingSystemVersion (DcmDspDataInfo): DcmDspDataFixedLength=true
        DevelopmentData_CanDriverVersion (DcmDspData): DcmDspDataSize=16, DcmDspDataType=UINT16, DcmDspDataInfoRef=DataInfo_DevelopmentData_CanDriverVersion
        DataInfo_DevelopmentData_CanDriverVersion (DcmDspDataInfo): DcmDspDataFixedLength=true
        DevelopmentData_NmVersion (DcmDspData): DcmDspDataSize=16, DcmDspDataType=UINT16, DcmDspDataInfoRef=DataInfo_DevelopmentData_NmVersion
        DataInfo_DevelopmentData_NmVersion (DcmDspDataInfo): DcmDspDataFixedLength=true
        DevelopmentData_DiagnosticModuleVersion (DcmDspData): DcmDspDataSize=16, DcmDspDataType=UINT16, DcmDspDataInfoRef=DataInfo_DevelopmentData_DiagnosticModuleVersion
        DataInfo_DevelopmentData_DiagnosticModuleVersion (DcmDspDataInfo): DcmDspDataFixedLength=true
        DevelopmentData_TransportLayerVersion (DcmDspData): DcmDspDataSize=16, DcmDspDataType=UINT16, DcmDspDataInfoRef=DataInfo_DevelopmentData_TransportLayerVersion
        DataInfo_DevelopmentData_TransportLayerVersion (DcmDspDataInfo): DcmDspDataFixedLength=true
        DataDiagnosticIdentifier_DDI_DataDiagnosticIdentifier (DcmDspData): DcmDspDataSize=16, DcmDspDataType=UINT16, DcmDspDataInfoRef=DataInfo_DataDiagnosticIdentifier_DDI_DataDiagnosticIdentifier
        DataInfo_DataDiagnosticIdentifier_DDI_DataDiagnosticIdentifier (DcmDspDataInfo): DcmDspDataFixedLength=true
        DID_0x0200_Data (DcmDspData): DcmDspDataSize=8, DcmDspDataType=UINT8, DcmDspDataInfoRef=DataInfo_DID_0x0200_Data
        DataInfo_DID_0x0200_Data (DcmDspDataInfo): DcmDspDataFixedLength=true
        DID_0x0300_DID_Data (DcmDspData): DcmDspDataConditionCheckReadFncUsed=false, DcmDspDataSize=32, DcmDspDataType=UINT32, DcmDspDataInfoRef=DataInfo_DID_0x0300_DID_Data
        DataInfo_DID_0x0300_DID_Data (DcmDspDataInfo): DcmDspDataFixedLength=true
        DID_0x0400_DID_Data (DcmDspData): DcmDspDataSize=16, DcmDspDataType=UINT16, DcmDspDataInfoRef=DataInfo_DID_0x0400_DID_Data
        DataInfo_DID_0x0400_DID_Data (DcmDspDataInfo): DcmDspDataFixedLength=true
        VCU_DID_00_DataRecord (DcmDspData): DcmDspDataSize=32, DcmDspDataType=UINT32, DcmDspDataInfoRef=DataInfo_VCU_DID_00_DataRecord
        DataInfo_VCU_DID_00_DataRecord (DcmDspDataInfo): DcmDspDataFixedLength=true
        Boot_Software_NumberOfModules (DcmDspData): DcmDspDataSize=8, DcmDspDataType=UINT8, DcmDspDataInfoRef=DataInfo_Boot_Software_NumberOfModules
        DataInfo_Boot_Software_NumberOfModules (DcmDspDataInfo): DcmDspDataFixedLength=true
        Boot_Software_Boot_Software_Identification (DcmDspData): DcmDspDataSize=32, DcmDspDataType=UINT32, DcmDspDataInfoRef=DataInfo_Boot_Software_Boot_Software_Identification
        DataInfo_Boot_Software_Boot_Software_Identification (DcmDspDataInfo): DcmDspDataFixedLength=true
        Spare_Part_Number_Spare_Part_Number (DcmDspData): DcmDspDataSize=32, DcmDspDataType=UINT32, DcmDspDataInfoRef=DataInfo_Spare_Part_Number_Spare_Part_Number
        DataInfo_Spare_Part_Number_Spare_Part_Number (DcmDspDataInfo): DcmDspDataFixedLength=true
        EcuIdentification_Part_Number (DcmDspData): DcmDspDataSize=104, DcmDspDataType=UINT8_N, DcmDspDataInfoRef=DataInfo_EcuIdentification_Part_Number
        DataInfo_EcuIdentification_Part_Number (DcmDspDataInfo): DcmDspDataFixedLength=true
        SerialNumber_SerialNumber (DcmDspData): DcmDspDataSize=32, DcmDspDataType=UINT32, DcmDspDataInfoRef=DataInfo_SerialNumber_SerialNumber
        DataInfo_SerialNumber_SerialNumber (DcmDspDataInfo): DcmDspDataFixedLength=true
        Vehicle_Identification_VIN (DcmDspData): DcmDspDataSize=136, DcmDspDataType=UINT8_N, DcmDspDataInfoRef=DataInfo_Vehicle_Identification_VIN
        DataInfo_Vehicle_Identification_VIN (DcmDspDataInfo): DcmDspDataFixedLength=true
        Hardware_Version_Hardware_Version_Number (DcmDspData): DcmDspDataSize=32, DcmDspDataType=UINT32, DcmDspDataInfoRef=DataInfo_Hardware_Version_Hardware_Version_Number
        DataInfo_Hardware_Version_Hardware_Version_Number (DcmDspDataInfo): DcmDspDataFixedLength=true
        DID_0xF194_1_New_Data_Object (DcmDspData): DcmDspDataSize=8, DcmDspDataType=UINT8, DcmDspDataInfoRef=DataInfo_DID_0xF194_1_New_Data_Object
        DataInfo_DID_0xF194_1_New_Data_Object (DcmDspDataInfo): DcmDspDataFixedLength=true
        DID_0xF1A0_F1A0_Data (DcmDspData): DcmDspDataSize=16, DcmDspDataType=UINT16, DcmDspDataInfoRef=DataInfo_DID_0xF1A0_F1A0_Data
        DataInfo_DID_0xF1A0_F1A0_Data (DcmDspDataInfo): DcmDspDataFixedLength=true
        DID_0xF1A1_F1A1_Data (DcmDspData): DcmDspDataSize=16, DcmDspDataType=UINT16, DcmDspDataInfoRef=DataInfo_DID_0xF1A1_F1A1_Data
        DataInfo_DID_0xF1A1_F1A1_Data (DcmDspDataInfo): DcmDspDataFixedLength=true
        DID_0xF1A2_F1A2_Data (DcmDspData): DcmDspDataSize=16, DcmDspDataType=UINT16, DcmDspDataInfoRef=DataInfo_DID_0xF1A2_F1A2_Data
        DataInfo_DID_0xF1A2_F1A2_Data (DcmDspDataInfo): DcmDspDataFixedLength=true
        DID_0xF1A3_F1A3_Data (DcmDspData): DcmDspDataSize=16, DcmDspDataType=UINT16, DcmDspDataInfoRef=DataInfo_DID_0xF1A3_F1A3_Data
        DataInfo_DID_0xF1A3_F1A3_Data (DcmDspDataInfo): DcmDspDataFixedLength=true
        18 x DcmDspDid:
          DevelopmentData: DcmDspDidIdentifier=256, DcmDspDidInfoRef=DidInfo_DevelopmentData
            5 x DcmDspDidSignal:
              OperatingSystemVersion: DcmDspDidDataPos=0, DcmDspDidDataRef=DevelopmentData_OperatingSystemVersion
              CanDriverVersion: DcmDspDidDataPos=16, DcmDspDidDataRef=DevelopmentData_CanDriverVersion
              NmVersion: DcmDspDidDataPos=32, DcmDspDidDataRef=DevelopmentData_NmVersion
              DiagnosticModuleVersion: DcmDspDidDataPos=48, DcmDspDidDataRef=DevelopmentData_DiagnosticModuleVersion
              TransportLayerVersion: DcmDspDidDataPos=64, DcmDspDidDataRef=DevelopmentData_TransportLayerVersion
          DataDiagnosticIdentifier_DDI: DcmDspDidIdentifier=257, DcmDspDidInfoRef=DidInfo_DataDiagnosticIdentifier_DDI
            DataDiagnosticIdentifier (DcmDspDidSignal): DcmDspDidDataPos=0, DcmDspDidDataRef=DataDiagnosticIdentifier_DDI_DataDiagnosticIdentifier
          DID_0x0200: DcmDspDidIdentifier=512, DcmDspDidInfoRef=DidInfo_DID_0x0200
            Data (DcmDspDidSignal): DcmDspDidDataPos=0, DcmDspDidDataRef=DID_0x0200_Data
          DID_0x0300: DcmDspDidIdentifier=768, DcmDspDidInfoRef=DidInfo_DID_0x0300
            DID_Data (DcmDspDidSignal): DcmDspDidDataPos=0, DcmDspDidDataRef=DID_0x0300_DID_Data
          DID_0x0400: DcmDspDidIdentifier=1024, DcmDspDidInfoRef=DidInfo_DID_0x0400
            DID_Data (DcmDspDidSignal): DcmDspDidDataPos=0, DcmDspDidDataRef=DID_0x0400_DID_Data
          VCU_DID_00: DcmDspDidIdentifier=4132, DcmDspDidInfoRef=DidInfo_VCU_DID_00
            DataRecord (DcmDspDidSignal): DcmDspDidDataPos=0, DcmDspDidDataRef=VCU_DID_00_DataRecord
          Boot_Software: DcmDspDidIdentifier=61824, DcmDspDidInfoRef=DidInfo_Boot_Software
            NumberOfModules (DcmDspDidSignal): DcmDspDidDataPos=0, DcmDspDidDataRef=Boot_Software_NumberOfModules
            Boot_Software_Identification (DcmDspDidSignal): DcmDspDidDataPos=8, DcmDspDidDataRef=Boot_Software_Boot_Software_Identification
          Spare_Part_Number: DcmDspDidIdentifier=61831, DcmDspDidInfoRef=DidInfo_Spare_Part_Number
            Spare_Part_Number (DcmDspDidSignal): DcmDspDidDataPos=0, DcmDspDidDataRef=Spare_Part_Number_Spare_Part_Number
          EcuIdentification: DcmDspDidIdentifier=61833, DcmDspDidInfoRef=DidInfo_EcuIdentification
            Part_Number (DcmDspDidSignal): DcmDspDidDataPos=0, DcmDspDidDataRef=EcuIdentification_Part_Number
          SerialNumber: DcmDspDidIdentifier=61836, DcmDspDidInfoRef=DidInfo_SerialNumber
            SerialNumber (DcmDspDidSignal): DcmDspDidDataPos=0, DcmDspDidDataRef=SerialNumber_SerialNumber
          Vehicle_Identification: DcmDspDidIdentifier=61840, DcmDspDidInfoRef=DidInfo_Vehicle_Identification
            VIN (DcmDspDidSignal): DcmDspDidDataPos=0, DcmDspDidDataRef=Vehicle_Identification_VIN
          Hardware_Version: DcmDspDidIdentifier=61843, DcmDspDidInfoRef=DidInfo_Hardware_Version
            Hardware_Version_Number (DcmDspDidSignal): DcmDspDidDataPos=0, DcmDspDidDataRef=Hardware_Version_Hardware_Version_Number
          DID_0xF194_1: DcmDspDidIdentifier=61844, DcmDspDidInfoRef=DidInfo_DID_0xF194_1
            New_Data_Object (DcmDspDidSignal): DcmDspDidDataPos=0, DcmDspDidDataRef=DID_0xF194_1_New_Data_Object
          DID_0xF1A0: DcmDspDidIdentifier=61856, DcmDspDidInfoRef=DidInfo_DID_0xF1A0
            F1A0_Data (DcmDspDidSignal): DcmDspDidDataPos=0, DcmDspDidDataRef=DID_0xF1A0_F1A0_Data
          DID_0xF1A1: DcmDspDidIdentifier=61857, DcmDspDidInfoRef=DidInfo_DID_0xF1A1
            F1A1_Data (DcmDspDidSignal): DcmDspDidDataPos=0, DcmDspDidDataRef=DID_0xF1A1_F1A1_Data
          DID_0xF1A2: DcmDspDidIdentifier=61858, DcmDspDidInfoRef=DidInfo_DID_0xF1A2
            F1A2_Data (DcmDspDidSignal): DcmDspDidDataPos=0, DcmDspDidDataRef=DID_0xF1A2_F1A2_Data
          DID_0xF1A3: DcmDspDidIdentifier=61859, DcmDspDidInfoRef=DidInfo_DID_0xF1A3
            F1A3_Data (DcmDspDidSignal): DcmDspDidDataPos=0, DcmDspDidDataRef=DID_0xF1A3_F1A3_Data
          New_Dynamically_Define_Non_Periodic_Data: DcmDspDidIdentifier=62208, DcmDspDidInfoRef=DidInfo_New_Dynamically_Define_Non_Periodic_Data
        18 x DcmDspDidInfo:
          DidInfo_DevelopmentData
            DcmDspDidAccess
              DcmDspDidRead
              DcmDspDidWrite
          DidInfo_DataDiagnosticIdentifier_DDI
            DcmDspDidAccess
              DcmDspDidRead
              DcmDspDidWrite
          DidInfo_DID_0x0200
            DcmDspDidAccess
              DcmDspDidRead
              DcmDspDidWrite
          DidInfo_DID_0x0300
            DcmDspDidAccess
              DcmDspDidControl:
                DcmDspDidFreezeCurrentState = true
                DcmDspDidResetToDefault = true
                DcmDspDidReturnControlToEcu = true
                DcmDspDidShortTermAdjustment = true
                DcmDspDidControlSessionRef = DcmDspSession/Extended
              DcmDspDidRead
          DidInfo_DID_0x0400
            DcmDspDidAccess
              DcmDspDidRead
          DidInfo_VCU_DID_00
            DcmDspDidAccess
              DcmDspDidRead
              DcmDspDidWrite
          DidInfo_Boot_Software
            DcmDspDidAccess
              DcmDspDidRead
              DcmDspDidWrite
          DidInfo_Spare_Part_Number
            DcmDspDidAccess
              DcmDspDidRead
              DcmDspDidWrite
          DidInfo_EcuIdentification
            DcmDspDidAccess
              DcmDspDidRead
              DcmDspDidWrite
          DidInfo_SerialNumber
            DcmDspDidAccess
              DcmDspDidRead
              DcmDspDidWrite
          DidInfo_Vehicle_Identification
            DcmDspDidAccess
              DcmDspDidRead
              DcmDspDidWrite
          DidInfo_Hardware_Version
            DcmDspDidAccess
              DcmDspDidRead
              DcmDspDidWrite
          DidInfo_DID_0xF194_1
            DcmDspDidAccess
              DcmDspDidRead
              DcmDspDidWrite
          DidInfo_DID_0xF1A0
            DcmDspDidAccess
              DcmDspDidRead
              DcmDspDidWrite
          DidInfo_DID_0xF1A1
            DcmDspDidAccess
              DcmDspDidRead
              DcmDspDidWrite
          DidInfo_DID_0xF1A2
            DcmDspDidAccess
              DcmDspDidRead
              DcmDspDidWrite
          DidInfo_DID_0xF1A3
            DcmDspDidAccess
              DcmDspDidRead
              DcmDspDidWrite
          DidInfo_New_Dynamically_Define_Non_Periodic_Data: DcmDspDidDynamicallyDefined=true
            DcmDspDidAccess
              DcmDspDidRead
              DcmDspDidDefine: DcmDspDDDidMaxElements=5
        New_Routine_Control (DcmDspRoutine):
          DcmDspRequestResultsRoutineSupported = false
          DcmDspStopRoutineSupported = false
          DcmDspRoutineIdentifier = 256
          DcmDspRoutineInfoRef = RoutineInfo_New_Routine_Control
        Vcu_Roution_00 (DcmDspRoutine):
          DcmDspRequestResultsRoutineSupported = true
          DcmDspStopRoutineSupported = true
          DcmDspRoutineIdentifier = 261
          DcmDspRoutineInfoRef = RoutineInfo_Vcu_Roution_00
        RoutineInfo_New_Routine_Control (DcmDspRoutineInfo)
          DcmDspRoutineAuthorization: DcmDspRoutineSessionRef=DcmDspSession/Programming, DcmDspRoutineSessionRef=DcmDspSession/Extended
        RoutineInfo_Vcu_Roution_00 (DcmDspRoutineInfo)
          DcmDspRoutineAuthorization: DcmDspRoutineSessionRef=DcmDspSession/Programming, DcmDspRoutineSessionRef=DcmDspSession/Extended
          DcmDspStartRoutineIn
            In_New_Data_Object (DcmDspStartRoutineInSignal): DcmDspRoutineSignalLength=16, DcmDspRoutineSignalType=UINT16, DcmDspRoutineSignalEndianness=BIG_ENDIAN, DcmDspRoutineSignalPos=0
          DcmDspStartRoutineOut
            Out_New_Data_Object (DcmDspStartRoutineOutSignal): DcmDspRoutineSignalLength=16, DcmDspRoutineSignalType=UINT16, DcmDspRoutineSignalEndianness=BIG_ENDIAN, DcmDspRoutineSignalPos=0
          DcmDspRoutineStopIn
            In_New_Data_Object (DcmDspRoutineStopInSignal): DcmDspRoutineSignalLength=16, DcmDspRoutineSignalType=UINT16, DcmDspRoutineSignalEndianness=BIG_ENDIAN, DcmDspRoutineSignalPos=0
          DcmDspRoutineStopOut
            Out_New_Data_Object (DcmDspRoutineStopOutSignal): DcmDspRoutineSignalLength=16, DcmDspRoutineSignalType=UINT16, DcmDspRoutineSignalEndianness=BIG_ENDIAN, DcmDspRoutineSignalPos=0
          DcmDspRoutineRequestResOut
            Out_New_Data_Object (DcmDspRoutineRequestResOutSignal): DcmDspRoutineSignalLength=16, DcmDspRoutineSignalType=UINT16, DcmDspRoutineSignalEndianness=BIG_ENDIAN, DcmDspRoutineSignalPos=0
        DcmDspSecurity
          UnlockedL1 (DcmDspSecurityRow):
            DcmDspSecurityDelayTime = 10
            DcmDspSecurityDelayTimeOnBoot = 0
            DcmDspSecurityKeySize = 4
            DcmDspSecurityLevel = 1
            DcmDspSecurityNumAttDelay = 3
            DcmDspSecuritySeedSize = 4
          Level_3 (DcmDspSecurityRow):
            DcmDspSecurityADRSize = 2
            DcmDspSecurityDelayTime = 10
            DcmDspSecurityDelayTimeOnBoot = 0
            DcmDspSecurityKeySize = 2
            DcmDspSecurityLevel = 2
            DcmDspSecurityNumAttDelay = 3
            DcmDspSecuritySeedSize = 2
        DcmDspSession
          3 x DcmDspSessionRow, all with DcmDspSessionP2ServerMax=0.05, DcmDspSessionP2StarServerMax=5:
            Default: DcmDspSessionLevel=1, DcmDspSessionForBoot=DCM_NO_BOOT
            Programming: DcmDspSessionLevel=2
            Extended: DcmDspSessionLevel=3, DcmDspSessionForBoot=DCM_NO_BOOT
        ComControl (DcmDspComControl)
          DspComContolAllChannel (DcmDspComControlAllChannel)
  module config Dem: module-description=Dem_Impl
    DemConfigSet
      DTCClass_DTC_0X000004 (DemDTCClass): DemDTCSeverity=DEM_DTC_SEV_NO_SEVERITY, DemUdsDTC=4
      DTC_0X000004 (DemEventParameter):
        DemEventKind = DEM_EVENT_KIND_SWC
        DemMaxNumberFreezeFrameRecords = 2
        DemDTCClassRef = DTCClass_DTC_0X000004
        DemExtendedDataClassRef = ExtendedDataClass_4f5344cd
        DemFreezeFrameClassRef = FreezeFrameClass_8de652ca
        DemEventClass:
          DemAgingAllowed = true
          DemAgingCycleCounterThreshold = 40
          DemEventDestination = DEM_DTC_ORIGIN_PRIMARY_MEMORY
          DemEventPriority = 4
          DemEventSignificance = DEM_EVENT_SIGNIFICANCE_FAULT
          DemEventFailureCycleCounterThreshold = 3
          DemAgingCycleRef = PowerCycle
          DemOperationCycleRef = PowerCycle
          DemDebounceAlgorithmClass
            DemDebounceCounterBased:
              DemDebounceCounterDecrementStepSize = 1
              DemDebounceCounterIncrementStepSize = 1
              DemDebounceCounterJumpDown = false
              DemDebounceCounterJumpUp = true
              DemDebounceCounterFailedThreshold = 40
              DemDebounceCounterPassedThreshold = -40
          IndicatorAttribute_WarningIndicator (DemIndicatorAttribute): DemIndicatorFailureCycleSource=DEM_FAILURE_CYCLE_EVENT, DemIndicatorHealingCycleRef=PowerCycle, DemIndicatorRef=WarningIndicator
      DTCClass_DTC_0X000002 (DemDTCClass): DemDTCSeverity=DEM_DTC_SEV_NO_SEVERITY, DemUdsDTC=514
      DTC_0X000002 (DemEventParameter):
        DemEventKind = DEM_EVENT_KIND_SWC
        DemMaxNumberFreezeFrameRecords = 2
        DemDTCClassRef = DTCClass_DTC_0X000002
        DemExtendedDataClassRef = ExtendedDataClass_4f5344cd
        DemFreezeFrameClassRef = FreezeFrameClass_34739cdf
        DemEventClass:
          DemAgingAllowed = true
          DemAgingCycleCounterThreshold = 40
          DemEventDestination = DEM_DTC_ORIGIN_PRIMARY_MEMORY
          DemEventPriority = 1
          DemEventSignificance = DEM_EVENT_SIGNIFICANCE_FAULT
          DemEventFailureCycleCounterThreshold = 3
          DemAgingCycleRef = PowerCycle
          DemEnableConditionGroupRef = EnableConditionGroup_2f9cc720
          DemOperationCycleRef = PowerCycle
          DemDebounceAlgorithmClass
            DemDebounceCounterBased:
              DemDebounceCounterDecrementStepSize = 1
              DemDebounceCounterIncrementStepSize = 1
              DemDebounceCounterJumpDown = false
              DemDebounceCounterJumpUp = true
              DemDebounceCounterFailedThreshold = 40
              DemDebounceCounterPassedThreshold = -40
          IndicatorAttribute_WarningIndicator (DemIndicatorAttribute): DemIndicatorFailureCycleSource=DEM_FAILURE_CYCLE_EVENT, DemIndicatorHealingCycleRef=PowerCycle, DemIndicatorRef=WarningIndicator
      DTCClass_DTC_0X000003 (DemDTCClass): DemDTCSeverity=DEM_DTC_SEV_NO_SEVERITY, DemUdsDTC=771
      DTC_0X000003 (DemEventParameter):
        DemEventKind = DEM_EVENT_KIND_SWC
        DemMaxNumberFreezeFrameRecords = 2
        DemDTCClassRef = DTCClass_DTC_0X000003
        DemExtendedDataClassRef = ExtendedDataClass_4f5344cd
        DemFreezeFrameClassRef = FreezeFrameClass_8de652ca
        DemEventClass:
          DemAgingAllowed = true
          DemAgingCycleCounterThreshold = 40
          DemEventDestination = DEM_DTC_ORIGIN_PRIMARY_MEMORY
          DemEventPriority = 2
          DemEventSignificance = DEM_EVENT_SIGNIFICANCE_FAULT
          DemEventFailureCycleCounterThreshold = 3
          DemAgingCycleRef = PowerCycle
          DemEnableConditionGroupRef = EnableConditionGroup_Example_EnableCondition1
          DemOperationCycleRef = PowerCycle
          DemDebounceAlgorithmClass
            DemDebounceCounterBased:
              DemDebounceCounterDecrementStepSize = 32
              DemDebounceCounterIncrementStepSize = 32
              DemDebounceCounterJumpDown = false
              DemDebounceCounterJumpUp = false
              DemDebounceCounterFailedThreshold = 40
              DemDebounceCounterPassedThreshold = -40
          IndicatorAttribute_WarningIndicator (DemIndicatorAttribute): DemIndicatorFailureCycleSource=DEM_FAILURE_CYCLE_EVENT, DemIndicatorHealingCycleRef=PowerCycle, DemIndicatorRef=WarningIndicator
      DTCClass_CAN00_BUSOFF (DemDTCClass): DemDTCSeverity=DEM_DTC_SEV_NO_SEVERITY, DemUdsDTC=13631748
      CAN00_BUSOFF (DemEventParameter):
        DemEventKind = DEM_EVENT_KIND_SWC
        DemMaxNumberFreezeFrameRecords = 2
        DemDTCClassRef = DTCClass_CAN00_BUSOFF
        DemExtendedDataClassRef = ExtendedDataClass_4f5344cd
        DemFreezeFrameClassRef = FreezeFrameClass_8de652ca
        DemEventClass:
          DemAgingAllowed = true
          DemAgingCycleCounterThreshold = 40
          DemEventDestination = DEM_DTC_ORIGIN_PRIMARY_MEMORY
          DemEventPriority = 3
          DemEventSignificance = DEM_EVENT_SIGNIFICANCE_FAULT
          DemEventFailureCycleCounterThreshold = 3
          DemAgingCycleRef = PowerCycle
          DemOperationCycleRef = PowerCycle
          DemDebounceAlgorithmClass
            DemDebounceCounterBased:
              DemDebounceCounterDecrementStepSize = 1
              DemDebounceCounterIncrementStepSize = 1
              DemDebounceCounterJumpDown = false
              DemDebounceCounterJumpUp = true
              DemDebounceCounterFailedThreshold = 40
              DemDebounceCounterPassedThreshold = -40
          IndicatorAttribute_WarningIndicator (DemIndicatorAttribute): DemIndicatorFailureCycleSource=DEM_FAILURE_CYCLE_EVENT, DemIndicatorHealingCycleRef=PowerCycle, DemIndicatorRef=WarningIndicator
      DTCClass_CAN01_ComLost (DemDTCClass): DemDTCSeverity=DEM_DTC_SEV_NO_SEVERITY, DemUdsDTC=13632005
      CAN01_ComLost (DemEventParameter):
        DemEventKind = DEM_EVENT_KIND_SWC
        DemMaxNumberFreezeFrameRecords = 2
        DemDTCClassRef = DTCClass_CAN01_ComLost
        DemExtendedDataClassRef = ExtendedDataClass_4f5344cd
        DemFreezeFrameClassRef = FreezeFrameClass_8de652ca
        DemEventClass:
          DemAgingAllowed = true
          DemAgingCycleCounterThreshold = 40
          DemEventDestination = DEM_DTC_ORIGIN_PRIMARY_MEMORY
          DemEventPriority = 3
          DemEventSignificance = DEM_EVENT_SIGNIFICANCE_FAULT
          DemEventFailureCycleCounterThreshold = 3
          DemAgingCycleRef = IgnitionCycle
          DemEnableConditionGroupRef = EnableConditionGroup_KL15_High
          DemOperationCycleRef = IgnitionCycle
          DemDebounceAlgorithmClass
            DemDebounceCounterBased:
              DemDebounceCounterDecrementStepSize = 1
              DemDebounceCounterIncrementStepSize = 1
              DemDebounceCounterJumpDown = false
              DemDebounceCounterJumpUp = true
              DemDebounceCounterFailedThreshold = 40
              DemDebounceCounterPassedThreshold = -40
          IndicatorAttribute_WarningIndicator (DemIndicatorAttribute): DemIndicatorFailureCycleSource=DEM_FAILURE_CYCLE_EVENT, DemIndicatorHealingCycleRef=IgnitionCycle, DemIndicatorRef=WarningIndicator
    DemGeneral:
      DemAgingCycleCounterProcessing = DEM_PROCESS_AGINGCTR_INTERN
      DemDebounceCounterBasedSupport = true
      DemEnableConditionSupport = true
      DemPTOSupport = false
      DemDtcStatusAvailabilityMask = 127
      DemTypeOfFreezeFrameRecordNumeration = DEM_FF_RECNUM_CALCULATED
      4 x DemDidClass:
        DID_0xF1A0: DemDidIdentifier=61856, DemDidDataClassRef=DID_0xf1a0_F1A0_Data
        DID_0xF1A1: DemDidIdentifier=61857, DemDidDataClassRef=DID_0xf1a1_F1A1_Data
        DID_0xF1A2: DemDidIdentifier=61858, DemDidDataClassRef=DID_0xf1a2_F1A2_Data
        DID_0xF1A3: DemDidIdentifier=61859, DemDidDataClassRef=DID_0xf1a3_F1A3_Data
      3 x DemEnableCondition:
        Example_EnableCondition1
        Example_EnableCondition2
        KL15_High
      ExtendedDataClass_4f5344cd (DemExtendedDataClass): DemExtendedDataRecordClassRef=ExtendedDataRecord0x01, DemExtendedDataRecordClassRef=ExtendedDataRecord0x02
      3 x DemEnableConditionGroup:
        EnableConditionGroup_2f9cc720: DemEnableConditionRef=Example_EnableCondition1, DemEnableConditionRef=Example_EnableCondition2
        EnableConditionGroup_KL15_High: DemEnableConditionRef=KL15_High
        EnableConditionGroup_Example_EnableCondition1: DemEnableConditionRef=Example_EnableCondition1
      ExtendedDataRecord0x01 (DemExtendedDataRecordClass):
        DemExtendedDataRecordNumber = 1
        DemDataClassRef = ExtendedDataRecord0x01_Occurence_Counter
        DemDataClassRef = ExtendedDataRecord0x01_Fault_Aging_Counter
      ExtendedDataRecord0x02 (DemExtendedDataRecordClass): DemExtendedDataRecordNumber=2, DemDataClassRef=ExtendedDataRecord0x02_Fault_Aging_Counte_Up
      FreezeFrameClass_34739cdf (DemFreezeFrameClass):
        DemDidClassRef = DemGeneral/DID_0xF1A{0..3}
      FreezeFrameClass_8de652ca (DemFreezeFrameClass): DemDidClassRef=DemGeneral/DID_0xF1A0, DemDidClassRef=DemGeneral/DID_0xF1A1, DemDidClassRef=DemGeneral/DID_0xF1A2
      WarningIndicator (DemIndicator)
      IgnitionCycle (DemOperationCycle): DemOperationCycleType=DEM_OPCYC_IGNITION
      PowerCycle (DemOperationCycle): DemOperationCycleType=DEM_OPCYC_POWER
      7 x DemDataClass:
        DID_0xf1a{0..3}_F1A{0..3}_Data: DemDataElementDataSize=2, DemDataElementDataType=UINT16, DemDataElementEndianness=BIG_ENDIAN, DemDataElementUsePort=USE_DATA_CLIENT_SERVER_PORT, DemDataElementStoreNonVolatile=true
        ExtendedDataRecord0x01_Occurence_Counter: DemDataElementDataSize=1, DemDataElementInternalData=DEM_OCCCTR, DemDataElementUsePort=USE_DATA_INTERNAL
        ExtendedDataRecord0x02_Fault_Aging_Counte_Up: DemDataElementDataSize=1, DemDataElementInternalData=DEM_AGINGCTR_UPCNT, DemDataElementUsePort=USE_DATA_INTERNAL
        ExtendedDataRecord0x01_Fault_Aging_Counter: DemDataElementDataSize=1, DemDataElementInternalData=DEM_AGINGCTR_DOWNCNT, DemDataElementUsePort=USE_DATA_INTERNAL
