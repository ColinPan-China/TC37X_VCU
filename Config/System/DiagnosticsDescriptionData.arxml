[part 1 of 2: package /InitialEcuC]
AUTOSAR XML (schema 00048)
package /InitialEcuC
  ecuc value collection InitialEcuC: ecuc-values=[Dcm, Dem]
  module config Dcm: module-description=Dcm_Impl
    DcmConfigSet
      DcmGeneral: DcmResetToFblAfterSessionFinalResponseEnabled=false
      DcmDsd
        DcmDsdServiceTable
          17 x DcmDsdService:
            ProcessOBDService01: DcmDsdSidTabServiceId=1, DcmDsdSidTabSubfuncAvail=false, DcmDsdSidTabSessionLevelRef=DcmDspSession/Default, DcmDsdSidTabSessionLevelRef=DcmDspSession/Extended, DcmDsdSidTabSessionLevelRef=Coding_Session
            ProcessOBDService09: DcmDsdSidTabServiceId=9, DcmDsdSidTabSubfuncAvail=false, DcmDsdSidTabSessionLevelRef=DcmDspSession/Default, DcmDsdSidTabSessionLevelRef=DcmDspSession/Extended, DcmDsdSidTabSessionLevelRef=Coding_Session
            DiagSessionControl: DcmDsdSidTabServiceId=16, DcmDsdSidTabSubfuncAvail=true
              4 x DcmDsdSubService:
                Default: DcmDsdSubServiceId=1
                Programming: DcmDsdSubServiceId=2, DcmDsdSubServiceSessionLevelRef=DcmDspSession/Programming, DcmDsdSubServiceSessionLevelRef=DcmDspSession/Extended
                Extended: DcmDsdSubServiceId=3, DcmDsdSubServiceSessionLevelRef=DcmDspSession/Default, DcmDsdSubServiceSessionLevelRef=DcmDspSession/Extended, DcmDsdSubServiceSessionLevelRef=Coding_Session
                Coding_Session_Start: DcmDsdSubServiceId=65, DcmDsdSubServiceSessionLevelRef=DcmDspSession/Extended, DcmDsdSubServiceSessionLevelRef=Coding_Session
            EcuReset: DcmDsdSidTabServiceId=17, DcmDsdSidTabSubfuncAvail=true, DcmDsdSidTabSessionLevelRef=DcmDspSession/Programming, DcmDsdSidTabSessionLevelRef=DcmDspSession/Extended, DcmDsdSidTabSessionLevelRef=Coding_Session
              Hard (DcmDsdSubService):
                DcmDsdSubServiceId = 1
                DcmDsdSubServiceSessionLevelRef = DcmDspSession/Programming
                DcmDsdSubServiceSessionLevelRef = DcmDspSession/Extended
                DcmDsdSubServiceSessionLevelRef = Coding_Session
              Soft (DcmDsdSubService):
                DcmDsdSubServiceId = 3
                DcmDsdSubServiceSessionLevelRef = DcmDspSession/Programming
                DcmDsdSubServiceSessionLevelRef = DcmDspSession/Extended
                DcmDsdSubServiceSessionLevelRef = Coding_Session
            ClearDiagInfo: DcmDsdSidTabServiceId=20, DcmDsdSidTabSubfuncAvail=false, DcmDsdSidTabSessionLevelRef=DcmDspSession/Default, DcmDsdSidTabSessionLevelRef=DcmDspSession/Extended, DcmDsdSidTabSessionLevelRef=Coding_Session
            ReadDtcInfo: DcmDsdSidTabServiceId=25, DcmDsdSidTabSubfuncAvail=true, DcmDsdSidTabSessionLevelRef=DcmDspSession/Default, DcmDsdSidTabSessionLevelRef=DcmDspSession/Extended, DcmDsdSidTabSessionLevelRef=Coding_Session
              6 x DcmDsdSubService, all with DcmDsdSubServiceSessionLevelRef=DcmDspSession/Default, DcmDsdSubServiceSessionLevelRef=DcmDspSession/Extended, DcmDsdSubServiceSessionLevelRef=Coding_Session:
                RNODTCBSM: DcmDsdSubServiceId=1
                RDTCBSM: DcmDsdSubServiceId=2
                RDTCSSI: DcmDsdSubServiceId=3
                RDTCSSBDTC: DcmDsdSubServiceId=4
                RDTCEDRBDN: DcmDsdSubServiceId=6
                RSUPDTC: DcmDsdSubServiceId=10
            ReadDataById: DcmDsdSidTabServiceId=34, DcmDsdSidTabSubfuncAvail=false
            SecurityAccess: DcmDsdSidTabServiceId=39, DcmDsdSidTabSubfuncAvail=true, DcmDsdSidTabSessionLevelRef=DcmDspSession/Programming, DcmDsdSidTabSessionLevelRef=DcmDspSession/Extended, DcmDsdSidTabSessionLevelRef=Coding_Session
              8 x DcmDsdSubService, all with DcmDsdSubServiceSessionLevelRef=DcmDspSession/Extended:
                RequestSeed_Level1_Request: DcmDsdSubServiceId=1
                SendKey_Level1_Send: DcmDsdSubServiceId=2
                RequestSeed_Level2_Request: DcmDsdSubServiceId=3
                SendKey_Level2_Send: DcmDsdSubServiceId=4
                RequestSeed_Level3_Request: DcmDsdSubServiceId=5, DcmDsdSubServiceSessionLevelRef=Coding_Session
                SendKey_Level3_Send: DcmDsdSubServiceId=6, DcmDsdSubServiceSessionLevelRef=Coding_Session
                RequestSeed_Level4_Request: DcmDsdSubServiceId=7, DcmDsdSubServiceSessionLevelRef=DcmDspSession/Programming
                SendKey_Level4_Send: DcmDsdSubServiceId=8, DcmDsdSubServiceSessionLevelRef=DcmDspSession/Programming
            CommunicationControl: DcmDsdSidTabServiceId=40, DcmDsdSidTabSubfuncAvail=true, DcmDsdSidTabSessionLevelRef=DcmDspSession/Extended, DcmDsdSidTabSessionLevelRef=Coding_Session
              EnableRxAndTx (DcmDsdSubService): DcmDsdSubServiceId=0, DcmDsdSubServiceSessionLevelRef=DcmDspSession/Extended, DcmDsdSubServiceSessionLevelRef=Coding_Session
              DisableRxAndTx (DcmDsdSubService): DcmDsdSubServiceId=3, DcmDsdSubServiceSessionLevelRef=DcmDspSession/Extended, DcmDsdSubServiceSessionLevelRef=Coding_Session
            WriteDataById: DcmDsdSidTabServiceId=46, DcmDsdSidTabSubfuncAvail=false, DcmDsdSidTabSessionLevelRef=DcmDspSession/Extended, DcmDsdSidTabSessionLevelRef=Coding_Session, DcmDsdSidTabSecurityLevelRef=UnlockedL1, DcmDsdSidTabSecurityLevelRef=Unlocked_Level_2, DcmDsdSidTabSecurityLevelRef=Unlocked_Level_3, DcmDsdSidTabSecurityLevelRef=Unlocked_Level_4
            RoutineControl: DcmDsdSidTabServiceId=49, DcmDsdSidTabSubfuncAvail=true, DcmDsdSidTabSessionLevelRef=DcmDspSession/Programming, DcmDsdSidTabSessionLevelRef=DcmDspSession/Extended, DcmDsdSidTabSessionLevelRef=Coding_Session
            RequestDownload: DcmDsdSidTabServiceId=52, DcmDsdSidTabSubfuncAvail=false, DcmDsdSidTabSessionLevelRef=DcmDspSession/Programming, DcmDsdSidTabSecurityLevelRef=Unlocked_Level_4
            TransferData: DcmDsdSidTabServiceId=54, DcmDsdSidTabSubfuncAvail=false, DcmDsdSidTabSessionLevelRef=DcmDspSession/Programming, DcmDsdSidTabSecurityLevelRef=Unlocked_Level_4
            RequestTransferExit: DcmDsdSidTabServiceId=55, DcmDsdSidTabSubfuncAvail=false, DcmDsdSidTabSessionLevelRef=DcmDspSession/Programming, DcmDsdSidTabSecurityLevelRef=Unlocked_Level_4
            Upload_Download_RequestFileTransfer: DcmDsdSidTabServiceId=56, DcmDsdSidTabSubfuncAvail=false, DcmDsdSidTabSessionLevelRef=DcmDspSession/Programming, DcmDsdSidTabSecurityLevelRef=Unlocked_Level_4
            TesterPresent: DcmDsdSidTabServiceId=62, DcmDsdSidTabSubfuncAvail=true
              TesterPresent (DcmDsdSubService): DcmDsdSubServiceId=0
            ControlDtcSetting: DcmDsdSidTabServiceId=133, DcmDsdSidTabSubfuncAvail=true, DcmDsdSidTabSessionLevelRef=DcmDspSession/Extended, DcmDsdSidTabSessionLevelRef=Coding_Session
              Enable (DcmDsdSubService): DcmDsdSubServiceId=1, DcmDsdSubServiceSessionLevelRef=DcmDspSession/Extended, DcmDsdSubServiceSessionLevelRef=Coding_Session
              Disable (DcmDsdSubService): DcmDsdSubServiceId=2, DcmDsdSubServiceSessionLevelRef=DcmDspSession/Extended, DcmDsdSubServiceSessionLevelRef=Coding_Session
      DcmDsp: DcmDspMaxDidToRead=5
        HV_Status_and_Charging_Status_HV_status_and_charging_status (DcmDspData): DcmDspDataSize=8, DcmDspDataType=UINT8, DcmDspDataInfoRef=DataInfo_HV_Status_and_Charging_Status_HV_status_and_charging_status
        DataInfo_HV_Status_and_Charging_Status_HV_status_and_charging_status (DcmDspDataInfo): DcmDspDataFixedLength=true
        VCU_AccPealparameter_VCU_VehicleSpeed (DcmDspData): DcmDspDataSize=16, DcmDspDataType=UINT16, DcmDspDataInfoRef=DataInfo_VCU_AccPealparameter_VCU_VehicleSpeed
        DataInfo_VCU_AccPealparameter_VCU_VehicleSpeed (DcmDspDataInfo): DcmDspDataFixedLength=true
        VCU_AccPealparameter_Accelerator_pedal_sensor_1_voltage (DcmDspData): DcmDspDataSize=16, DcmDspDataType=UINT16, DcmDspDataInfoRef=DataInfo_VCU_AccPealparameter_Accelerator_pedal_sensor_1_voltage
        DataInfo_VCU_AccPealparameter_Accelerator_pedal_sensor_1_voltage (DcmDspDataInfo): DcmDspDataFixedLength=true
        VCU_AccPealparameter_Accelerator_pedal_sensor_2_voltage (DcmDspData): DcmDspDataSize=16, DcmDspDataType=UINT16, DcmDspDataInfoRef=DataInfo_VCU_AccPealparameter_Accelerator_pedal_sensor_2_voltage
        DataInfo_VCU_AccPealparameter_Accelerator_pedal_sensor_2_voltage (DcmDspDataInfo): DcmDspDataFixedLength=true
        VCU_AccPealparameter_VCU_AccelerationPedal (DcmDspData): DcmDspDataSize=16, DcmDspDataType=UINT16, DcmDspDataInfoRef=DataInfo_VCU_AccPealparameter_VCU_AccelerationPedal
        DataInfo_VCU_AccPealparameter_VCU_AccelerationPedal (DcmDspDataInfo): DcmDspDataFixedLength=true
        VCU_Torque_parameter_VCU_MCUDesiredTorque (DcmDspData): DcmDspDataSize=16, DcmDspDataType=UINT16, DcmDspDataInfoRef=DataInfo_VCU_Torque_parameter_VCU_MCUDesiredTorque
        DataInfo_VCU_Torque_parameter_VCU_MCUDesiredTorque (DcmDspDataInfo): DcmDspDataFixedLength=true
        VCU_Torque_parameter_Torque_MinAllowed (DcmDspData): DcmDspDataSize=16, DcmDspDataType=UINT16, DcmDspDataInfoRef=DataInfo_VCU_Torque_parameter_Torque_MinAllowed
        DataInfo_VCU_Torque_parameter_Torque_MinAllowed (DcmDspDataInfo): DcmDspDataFixedLength=true
        VCU_Torque_parameter_Torque_MaxAllowed (DcmDspData): DcmDspDataSize=16, DcmDspDataType=UINT16, DcmDspDataInfoRef=DataInfo_VCU_Torque_parameter_Torque_MaxAllowed
        DataInfo_VCU_Torque_parameter_Torque_MaxAllowed (DcmDspDataInfo): DcmDspDataFixedLength=true
        VCU_Torque_parameter_VCU_RegenTorqueCap (DcmDspData): DcmDspDataSize=16, DcmDspDataType=UINT16, DcmDspDataInfoRef=DataInfo_VCU_Torque_parameter_VCU_RegenTorqueCap
        DataInfo_VCU_Torque_parameter_VCU_RegenTorqueCap (DcmDspDataInfo): DcmDspDataFixedLength=true
        Driver_Mode_Driver_Mode (DcmDspData): DcmDspDataSize=8, DcmDspDataType=UINT8, DcmDspDataInfoRef=DataInfo_Driver_Mode_Driver_Mode
        DataInfo_Driver_Mode_Driver_Mode (DcmDspDataInfo): DcmDspDataFixedLength=true
        VCU_PowerMaxAllowed_parameter1_VCU_TCUPowerAllowed (DcmDspData): DcmDspDataSize=16, DcmDspDataType=UINT16, DcmDspDataInfoRef=DataInfo_VCU_PowerMaxAllowed_parameter1_VCU_TCUPowerAllowed
        DataInfo_VCU_PowerMaxAllowed_parameter1_VCU_TCUPowerAllowed (DcmDspDataInfo): DcmDspDataFixedLength=true
        VCU_PowerMaxAllowed_parameter1_VCU_DCDCPowerLimit (DcmDspData): DcmDspDataSize=8, DcmDspDataType=UINT8_N, DcmDspDataInfoRef=DataInfo_VCU_PowerMaxAllowed_parameter1_VCU_DCDCPowerLimit
        DataInfo_VCU_PowerMaxAllowed_parameter1_VCU_DCDCPowerLimit (DcmDspDataInfo): DcmDspDataFixedLength=true
        VCU_PowerMaxAllowed_parameter1_MCUPowerLimit (DcmDspData): DcmDspDataSize=16, DcmDspDataType=UINT16, DcmDspDataInfoRef=DataInfo_VCU_PowerMaxAllowed_parameter1_MCUPowerLimit
        DataInfo_VCU_PowerMaxAllowed_parameter1_MCUPowerLimit (DcmDspDataInfo): DcmDspDataFixedLength=true
        VCU_PowerMaxAllowed_parameter1_VCU_DisChgPowerLimit (DcmDspData): DcmDspDataSize=8, DcmDspDataType=UINT8, DcmDspDataInfoRef=DataInfo_VCU_PowerMaxAllowed_parameter1_VCU_DisChgPowerLimit
        DataInfo_VCU_PowerMaxAllowed_parameter1_VCU_DisChgPowerLimit (DcmDspDataInfo): DcmDspDataFixedLength=true
        AC_charging_parameter_POD_OBC_InputACVoltage (DcmDspData): DcmDspDataSize=16, DcmDspDataType=UINT16, DcmDspDataInfoRef=DataInfo_AC_charging_parameter_POD_OBC_InputACVoltage
        DataInfo_AC_charging_parameter_POD_OBC_InputACVoltage (DcmDspDataInfo): DcmDspDataFixedLength=true
        AC_charging_parameter_VCU_OBC_ChargeCurrentCommand (DcmDspData): DcmDspDataSize=16, DcmDspDataType=UINT16, DcmDspDataInfoRef=DataInfo_AC_charging_parameter_VCU_OBC_ChargeCurrentCommand
        DataInfo_AC_charging_parameter_VCU_OBC_ChargeCurrentCommand (DcmDspDataInfo): DcmDspDataFixedLength=true
        AC_charging_parameter_POD_OBC_OutputDCChargeCurrent (DcmDspData): DcmDspDataSize=16, DcmDspDataType=UINT16, DcmDspDataInfoRef=DataInfo_AC_charging_parameter_POD_OBC_OutputDCChargeCurrent
        DataInfo_AC_charging_parameter_POD_OBC_OutputDCChargeCurrent (DcmDspDataInfo): DcmDspDataFixedLength=true
        AC_charging_parameter_POD_OBC_OutputDCChargeVoltage (DcmDspData): DcmDspDataSize=16, DcmDspDataType=UINT16, DcmDspDataInfoRef=DataInfo_AC_charging_parameter_POD_OBC_OutputDCChargeVoltage
        DataInfo_AC_charging_parameter_POD_OBC_OutputDCChargeVoltage (DcmDspDataInfo): DcmDspDataFixedLength=true
        Chargestatus_Chargestatus (DcmDspData): DcmDspDataSize=8, DcmDspDataType=UINT8, DcmDspDataInfoRef=DataInfo_Chargestatus_Chargestatus
        DataInfo_Chargestatus_Chargestatus (DcmDspDataInfo): DcmDspDataFixedLength=true
        Electronic_lock_state_Electronic_lock_state (DcmDspData): DcmDspDataSize=8, DcmDspDataType=UINT8, DcmDspDataInfoRef=DataInfo_Electronic_lock_state_Electronic_lock_state
        DataInfo_Electronic_lock_state_Electronic_lock_state (DcmDspDataInfo): DcmDspDataFixedLength=true
        VCU_HV_InterLock_PWM_pfrequency_VCU_HVIL (DcmDspData): DcmDspDataSize=8, DcmDspDataType=UINT8, DcmDspDataInfoRef=DataInfo_VCU_HV_InterLock_PWM_pfrequency_VCU_HVIL
        DataInfo_VCU_HV_InterLock_PWM_pfrequency_VCU_HVIL (DcmDspDataInfo): DcmDspDataFixedLength=true
        VCU_control_S2_status_New_Bit_Field (DcmDspData): DcmDspDataSize=8, DcmDspDataType=UINT8, DcmDspDataInfoRef=DataInfo_VCU_control_S2_status_New_Bit_Field
        DataInfo_VCU_control_S2_status_New_Bit_Field (DcmDspDataInfo): DcmDspDataFixedLength=true
        VCU_PowerMaxAllowed_parameter2_BMSDisChgPowerLimit (DcmDspData): DcmDspDataSize=16, DcmDspDataType=UINT16, DcmDspDataInfoRef=DataInfo_VCU_PowerMaxAllowed_parameter2_BMSDisChgPowerLimit
        DataInfo_VCU_PowerMaxAllowed_parameter2_BMSDisChgPowerLimit (DcmDspDataInfo): DcmDspDataFixedLength=true
        VCU_PowerMaxAllowed_parameter2_MCUFeedbackPowerLimit (DcmDspData): DcmDspDataSize=16, DcmDspDataType=UINT16, DcmDspDataInfoRef=DataInfo_VCU_PowerMaxAllowed_parameter2_MCUFeedbackPowerLimit
        DataInfo_VCU_PowerMaxAllowed_parameter2_MCUFeedbackPowerLimit (DcmDspDataInfo): DcmDspDataFixedLength=true
        VCU_PowerMaxAllowed_parameter2_BMSChgPowerLimit (DcmDspData): DcmDspDataSize=16, DcmDspDataType=UINT16, DcmDspDataInfoRef=DataInfo_VCU_PowerMaxAllowed_parameter2_BMSChgPowerLimit
        DataInfo_VCU_PowerMaxAllowed_parameter2_BMSChgPowerLimit (DcmDspDataInfo): DcmDspDataFixedLength=true
        VCU_control_main_relay_Mainrealy1 (DcmDspData): DcmDspDataSize=8, DcmDspDataType=UINT8, DcmDspDataInfoRef=DataInfo_VCU_control_main_relay_Mainrealy1
        DataInfo_VCU_control_main_relay_Mainrealy1 (DcmDspDataInfo): DcmDspDataFixedLength=true
        VCU_control_main_relay_Mainrelay2 (DcmDspData): DcmDspDataSize=8, DcmDspDataType=UINT8, DcmDspDataInfoRef=DataInfo_VCU_control_main_relay_Mainrelay2
        DataInfo_VCU_control_main_relay_Mainrelay2 (DcmDspDataInfo): DcmDspDataFixedLength=true
        PWT_vehicle_fault_PWT_ErrorLevel1 (DcmDspData): DcmDspDataSize=8, DcmDspDataType=UINT8, DcmDspDataInfoRef=DataInfo_PWT_vehicle_fault_PWT_ErrorLevel1
        DataInfo_PWT_vehicle_fault_PWT_ErrorLevel1 (DcmDspDataInfo): DcmDspDataFixedLength=true
        PWT_vehicle_fault_PWT_ErrorLevel2 (DcmDspData): DcmDspDataSize=8, DcmDspDataType=UINT8, DcmDspDataInfoRef=DataInfo_PWT_vehicle_fault_PWT_ErrorLevel2
        DataInfo_PWT_vehicle_fault_PWT_ErrorLevel2 (DcmDspDataInfo): DcmDspDataFixedLength=true
        PWT_vehicle_fault_PWT_ErrorLevel3 (DcmDspData): DcmDspDataSize=8, DcmDspDataType=UINT8, DcmDspDataInfoRef=DataInfo_PWT_vehicle_fault_PWT_ErrorLevel3
        DataInfo_PWT_vehicle_fault_PWT_ErrorLevel3 (DcmDspDataInfo): DcmDspDataFixedLength=true
        DC_Charging_port_Temperature_POD_DCInletTempA (DcmDspData): DcmDspDataSize=8, DcmDspDataType=UINT8, DcmDspDataInfoRef=DataInfo_DC_Charging_port_Temperature_POD_DCInletTempA
        DataInfo_DC_Charging_port_Temperature_POD_DCInletTempA (DcmDspDataInfo): DcmDspDataFixedLength=true
        DC_Charging_port_Temperature_POD_DCInletTempB (DcmDspData): DcmDspDataSize=8, DcmDspDataType=UINT8, DcmDspDataInfoRef=DataInfo_DC_Charging_port_Temperature_POD_DCInletTempB
        DataInfo_DC_Charging_port_Temperature_POD_DCInletTempB (DcmDspDataInfo): DcmDspDataFixedLength=true
        HV_part_work_mode_HV_part_work_mode1 (DcmDspData): DcmDspDataSize=8, DcmDspDataType=UINT8, DcmDspDataInfoRef=DataInfo_HV_part_work_mode_HV_part_work_mode1
        DataInfo_HV_part_work_mode_HV_part_work_mode1 (DcmDspDataInfo): DcmDspDataFixedLength=true
        HV_part_work_mode_HV_part_work_mode2 (DcmDspData): DcmDspDataSize=8, DcmDspDataType=UINT8, DcmDspDataInfoRef=DataInfo_HV_part_work_mode_HV_part_work_mode2
        DataInfo_HV_part_work_mode_HV_part_work_mode2 (DcmDspDataInfo): DcmDspDataFixedLength=true
        VCU_PowerMaxAllowed_parameter3_DCDCPower (DcmDspData): DcmDspDataSize=8, DcmDspDataType=UINT8, DcmDspDataInfoRef=DataInfo_VCU_PowerMaxAllowed_parameter3_DCDCPower
        DataInfo_VCU_PowerMaxAllowed_parameter3_DCDCPower (DcmDspDataInfo): DcmDspDataFixedLength=true
        VCU_PowerMaxAllowed_parameter3_ACSystemPower (DcmDspData): DcmDspDataSize=8, DcmDspDataType=UINT8, DcmDspDataInfoRef=DataInfo_VCU_PowerMaxAllowed_parameter3_ACSystemPower
        DataInfo_VCU_PowerMaxAllowed_parameter3_ACSystemPower (DcmDspDataInfo): DcmDspDataFixedLength=true
        VCU_PowerMaxAllowed_parameter3_PackPTCPower (DcmDspData): DcmDspDataSize=8, DcmDspDataType=UINT8, DcmDspDataInfoRef=DataInfo_VCU_PowerMaxAllowed_parameter3_PackPTCPower
        DataInfo_VCU_PowerMaxAllowed_parameter3_PackPTCPower (DcmDspDataInfo): DcmDspDataFixedLength=true
        VCU_PowerMaxAllowed_parameter3_MCUPower (DcmDspData): DcmDspDataSize=8, DcmDspDataType=UINT8, DcmDspDataInfoRef=DataInfo_VCU_PowerMaxAllowed_parameter3_MCUPower
        DataInfo_VCU_PowerMaxAllowed_parameter3_MCUPower (DcmDspDataInfo): DcmDspDataFixedLength=true
        VCU_PowerMaxAllowed_parameter3_V2LPower (DcmDspData): DcmDspDataSize=8, DcmDspDataType=UINT8, DcmDspDataInfoRef=DataInfo_VCU_PowerMaxAllowed_parameter3_V2LPower
        DataInfo_VCU_PowerMaxAllowed_parameter3_V2LPower (DcmDspDataInfo): DcmDspDataFixedLength=true
        BSW_version_number_Major_release (DcmDspData): DcmDspDataSize=8, DcmDspDataType=UINT8, DcmDspDataInfoRef=DataInfo_BSW_version_number_Major_release
        DataInfo_BSW_version_number_Major_release (DcmDspDataInfo): DcmDspDataFixedLength=true
        BSW_version_number_Minor_release (DcmDspData): DcmDspDataSize=8, DcmDspDataType=UINT8, DcmDspDataInfoRef=DataInfo_BSW_version_number_Minor_release
        DataInfo_BSW_version_number_Minor_release (DcmDspDataInfo): DcmDspDataFixedLength=true
        BSW_version_number_No_functional_content_change (DcmDspData): DcmDspDataSize=8, DcmDspDataType=UINT8, DcmDspDataInfoRef=DataInfo_BSW_version_number_No_functional_content_change
        DataInfo_BSW_version_number_No_functional_content_change (DcmDspDataInfo): DcmDspDataFixedLength=true
        Total_Odometer_VCU_Total_Odometer_VCU (DcmDspData): DcmDspDataSize=24, DcmDspDataType=UINT8_N, DcmDspDataInfoRef=DataInfo_Total_Odometer_VCU_Total_Odometer_VCU
        DataInfo_Total_Odometer_VCU_Total_Odometer_VCU (DcmDspDataInfo): DcmDspDataFixedLength=true
        BS_base_information4_BS_SOC (DcmDspData): DcmDspDataSize=8, DcmDspDataType=UINT8, DcmDspDataInfoRef=DataInfo_BS_base_information4_BS_SOC
        DataInfo_BS_base_information4_BS_SOC (DcmDspDataInfo): DcmDspDataFixedLength=true
        BS_base_information4_VCU_BS_Hcurrent (DcmDspData): DcmDspDataSize=16, DcmDspDataType=UINT16, DcmDspDataInfoRef=DataInfo_BS_base_information4_VCU_BS_Hcurrent
        DataInfo_BS_base_information4_VCU_BS_Hcurrent (DcmDspDataInfo): DcmDspDataFixedLength=true
        BS_base_information4_T_BATT (DcmDspData): DcmDspDataSize=8, DcmDspDataType=UINT8, DcmDspDataInfoRef=DataInfo_BS_base_information4_T_BATT
        DataInfo_BS_base_information4_T_BATT (DcmDspDataInfo): DcmDspDataFixedLength=true
        BS_base_information4_SOF_V1 (DcmDspData): DcmDspDataSize=8, DcmDspDataType=UINT8, DcmDspDataInfoRef=DataInfo_BS_base_information4_SOF_V1
        DataInfo_BS_base_information4_SOF_V1 (DcmDspDataInfo): DcmDspDataFixedLength=true
        BS_base_information4_SOF_V2 (DcmDspData): DcmDspDataSize=8, DcmDspDataType=UINT8, DcmDspDataInfoRef=DataInfo_BS_base_information4_SOF_V2
        DataInfo_BS_base_information4_SOF_V2 (DcmDspDataInfo): DcmDspDataFixedLength=true
        BS_base_information4_SOH (DcmDspData): DcmDspDataSize=8, DcmDspDataType=UINT8, DcmDspDataInfoRef=DataInfo_BS_base_information4_SOH
        DataInfo_BS_base_information4_SOH (DcmDspDataInfo): DcmDspDataFixedLength=true
        Write_Level1_OEM_Key_OEM_Key_Value (DcmDspData): DcmDspDataSize=128, DcmDspDataType=UINT8_N, DcmDspDataInfoRef=DataInfo_Write_Level1_OEM_Key_OEM_Key_Value
        DataInfo_Write_Level1_OEM_Key_OEM_Key_Value (DcmDspDataInfo): DcmDspDataFixedLength=true
        Write_Level1_OEM_Key_CRC (DcmDspData): DcmDspDataSize=8, DcmDspDataType=UINT8, DcmDspDataInfoRef=DataInfo_Write_Level1_OEM_Key_CRC
        DataInfo_Write_Level1_OEM_Key_CRC (DcmDspDataInfo): DcmDspDataFixedLength=true
        Read_Level1_OEM_Key_written_status_Read_Level1_OEM_Key_rewrite_counter (DcmDspData): DcmDspDataSize=8, DcmDspDataType=UINT8, DcmDspDataInfoRef=DataInfo_Read_Level1_OEM_Key_written_status_Read_Level1_OEM_Key_rewrite_counter
        DataInfo_Read_Level1_OEM_Key_written_status_Read_Level1_OEM_Key_rewrite_counter (DcmDspDataInfo): DcmDspDataFixedLength=true
        Write_Level2_OEM_Key_OEM_Key_Value (DcmDspData): DcmDspDataSize=128, DcmDspDataType=UINT8_N, DcmDspDataInfoRef=DataInfo_Write_Level2_OEM_Key_OEM_Key_Value
        DataInfo_Write_Level2_OEM_Key_OEM_Key_Value (DcmDspDataInfo): DcmDspDataFixedLength=true
        Write_Level2_OEM_Key_CRC (DcmDspData): DcmDspDataSize=8, DcmDspDataType=UINT8, DcmDspDataInfoRef=DataInfo_Write_Level2_OEM_Key_CRC
        DataInfo_Write_Level2_OEM_Key_CRC (DcmDspDataInfo): DcmDspDataFixedLength=true
        Read_Level2_OEM_Key_written_status_Read_Level2_OEM_Key_rewrite_counter (DcmDspData): DcmDspDataSize=8, DcmDspDataType=UINT8, DcmDspDataInfoRef=DataInfo_Read_Level2_OEM_Key_written_status_Read_Level2_OEM_Key_rewrite_counter
        DataInfo_Read_Level2_OEM_Key_written_status_Read_Level2_OEM_Key_rewrite_counter (DcmDspDataInfo): DcmDspDataFixedLength=true
        Write_Level3_OEM_Key_OEM_Key_Value (DcmDspData): DcmDspDataSize=128, DcmDspDataType=UINT8_N, DcmDspDataInfoRef=DataInfo_Write_Level3_OEM_Key_OEM_Key_Value
        DataInfo_Write_Level3_OEM_Key_OEM_Key_Value (DcmDspDataInfo): DcmDspDataFixedLength=true
        Write_Level3_OEM_Key_CRC (DcmDspData): DcmDspDataSize=8, DcmDspDataType=UINT8, DcmDspDataInfoRef=DataInfo_Write_Level3_OEM_Key_CRC
        DataInfo_Write_Level3_OEM_Key_CRC (DcmDspDataInfo): DcmDspDataFixedLength=true
        Read_Level3_OEM_Key_written_status_Read_Level3_OEM_Key_rewrite_counter (DcmDspData): DcmDspDataSize=8, DcmDspDataType=UINT8, DcmDspDataInfoRef=DataInfo_Read_Level3_OEM_Key_written_status_Read_Level3_OEM_Key_rewrite_counter
        DataInfo_Read_Level3_OEM_Key_written_status_Read_Level3_OEM_Key_rewrite_counter (DcmDspDataInfo): DcmDspDataFixedLength=true
        Write_Level4_OEM_Key_OEM_Key_Value (DcmDspData): DcmDspDataSize=128, DcmDspDataType=UINT8_N, DcmDspDataInfoRef=DataInfo_Write_Level4_OEM_Key_OEM_Key_Value
        DataInfo_Write_Level4_OEM_Key_OEM_Key_Value (DcmDspDataInfo): DcmDspDataFixedLength=true
        Write_Level4_OEM_Key_CRC (DcmDspData): DcmDspDataSize=8, DcmDspDataType=UINT8, DcmDspDataInfoRef=DataInfo_Write_Level4_OEM_Key_CRC
        DataInfo_Write_Level4_OEM_Key_CRC (DcmDspDataInfo): DcmDspDataFixedLength=true
        Read_Level4_OEM_Key_written_status_Read_Level4_OEM_Key_rewrite_counter (DcmDspData): DcmDspDataSize=8, DcmDspDataType=UINT8, DcmDspDataInfoRef=DataInfo_Read_Level4_OEM_Key_written_status_Read_Level4_OEM_Key_rewrite_counter
        DataInfo_Read_Level4_OEM_Key_written_status_Read_Level4_OEM_Key_rewrite_counter (DcmDspDataInfo): DcmDspDataFixedLength=true
        Read_Vehicle_Security_related_events_Software_configuration_inte_Software_configuration_integrity_check_1 (DcmDspData):
          DcmDspDataSize = 8
          DcmDspDataType = UINT8
          DcmDspDataInfoRef = DataInfo_Read_Vehicle_Security_related_events_Software_configuration_inte_Software_configuration_integrity_check_1
        DataInfo_Read_Vehicle_Security_related_events_Software_configuration_inte_Software_configuration_integrity_check_1 (DcmDspDataInfo): DcmDspDataFixedLength=true
        Read_Vehicle_Security_related_events_Software_configuration_inte_Event_occurance_time_Year_1 (DcmDspData):
          DcmDspDataSize = 8
          DcmDspDataType = UINT8
          DcmDspDataInfoRef = DataInfo_Read_Vehicle_Security_related_events_Software_configuration_inte_Event_occurance_time_Year_1
        DataInfo_Read_Vehicle_Security_related_events_Software_configuration_inte_Event_occurance_time_Year_1 (DcmDspDataInfo): DcmDspDataFixedLength=true
        Read_Vehicle_Security_related_events_Software_configuration_inte_Event_occurance_time_Month_1 (DcmDspData):
          DcmDspDataSize = 8
          DcmDspDataType = UINT8
          DcmDspDataInfoRef = DataInfo_Read_Vehicle_Security_related_events_Software_configuration_inte_Event_occurance_time_Month_1
        DataInfo_Read_Vehicle_Security_related_events_Software_configuration_inte_Event_occurance_time_Month_1 (DcmDspDataInfo): DcmDspDataFixedLength=true
        Read_Vehicle_Security_related_events_Software_configuration_inte_Event_occurance_time_Day_1 (DcmDspData):
          DcmDspDataSize = 8
          DcmDspDataType = UINT8
          DcmDspDataInfoRef = DataInfo_Read_Vehicle_Security_related_events_Software_configuration_inte_Event_occurance_time_Day_1
        DataInfo_Read_Vehicle_Security_related_events_Software_configuration_inte_Event_occurance_time_Day_1 (DcmDspDataInfo): DcmDspDataFixedLength=true
        Read_Vehicle_Security_related_events_Software_configuration_inte_Software_configuration_integrity_check_2 (DcmDspData):
          DcmDspDataSize = 8
          DcmDspDataType = UINT8
          DcmDspDataInfoRef = DataInfo_Read_Vehicle_Security_related_events_Software_configuration_inte_Software_configuration_integrity_check_2
        DataInfo_Read_Vehicle_Security_related_events_Software_configuration_inte_Software_configuration_integrity_check_2 (DcmDspDataInfo): DcmDspDataFixedLength=true
        Read_Vehicle_Security_related_events_Software_configuration_inte_Event_occurance_time_Year_2 (DcmDspData):
          DcmDspDataSize = 8
          DcmDspDataType = UINT8
          DcmDspDataInfoRef = DataInfo_Read_Vehicle_Security_related_events_Software_configuration_inte_Event_occurance_time_Year_2
        DataInfo_Read_Vehicle_Security_related_events_Software_configuration_inte_Event_occurance_time_Year_2 (DcmDspDataInfo): DcmDspDataFixedLength=true
        Read_Vehicle_Security_related_events_Software_configuration_inte_Event_occurance_time_Month_2 (DcmDspData):
          DcmDspDataSize = 8
          DcmDspDataType = UINT8
          DcmDspDataInfoRef = DataInfo_Read_Vehicle_Security_related_events_Software_configuration_inte_Event_occurance_time_Month_2
        DataInfo_Read_Vehicle_Security_related_events_Software_configuration_inte_Event_occurance_time_Month_2 (DcmDspDataInfo): DcmDspDataFixedLength=true
        Read_Vehicle_Security_related_events_Software_configuration_inte_Event_occurance_time_Day_2 (DcmDspData):
          DcmDspDataSize = 8
          DcmDspDataType = UINT8
          DcmDspDataInfoRef = DataInfo_Read_Vehicle_Security_related_events_Software_configuration_inte_Event_occurance_time_Day_2
        DataInfo_Read_Vehicle_Security_related_events_Software_configuration_inte_Event_occurance_time_Day_2 (DcmDspDataInfo): DcmDspDataFixedLength=true
        Read_Vehicle_Security_related_events_Software_configuration_inte_Software_configuration_integrity_check_3 (DcmDspData):
          DcmDspDataSize = 8
          DcmDspDataType = UINT8
          DcmDspDataInfoRef = DataInfo_Read_Vehicle_Security_related_events_Software_configuration_inte_Software_configuration_integrity_check_3
        DataInfo_Read_Vehicle_Security_related_events_Software_configuration_inte_Software_configuration_integrity_check_3 (DcmDspDataInfo): DcmDspDataFixedLength=true
        Read_Vehicle_Security_related_events_Software_configuration_inte_Event_occurance_time_Year_3 (DcmDspData):
          DcmDspDataSize = 8
          DcmDspDataType = UINT8
          DcmDspDataInfoRef = DataInfo_Read_Vehicle_Security_related_events_Software_configuration_inte_Event_occurance_time_Year_3
        DataInfo_Read_Vehicle_Security_related_events_Software_configuration_inte_Event_occurance_time_Year_3 (DcmDspDataInfo): DcmDspDataFixedLength=true
        Read_Vehicle_Security_related_events_Software_configuration_inte_Event_occurance_time_Month_3 (DcmDspData):
          DcmDspDataSize = 8
          DcmDspDataType = UINT8
          DcmDspDataInfoRef = DataInfo_Read_Vehicle_Security_related_events_Software_configuration_inte_Event_occurance_time_Month_3
        DataInfo_Read_Vehicle_Security_related_events_Software_configuration_inte_Event_occurance_time_Month_3 (DcmDspDataInfo): DcmDspDataFixedLength=true
        Read_Vehicle_Security_related_events_Software_configuration_inte_Event_occurance_time_Day_3 (DcmDspData):
          DcmDspDataSize = 8
          DcmDspDataType = UINT8
          DcmDspDataInfoRef = DataInfo_Read_Vehicle_Security_related_events_Software_configuration_inte_Event_occurance_time_Day_3
        DataInfo_Read_Vehicle_Security_related_events_Software_configuration_inte_Event_occurance_time_Day_3 (DcmDspDataInfo): DcmDspDataFixedLength=true
        Read_Vehicle_Security_related_events_Software_configuration_inte_Software_configuration_integrity_check_4 (DcmDspData):
          DcmDspDataSize = 8
          DcmDspDataType = UINT8
          DcmDspDataInfoRef = DataInfo_Read_Vehicle_Security_related_events_Software_configuration_inte_Software_configuration_integrity_check_4
        DataInfo_Read_Vehicle_Security_related_events_Software_configuration_inte_Software_configuration_integrity_check_4 (DcmDspDataInfo): DcmDspDataFixedLength=true
        Read_Vehicle_Security_related_events_Software_configuration_inte_Event_occurance_time_Year_4 (DcmDspData):
          DcmDspDataSize = 8
          DcmDspDataType = UINT8
          DcmDspDataInfoRef = DataInfo_Read_Vehicle_Security_related_events_Software_configuration_inte_Event_occurance_time_Year_4
        DataInfo_Read_Vehicle_Security_related_events_Software_configuration_inte_Event_occurance_time_Year_4 (DcmDspDataInfo): DcmDspDataFixedLength=true
        Read_Vehicle_Security_related_events_Software_configuration_inte_Event_occurance_time_Month_4 (DcmDspData):
          DcmDspDataSize = 8
          DcmDspDataType = UINT8
          DcmDspDataInfoRef = DataInfo_Read_Vehicle_Security_related_events_Software_configuration_inte_Event_occurance_time_Month_4
        DataInfo_Read_Vehicle_Security_related_events_Software_configuration_inte_Event_occurance_time_Month_4 (DcmDspDataInfo): DcmDspDataFixedLength=true
        Read_Vehicle_Security_related_events_Software_configuration_inte_Event_occurance_time_Day_4 (DcmDspData):
          DcmDspDataSize = 8
          DcmDspDataType = UINT8
          DcmDspDataInfoRef = DataInfo_Read_Vehicle_Security_related_events_Software_configuration_inte_Event_occurance_time_Day_4
        DataInfo_Read_Vehicle_Security_related_events_Software_configuration_inte_Event_occurance_time_Day_4 (DcmDspDataInfo): DcmDspDataFixedLength=true
        Read_Vehicle_Security_related_events_Software_configuration_inte_Software_configuration_integrity_check_5 (DcmDspData):
          DcmDspDataSize = 8
          DcmDspDataType = UINT8
          DcmDspDataInfoRef = DataInfo_Read_Vehicle_Security_related_events_Software_configuration_inte_Software_configuration_integrity_check_5
        DataInfo_Read_Vehicle_Security_related_events_Software_configuration_inte_Software_configuration_integrity_check_5 (DcmDspDataInfo): DcmDspDataFixedLength=true
        Read_Vehicle_Security_related_events_Software_configuration_inte_Event_occurance_time_Year_5 (DcmDspData):
          DcmDspDataSize = 8
          DcmDspDataType = UINT8
          DcmDspDataInfoRef = DataInfo_Read_Vehicle_Security_related_events_Software_configuration_inte_Event_occurance_time_Year_5
        DataInfo_Read_Vehicle_Security_related_events_Software_configuration_inte_Event_occurance_time_Year_5 (DcmDspDataInfo): DcmDspDataFixedLength=true
        Read_Vehicle_Security_related_events_Software_configuration_inte_Event_occurance_time_Month_5 (DcmDspData):
          DcmDspDataSize = 8
          DcmDspDataType = UINT8
          DcmDspDataInfoRef = DataInfo_Read_Vehicle_Security_related_events_Software_configuration_inte_Event_occurance_time_Month_5
        DataInfo_Read_Vehicle_Security_related_events_Software_configuration_inte_Event_occurance_time_Month_5 (DcmDspDataInfo): DcmDspDataFixedLength=true
        Read_Vehicle_Security_related_events_Software_configuration_inte_Event_occurance_time_Day_5 (DcmDspData):
          DcmDspDataSize = 8
          DcmDspDataType = UINT8
          DcmDspDataInfoRef = DataInfo_Read_Vehicle_Security_related_events_Software_configuration_inte_Event_occurance_time_Day_5
        DataInfo_Read_Vehicle_Security_related_events_Software_configuration_inte_Event_occurance_time_Day_5 (DcmDspDataInfo): DcmDspDataFixedLength=true
        Read_Vehicle_Security_related_events_Software_configuration_inte_Software_configuration_integrity_check_failure_Event_oc4f77644e (DcmDspData):
          DcmDspDataSize = 16
          DcmDspDataType = UINT16
          DcmDspDataInfoRef = DataInfo_Read_Vehicle_Security_related_events_Software_configuration_inte_Software_configuration_integrity_check_failurec315628
        DataInfo_Read_Vehicle_Security_related_events_Software_configuration_inte_Software_configuration_integrity_check_failurec315628 (DcmDspDataInfo): DcmDspDataFixedLength=true
        Read_Vehicle_Security_related_events_Brute_Force_UDS_0x27_servic_Brute_Force_UDS_0x27_service_1 (DcmDspData):
          DcmDspDataSize = 8
          DcmDspDataType = UINT8
          DcmDspDataInfoRef = DataInfo_Read_Vehicle_Security_related_events_Brute_Force_UDS_0x27_servic_Brute_Force_UDS_0x27_service_1
        DataInfo_Read_Vehicle_Security_related_events_Brute_Force_UDS_0x27_servic_Brute_Force_UDS_0x27_service_1 (DcmDspDataInfo): DcmDspDataFixedLength=true
        Read_Vehicle_Security_related_events_Brute_Force_UDS_0x27_servic_Event_occurance_time_Year_1 (DcmDspData):
          DcmDspDataSize = 8
          DcmDspDataType = UINT8
          DcmDspDataInfoRef = DataInfo_Read_Vehicle_Security_related_events_Brute_Force_UDS_0x27_servic_Event_occurance_time_Year_1
        DataInfo_Read_Vehicle_Security_related_events_Brute_Force_UDS_0x27_servic_Event_occurance_time_Year_1 (DcmDspDataInfo): DcmDspDataFixedLength=true
        Read_Vehicle_Security_related_events_Brute_Force_UDS_0x27_servic_Event_occurance_time_Month_1 (DcmDspData):
          DcmDspDataSize = 8
          DcmDspDataType = UINT8
          DcmDspDataInfoRef = DataInfo_Read_Vehicle_Security_related_events_Brute_Force_UDS_0x27_servic_Event_occurance_time_Month_1
        DataInfo_Read_Vehicle_Security_related_events_Brute_Force_UDS_0x27_servic_Event_occurance_time_Month_1 (DcmDspDataInfo): DcmDspDataFixedLength=true
        Read_Vehicle_Security_related_events_Brute_Force_UDS_0x27_servic_Event_occurance_time_Day_1 (DcmDspData):
          DcmDspDataSize = 8
          DcmDspDataType = UINT8
          DcmDspDataInfoRef = DataInfo_Read_Vehicle_Security_related_events_Brute_Force_UDS_0x27_servic_Event_occurance_time_Day_1
        DataInfo_Read_Vehicle_Security_related_events_Brute_Force_UDS_0x27_servic_Event_occurance_time_Day_1 (DcmDspDataInfo): DcmDspDataFixedLength=true
        Read_Vehicle_Security_related_events_Brute_Force_UDS_0x27_servic_Brute_Force_UDS_0x27_service_2 (DcmDspData):
          DcmDspDataSize = 8
          DcmDspDataType = UINT8
          DcmDspDataInfoRef = DataInfo_Read_Vehicle_Security_related_events_Brute_Force_UDS_0x27_servic_Brute_Force_UDS_0x27_service_2
        DataInfo_Read_Vehicle_Security_related_events_Brute_Force_UDS_0x27_servic_Brute_Force_UDS_0x27_service_2 (DcmDspDataInfo): DcmDspDataFixedLength=true
        Read_Vehicle_Security_related_events_Brute_Force_UDS_0x27_servic_Event_occurance_time_Year_2 (DcmDspData):
          DcmDspDataSize = 8
          DcmDspDataType = UINT8
          DcmDspDataInfoRef = DataInfo_Read_Vehicle_Security_related_events_Brute_Force_UDS_0x27_servic_Event_occurance_time_Year_2
        DataInfo_Read_Vehicle_Security_related_events_Brute_Force_UDS_0x27_servic_Event_occurance_time_Year_2 (DcmDspDataInfo): DcmDspDataFixedLength=true
        Read_Vehicle_Security_related_events_Brute_Force_UDS_0x27_servic_Event_occurance_time_Month_2 (DcmDspData):
          DcmDspDataSize = 8
          DcmDspDataType = UINT8
          DcmDspDataInfoRef = DataInfo_Read_Vehicle_Security_related_events_Brute_Force_UDS_0x27_servic_Event_occurance_time_Month_2
        DataInfo_Read_Vehicle_Security_related_events_Brute_Force_UDS_0x27_servic_Event_occurance_time_Month_2 (DcmDspDataInfo): DcmDspDataFixedLength=true
        Read_Vehicle_Security_related_events_Brute_Force_UDS_0x27_servic_Event_occurance_time_Day_2 (DcmDspData):
          DcmDspDataSize = 8
          DcmDspDataType = UINT8
          DcmDspDataInfoRef = DataInfo_Read_Vehicle_Security_related_events_Brute_Force_UDS_0x27_servic_Event_occurance_time_Day_2
        DataInfo_Read_Vehicle_Security_related_events_Brute_Force_UDS_0x27_servic_Event_occurance_time_Day_2 (DcmDspDataInfo): DcmDspDataFixedLength=true
        Read_Vehicle_Security_related_events_Brute_Force_UDS_0x27_servic_Brute_Force_UDS_0x27_service_3 (DcmDspData):
          DcmDspDataSize = 8
          DcmDspDataType = UINT8
          DcmDspDataInfoRef = DataInfo_Read_Vehicle_Security_related_events_Brute_Force_UDS_0x27_servic_Brute_Force_UDS_0x27_service_3
        DataInfo_Read_Vehicle_Security_related_events_Brute_Force_UDS_0x27_servic_Brute_Force_UDS_0x27_service_3 (DcmDspDataInfo): DcmDspDataFixedLength=true
        Read_Vehicle_Security_related_events_Brute_Force_UDS_0x27_servic_Event_occurance_time_Year_3 (DcmDspData):
          DcmDspDataSize = 8
          DcmDspDataType = UINT8
          DcmDspDataInfoRef = DataInfo_Read_Vehicle_Security_related_events_Brute_Force_UDS_0x27_servic_Event_occurance_time_Year_3
        DataInfo_Read_Vehicle_Security_related_events_Brute_Force_UDS_0x27_servic_Event_occurance_time_Year_3 (DcmDspDataInfo): DcmDspDataFixedLength=true
        Read_Vehicle_Security_related_events_Brute_Force_UDS_0x27_servic_Event_occurance_time_Month_3 (DcmDspData):
          DcmDspDataSize = 8
          DcmDspDataType = UINT8
          DcmDspDataInfoRef = DataInfo_Read_Vehicle_Security_related_events_Brute_Force_UDS_0x27_servic_Event_occurance_time_Month_3
        DataInfo_Read_Vehicle_Security_related_events_Brute_Force_UDS_0x27_servic_Event_occurance_time_Month_3 (DcmDspDataInfo): DcmDspDataFixedLength=true
        Read_Vehicle_Security_related_events_Brute_Force_UDS_0x27_servic_Event_occurance_time_Day_3 (DcmDspData):
          DcmDspDataSize = 8
          DcmDspDataType = UINT8
          DcmDspDataInfoRef = DataInfo_Read_Vehicle_Security_related_events_Brute_Force_UDS_0x27_servic_Event_occurance_time_Day_3
        DataInfo_Read_Vehicle_Security_related_events_Brute_Force_UDS_0x27_servic_Event_occurance_time_Day_3 (DcmDspDataInfo): DcmDspDataFixedLength=true
        Read_Vehicle_Security_related_events_Brute_Force_UDS_0x27_servic_Brute_Force_UDS_0x27_service_4 (DcmDspData):
          DcmDspDataSize = 8
          DcmDspDataType = UINT8
          DcmDspDataInfoRef = DataInfo_Read_Vehicle_Security_related_events_Brute_Force_UDS_0x27_servic_Brute_Force_UDS_0x27_service_4
        DataInfo_Read_Vehicle_Security_related_events_Brute_Force_UDS_0x27_servic_Brute_Force_UDS_0x27_service_4 (DcmDspDataInfo): DcmDspDataFixedLength=true
        Read_Vehicle_Security_related_events_Brute_Force_UDS_0x27_servic_Event_occurance_time_Year_4 (DcmDspData):
          DcmDspDataSize = 8
          DcmDspDataType = UINT8
          DcmDspDataInfoRef = DataInfo_Read_Vehicle_Security_related_events_Brute_Force_UDS_0x27_servic_Event_occurance_time_Year_4
        DataInfo_Read_Vehicle_Security_related_events_Brute_Force_UDS_0x27_servic_Event_occurance_time_Year_4 (DcmDspDataInfo): DcmDspDataFixedLength=true
        Read_Vehicle_Security_related_events_Brute_Force_UDS_0x27_servic_Event_occurance_time_Month_4 (DcmDspData):
          DcmDspDataSize = 8
          DcmDspDataType = UINT8
          DcmDspDataInfoRef = DataInfo_Read_Vehicle_Security_related_events_Brute_Force_UDS_0x27_servic_Event_occurance_time_Month_4
        DataInfo_Read_Vehicle_Security_related_events_Brute_Force_UDS_0x27_servic_Event_occurance_time_Month_4 (DcmDspDataInfo): DcmDspDataFixedLength=true
        Read_Vehicle_Security_related_events_Brute_Force_UDS_0x27_servic_Event_occurance_time_Day_4 (DcmDspData):
          DcmDspDataSize = 8
          DcmDspDataType = UINT8
          DcmDspDataInfoRef = DataInfo_Read_Vehicle_Security_related_events_Brute_Force_UDS_0x27_servic_Event_occurance_time_Day_4
        DataInfo_Read_Vehicle_Security_related_events_Brute_Force_UDS_0x27_servic_Event_occurance_time_Day_4 (DcmDspDataInfo): DcmDspDataFixedLength=true
        Read_Vehicle_Security_related_events_Brute_Force_UDS_0x27_servic_Brute_Force_UDS_0x27_service_5 (DcmDspData):
          DcmDspDataSize = 8
          DcmDspDataType = UINT8
          DcmDspDataInfoRef = DataInfo_Read_Vehicle_Security_related_events_Brute_Force_UDS_0x27_servic_Brute_Force_UDS_0x27_service_5
        DataInfo_Read_Vehicle_Security_related_events_Brute_Force_UDS_0x27_servic_Brute_Force_UDS_0x27_service_5 (DcmDspDataInfo): DcmDspDataFixedLength=true
        Read_Vehicle_Security_related_events_Brute_Force_UDS_0x27_servic_Event_occurance_time_Year_5 (DcmDspData):
          DcmDspDataSize = 8
          DcmDspDataType = UINT8
          DcmDspDataInfoRef = DataInfo_Read_Vehicle_Security_related_events_Brute_Force_UDS_0x27_servic_Event_occurance_time_Year_5
        DataInfo_Read_Vehicle_Security_related_events_Brute_Force_UDS_0x27_servic_Event_occurance_time_Year_5 (DcmDspDataInfo): DcmDspDataFixedLength=true
        Read_Vehicle_Security_related_events_Brute_Force_UDS_0x27_servic_Event_occurance_time_Month_5 (DcmDspData):
          DcmDspDataSize = 8
          DcmDspDataType = UINT8
          DcmDspDataInfoRef = DataInfo_Read_Vehicle_Security_related_events_Brute_Force_UDS_0x27_servic_Event_occurance_time_Month_5
        DataInfo_Read_Vehicle_Security_related_events_Brute_Force_UDS_0x27_servic_Event_occurance_time_Month_5 (DcmDspDataInfo): DcmDspDataFixedLength=true
        Read_Vehicle_Security_related_events_Brute_Force_UDS_0x27_servic_Event_occurance_time_Day_5 (DcmDspData):
          DcmDspDataSize = 8
          DcmDspDataType = UINT8
          DcmDspDataInfoRef = DataInfo_Read_Vehicle_Security_related_events_Brute_Force_UDS_0x27_servic_Event_occurance_time_Day_5
        DataInfo_Read_Vehicle_Security_related_events_Brute_Force_UDS_0x27_servic_Event_occurance_time_Day_5 (DcmDspDataInfo): DcmDspDataFixedLength=true
        Read_Vehicle_Security_related_events_Brute_Force_UDS_0x27_servic_Brute_Force_UDS_0x27_service_Event_occurrence_counter (DcmDspData):
          DcmDspDataSize = 16
          DcmDspDataType = UINT16
          DcmDspDataInfoRef = DataInfo_Read_Vehicle_Security_related_events_Brute_Force_UDS_0x27_servic_Brute_Force_UDS_0x27_service_Event_occurrence_counter
        DataInfo_Read_Vehicle_Security_related_events_Brute_Force_UDS_0x27_servic_Brute_Force_UDS_0x27_service_Event_occurrence_counter (DcmDspDataInfo): DcmDspDataFixedLength=true
        Bootloader_version_number_Major_release (DcmDspData): DcmDspDataSize=8, DcmDspDataType=UINT8, DcmDspDataInfoRef=DataInfo_Bootloader_version_number_Major_release
        DataInfo_Bootloader_version_number_Major_release (DcmDspDataInfo): DcmDspDataFixedLength=true
        Bootloader_version_number_Minor_release (DcmDspData): DcmDspDataSize=8, DcmDspDataType=UINT8, DcmDspDataInfoRef=DataInfo_Bootloader_version_number_Minor_release
        DataInfo_Bootloader_version_number_Minor_release (DcmDspDataInfo): DcmDspDataFixedLength=true
        Bootloader_version_number_No_functional_content_change (DcmDspData): DcmDspDataSize=8, DcmDspDataType=UINT8, DcmDspDataInfoRef=DataInfo_Bootloader_version_number_No_functional_content_change
        DataInfo_Bootloader_version_number_No_functional_content_change (DcmDspDataInfo): DcmDspDataFixedLength=true
        EcuIdentification_Specific_Vehicle_Code_WMI (DcmDspData): DcmDspDataSize=48, DcmDspDataType=UINT8_N, DcmDspDataInfoRef=DataInfo_EcuIdentification_Specific_Vehicle_Code_WMI
        DataInfo_EcuIdentification_Specific_Vehicle_Code_WMI (DcmDspDataInfo): DcmDspDataFixedLength=true
        EcuIdentification_Group (DcmDspData): DcmDspDataSize=16, DcmDspDataType=UINT8_N, DcmDspDataInfoRef=DataInfo_EcuIdentification_Group
        DataInfo_EcuIdentification_Group (DcmDspDataInfo): DcmDspDataFixedLength=true
        EcuIdentification_Subgroup (DcmDspData): DcmDspDataSize=16, DcmDspDataType=UINT8_N, DcmDspDataInfoRef=DataInfo_EcuIdentification_Subgroup
        DataInfo_EcuIdentification_Subgroup (DcmDspDataInfo): DcmDspDataFixedLength=true
        EcuIdentification_Detail_Code (DcmDspData): DcmDspDataSize=24, DcmDspDataType=UINT8_N, DcmDspDataInfoRef=DataInfo_EcuIdentification_Detail_Code
        DataInfo_EcuIdentification_Detail_Code (DcmDspDataInfo): DcmDspDataFixedLength=true
        EcuIdentification_Execution_Package (DcmDspData): DcmDspDataSize=16, DcmDspDataType=UINT8_N, DcmDspDataInfoRef=DataInfo_EcuIdentification_Execution_Package
        DataInfo_EcuIdentification_Execution_Package (DcmDspDataInfo): DcmDspDataFixedLength=true
        ECU_application_software_ASW_version_number_Major_release (DcmDspData): DcmDspDataSize=8, DcmDspDataType=UINT8, DcmDspDataInfoRef=DataInfo_ECU_application_software_ASW_version_number_Major_release
        DataInfo_ECU_application_software_ASW_version_number_Major_release (DcmDspDataInfo): DcmDspDataFixedLength=true
        ECU_application_software_ASW_version_number_Minor_release (DcmDspData): DcmDspDataSize=8, DcmDspDataType=UINT8, DcmDspDataInfoRef=DataInfo_ECU_application_software_ASW_version_number_Minor_release
        DataInfo_ECU_application_software_ASW_version_number_Minor_release (DcmDspDataInfo): DcmDspDataFixedLength=true
        ECU_application_software_ASW_version_number_No_functional_content_change (DcmDspData): DcmDspDataSize=8, DcmDspDataType=UINT8, DcmDspDataInfoRef=DataInfo_ECU_application_software_ASW_version_number_No_functional_content_change
        DataInfo_ECU_application_software_ASW_version_number_No_functional_content_change (DcmDspDataInfo): DcmDspDataFixedLength=true
        Read_Write_coding_data_string_CDS_Version_Byte_0 (DcmDspData): DcmDspDataSize=8, DcmDspDataType=UINT8, DcmDspDataInfoRef=DataInfo_Read_Write_coding_data_string_CDS_Version_Byte_0
        DataInfo_Read_Write_coding_data_string_CDS_Version_Byte_0 (DcmDspDataInfo): DcmDspDataFixedLength=true
        Read_Write_coding_data_string_CDS_Version_Byte_1 (DcmDspData): DcmDspDataSize=8, DcmDspDataType=UINT8, DcmDspDataInfoRef=DataInfo_Read_Write_coding_data_string_CDS_Version_Byte_1
        DataInfo_Read_Write_coding_data_string_CDS_Version_Byte_1 (DcmDspDataInfo): DcmDspDataFixedLength=true
        Read_Write_coding_data_string_CDS_CDS_Short_VIN_High_Byte_0 (DcmDspData): DcmDspDataSize=8, DcmDspDataType=UINT8_N, DcmDspDataInfoRef=DataInfo_Read_Write_coding_data_string_CDS_CDS_Short_VIN_High_Byte_0
        DataInfo_Read_Write_coding_data_string_CDS_CDS_Short_VIN_High_Byte_0 (DcmDspDataInfo): DcmDspDataFixedLength=true
        Read_Write_coding_data_string_CDS_CDS_Short_VIN_High_Byte_1 (DcmDspData): DcmDspDataSize=8, DcmDspDataType=UINT8_N, DcmDspDataInfoRef=DataInfo_Read_Write_coding_data_string_CDS_CDS_Short_VIN_High_Byte_1
        DataInfo_Read_Write_coding_data_string_CDS_CDS_Short_VIN_High_Byte_1 (DcmDspDataInfo): DcmDspDataFixedLength=true
        Read_Write_coding_data_string_CDS_CDS_Short_VIN_High_Byte_2 (DcmDspData): DcmDspDataSize=8, DcmDspDataType=UINT8_N, DcmDspDataInfoRef=DataInfo_Read_Write_coding_data_string_CDS_CDS_Short_VIN_High_Byte_2
        DataInfo_Read_Write_coding_data_string_CDS_CDS_Short_VIN_High_Byte_2 (DcmDspDataInfo): DcmDspDataFixedLength=true
        Read_Write_coding_data_string_CDS_CDS_Short_VIN_High_Byte_3 (DcmDspData): DcmDspDataSize=8, DcmDspDataType=UINT8_N, DcmDspDataInfoRef=DataInfo_Read_Write_coding_data_string_CDS_CDS_Short_VIN_High_Byte_3
        DataInfo_Read_Write_coding_data_string_CDS_CDS_Short_VIN_High_Byte_3 (DcmDspDataInfo): DcmDspDataFixedLength=true
        Read_Write_coding_data_string_CDS_CDS_Short_VIN_High_Byte_4 (DcmDspData): DcmDspDataSize=8, DcmDspDataType=UINT8_N, DcmDspDataInfoRef=DataInfo_Read_Write_coding_data_string_CDS_CDS_Short_VIN_High_Byte_4
        DataInfo_Read_Write_coding_data_string_CDS_CDS_Short_VIN_High_Byte_4 (DcmDspDataInfo): DcmDspDataFixedLength=true
        Read_Write_coding_data_string_CDS_CDS_Short_VIN_High_Byte_5 (DcmDspData): DcmDspDataSize=8, DcmDspDataType=UINT8_N, DcmDspDataInfoRef=DataInfo_Read_Write_coding_data_string_CDS_CDS_Short_VIN_High_Byte_5
        DataInfo_Read_Write_coding_data_string_CDS_CDS_Short_VIN_High_Byte_5 (DcmDspDataInfo): DcmDspDataFixedLength=true
        Read_Write_coding_data_string_CDS_CDS_Short_VIN_High_Byte_7 (DcmDspData): DcmDspDataSize=8, DcmDspDataType=UINT8_N, DcmDspDataInfoRef=DataInfo_Read_Write_coding_data_string_CDS_CDS_Short_VIN_High_Byte_7
        DataInfo_Read_Write_coding_data_string_CDS_CDS_Short_VIN_High_Byte_7 (DcmDspDataInfo): DcmDspDataFixedLength=true
        Read_Write_coding_data_string_CDS_CDS_Format_Byte_High_Byte_0 (DcmDspData): DcmDspDataSize=8, DcmDspDataType=UINT8, DcmDspDataInfoRef=DataInfo_Read_Write_coding_data_string_CDS_CDS_Format_Byte_High_Byte_0
        DataInfo_Read_Write_coding_data_string_CDS_CDS_Format_Byte_High_Byte_0 (DcmDspDataInfo): DcmDspDataFixedLength=true
        Read_Write_coding_data_string_CDS_CDS_Format_Byte_High_Byte_1 (DcmDspData): DcmDspDataSize=8, DcmDspDataType=UINT8, DcmDspDataInfoRef=DataInfo_Read_Write_coding_data_string_CDS_CDS_Format_Byte_High_Byte_1
        DataInfo_Read_Write_coding_data_string_CDS_CDS_Format_Byte_High_Byte_1 (DcmDspDataInfo): DcmDspDataFixedLength=true
        Read_Write_coding_data_string_CDS_Configuration (DcmDspData): DcmDspDataSize=8, DcmDspDataType=UINT8, DcmDspDataInfoRef=DataInfo_Read_Write_coding_data_string_CDS_Configuration
        DataInfo_Read_Write_coding_data_string_CDS_Configuration (DcmDspDataInfo): DcmDspDataFixedLength=true
        Read_Write_coding_data_string_CDS_Reserved1 (DcmDspData): DcmDspDataSize=8, DcmDspDataType=UINT8, DcmDspDataInfoRef=DataInfo_Read_Write_coding_data_string_CDS_Reserved1
        DataInfo_Read_Write_coding_data_string_CDS_Reserved1 (DcmDspDataInfo): DcmDspDataFixedLength=true
        Read_Write_coding_data_string_CDS_Reserved2 (DcmDspData): DcmDspDataSize=8, DcmDspDataType=UINT8, DcmDspDataInfoRef=DataInfo_Read_Write_coding_data_string_CDS_Reserved2
        DataInfo_Read_Write_coding_data_string_CDS_Reserved2 (DcmDspDataInfo): DcmDspDataFixedLength=true
        Read_Write_coding_data_string_CDS_Reserved3 (DcmDspData): DcmDspDataSize=8, DcmDspDataType=UINT8, DcmDspDataInfoRef=DataInfo_Read_Write_coding_data_string_CDS_Reserved3
        DataInfo_Read_Write_coding_data_string_CDS_Reserved3 (DcmDspDataInfo): DcmDspDataFixedLength=true
        Read_Write_coding_data_string_CDS_CDS_CRC (DcmDspData): DcmDspDataSize=8, DcmDspDataType=UINT8, DcmDspDataInfoRef=DataInfo_Read_Write_coding_data_string_CDS_CDS_CRC
        DataInfo_Read_Write_coding_data_string_CDS_CDS_CRC (DcmDspDataInfo): DcmDspDataFixedLength=true
        Coding_for_CDS_fingerprint_codingDate_byte_1_YY (DcmDspData): DcmDspDataSize=8, DcmDspDataType=UINT8, DcmDspDataInfoRef=DataInfo_Coding_for_CDS_fingerprint_codingDate_byte_1_YY
        DataInfo_Coding_for_CDS_fingerprint_codingDate_byte_1_YY (DcmDspDataInfo): DcmDspDataFixedLength=true
        Coding_for_CDS_fingerprint_codingDate_byte_2_MM (DcmDspData): DcmDspDataSize=8, DcmDspDataType=UINT8, DcmDspDataInfoRef=DataInfo_Coding_for_CDS_fingerprint_codingDate_byte_2_MM
        DataInfo_Coding_for_CDS_fingerprint_codingDate_byte_2_MM (DcmDspDataInfo): DcmDspDataFixedLength=true
        Coding_for_CDS_fingerprint_codingDate_byte_3_DD (DcmDspData): DcmDspDataSize=8, DcmDspDataType=UINT8, DcmDspDataInfoRef=DataInfo_Coding_for_CDS_fingerprint_codingDate_byte_3_DD
        DataInfo_Coding_for_CDS_fingerprint_codingDate_byte_3_DD (DcmDspDataInfo): DcmDspDataFixedLength=true
        Coding_for_CDS_fingerprint_repairShopCodeorTesterSerialNumber_byte_1_27_MSB (DcmDspData):
          DcmDspDataSize = 216
          DcmDspDataType = UINT8_N
          DcmDspDataInfoRef = DataInfo_Coding_for_CDS_fingerprint_repairShopCodeorTesterSerialNumber_byte_1_27_MSB
        DataInfo_Coding_for_CDS_fingerprint_repairShopCodeorTesterSerialNumber_byte_1_27_MSB (DcmDspDataInfo): DcmDspDataFixedLength=true
        Last_service_date_Year (DcmDspData): DcmDspDataSize=8, DcmDspDataType=UINT8, DcmDspDataInfoRef=DataInfo_Last_service_date_Year
        DataInfo_Last_service_date_Year (DcmDspDataInfo): DcmDspDataFixedLength=true
        Last_service_date_Month (DcmDspData): DcmDspDataSize=8, DcmDspDataType=UINT8, DcmDspDataInfoRef=DataInfo_Last_service_date_Month
        DataInfo_Last_service_date_Month (DcmDspDataInfo): DcmDspDataFixedLength=true
        Last_service_date_Day (DcmDspData): DcmDspDataSize=8, DcmDspDataType=UINT8, DcmDspDataInfoRef=DataInfo_Last_service_date_Day
        DataInfo_Last_service_date_Day (DcmDspDataInfo): DcmDspDataFixedLength=true
        Read_active_diagnostic_session_Active_diagnostic_session (DcmDspData): DcmDspDataSize=8, DcmDspDataType=UINT8, DcmDspDataInfoRef=DataInfo_Read_active_diagnostic_session_Active_diagnostic_session
        DataInfo_Read_active_diagnostic_session_Active_diagnostic_session (DcmDspDataInfo): DcmDspDataFixedLength=true
        Read_ECU_Part_Number_Specific_Vehicle_Code_WMI (DcmDspData): DcmDspDataSize=48, DcmDspDataType=UINT8_N, DcmDspDataInfoRef=DataInfo_Read_ECU_Part_Number_Specific_Vehicle_Code_WMI
        DataInfo_Read_ECU_Part_Number_Specific_Vehicle_Code_WMI (DcmDspDataInfo): DcmDspDataFixedLength=true
        Read_ECU_Part_Number_Group (DcmDspData): DcmDspDataSize=16, DcmDspDataType=UINT8_N, DcmDspDataInfoRef=DataInfo_Read_ECU_Part_Number_Group
        DataInfo_Read_ECU_Part_Number_Group (DcmDspDataInfo): DcmDspDataFixedLength=true
        Read_ECU_Part_Number_Subgroup (DcmDspData): DcmDspDataSize=16, DcmDspDataType=UINT8_N, DcmDspDataInfoRef=DataInfo_Read_ECU_Part_Number_Subgroup
        DataInfo_Read_ECU_Part_Number_Subgroup (DcmDspDataInfo): DcmDspDataFixedLength=true
        Read_ECU_Part_Number_Detail_Code (DcmDspData): DcmDspDataSize=24, DcmDspDataType=UINT8_N, DcmDspDataInfoRef=DataInfo_Read_ECU_Part_Number_Detail_Code
        DataInfo_Read_ECU_Part_Number_Detail_Code (DcmDspDataInfo): DcmDspDataFixedLength=true
        Read_ECU_Part_Number_Execution_Package (DcmDspData): DcmDspDataSize=16, DcmDspDataType=UINT8_N, DcmDspDataInfoRef=DataInfo_Read_ECU_Part_Number_Execution_Package
        DataInfo_Read_ECU_Part_Number_Execution_Package (DcmDspDataInfo): DcmDspDataFixedLength=true
        DevelopmentData_Country_code (DcmDspData): DcmDspDataSize=16, DcmDspDataType=UINT8_N, DcmDspDataInfoRef=DataInfo_DevelopmentData_Country_code
        DataInfo_DevelopmentData_Country_code (DcmDspDataInfo): DcmDspDataFixedLength=true
        DevelopmentData_Supplier_family_code (DcmDspData): DcmDspDataSize=24, DcmDspDataType=UINT8_N, DcmDspDataInfoRef=DataInfo_DevelopmentData_Supplier_family_code
        DataInfo_DevelopmentData_Supplier_family_code (DcmDspDataInfo): DcmDspDataFixedLength=true
        DevelopmentData_Supplier_code (DcmDspData): DcmDspDataSize=8, DcmDspDataType=UINT8_N, DcmDspDataInfoRef=DataInfo_DevelopmentData_Supplier_code
        DataInfo_DevelopmentData_Supplier_code (DcmDspDataInfo): DcmDspDataFixedLength=true
        Read_ECU_manufacturing_date_ECU_Manufacturing_Date_Year (DcmDspData): DcmDspDataSize=8, DcmDspDataType=UINT8, DcmDspDataInfoRef=DataInfo_Read_ECU_manufacturing_date_ECU_Manufacturing_Date_Year
        DataInfo_Read_ECU_manufacturing_date_ECU_Manufacturing_Date_Year (DcmDspDataInfo): DcmDspDataFixedLength=true
        Read_ECU_manufacturing_date_ECU_Manufacturing_Date_Month (DcmDspData): DcmDspDataSize=8, DcmDspDataType=UINT8, DcmDspDataInfoRef=DataInfo_Read_ECU_manufacturing_date_ECU_Manufacturing_Date_Month
        DataInfo_Read_ECU_manufacturing_date_ECU_Manufacturing_Date_Month (DcmDspDataInfo): DcmDspDataFixedLength=true
        Read_ECU_manufacturing_date_ECU_Manufacturing_Date_Day (DcmDspData): DcmDspDataSize=8, DcmDspDataType=UINT8, DcmDspDataInfoRef=DataInfo_Read_ECU_manufacturing_date_ECU_Manufacturing_Date_Day
        DataInfo_Read_ECU_manufacturing_date_ECU_Manufacturing_Date_Day (DcmDspDataInfo): DcmDspDataFixedLength=true
        SerialNumber_ECU_Name (DcmDspData): DcmDspDataSize=24, DcmDspDataType=UINT8_N, DcmDspDataInfoRef=DataInfo_SerialNumber_ECU_Name
        DataInfo_SerialNumber_ECU_Name (DcmDspDataInfo): DcmDspDataFixedLength=true
        SerialNumber_Supplier_name (DcmDspData): DcmDspDataSize=40, DcmDspDataType=UINT8_N, DcmDspDataInfoRef=DataInfo_SerialNumber_Supplier_name
        DataInfo_SerialNumber_Supplier_name (DcmDspDataInfo): DcmDspDataFixedLength=true
        SerialNumber_ECU_production_date_in_DD_MM_YY_format (DcmDspData): DcmDspDataSize=48, DcmDspDataType=UINT8_N, DcmDspDataInfoRef=DataInfo_SerialNumber_ECU_production_date_in_DD_MM_YY_format
        DataInfo_SerialNumber_ECU_production_date_in_DD_MM_YY_format (DcmDspDataInfo): DcmDspDataFixedLength=true
        SerialNumber_ECU_index_number (DcmDspData): DcmDspDataSize=48, DcmDspDataType=UINT8_N, DcmDspDataInfoRef=DataInfo_SerialNumber_ECU_index_number
        DataInfo_SerialNumber_ECU_index_number (DcmDspDataInfo): DcmDspDataFixedLength=true
        Read_Write_complete_VIN_World_Manufacturers_Identification (DcmDspData): DcmDspDataSize=24, DcmDspDataType=UINT8_N, DcmDspDataInfoRef=DataInfo_Read_Write_complete_VIN_World_Manufacturers_Identification
        DataInfo_Read_Write_complete_VIN_World_Manufacturers_Identification (DcmDspDataInfo): DcmDspDataFixedLength=true
        Read_Write_complete_VIN_Vehicle_Description_Section (DcmDspData): DcmDspDataSize=40, DcmDspDataType=UINT8_N, DcmDspDataInfoRef=DataInfo_Read_Write_complete_VIN_Vehicle_Description_Section
        DataInfo_Read_Write_complete_VIN_Vehicle_Description_Section (DcmDspDataInfo): DcmDspDataFixedLength=true
        Read_Write_complete_VIN_Vehicle_Identification_Section (DcmDspData): DcmDspDataSize=72, DcmDspDataType=UINT8_N, DcmDspDataInfoRef=DataInfo_Read_Write_complete_VIN_Vehicle_Identification_Section
        DataInfo_Read_Write_complete_VIN_Vehicle_Identification_Section (DcmDspDataInfo): DcmDspDataFixedLength=true
        Supplier_ECU_hardware_part_number_Major_release (DcmDspData): DcmDspDataSize=8, DcmDspDataType=UINT8, DcmDspDataInfoRef=DataInfo_Supplier_ECU_hardware_part_number_Major_release
        DataInfo_Supplier_ECU_hardware_part_number_Major_release (DcmDspDataInfo): DcmDspDataFixedLength=true
        Supplier_ECU_hardware_part_number_Changes_in_electronic_components_level (DcmDspData): DcmDspDataSize=8, DcmDspDataType=UINT8, DcmDspDataInfoRef=DataInfo_Supplier_ECU_hardware_part_number_Changes_in_electronic_components_level
        DataInfo_Supplier_ECU_hardware_part_number_Changes_in_electronic_components_level (DcmDspDataInfo): DcmDspDataFixedLength=true
        Vehicle_State_Ignition_Switch_Signal (DcmDspData): DcmDspDataSize=8, DcmDspDataType=UINT8, DcmDspDataInfoRef=DataInfo_Vehicle_State_Ignition_Switch_Signal
        DataInfo_Vehicle_State_Ignition_Switch_Signal (DcmDspDataInfo): DcmDspDataFixedLength=true
        Battery_Voltage_Battery_Voltage (DcmDspData): DcmDspDataSize=16, DcmDspDataType=UINT16, DcmDspDataInfoRef=DataInfo_Battery_Voltage_Battery_Voltage
        DataInfo_Battery_Voltage_Battery_Voltage (DcmDspDataInfo): DcmDspDataFixedLength=true
        Total_Odometer_Total_Odometer (DcmDspData): DcmDspDataSize=24, DcmDspDataType=UINT8_N, DcmDspDataInfoRef=DataInfo_Total_Odometer_Total_Odometer
        DataInfo_Total_Odometer_Total_Odometer (DcmDspDataInfo): DcmDspDataFixedLength=true
        Vehicle_speed_Vehicle_speed (DcmDspData): DcmDspDataSize=16, DcmDspDataType=UINT16, DcmDspDataInfoRef=DataInfo_Vehicle_speed_Vehicle_speed
        DataInfo_Vehicle_speed_Vehicle_speed (DcmDspDataInfo): DcmDspDataFixedLength=true
        Date_And_Time_Date_And_Time_Second (DcmDspData): DcmDspDataSize=8, DcmDspDataType=UINT8, DcmDspDataInfoRef=DataInfo_Date_And_Time_Date_And_Time_Second
        DataInfo_Date_And_Time_Date_And_Time_Second (DcmDspDataInfo): DcmDspDataFixedLength=true
        Date_And_Time_Date_And_Time_Minute (DcmDspData): DcmDspDataSize=8, DcmDspDataType=UINT8, DcmDspDataInfoRef=DataInfo_Date_And_Time_Date_And_Time_Minute
        DataInfo_Date_And_Time_Date_And_Time_Minute (DcmDspDataInfo): DcmDspDataFixedLength=true
        Date_And_Time_Date_And_Time_Hour (DcmDspData): DcmDspDataSize=8, DcmDspDataType=UINT8, DcmDspDataInfoRef=DataInfo_Date_And_Time_Date_And_Time_Hour
        DataInfo_Date_And_Time_Date_And_Time_Hour (DcmDspDataInfo): DcmDspDataFixedLength=true
        Date_And_Time_Date_And_Time_Day (DcmDspData): DcmDspDataSize=8, DcmDspDataType=UINT8, DcmDspDataInfoRef=DataInfo_Date_And_Time_Date_And_Time_Day
        DataInfo_Date_And_Time_Date_And_Time_Day (DcmDspDataInfo): DcmDspDataFixedLength=true
        Date_And_Time_Date_And_Time_Month (DcmDspData): DcmDspDataSize=8, DcmDspDataType=UINT8, DcmDspDataInfoRef=DataInfo_Date_And_Time_Date_And_Time_Month
        DataInfo_Date_And_Time_Date_And_Time_Month (DcmDspDataInfo): DcmDspDataFixedLength=true
        Date_And_Time_Date_And_Time_Year (DcmDspData): DcmDspDataSize=8, DcmDspDataType=UINT8, DcmDspDataInfoRef=DataInfo_Date_And_Time_Date_And_Time_Year
        DataInfo_Date_And_Time_Date_And_Time_Year (DcmDspDataInfo): DcmDspDataFixedLength=true
        VCU_HVStatus_VCU_HVStatus (DcmDspData): DcmDspDataSize=8, DcmDspDataType=UINT8, DcmDspDataInfoRef=DataInfo_VCU_HVStatus_VCU_HVStatus
        DataInfo_VCU_HVStatus_VCU_HVStatus (DcmDspDataInfo): DcmDspDataFixedLength=true
        SOC_SOC (DcmDspData): DcmDspDataSize=16, DcmDspDataType=UINT16, DcmDspDataInfoRef=DataInfo_SOC_SOC
        DataInfo_SOC_SOC (DcmDspDataInfo): DcmDspDataFixedLength=true
        Gear_Gear (DcmDspData): DcmDspDataSize=8, DcmDspDataType=UINT8, DcmDspDataInfoRef=DataInfo_Gear_Gear
        DataInfo_Gear_Gear (DcmDspDataInfo): DcmDspDataFixedLength=true
        50 x DcmDspDid:
          HV_Status_and_Charging_Status: DcmDspDidIdentifier=364, DcmDspDidInfoRef=DidInfo_HV_Status_and_Charging_Status
            HV_status_and_charging_status (DcmDspDidSignal): DcmDspDidDataPos=0, DcmDspDidDataRef=HV_Status_and_Charging_Status_HV_status_and_charging_status
          VCU_AccPealparameter: DcmDspDidIdentifier=7425, DcmDspDidInfoRef=DidInfo_VCU_AccPealparameter
            4 x DcmDspDidSignal:
              VCU_VehicleSpeed: DcmDspDidDataPos=0, DcmDspDidDataRef=VCU_AccPealparameter_VCU_VehicleSpeed
              Accelerator_pedal_sensor_1_voltage: DcmDspDidDataPos=16, DcmDspDidDataRef=VCU_AccPealparameter_Accelerator_pedal_sensor_1_voltage
              Accelerator_pedal_sensor_2_voltage: DcmDspDidDataPos=32, DcmDspDidDataRef=VCU_AccPealparameter_Accelerator_pedal_sensor_2_voltage
              VCU_AccelerationPedal: DcmDspDidDataPos=48, DcmDspDidDataRef=VCU_AccPealparameter_VCU_AccelerationPedal
          VCU_Torque_parameter: DcmDspDidIdentifier=7426, DcmDspDidInfoRef=DidInfo_VCU_Torque_parameter
            4 x DcmDspDidSignal:
              VCU_MCUDesiredTorque: DcmDspDidDataPos=0, DcmDspDidDataRef=VCU_Torque_parameter_VCU_MCUDesiredTorque
              Torque_MinAllowed: DcmDspDidDataPos=16, DcmDspDidDataRef=VCU_Torque_parameter_Torque_MinAllowed
              Torque_MaxAllowed: DcmDspDidDataPos=32, DcmDspDidDataRef=VCU_Torque_parameter_Torque_MaxAllowed
              VCU_RegenTorqueCap: DcmDspDidDataPos=48, DcmDspDidDataRef=VCU_Torque_parameter_VCU_RegenTorqueCap
          Driver_Mode: DcmDspDidIdentifier=7427, DcmDspDidInfoRef=DidInfo_Driver_Mode
            Driver_Mode (DcmDspDidSignal): DcmDspDidDataPos=0, DcmDspDidDataRef=Driver_Mode_Driver_Mode
          VCU_PowerMaxAllowed_parameter1: DcmDspDidIdentifier=7428, DcmDspDidInfoRef=DidInfo_VCU_PowerMaxAllowed_parameter1
            4 x DcmDspDidSignal:
              VCU_TCUPowerAllowed: DcmDspDidDataPos=0, DcmDspDidDataRef=VCU_PowerMaxAllowed_parameter1_VCU_TCUPowerAllowed
              VCU_DCDCPowerLimit: DcmDspDidDataPos=16, DcmDspDidDataRef=VCU_PowerMaxAllowed_parameter1_VCU_DCDCPowerLimit
              MCUPowerLimit: DcmDspDidDataPos=24, DcmDspDidDataRef=VCU_PowerMaxAllowed_parameter1_MCUPowerLimit
              VCU_DisChgPowerLimit: DcmDspDidDataPos=40, DcmDspDidDataRef=VCU_PowerMaxAllowed_parameter1_VCU_DisChgPowerLimit
          AC_charging_parameter: DcmDspDidIdentifier=7429, DcmDspDidInfoRef=DidInfo_AC_charging_parameter
            4 x DcmDspDidSignal:
              POD_OBC_InputACVoltage: DcmDspDidDataPos=0, DcmDspDidDataRef=AC_charging_parameter_POD_OBC_InputACVoltage
              VCU_OBC_ChargeCurrentCommand: DcmDspDidDataPos=16, DcmDspDidDataRef=AC_charging_parameter_VCU_OBC_ChargeCurrentCommand
              POD_OBC_OutputDCChargeCurrent: DcmDspDidDataPos=32, DcmDspDidDataRef=AC_charging_parameter_POD_OBC_OutputDCChargeCurrent
              POD_OBC_OutputDCChargeVoltage: DcmDspDidDataPos=48, DcmDspDidDataRef=AC_charging_parameter_POD_OBC_OutputDCChargeVoltage
          Chargestatus: DcmDspDidIdentifier=7430, DcmDspDidInfoRef=DidInfo_Chargestatus
            Chargestatus (DcmDspDidSignal): DcmDspDidDataPos=0, DcmDspDidDataRef=Chargestatus_Chargestatus
          Electronic_lock_state: DcmDspDidIdentifier=7431, DcmDspDidInfoRef=DidInfo_Electronic_lock_state
            Electronic_lock_state (DcmDspDidSignal): DcmDspDidDataPos=0, DcmDspDidDataRef=Electronic_lock_state_Electronic_lock_state
          VCU_HV_InterLock_PWM_pfrequency: DcmDspDidIdentifier=7432, DcmDspDidInfoRef=DidInfo_VCU_HV_InterLock_PWM_pfrequency
            VCU_HVIL (DcmDspDidSignal): DcmDspDidDataPos=0, DcmDspDidDataRef=VCU_HV_InterLock_PWM_pfrequency_VCU_HVIL
          VCU_control_S2_status: DcmDspDidIdentifier=7433, DcmDspDidInfoRef=DidInfo_VCU_control_S2_status
            New_Bit_Field (DcmDspDidSignal): DcmDspDidDataPos=0, DcmDspDidDataRef=VCU_control_S2_status_New_Bit_Field
          VCU_PowerMaxAllowed_parameter2: DcmDspDidIdentifier=7440, DcmDspDidInfoRef=DidInfo_VCU_PowerMaxAllowed_parameter2
            3 x DcmDspDidSignal:
              BMSDisChgPowerLimit: DcmDspDidDataPos=0, DcmDspDidDataRef=VCU_PowerMaxAllowed_parameter2_BMSDisChgPowerLimit
              MCUFeedbackPowerLimit: DcmDspDidDataPos=16, DcmDspDidDataRef=VCU_PowerMaxAllowed_parameter2_MCUFeedbackPowerLimit
              BMSChgPowerLimit: DcmDspDidDataPos=32, DcmDspDidDataRef=VCU_PowerMaxAllowed_parameter2_BMSChgPowerLimit
          VCU_control_main_relay: DcmDspDidIdentifier=7441, DcmDspDidInfoRef=DidInfo_VCU_control_main_relay
            Mainrealy1 (DcmDspDidSignal): DcmDspDidDataPos=0, DcmDspDidDataRef=VCU_control_main_relay_Mainrealy1
            Mainrelay2 (DcmDspDidSignal): DcmDspDidDataPos=8, DcmDspDidDataRef=VCU_control_main_relay_Mainrelay2
          PWT_vehicle_fault: DcmDspDidIdentifier=7442, DcmDspDidInfoRef=DidInfo_PWT_vehicle_fault
            3 x DcmDspDidSignal:
              PWT_ErrorLevel1: DcmDspDidDataPos=0, DcmDspDidDataRef=PWT_vehicle_fault_PWT_ErrorLevel1
              PWT_ErrorLevel2: DcmDspDidDataPos=8, DcmDspDidDataRef=PWT_vehicle_fault_PWT_ErrorLevel2
              PWT_ErrorLevel3: DcmDspDidDataPos=16, DcmDspDidDataRef=PWT_vehicle_fault_PWT_ErrorLevel3
          DC_Charging_port_Temperature: DcmDspDidIdentifier=7443, DcmDspDidInfoRef=DidInfo_DC_Charging_port_Temperature
            POD_DCInletTempA (DcmDspDidSignal): DcmDspDidDataPos=0, DcmDspDidDataRef=DC_Charging_port_Temperature_POD_DCInletTempA
            POD_DCInletTempB (DcmDspDidSignal): DcmDspDidDataPos=8, DcmDspDidDataRef=DC_Charging_port_Temperature_POD_DCInletTempB
          HV_part_work_mode: DcmDspDidIdentifier=7444, DcmDspDidInfoRef=DidInfo_HV_part_work_mode
            HV_part_work_mode1 (DcmDspDidSignal): DcmDspDidDataPos=0, DcmDspDidDataRef=HV_part_work_mode_HV_part_work_mode1
            HV_part_work_mode2 (DcmDspDidSignal): DcmDspDidDataPos=8, DcmDspDidDataRef=HV_part_work_mode_HV_part_work_mode2
          VCU_PowerMaxAllowed_parameter3: DcmDspDidIdentifier=7445, DcmDspDidInfoRef=DidInfo_VCU_PowerMaxAllowed_parameter3
            5 x DcmDspDidSignal:
              DCDCPower: DcmDspDidDataPos=0, DcmDspDidDataRef=VCU_PowerMaxAllowed_parameter3_DCDCPower
              ACSystemPower: DcmDspDidDataPos=8, DcmDspDidDataRef=VCU_PowerMaxAllowed_parameter3_ACSystemPower
              PackPTCPower: DcmDspDidDataPos=16, DcmDspDidDataRef=VCU_PowerMaxAllowed_parameter3_PackPTCPower
              MCUPower: DcmDspDidDataPos=24, DcmDspDidDataRef=VCU_PowerMaxAllowed_parameter3_MCUPower
              V2LPower: DcmDspDidDataPos=32, DcmDspDidDataRef=VCU_PowerMaxAllowed_parameter3_V2LPower
          BSW_version_number: DcmDspDidIdentifier=7449, DcmDspDidInfoRef=DidInfo_BSW_version_number
            3 x DcmDspDidSignal:
              Major_release: DcmDspDidDataPos=0, DcmDspDidDataRef=BSW_version_number_Major_release
              Minor_release: DcmDspDidDataPos=8, DcmDspDidDataRef=BSW_version_number_Minor_release
              No_functional_content_change: DcmDspDidDataPos=16, DcmDspDidDataRef=BSW_version_number_No_functional_content_change
          Total_Odometer_VCU: DcmDspDidIdentifier=7456, DcmDspDidInfoRef=DidInfo_Total_Odometer_VCU
            Total_Odometer_VCU (DcmDspDidSignal): DcmDspDidDataPos=0, DcmDspDidDataRef=Total_Odometer_VCU_Total_Odometer_VCU
          BS_base_information4: DcmDspDidIdentifier=7457, DcmDspDidInfoRef=DidInfo_BS_base_information4
            6 x DcmDspDidSignal:
              BS_SOC: DcmDspDidDataPos=0, DcmDspDidDataRef=BS_base_information4_BS_SOC
              VCU_BS_Hcurrent: DcmDspDidDataPos=8, DcmDspDidDataRef=BS_base_information4_VCU_BS_Hcurrent
              T_BATT: DcmDspDidDataPos=24, DcmDspDidDataRef=BS_base_information4_T_BATT
              SOF_V1: DcmDspDidDataPos=32, DcmDspDidDataRef=BS_base_information4_SOF_V1
              SOF_V2: DcmDspDidDataPos=40, DcmDspDidDataRef=BS_base_information4_SOF_V2
              SOH: DcmDspDidDataPos=48, DcmDspDidDataRef=BS_base_information4_SOH
          Write_Level1_OEM_Key: DcmDspDidIdentifier=61456, DcmDspDidInfoRef=DidInfo_Write_Level1_OEM_Key
            OEM_Key_Value (DcmDspDidSignal): DcmDspDidDataPos=0, DcmDspDidDataRef=Write_Level1_OEM_Key_OEM_Key_Value
            CRC (DcmDspDidSignal): DcmDspDidDataPos=128, DcmDspDidDataRef=Write_Level1_OEM_Key_CRC
          Read_Level1_OEM_Key_written_status: DcmDspDidIdentifier=61457, DcmDspDidInfoRef=DidInfo_Read_Level1_OEM_Key_written_status
            Read_Level1_OEM_Key_rewrite_counter (DcmDspDidSignal): DcmDspDidDataPos=0, DcmDspDidDataRef=Read_Level1_OEM_Key_written_status_Read_Level1_OEM_Key_rewrite_counter
          Write_Level2_OEM_Key: DcmDspDidIdentifier=61458, DcmDspDidInfoRef=DidInfo_Write_Level2_OEM_Key
            OEM_Key_Value (DcmDspDidSignal): DcmDspDidDataPos=0, DcmDspDidDataRef=Write_Level2_OEM_Key_OEM_Key_Value
            CRC (DcmDspDidSignal): DcmDspDidDataPos=128, DcmDspDidDataRef=Write_Level2_OEM_Key_CRC
          Read_Level2_OEM_Key_written_status: DcmDspDidIdentifier=61459, DcmDspDidInfoRef=DidInfo_Read_Level2_OEM_Key_written_status
            Read_Level2_OEM_Key_rewrite_counter (DcmDspDidSignal): DcmDspDidDataPos=0, DcmDspDidDataRef=Read_Level2_OEM_Key_written_status_Read_Level2_OEM_Key_rewrite_counter
          Write_Level3_OEM_Key: DcmDspDidIdentifier=61460, DcmDspDidInfoRef=DidInfo_Write_Level3_OEM_Key
            OEM_Key_Value (DcmDspDidSignal): DcmDspDidDataPos=0, DcmDspDidDataRef=Write_Level3_OEM_Key_OEM_Key_Value
            CRC (DcmDspDidSignal): DcmDspDidDataPos=128, DcmDspDidDataRef=Write_Level3_OEM_Key_CRC
          Read_Level3_OEM_Key_written_status: DcmDspDidIdentifier=61461, DcmDspDidInfoRef=DidInfo_Read_Level3_OEM_Key_written_status
            Read_Level3_OEM_Key_rewrite_counter (DcmDspDidSignal): DcmDspDidDataPos=0, DcmDspDidDataRef=Read_Level3_OEM_Key_written_status_Read_Level3_OEM_Key_rewrite_counter
          Write_Level4_OEM_Key: DcmDspDidIdentifier=61462, DcmDspDidInfoRef=DidInfo_Write_Level4_OEM_Key
            OEM_Key_Value (DcmDspDidSignal): DcmDspDidDataPos=0, DcmDspDidDataRef=Write_Level4_OEM_Key_OEM_Key_Value
            CRC (DcmDspDidSignal): DcmDspDidDataPos=128, DcmDspDidDataRef=Write_Level4_OEM_Key_CRC
          Read_Level4_OEM_Key_written_status: DcmDspDidIdentifier=61463, DcmDspDidInfoRef=DidInfo_Read_Level4_OEM_Key_written_status
            Read_Level4_OEM_Key_rewrite_counter (DcmDspDidSignal): DcmDspDidDataPos=0, DcmDspDidDataRef=Read_Level4_OEM_Key_written_status_Read_Level4_OEM_Key_rewrite_counter
          Read_Vehicle_Security_related_events_Software_configuration_inte: DcmDspDidIdentifier=61472, DcmDspDidInfoRef=DidInfo_Read_Vehicle_Security_related_events_Software_configuration_inte
            21 x DcmDspDidSignal:
              Software_configuration_integrity_check_1: DcmDspDidDataPos=0, DcmDspDidDataRef=Read_Vehicle_Security_related_events_Software_configuration_inte_Software_configuration_integrity_check_1
              Event_occurance_time_Year_1: DcmDspDidDataPos=8, DcmDspDidDataRef=Read_Vehicle_Security_related_events_Software_configuration_inte_Event_occurance_time_Year_1
              Event_occurance_time_Month_1: DcmDspDidDataPos=16, DcmDspDidDataRef=Read_Vehicle_Security_related_events_Software_configuration_inte_Event_occurance_time_Month_1
              Event_occurance_time_Day_1: DcmDspDidDataPos=24, DcmDspDidDataRef=Read_Vehicle_Security_related_events_Software_configuration_inte_Event_occurance_time_Day_1
              Software_configuration_integrity_check_2: DcmDspDidDataPos=32, DcmDspDidDataRef=Read_Vehicle_Security_related_events_Software_configuration_inte_Software_configuration_integrity_check_2
              Event_occurance_time_Year_2: DcmDspDidDataPos=40, DcmDspDidDataRef=Read_Vehicle_Security_related_events_Software_configuration_inte_Event_occurance_time_Year_2
              Event_occurance_time_Month_2: DcmDspDidDataPos=48, DcmDspDidDataRef=Read_Vehicle_Security_related_events_Software_configuration_inte_Event_occurance_time_Month_2
              Event_occurance_time_Day_2: DcmDspDidDataPos=56, DcmDspDidDataRef=Read_Vehicle_Security_related_events_Software_configuration_inte_Event_occurance_time_Day_2
              Software_configuration_integrity_check_3: DcmDspDidDataPos=64, DcmDspDidDataRef=Read_Vehicle_Security_related_events_Software_configuration_inte_Software_configuration_integrity_check_3
              Event_occurance_time_Year_3: DcmDspDidDataPos=72, DcmDspDidDataRef=Read_Vehicle_Security_related_events_Software_configuration_inte_Event_occurance_time_Year_3
              Event_occurance_time_Month_3: DcmDspDidDataPos=80, DcmDspDidDataRef=Read_Vehicle_Security_related_events_Software_configuration_inte_Event_occurance_time_Month_3
              Event_occurance_time_Day_3: DcmDspDidDataPos=88, DcmDspDidDataRef=Read_Vehicle_Security_related_events_Software_configuration_inte_Event_occurance_time_Day_3
              Software_configuration_integrity_check_4: DcmDspDidDataPos=96, DcmDspDidDataRef=Read_Vehicle_Security_related_events_Software_configuration_inte_Software_configuration_integrity_check_4
              Event_occurance_time_Year_4: DcmDspDidDataPos=104, DcmDspDidDataRef=Read_Vehicle_Security_related_events_Software_configuration_inte_Event_occurance_time_Year_4
              Event_occurance_time_Month_4: DcmDspDidDataPos=112, DcmDspDidDataRef=Read_Vehicle_Security_related_events_Software_configuration_inte_Event_occurance_time_Month_4
              Event_occurance_time_Day_4: DcmDspDidDataPos=120, DcmDspDidDataRef=Read_Vehicle_Security_related_events_Software_configuration_inte_Event_occurance_time_Day_4
              Software_configuration_integrity_check_5: DcmDspDidDataPos=128, DcmDspDidDataRef=Read_Vehicle_Security_related_events_Software_configuration_inte_Software_configuration_integrity_check_5
              Event_occurance_time_Year_5: DcmDspDidDataPos=136, DcmDspDidDataRef=Read_Vehicle_Security_related_events_Software_configuration_inte_Event_occurance_time_Year_5
              Event_occurance_time_Month_5: DcmDspDidDataPos=144, DcmDspDidDataRef=Read_Vehicle_Security_related_events_Software_configuration_inte_Event_occurance_time_Month_5
              Event_occurance_time_Day_5: DcmDspDidDataPos=152, DcmDspDidDataRef=Read_Vehicle_Security_related_events_Software_configuration_inte_Event_occurance_time_Day_5
              Software_configuration_integrity_check_failure_Event_occurrence_: DcmDspDidDataPos=160, DcmDspDidDataRef=Read_Vehicle_Security_related_events_Software_configuration_inte_Software_configuration_integrity_check_failure_Event_oc4f77644e
          Read_Vehicle_Security_related_events_Brute_Force_UDS_0x27_servic: DcmDspDidIdentifier=61473, DcmDspDidInfoRef=DidInfo_Read_Vehicle_Security_related_events_Brute_Force_UDS_0x27_servic
            21 x DcmDspDidSignal:
              Brute_Force_UDS_0x27_service_1: DcmDspDidDataPos=0, DcmDspDidDataRef=Read_Vehicle_Security_related_events_Brute_Force_UDS_0x27_servic_Brute_Force_UDS_0x27_service_1
              Event_occurance_time_Year_1: DcmDspDidDataPos=8, DcmDspDidDataRef=Read_Vehicle_Security_related_events_Brute_Force_UDS_0x27_servic_Event_occurance_time_Year_1
              Event_occurance_time_Month_1: DcmDspDidDataPos=16, DcmDspDidDataRef=Read_Vehicle_Security_related_events_Brute_Force_UDS_0x27_servic_Event_occurance_time_Month_1
              Event_occurance_time_Day_1: DcmDspDidDataPos=24, DcmDspDidDataRef=Read_Vehicle_Security_related_events_Brute_Force_UDS_0x27_servic_Event_occurance_time_Day_1
              Brute_Force_UDS_0x27_service_2: DcmDspDidDataPos=32, DcmDspDidDataRef=Read_Vehicle_Security_related_events_Brute_Force_UDS_0x27_servic_Brute_Force_UDS_0x27_service_2
              Event_occurance_time_Year_2: DcmDspDidDataPos=40, DcmDspDidDataRef=Read_Vehicle_Security_related_events_Brute_Force_UDS_0x27_servic_Event_occurance_time_Year_2
              Event_occurance_time_Month_2: DcmDspDidDataPos=48, DcmDspDidDataRef=Read_Vehicle_Security_related_events_Brute_Force_UDS_0x27_servic_Event_occurance_time_Month_2
              Event_occurance_time_Day_2: DcmDspDidDataPos=56, DcmDspDidDataRef=Read_Vehicle_Security_related_events_Brute_Force_UDS_0x27_servic_Event_occurance_time_Day_2
              Brute_Force_UDS_0x27_service_3: DcmDspDidDataPos=64, DcmDspDidDataRef=Read_Vehicle_Security_related_events_Brute_Force_UDS_0x27_servic_Brute_Force_UDS_0x27_service_3
              Event_occurance_time_Year_3: DcmDspDidDataPos=72, DcmDspDidDataRef=Read_Vehicle_Security_related_events_Brute_Force_UDS_0x27_servic_Event_occurance_time_Year_3
              Event_occurance_time_Month_3: DcmDspDidDataPos=80, DcmDspDidDataRef=Read_Vehicle_Security_related_events_Brute_Force_UDS_0x27_servic_Event_occurance_time_Month_3
              Event_occurance_time_Day_3: DcmDspDidDataPos=88, DcmDspDidDataRef=Read_Vehicle_Security_related_events_Brute_Force_UDS_0x27_servic_Event_occurance_time_Day_3
              Brute_Force_UDS_0x27_service_4: DcmDspDidDataPos=96, DcmDspDidDataRef=Read_Vehicle_Security_related_events_Brute_Force_UDS_0x27_servic_Brute_Force_UDS_0x27_service_4
              Event_occurance_time_Year_4: DcmDspDidDataPos=104, DcmDspDidDataRef=Read_Vehicle_Security_related_events_Brute_Force_UDS_0x27_servic_Event_occurance_time_Year_4
              Event_occurance_time_Month_4: DcmDspDidDataPos=112, DcmDspDidDataRef=Read_Vehicle_Security_related_events_Brute_Force_UDS_0x27_servic_Event_occurance_time_Month_4
              Event_occurance_time_Day_4: DcmDspDidDataPos=120, DcmDspDidDataRef=Read_Vehicle_Security_related_events_Brute_Force_UDS_0x27_servic_Event_occurance_time_Day_4
              Brute_Force_UDS_0x27_service_5: DcmDspDidDataPos=128, DcmDspDidDataRef=Read_Vehicle_Security_related_events_Brute_Force_UDS_0x27_servic_Brute_Force_UDS_0x27_service_5
              Event_occurance_time_Year_5: DcmDspDidDataPos=136, DcmDspDidDataRef=Read_Vehicle_Security_related_events_Brute_Force_UDS_0x27_servic_Event_occurance_time_Year_5
              Event_occurance_time_Month_5: DcmDspDidDataPos=144, DcmDspDidDataRef=Read_Vehicle_Security_related_events_Brute_Force_UDS_0x27_servic_Event_occurance_time_Month_5
              Event_occurance_time_Day_5: DcmDspDidDataPos=152, DcmDspDidDataRef=Read_Vehicle_Security_related_events_Brute_Force_UDS_0x27_servic_Event_occurance_time_Day_5
              Brute_Force_UDS_0x27_service_Event_occurrence_counter: DcmDspDidDataPos=160, DcmDspDidDataRef=Read_Vehicle_Security_related_events_Brute_Force_UDS_0x27_servic_Brute_Force_UDS_0x27_service_Event_occurrence_counter
          Bootloader_version_number: DcmDspDidIdentifier=61697, DcmDspDidInfoRef=DidInfo_Bootloader_version_number
            3 x DcmDspDidSignal:
              Major_release: DcmDspDidDataPos=0, DcmDspDidDataRef=Bootloader_version_number_Major_release
              Minor_release: DcmDspDidDataPos=8, DcmDspDidDataRef=Bootloader_version_number_Minor_release
              No_functional_content_change: DcmDspDidDataPos=16, DcmDspDidDataRef=Bootloader_version_number_No_functional_content_change
          EcuIdentification: DcmDspDidIdentifier=61698, DcmDspDidInfoRef=DidInfo_EcuIdentification
            5 x DcmDspDidSignal:
              Specific_Vehicle_Code_WMI: DcmDspDidDataPos=0, DcmDspDidDataRef=EcuIdentification_Specific_Vehicle_Code_WMI
              Group: DcmDspDidDataPos=48, DcmDspDidDataRef=EcuIdentification_Group
              Subgroup: DcmDspDidDataPos=64, DcmDspDidDataRef=EcuIdentification_Subgroup
              Detail_Code: DcmDspDidDataPos=80, DcmDspDidDataRef=EcuIdentification_Detail_Code
              Execution_Package: DcmDspDidDataPos=104, DcmDspDidDataRef=EcuIdentification_Execution_Package
          ECU_application_software_ASW_version_number: DcmDspDidIdentifier=61700, DcmDspDidInfoRef=DidInfo_ECU_application_software_ASW_version_number
            3 x DcmDspDidSignal:
              Major_release: DcmDspDidDataPos=0, DcmDspDidDataRef=ECU_application_software_ASW_version_number_Major_release
              Minor_release: DcmDspDidDataPos=8, DcmDspDidDataRef=ECU_application_software_ASW_version_number_Minor_release
              No_functional_content_change: DcmDspDidDataPos=16, DcmDspDidDataRef=ECU_application_software_ASW_version_number_No_functional_content_change
          Read_Write_coding_data_string_CDS: DcmDspDidIdentifier=61704, DcmDspDidInfoRef=DidInfo_Read_Write_coding_data_string_CDS
            16 x DcmDspDidSignal:
              Version_Byte_0: DcmDspDidDataPos=0, DcmDspDidDataRef=Read_Write_coding_data_string_CDS_Version_Byte_0
              Version_Byte_1: DcmDspDidDataPos=8, DcmDspDidDataRef=Read_Write_coding_data_string_CDS_Version_Byte_1
              CDS_Short_VIN_High_Byte_0: DcmDspDidDataPos=16, DcmDspDidDataRef=Read_Write_coding_data_string_CDS_CDS_Short_VIN_High_Byte_0
              CDS_Short_VIN_High_Byte_1: DcmDspDidDataPos=24, DcmDspDidDataRef=Read_Write_coding_data_string_CDS_CDS_Short_VIN_High_Byte_1
              CDS_Short_VIN_High_Byte_2: DcmDspDidDataPos=32, DcmDspDidDataRef=Read_Write_coding_data_string_CDS_CDS_Short_VIN_High_Byte_2
              CDS_Short_VIN_High_Byte_3: DcmDspDidDataPos=40, DcmDspDidDataRef=Read_Write_coding_data_string_CDS_CDS_Short_VIN_High_Byte_3
              CDS_Short_VIN_High_Byte_4: DcmDspDidDataPos=48, DcmDspDidDataRef=Read_Write_coding_data_string_CDS_CDS_Short_VIN_High_Byte_4
              CDS_Short_VIN_High_Byte_5: DcmDspDidDataPos=56, DcmDspDidDataRef=Read_Write_coding_data_string_CDS_CDS_Short_VIN_High_Byte_5
              CDS_Short_VIN_High_Byte_7: DcmDspDidDataPos=64, DcmDspDidDataRef=Read_Write_coding_data_string_CDS_CDS_Short_VIN_High_Byte_7
              CDS_Format_Byte_High_Byte_0: DcmDspDidDataPos=72, DcmDspDidDataRef=Read_Write_coding_data_string_CDS_CDS_Format_Byte_High_Byte_0
              CDS_Format_Byte_High_Byte_1: DcmDspDidDataPos=80, DcmDspDidDataRef=Read_Write_coding_data_string_CDS_CDS_Format_Byte_High_Byte_1
              Configuration: DcmDspDidDataPos=88, DcmDspDidDataRef=Read_Write_coding_data_string_CDS_Configuration
              Reserved1: DcmDspDidDataPos=96, DcmDspDidDataRef=Read_Write_coding_data_string_CDS_Reserved1
              Reserved2: DcmDspDidDataPos=104, DcmDspDidDataRef=Read_Write_coding_data_string_CDS_Reserved2
              Reserved3: DcmDspDidDataPos=112, DcmDspDidDataRef=Read_Write_coding_data_string_CDS_Reserved3
              CDS_CRC: DcmDspDidDataPos=120, DcmDspDidDataRef=Read_Write_coding_data_string_CDS_CDS_CRC
          Coding_for_CDS_fingerprint: DcmDspDidIdentifier=61706, DcmDspDidInfoRef=DidInfo_Coding_for_CDS_fingerprint
            4 x DcmDspDidSignal:
              codingDate_byte_1_YY: DcmDspDidDataPos=0, DcmDspDidDataRef=Coding_for_CDS_fingerprint_codingDate_byte_1_YY
              codingDate_byte_2_MM: DcmDspDidDataPos=8, DcmDspDidDataRef=Coding_for_CDS_fingerprint_codingDate_byte_2_MM
              codingDate_byte_3_DD: DcmDspDidDataPos=16, DcmDspDidDataRef=Coding_for_CDS_fingerprint_codingDate_byte_3_DD
              repairShopCodeorTesterSerialNumber_byte_1_27_MSB: DcmDspDidDataPos=24, DcmDspDidDataRef=Coding_for_CDS_fingerprint_repairShopCodeorTesterSerialNumber_byte_1_27_MSB
          Last_service_date: DcmDspDidIdentifier=61711, DcmDspDidInfoRef=DidInfo_Last_service_date
            3 x DcmDspDidSignal:
              Year: DcmDspDidDataPos=0, DcmDspDidDataRef=Last_service_date_Year
              Month: DcmDspDidDataPos=8, DcmDspDidDataRef=Last_service_date_Month
              Day: DcmDspDidDataPos=16, DcmDspDidDataRef=Last_service_date_Day
          Read_active_diagnostic_session: DcmDspDidIdentifier=61830, DcmDspDidInfoRef=DidInfo_Read_active_diagnostic_session
            Active_diagnostic_session (DcmDspDidSignal): DcmDspDidDataPos=0, DcmDspDidDataRef=Read_active_diagnostic_session_Active_diagnostic_session
          Read_ECU_Part_Number: DcmDspDidIdentifier=61831, DcmDspDidInfoRef=DidInfo_Read_ECU_Part_Number
            5 x DcmDspDidSignal:
              Specific_Vehicle_Code_WMI: DcmDspDidDataPos=0, DcmDspDidDataRef=Read_ECU_Part_Number_Specific_Vehicle_Code_WMI
              Group: DcmDspDidDataPos=48, DcmDspDidDataRef=Read_ECU_Part_Number_Group
              Subgroup: DcmDspDidDataPos=64, DcmDspDidDataRef=Read_ECU_Part_Number_Subgroup
              Detail_Code: DcmDspDidDataPos=80, DcmDspDidDataRef=Read_ECU_Part_Number_Detail_Code
              Execution_Package: DcmDspDidDataPos=104, DcmDspDidDataRef=Read_ECU_Part_Number_Execution_Package
          DevelopmentData: DcmDspDidIdentifier=61834, DcmDspDidInfoRef=DidInfo_DevelopmentData
            3 x DcmDspDidSignal:
              Country_code: DcmDspDidDataPos=0, DcmDspDidDataRef=DevelopmentData_Country_code
              Supplier_family_code: DcmDspDidDataPos=16, DcmDspDidDataRef=DevelopmentData_Supplier_family_code
              Supplier_code: DcmDspDidDataPos=40, DcmDspDidDataRef=DevelopmentData_Supplier_code
          Read_ECU_manufacturing_date: DcmDspDidIdentifier=61835, DcmDspDidInfoRef=DidInfo_Read_ECU_manufacturing_date
            3 x DcmDspDidSignal:
              ECU_Manufacturing_Date_Year: DcmDspDidDataPos=0, DcmDspDidDataRef=Read_ECU_manufacturing_date_ECU_Manufacturing_Date_Year
              ECU_Manufacturing_Date_Month: DcmDspDidDataPos=8, DcmDspDidDataRef=Read_ECU_manufacturing_date_ECU_Manufacturing_Date_Month
              ECU_Manufacturing_Date_Day: DcmDspDidDataPos=16, DcmDspDidDataRef=Read_ECU_manufacturing_date_ECU_Manufacturing_Date_Day
          SerialNumber: DcmDspDidIdentifier=61836, DcmDspDidInfoRef=DidInfo_SerialNumber
            4 x DcmDspDidSignal:
              ECU_Name: DcmDspDidDataPos=0, DcmDspDidDataRef=SerialNumber_ECU_Name
              Supplier_name: DcmDspDidDataPos=24, DcmDspDidDataRef=SerialNumber_Supplier_name
              ECU_production_date_in_DD_MM_YY_format: DcmDspDidDataPos=64, DcmDspDidDataRef=SerialNumber_ECU_production_date_in_DD_MM_YY_format
              ECU_index_number: DcmDspDidDataPos=112, DcmDspDidDataRef=SerialNumber_ECU_index_number
          Read_Write_complete_VIN: DcmDspDidIdentifier=61840, DcmDspDidInfoRef=DidInfo_Read_Write_complete_VIN
            3 x DcmDspDidSignal:
              World_Manufacturers_Identification: DcmDspDidDataPos=0, DcmDspDidDataRef=Read_Write_complete_VIN_World_Manufacturers_Identification
              Vehicle_Description_Section: DcmDspDidDataPos=24, DcmDspDidDataRef=Read_Write_complete_VIN_Vehicle_Description_Section
              Vehicle_Identification_Section: DcmDspDidDataPos=64, DcmDspDidDataRef=Read_Write_complete_VIN_Vehicle_Identification_Section
          Supplier_ECU_hardware_part_number: DcmDspDidIdentifier=61842, DcmDspDidInfoRef=DidInfo_Supplier_ECU_hardware_part_number
            Major_release (DcmDspDidSignal): DcmDspDidDataPos=0, DcmDspDidDataRef=Supplier_ECU_hardware_part_number_Major_release
            Changes_in_electronic_components_level (DcmDspDidSignal): DcmDspDidDataPos=8, DcmDspDidDataRef=Supplier_ECU_hardware_part_number_Changes_in_electronic_components_level
          Vehicle_State: DcmDspDidIdentifier=61856, DcmDspDidInfoRef=DidInfo_Vehicle_State
            Ignition_Switch_Signal (DcmDspDidSignal): DcmDspDidDataPos=0, DcmDspDidDataRef=Vehicle_State_Ignition_Switch_Signal
          Battery_Voltage: DcmDspDidIdentifier=61857, DcmDspDidInfoRef=DidInfo_Battery_Voltage
            Battery_Voltage (DcmDspDidSignal): DcmDspDidDataPos=0, DcmDspDidDataRef=Battery_Voltage_Battery_Voltage
          Total_Odometer: DcmDspDidIdentifier=61858, DcmDspDidInfoRef=DidInfo_Total_Odometer
            Total_Odometer (DcmDspDidSignal): DcmDspDidDataPos=0, DcmDspDidDataRef=Total_Odometer_Total_Odometer
          Vehicle_speed: DcmDspDidIdentifier=61859, DcmDspDidInfoRef=DidInfo_Vehicle_speed
            Vehicle_speed (DcmDspDidSignal): DcmDspDidDataPos=0, DcmDspDidDataRef=Vehicle_speed_Vehicle_speed
          Date_And_Time: DcmDspDidIdentifier=61860, DcmDspDidInfoRef=DidInfo_Date_And_Time
            6 x DcmDspDidSignal:
              Date_And_Time_Second: DcmDspDidDataPos=0, DcmDspDidDataRef=Date_And_Time_Date_And_Time_Second
              Date_And_Time_Minute: DcmDspDidDataPos=8, DcmDspDidDataRef=Date_And_Time_Date_And_Time_Minute
              Date_And_Time_Hour: DcmDspDidDataPos=16, DcmDspDidDataRef=Date_And_Time_Date_And_Time_Hour
              Date_And_Time_Day: DcmDspDidDataPos=24, DcmDspDidDataRef=Date_And_Time_Date_And_Time_Day
              Date_And_Time_Month: DcmDspDidDataPos=32, DcmDspDidDataRef=Date_And_Time_Date_And_Time_Month
              Date_And_Time_Year: DcmDspDidDataPos=40, DcmDspDidDataRef=Date_And_Time_Date_And_Time_Year
          VCU_HVStatus: DcmDspDidIdentifier=61861, DcmDspDidInfoRef=DidInfo_VCU_HVStatus
            VCU_HVStatus (DcmDspDidSignal): DcmDspDidDataPos=0, DcmDspDidDataRef=VCU_HVStatus_VCU_HVStatus
          SOC: DcmDspDidIdentifier=61862, DcmDspDidInfoRef=DidInfo_SOC
            SOC (DcmDspDidSignal): DcmDspDidDataPos=0, DcmDspDidDataRef=SOC_SOC
          Gear: DcmDspDidIdentifier=61863, DcmDspDidInfoRef=DidInfo_Gear
            Gear (DcmDspDidSignal): DcmDspDidDataPos=0, DcmDspDidDataRef=Gear_Gear
        50 x DcmDspDidInfo:
          DidInfo_HV_Status_and_Charging_Status
            DcmDspDidAccess
              DcmDspDidRead: DcmDspDidReadSessionRef=DcmDspSession/Default, DcmDspDidReadSessionRef=DcmDspSession/Extended, DcmDspDidReadSessionRef=Coding_Session
          DidInfo_VCU_AccPealparameter
            DcmDspDidAccess
              DcmDspDidRead: DcmDspDidReadSessionRef=DcmDspSession/Default, DcmDspDidReadSessionRef=DcmDspSession/Extended, DcmDspDidReadSessionRef=Coding_Session
          DidInfo_VCU_Torque_parameter
            DcmDspDidAccess
              DcmDspDidRead: DcmDspDidReadSessionRef=DcmDspSession/Default, DcmDspDidReadSessionRef=DcmDspSession/Extended, DcmDspDidReadSessionRef=Coding_Session
          DidInfo_Driver_Mode
            DcmDspDidAccess
              DcmDspDidRead: DcmDspDidReadSessionRef=DcmDspSession/Default, DcmDspDidReadSessionRef=DcmDspSession/Extended, DcmDspDidReadSessionRef=Coding_Session
          DidInfo_VCU_PowerMaxAllowed_parameter1
            DcmDspDidAccess
              DcmDspDidRead: DcmDspDidReadSessionRef=DcmDspSession/Default, DcmDspDidReadSessionRef=DcmDspSession/Extended, DcmDspDidReadSessionRef=Coding_Session
          DidInfo_AC_charging_parameter
            DcmDspDidAccess
              DcmDspDidRead: DcmDspDidReadSessionRef=DcmDspSession/Default, DcmDspDidReadSessionRef=DcmDspSession/Extended, DcmDspDidReadSessionRef=Coding_Session
          DidInfo_Chargestatus
            DcmDspDidAccess
              DcmDspDidRead: DcmDspDidReadSessionRef=DcmDspSession/Default, DcmDspDidReadSessionRef=DcmDspSession/Extended, DcmDspDidReadSessionRef=Coding_Session
          DidInfo_Electronic_lock_state
            DcmDspDidAccess
              DcmDspDidRead: DcmDspDidReadSessionRef=DcmDspSession/Default, DcmDspDidReadSessionRef=DcmDspSession/Extended, DcmDspDidReadSessionRef=Coding_Session
          DidInfo_VCU_HV_InterLock_PWM_pfrequency
            DcmDspDidAccess
              DcmDspDidRead: DcmDspDidReadSessionRef=DcmDspSession/Default, DcmDspDidReadSessionRef=DcmDspSession/Extended, DcmDspDidReadSessionRef=Coding_Session
          DidInfo_VCU_control_S2_status
            DcmDspDidAccess
              DcmDspDidRead: DcmDspDidReadSessionRef=DcmDspSession/Default, DcmDspDidReadSessionRef=DcmDspSession/Extended, DcmDspDidReadSessionRef=Coding_Session
          DidInfo_VCU_PowerMaxAllowed_parameter2
            DcmDspDidAccess
              DcmDspDidRead: DcmDspDidReadSessionRef=DcmDspSession/Default, DcmDspDidReadSessionRef=DcmDspSession/Extended, DcmDspDidReadSessionRef=Coding_Session
          DidInfo_VCU_control_main_relay
            DcmDspDidAccess
              DcmDspDidRead: DcmDspDidReadSessionRef=DcmDspSession/Default, DcmDspDidReadSessionRef=DcmDspSession/Extended, DcmDspDidReadSessionRef=Coding_Session
          DidInfo_PWT_vehicle_fault
            DcmDspDidAccess
              DcmDspDidRead: DcmDspDidReadSessionRef=DcmDspSession/Default, DcmDspDidReadSessionRef=DcmDspSession/Extended, DcmDspDidReadSessionRef=Coding_Session
          DidInfo_DC_Charging_port_Temperature
            DcmDspDidAccess
              DcmDspDidRead: DcmDspDidReadSessionRef=DcmDspSession/Default, DcmDspDidReadSessionRef=DcmDspSession/Extended, DcmDspDidReadSessionRef=Coding_Session
          DidInfo_HV_part_work_mode
            DcmDspDidAccess
              DcmDspDidRead: DcmDspDidReadSessionRef=DcmDspSession/Default, DcmDspDidReadSessionRef=DcmDspSession/Extended, DcmDspDidReadSessionRef=Coding_Session
          DidInfo_VCU_PowerMaxAllowed_parameter3
            DcmDspDidAccess
              DcmDspDidRead: DcmDspDidReadSessionRef=DcmDspSession/Default, DcmDspDidReadSessionRef=DcmDspSession/Extended, DcmDspDidReadSessionRef=Coding_Session
          DidInfo_BSW_version_number
            DcmDspDidAccess
              DcmDspDidRead: DcmDspDidReadSessionRef=DcmDspSession/Default, DcmDspDidReadSessionRef=DcmDspSession/Extended, DcmDspDidReadSessionRef=Coding_Session
          DidInfo_Total_Odometer_VCU
            DcmDspDidAccess
              DcmDspDidRead: DcmDspDidReadSessionRef=DcmDspSession/Default, DcmDspDidReadSessionRef=DcmDspSession/Extended, DcmDspDidReadSessionRef=Coding_Session
              DcmDspDidWrite: DcmDspDidWriteSessionRef=DcmDspSession/Extended, DcmDspDidWriteSecurityLevelRef=Unlocked_Level_2
          DidInfo_BS_base_information4
            DcmDspDidAccess
              DcmDspDidRead: DcmDspDidReadSessionRef=DcmDspSession/Default, DcmDspDidReadSessionRef=DcmDspSession/Extended, DcmDspDidReadSessionRef=Coding_Session
          DidInfo_Write_Level1_OEM_Key
            DcmDspDidAccess
              DcmDspDidWrite: DcmDspDidWriteSessionRef=DcmDspSession/Extended, DcmDspDidWriteSecurityLevelRef=UnlockedL1
          DidInfo_Read_Level1_OEM_Key_written_status
            DcmDspDidAccess
              DcmDspDidRead: DcmDspDidReadSessionRef=DcmDspSession/Default, DcmDspDidReadSessionRef=DcmDspSession/Extended, DcmDspDidReadSessionRef=Coding_Session
          DidInfo_Write_Level2_OEM_Key
            DcmDspDidAccess
              DcmDspDidWrite: DcmDspDidWriteSessionRef=DcmDspSession/Extended, DcmDspDidWriteSecurityLevelRef=Unlocked_Level_2
          DidInfo_Read_Level2_OEM_Key_written_status
            DcmDspDidAccess
              DcmDspDidRead: DcmDspDidReadSessionRef=DcmDspSession/Default, DcmDspDidReadSessionRef=DcmDspSession/Extended, DcmDspDidReadSessionRef=Coding_Session
          DidInfo_Write_Level3_OEM_Key
            DcmDspDidAccess
              DcmDspDidWrite: DcmDspDidWriteSessionRef=DcmDspSession/Extended, DcmDspDidWriteSecurityLevelRef=Unlocked_Level_3
          DidInfo_Read_Level3_OEM_Key_written_status
            DcmDspDidAccess
              DcmDspDidRead: DcmDspDidReadSessionRef=DcmDspSession/Default, DcmDspDidReadSessionRef=DcmDspSession/Extended, DcmDspDidReadSessionRef=Coding_Session
          DidInfo_Write_Level4_OEM_Key
            DcmDspDidAccess
              DcmDspDidWrite: DcmDspDidWriteSessionRef=DcmDspSession/Extended, DcmDspDidWriteSecurityLevelRef=Unlocked_Level_4
          DidInfo_Read_Level4_OEM_Key_written_status
            DcmDspDidAccess
              DcmDspDidRead: DcmDspDidReadSessionRef=DcmDspSession/Default, DcmDspDidReadSessionRef=DcmDspSession/Extended, DcmDspDidReadSessionRef=Coding_Session
          DidInfo_Read_Vehicle_Security_related_events_Software_configuration_inte
            DcmDspDidAccess
              DcmDspDidRead: DcmDspDidReadSessionRef=DcmDspSession/Default, DcmDspDidReadSessionRef=DcmDspSession/Extended, DcmDspDidReadSessionRef=Coding_Session
          DidInfo_Read_Vehicle_Security_related_events_Brute_Force_UDS_0x27_servic
            DcmDspDidAccess
              DcmDspDidRead: DcmDspDidReadSessionRef=DcmDspSession/Default, DcmDspDidReadSessionRef=DcmDspSession/Extended, DcmDspDidReadSessionRef=Coding_Session
          DidInfo_Bootloader_version_number
            DcmDspDidAccess
              DcmDspDidRead: DcmDspDidReadSessionRef=DcmDspSession/Default, DcmDspDidReadSessionRef=DcmDspSession/Extended, DcmDspDidReadSessionRef=Coding_Session
          DidInfo_EcuIdentification
            DcmDspDidAccess
              DcmDspDidRead: DcmDspDidReadSessionRef=DcmDspSession/Default, DcmDspDidReadSessionRef=DcmDspSession/Extended, DcmDspDidReadSessionRef=Coding_Session
              DcmDspDidWrite: DcmDspDidWriteSessionRef=DcmDspSession/Extended, DcmDspDidWriteSecurityLevelRef=UnlockedL1, DcmDspDidWriteSecurityLevelRef=Unlocked_Level_2
          DidInfo_ECU_application_software_ASW_version_number
            DcmDspDidAccess
              DcmDspDidRead: DcmDspDidReadSessionRef=DcmDspSession/Default, DcmDspDidReadSessionRef=DcmDspSession/Extended, DcmDspDidReadSessionRef=Coding_Session
          DidInfo_Read_Write_coding_data_string_CDS
            DcmDspDidAccess
              DcmDspDidRead: DcmDspDidReadSessionRef=DcmDspSession/Default, DcmDspDidReadSessionRef=DcmDspSession/Extended, DcmDspDidReadSessionRef=Coding_Session
              DcmDspDidWrite: DcmDspDidWriteSessionRef=Coding_Session, DcmDspDidWriteSecurityLevelRef=Unlocked_Level_3
          DidInfo_Coding_for_CDS_fingerprint
            DcmDspDidAccess
              DcmDspDidRead: DcmDspDidReadSessionRef=DcmDspSession/Default, DcmDspDidReadSessionRef=DcmDspSession/Extended, DcmDspDidReadSessionRef=Coding_Session
              DcmDspDidWrite: DcmDspDidWriteSessionRef=Coding_Session, DcmDspDidWriteSecurityLevelRef=Unlocked_Level_3
          DidInfo_Last_service_date
            DcmDspDidAccess
              DcmDspDidRead: DcmDspDidReadSessionRef=DcmDspSession/Default, DcmDspDidReadSessionRef=DcmDspSession/Extended, DcmDspDidReadSessionRef=Coding_Session
              DcmDspDidWrite: DcmDspDidWriteSessionRef=DcmDspSession/Extended, DcmDspDidWriteSecurityLevelRef=UnlockedL1
          DidInfo_Read_active_diagnostic_session
            DcmDspDidAccess
              DcmDspDidRead
          DidInfo_Read_ECU_Part_Number
            DcmDspDidAccess
              DcmDspDidRead: DcmDspDidReadSessionRef=DcmDspSession/Default, DcmDspDidReadSessionRef=DcmDspSession/Extended, DcmDspDidReadSessionRef=Coding_Session
          DidInfo_DevelopmentData
            DcmDspDidAccess
              DcmDspDidRead: DcmDspDidReadSessionRef=DcmDspSession/Default, DcmDspDidReadSessionRef=DcmDspSession/Extended, DcmDspDidReadSessionRef=Coding_Session
          DidInfo_Read_ECU_manufacturing_date
            DcmDspDidAccess
              DcmDspDidRead: DcmDspDidReadSessionRef=DcmDspSession/Default, DcmDspDidReadSessionRef=DcmDspSession/Extended, DcmDspDidReadSessionRef=Coding_Session
          DidInfo_SerialNumber
            DcmDspDidAccess
              DcmDspDidRead: DcmDspDidReadSessionRef=DcmDspSession/Default, DcmDspDidReadSessionRef=DcmDspSession/Extended, DcmDspDidReadSessionRef=Coding_Session
          DidInfo_Read_Write_complete_VIN
            DcmDspDidAccess
              DcmDspDidRead: DcmDspDidReadSessionRef=DcmDspSession/Default, DcmDspDidReadSessionRef=DcmDspSession/Extended, DcmDspDidReadSessionRef=Coding_Session
              DcmDspDidWrite: DcmDspDidWriteSessionRef=DcmDspSession/Extended, DcmDspDidWriteSecurityLevelRef=UnlockedL1, DcmDspDidWriteSecurityLevelRef=Unlocked_Level_2
          DidInfo_Supplier_ECU_hardware_part_number
            DcmDspDidAccess
              DcmDspDidRead: DcmDspDidReadSessionRef=DcmDspSession/Default, DcmDspDidReadSessionRef=DcmDspSession/Extended, DcmDspDidReadSessionRef=Coding_Session
          DidInfo_Vehicle_State
            DcmDspDidAccess
              DcmDspDidRead: DcmDspDidReadSessionRef=DcmDspSession/Default, DcmDspDidReadSessionRef=DcmDspSession/Extended, DcmDspDidReadSessionRef=Coding_Session
          DidInfo_Battery_Voltage
            DcmDspDidAccess
              DcmDspDidRead: DcmDspDidReadSessionRef=DcmDspSession/Default, DcmDspDidReadSessionRef=DcmDspSession/Extended, DcmDspDidReadSessionRef=Coding_Session
          DidInfo_Total_Odometer
            DcmDspDidAccess
              DcmDspDidRead: DcmDspDidReadSessionRef=DcmDspSession/Default, DcmDspDidReadSessionRef=DcmDspSession/Extended, DcmDspDidReadSessionRef=Coding_Session
          DidInfo_Vehicle_speed
            DcmDspDidAccess
              DcmDspDidRead: DcmDspDidReadSessionRef=DcmDspSession/Default, DcmDspDidReadSessionRef=DcmDspSession/Extended, DcmDspDidReadSessionRef=Coding_Session
          DidInfo_Date_And_Time
            DcmDspDidAccess
              DcmDspDidRead: DcmDspDidReadSessionRef=DcmDspSession/Default, DcmDspDidReadSessionRef=DcmDspSession/Extended, DcmDspDidReadSessionRef=Coding_Session
          DidInfo_VCU_HVStatus
            DcmDspDidAccess
              DcmDspDidRead: DcmDspDidReadSessionRef=DcmDspSession/Default, DcmDspDidReadSessionRef=DcmDspSession/Extended, DcmDspDidReadSessionRef=Coding_Session
          DidInfo_SOC
            DcmDspDidAccess
              DcmDspDidRead: DcmDspDidReadSessionRef=DcmDspSession/Default, DcmDspDidReadSessionRef=DcmDspSession/Extended, DcmDspDidReadSessionRef=Coding_Session
          DidInfo_Gear
            DcmDspDidAccess
              DcmDspDidRead: DcmDspDidReadSessionRef=DcmDspSession/Default, DcmDspDidReadSessionRef=DcmDspSession/Extended, DcmDspDidReadSessionRef=Coding_Session
        7 x DcmDspRoutine, all with DcmDspRequestResultsRoutineSupported=false:
          CheckCodingState: DcmDspStopRoutineSupported=false, DcmDspRoutineIdentifier=258, DcmDspRoutineInfoRef=RoutineInfo_CheckCodingState
          Check_Memory: DcmDspStopRoutineSupported=false, DcmDspRoutineIdentifier=514, DcmDspRoutineInfoRef=RoutineInfo_Check_Memory
          CheckProgrammingPreCondition: DcmDspStopRoutineSupported=false, DcmDspRoutineIdentifier=515, DcmDspRoutineInfoRef=RoutineInfo_CheckProgrammingPreCondition
          Erase_Mileage_Provisional_Parameter: DcmDspStopRoutineSupported=false, DcmDspRoutineIdentifier=40192, DcmDspRoutineInfoRef=RoutineInfo_Erase_Mileage_Provisional_Parameter
          Turn_Off_HV_Turn_Off_Charging: DcmDspStopRoutineSupported=true, DcmDspRoutineIdentifier=61440, DcmDspRoutineInfoRef=RoutineInfo_Turn_Off_HV_Turn_Off_Charging
          Erase_Memory: DcmDspStopRoutineSupported=false, DcmDspRoutineIdentifier=65280, DcmDspRoutineInfoRef=RoutineInfo_Erase_Memory
          CheckProgrammingDependencies: DcmDspStopRoutineSupported=false, DcmDspRoutineIdentifier=65281, DcmDspRoutineInfoRef=RoutineInfo_CheckProgrammingDependencies
        7 x DcmDspRoutineInfo:
          RoutineInfo_CheckCodingState
            DcmDspRoutineAuthorization: DcmDspRoutineSessionRef=Coding_Session, DcmDspRoutineSecurityLevelRef=Unlocked_Level_3
            DcmDspStartRoutineOut
              Out_routineResult (DcmDspStartRoutineOutSignal): DcmDspRoutineSignalLength=8, DcmDspRoutineSignalType=UINT8, DcmDspRoutineSignalPos=0
          RoutineInfo_Check_Memory
            DcmDspRoutineAuthorization: DcmDspRoutineSessionRef=DcmDspSession/Programming, DcmDspRoutineSecurityLevelRef=Unlocked_Level_4
            DcmDspStartRoutineIn
              In_checksum (DcmDspStartRoutineInSignal): DcmDspRoutineSignalLength=32, DcmDspRoutineSignalType=UINT32, DcmDspRoutineSignalEndianness=BIG_ENDIAN, DcmDspRoutineSignalPos=0
            DcmDspStartRoutineOut
              Out_routineResult (DcmDspStartRoutineOutSignal): DcmDspRoutineSignalLength=8, DcmDspRoutineSignalType=UINT8, DcmDspRoutineSignalPos=0
          RoutineInfo_CheckProgrammingPreCondition
            DcmDspRoutineAuthorization: DcmDspRoutineSessionRef=DcmDspSession/Extended
            DcmDspStartRoutineOut
              Out_programmingPreConditionList (DcmDspStartRoutineOutSignal): DcmDspRoutineSignalLength=40, DcmDspRoutineSignalType=UINT8_N, DcmDspRoutineSignalEndianness=opaque, DcmDspRoutineSignalPos=0
          RoutineInfo_Erase_Mileage_Provisional_Parameter
            DcmDspRoutineAuthorization: DcmDspRoutineSessionRef=DcmDspSession/Extended, DcmDspRoutineSecurityLevelRef=UnlockedL1, DcmDspRoutineSecurityLevelRef=Unlocked_Level_2
            DcmDspStartRoutineOut
              Out_routineResult (DcmDspStartRoutineOutSignal): DcmDspRoutineSignalLength=8, DcmDspRoutineSignalType=UINT8, DcmDspRoutineSignalPos=0
          RoutineInfo_Turn_Off_HV_Turn_Off_Charging
            DcmDspRoutineAuthorization:
              DcmDspRoutineSessionRef = DcmDspSession/Extended
              DcmDspRoutineSecurityLevelRef = UnlockedL1
              DcmDspRoutineSecurityLevelRef = Unlocked_Level_2
              DcmDspRoutineSecurityLevelRef = Unlocked_Level_4
            DcmDspStartRoutineOut
              Out_routineResult (DcmDspStartRoutineOutSignal): DcmDspRoutineSignalLength=8, DcmDspRoutineSignalType=UINT8, DcmDspRoutineSignalPos=0
            DcmDspRoutineStopOut
              Out_routineResult (DcmDspRoutineStopOutSignal): DcmDspRoutineSignalLength=8, DcmDspRoutineSignalType=UINT8, DcmDspRoutineSignalPos=0
          RoutineInfo_Erase_Memory
            DcmDspRoutineAuthorization: DcmDspRoutineSessionRef=DcmDspSession/Programming, DcmDspRoutineSecurityLevelRef=Unlocked_Level_4
            DcmDspStartRoutineIn
              3 x DcmDspStartRoutineInSignal:
                In_addressAndLengthFormatIdentifier: DcmDspRoutineSignalLength=8, DcmDspRoutineSignalType=UINT8, DcmDspRoutineSignalPos=0
                In_memoryAddress: DcmDspRoutineSignalLength=32, DcmDspRoutineSignalType=UINT32, DcmDspRoutineSignalEndianness=BIG_ENDIAN, DcmDspRoutineSignalPos=8
                In_memorySize: DcmDspRoutineSignalLength=32, DcmDspRoutineSignalType=UINT32, DcmDspRoutineSignalEndianness=BIG_ENDIAN, DcmDspRoutineSignalPos=40
            DcmDspStartRoutineOut
              Out_routineResult (DcmDspStartRoutineOutSignal): DcmDspRoutineSignalLength=8, DcmDspRoutineSignalType=UINT8, DcmDspRoutineSignalPos=0
          RoutineInfo_CheckProgrammingDependencies
            DcmDspRoutineAuthorization: DcmDspRoutineSessionRef=DcmDspSession/Programming, DcmDspRoutineSecurityLevelRef=Unlocked_Level_4
            DcmDspStartRoutineOut
              Out_routineResult (DcmDspStartRoutineOutSignal): DcmDspRoutineSignalLength=8, DcmDspRoutineSignalType=UINT8, DcmDspRoutineSignalPos=0
        DcmDspSecurity
          4 x DcmDspSecurityRow, all with DcmDspSecurityDelayTime=10, DcmDspSecurityDelayTimeOnBoot=0, DcmDspSecurityKeySize=16, DcmDspSecurityNumAttDelay=3, DcmDspSecuritySeedSize=16:
            UnlockedL1: DcmDspSecurityLevel=1
            Unlocked_Level_{2..4}: DcmDspSecurityLevel={2..4}
        DcmDspSession
          4 x DcmDspSessionRow, all with DcmDspSessionP2ServerMax=0.05, DcmDspSessionP2StarServerMax=5:
            Default: DcmDspSessionLevel=1, DcmDspSessionForBoot=DCM_NO_BOOT
            Programming: DcmDspSessionLevel=2
            Extended: DcmDspSessionLevel=3, DcmDspSessionForBoot=DCM_NO_BOOT
            Coding_Session: DcmDspSessionLevel=65
        ComControl (DcmDspComControl)
          DspComContolAllChannel (DcmDspComControlAllChannel)
