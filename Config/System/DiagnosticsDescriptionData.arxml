[part 2 of 2: package /InitialEcuC]
AUTOSAR XML (schema 00048)
package /InitialEcuC  (continued)
  module config Dem: module-description=Dem_Impl
    DemConfigSet
      DTCClass_DTC_0x110012 (DemDTCClass): DemDTCSeverity=DEM_DTC_SEV_NO_SEVERITY, DemUdsDTC=1114130
      DTC_0x110012 (DemEventParameter):
        DemEventKind = DEM_EVENT_KIND_SWC
        DemDTCClassRef = DTCClass_DTC_0x110012
        DemExtendedDataClassRef = ExtendedDataClass_83dcefb7
        DemFreezeFrameClassRef = FreezeFrameClass_5f5b5001
        DemFreezeFrameRecNumClassRef = FreezeFrameRecNumClass_f98c8aa7
        DemEventClass:
          DemAgingAllowed = true
          DemAgingCycleCounterThreshold = 40
          DemEventDestination = DEM_DTC_ORIGIN_PRIMARY_MEMORY
          DemEventPriority = 1
          DemEventSignificance = DEM_EVENT_SIGNIFICANCE_FAULT
          DemEventFailureCycleCounterThreshold = 0
          DemAgingCycleRef = PowerCycle
          DemEnableConditionGroupRef = EnableConditionGroup_bbe52cb7
          DemOperationCycleRef = PowerCycle
          DemDebounceAlgorithmClass
            DemDebounceCounterBased: DemDebounceCounterDecrementStepSize=1, DemDebounceCounterIncrementStepSize=1, DemDebounceCounterJumpDown=false, DemDebounceCounterJumpUp=true
          IndicatorAttribute_WarningIndicator (DemIndicatorAttribute): DemIndicatorFailureCycleSource=DEM_FAILURE_CYCLE_EVENT, DemIndicatorHealingCycleRef=PowerCycle, DemIndicatorRef=WarningIndicator
      DTCClass_DTC_0x110112 (DemDTCClass): DemDTCSeverity=DEM_DTC_SEV_NO_SEVERITY, DemUdsDTC=1114386
      DTC_0x110112 (DemEventParameter):
        DemEventKind = DEM_EVENT_KIND_SWC
        DemDTCClassRef = DTCClass_DTC_0x110112
        DemExtendedDataClassRef = ExtendedDataClass_83dcefb7
        DemFreezeFrameClassRef = FreezeFrameClass_5f5b5001
        DemFreezeFrameRecNumClassRef = FreezeFrameRecNumClass_f98c8aa7
        DemEventClass:
          DemAgingAllowed = true
          DemAgingCycleCounterThreshold = 40
          DemEventDestination = DEM_DTC_ORIGIN_PRIMARY_MEMORY
          DemEventPriority = 1
          DemEventSignificance = DEM_EVENT_SIGNIFICANCE_FAULT
          DemEventFailureCycleCounterThreshold = 0
          DemAgingCycleRef = PowerCycle
          DemEnableConditionGroupRef = EnableConditionGroup_bbe52cb7
          DemOperationCycleRef = PowerCycle
          DemDebounceAlgorithmClass
            DemDebounceCounterBased: DemDebounceCounterDecrementStepSize=1, DemDebounceCounterIncrementStepSize=1, DemDebounceCounterJumpDown=false, DemDebounceCounterJumpUp=true
          IndicatorAttribute_WarningIndicator (DemIndicatorAttribute): DemIndicatorFailureCycleSource=DEM_FAILURE_CYCLE_EVENT, DemIndicatorHealingCycleRef=PowerCycle, DemIndicatorRef=WarningIndicator
      DTCClass_DTC_0x110211 (DemDTCClass): DemDTCSeverity=DEM_DTC_SEV_NO_SEVERITY, DemUdsDTC=1114641
      DTC_0x110211 (DemEventParameter):
        DemEventKind = DEM_EVENT_KIND_SWC
        DemDTCClassRef = DTCClass_DTC_0x110211
        DemExtendedDataClassRef = ExtendedDataClass_83dcefb7
        DemFreezeFrameClassRef = FreezeFrameClass_5f5b5001
        DemFreezeFrameRecNumClassRef = FreezeFrameRecNumClass_f98c8aa7
        DemEventClass:
          DemAgingAllowed = true
          DemAgingCycleCounterThreshold = 40
          DemEventDestination = DEM_DTC_ORIGIN_PRIMARY_MEMORY
          DemEventPriority = 1
          DemEventSignificance = DEM_EVENT_SIGNIFICANCE_FAULT
          DemEventFailureCycleCounterThreshold = 0
          DemAgingCycleRef = PowerCycle
          DemEnableConditionGroupRef = EnableConditionGroup_bbe52cb7
          DemOperationCycleRef = PowerCycle
          DemDebounceAlgorithmClass
            DemDebounceCounterBased: DemDebounceCounterDecrementStepSize=1, DemDebounceCounterIncrementStepSize=1, DemDebounceCounterJumpDown=false, DemDebounceCounterJumpUp=true
          IndicatorAttribute_WarningIndicator (DemIndicatorAttribute): DemIndicatorFailureCycleSource=DEM_FAILURE_CYCLE_EVENT, DemIndicatorHealingCycleRef=PowerCycle, DemIndicatorRef=WarningIndicator
      DTCClass_DTC_0x110311 (DemDTCClass): DemDTCSeverity=DEM_DTC_SEV_NO_SEVERITY, DemUdsDTC=1114897
      DTC_0x110311 (DemEventParameter):
        DemEventKind = DEM_EVENT_KIND_SWC
        DemDTCClassRef = DTCClass_DTC_0x110311
        DemExtendedDataClassRef = ExtendedDataClass_83dcefb7
        DemFreezeFrameClassRef = FreezeFrameClass_5f5b5001
        DemFreezeFrameRecNumClassRef = FreezeFrameRecNumClass_f98c8aa7
        DemEventClass:
          DemAgingAllowed = true
          DemAgingCycleCounterThreshold = 40
          DemEventDestination = DEM_DTC_ORIGIN_PRIMARY_MEMORY
          DemEventPriority = 1
          DemEventSignificance = DEM_EVENT_SIGNIFICANCE_FAULT
          DemEventFailureCycleCounterThreshold = 0
          DemAgingCycleRef = PowerCycle
          DemEnableConditionGroupRef = EnableConditionGroup_bbe52cb7
          DemOperationCycleRef = PowerCycle
          DemDebounceAlgorithmClass
            DemDebounceCounterBased: DemDebounceCounterDecrementStepSize=1, DemDebounceCounterIncrementStepSize=1, DemDebounceCounterJumpDown=false, DemDebounceCounterJumpUp=true
          IndicatorAttribute_WarningIndicator (DemIndicatorAttribute): DemIndicatorFailureCycleSource=DEM_FAILURE_CYCLE_EVENT, DemIndicatorHealingCycleRef=PowerCycle, DemIndicatorRef=WarningIndicator
      DTCClass_DTC_0x111152 (DemDTCClass): DemDTCSeverity=DEM_DTC_SEV_NO_SEVERITY, DemUdsDTC=1118546
      DTC_0x111152 (DemEventParameter):
        DemEventKind = DEM_EVENT_KIND_SWC
        DemDTCClassRef = DTCClass_DTC_0x111152
        DemExtendedDataClassRef = ExtendedDataClass_83dcefb7
        DemFreezeFrameClassRef = FreezeFrameClass_5f5b5001
        DemFreezeFrameRecNumClassRef = FreezeFrameRecNumClass_f98c8aa7
        DemEventClass:
          DemAgingAllowed = true
          DemAgingCycleCounterThreshold = 40
          DemEventDestination = DEM_DTC_ORIGIN_PRIMARY_MEMORY
          DemEventPriority = 1
          DemEventSignificance = DEM_EVENT_SIGNIFICANCE_FAULT
          DemEventFailureCycleCounterThreshold = 0
          DemAgingCycleRef = PowerCycle
          DemEnableConditionGroupRef = EnableConditionGroup_bbe52cb7
          DemOperationCycleRef = PowerCycle
          DemDebounceAlgorithmClass
            DemDebounceCounterBased: DemDebounceCounterDecrementStepSize=1, DemDebounceCounterIncrementStepSize=1, DemDebounceCounterJumpDown=false, DemDebounceCounterJumpUp=true
          IndicatorAttribute_WarningIndicator (DemIndicatorAttribute): DemIndicatorFailureCycleSource=DEM_FAILURE_CYCLE_EVENT, DemIndicatorHealingCycleRef=PowerCycle, DemIndicatorRef=WarningIndicator
      DTCClass_DTC_0x111252 (DemDTCClass): DemDTCSeverity=DEM_DTC_SEV_NO_SEVERITY, DemUdsDTC=1118802
      DTC_0x111252 (DemEventParameter):
        DemEventKind = DEM_EVENT_KIND_SWC
        DemDTCClassRef = DTCClass_DTC_0x111252
        DemExtendedDataClassRef = ExtendedDataClass_83dcefb7
        DemFreezeFrameClassRef = FreezeFrameClass_5f5b5001
        DemFreezeFrameRecNumClassRef = FreezeFrameRecNumClass_f98c8aa7
        DemEventClass:
          DemAgingAllowed = true
          DemAgingCycleCounterThreshold = 40
          DemEventDestination = DEM_DTC_ORIGIN_PRIMARY_MEMORY
          DemEventPriority = 1
          DemEventSignificance = DEM_EVENT_SIGNIFICANCE_FAULT
          DemEventFailureCycleCounterThreshold = 0
          DemAgingCycleRef = PowerCycle
          DemEnableConditionGroupRef = EnableConditionGroup_bbe52cb7
          DemOperationCycleRef = PowerCycle
          DemDebounceAlgorithmClass
            DemDebounceCounterBased: DemDebounceCounterDecrementStepSize=1, DemDebounceCounterIncrementStepSize=1, DemDebounceCounterJumpDown=false, DemDebounceCounterJumpUp=true
          IndicatorAttribute_WarningIndicator (DemIndicatorAttribute): DemIndicatorFailureCycleSource=DEM_FAILURE_CYCLE_EVENT, DemIndicatorHealingCycleRef=PowerCycle, DemIndicatorRef=WarningIndicator
      DTCClass_DTC_0x111352 (DemDTCClass): DemDTCSeverity=DEM_DTC_SEV_NO_SEVERITY, DemUdsDTC=1119058
      DTC_0x111352 (DemEventParameter):
        DemEventKind = DEM_EVENT_KIND_SWC
        DemDTCClassRef = DTCClass_DTC_0x111352
        DemExtendedDataClassRef = ExtendedDataClass_83dcefb7
        DemFreezeFrameClassRef = FreezeFrameClass_5f5b5001
        DemFreezeFrameRecNumClassRef = FreezeFrameRecNumClass_f98c8aa7
        DemEventClass:
          DemAgingAllowed = true
          DemAgingCycleCounterThreshold = 40
          DemEventDestination = DEM_DTC_ORIGIN_PRIMARY_MEMORY
          DemEventPriority = 1
          DemEventSignificance = DEM_EVENT_SIGNIFICANCE_FAULT
          DemEventFailureCycleCounterThreshold = 0
          DemAgingCycleRef = PowerCycle
          DemEnableConditionGroupRef = EnableConditionGroup_bbe52cb7
          DemOperationCycleRef = PowerCycle
          DemDebounceAlgorithmClass
            DemDebounceCounterBased: DemDebounceCounterDecrementStepSize=1, DemDebounceCounterIncrementStepSize=1, DemDebounceCounterJumpDown=false, DemDebounceCounterJumpUp=true
          IndicatorAttribute_WarningIndicator (DemIndicatorAttribute): DemIndicatorFailureCycleSource=DEM_FAILURE_CYCLE_EVENT, DemIndicatorHealingCycleRef=PowerCycle, DemIndicatorRef=WarningIndicator
      DTCClass_DTC_0x111e71 (DemDTCClass): DemDTCSeverity=DEM_DTC_SEV_NO_SEVERITY, DemUdsDTC=1121905
      DTC_0x111e71 (DemEventParameter):
        DemEventKind = DEM_EVENT_KIND_SWC
        DemDTCClassRef = DTCClass_DTC_0x111e71
        DemExtendedDataClassRef = ExtendedDataClass_83dcefb7
        DemFreezeFrameClassRef = FreezeFrameClass_376d31f7
        DemFreezeFrameRecNumClassRef = FreezeFrameRecNumClass_f98c8aa7
        DemEventClass:
          DemAgingAllowed = true
          DemAgingCycleCounterThreshold = 40
          DemEventDestination = DEM_DTC_ORIGIN_PRIMARY_MEMORY
          DemEventPriority = 2
          DemEventSignificance = DEM_EVENT_SIGNIFICANCE_FAULT
          DemEventFailureCycleCounterThreshold = 0
          DemAgingCycleRef = PowerCycle
          DemEnableConditionGroupRef = EnableConditionGroup_fdfec498
          DemOperationCycleRef = PowerCycle
          DemDebounceAlgorithmClass
            DemDebounceCounterBased: DemDebounceCounterDecrementStepSize=1, DemDebounceCounterIncrementStepSize=1, DemDebounceCounterJumpDown=false, DemDebounceCounterJumpUp=true
          IndicatorAttribute_WarningIndicator (DemIndicatorAttribute): DemIndicatorFailureCycleSource=DEM_FAILURE_CYCLE_EVENT, DemIndicatorHealingCycleRef=PowerCycle, DemIndicatorRef=WarningIndicator
      DTCClass_DTC_0x111f16 (DemDTCClass): DemDTCSeverity=DEM_DTC_SEV_NO_SEVERITY, DemUdsDTC=1122070
      DTC_0x111f16 (DemEventParameter):
        DemEventKind = DEM_EVENT_KIND_SWC
        DemDTCClassRef = DTCClass_DTC_0x111f16
        DemExtendedDataClassRef = ExtendedDataClass_83dcefb7
        DemFreezeFrameClassRef = FreezeFrameClass_d96350db
        DemFreezeFrameRecNumClassRef = FreezeFrameRecNumClass_f98c8aa7
        DemEventClass:
          DemAgingAllowed = true
          DemAgingCycleCounterThreshold = 40
          DemEventDestination = DEM_DTC_ORIGIN_PRIMARY_MEMORY
          DemEventPriority = 1
          DemEventSignificance = DEM_EVENT_SIGNIFICANCE_FAULT
          DemEventFailureCycleCounterThreshold = 0
          DemAgingCycleRef = PowerCycle
          DemEnableConditionGroupRef = EnableConditionGroup_fdfec498
          DemOperationCycleRef = PowerCycle
          DemDebounceAlgorithmClass
            DemDebounceCounterBased: DemDebounceCounterDecrementStepSize=1, DemDebounceCounterIncrementStepSize=1, DemDebounceCounterJumpDown=false, DemDebounceCounterJumpUp=true
          IndicatorAttribute_WarningIndicator (DemIndicatorAttribute): DemIndicatorFailureCycleSource=DEM_FAILURE_CYCLE_EVENT, DemIndicatorHealingCycleRef=PowerCycle, DemIndicatorRef=WarningIndicator
      DTCClass_DTC_0x11281e (DemDTCClass): DemDTCSeverity=DEM_DTC_SEV_NO_SEVERITY, DemUdsDTC=1124382
      DTC_0x11281e (DemEventParameter):
        DemEventKind = DEM_EVENT_KIND_SWC
        DemDTCClassRef = DTCClass_DTC_0x11281e
        DemExtendedDataClassRef = ExtendedDataClass_83dcefb7
        DemFreezeFrameClassRef = FreezeFrameClass_5f5b5001
        DemFreezeFrameRecNumClassRef = FreezeFrameRecNumClass_f98c8aa7
        DemEventClass:
          DemAgingAllowed = true
          DemAgingCycleCounterThreshold = 40
          DemEventDestination = DEM_DTC_ORIGIN_PRIMARY_MEMORY
          DemEventPriority = 1
          DemEventSignificance = DEM_EVENT_SIGNIFICANCE_FAULT
          DemEventFailureCycleCounterThreshold = 0
          DemAgingCycleRef = PowerCycle
          DemEnableConditionGroupRef = EnableConditionGroup_bbe52cb7
          DemOperationCycleRef = PowerCycle
          DemDebounceAlgorithmClass
            DemDebounceCounterBased: DemDebounceCounterDecrementStepSize=1, DemDebounceCounterIncrementStepSize=1, DemDebounceCounterJumpDown=false, DemDebounceCounterJumpUp=true
          IndicatorAttribute_WarningIndicator (DemIndicatorAttribute): DemIndicatorFailureCycleSource=DEM_FAILURE_CYCLE_EVENT, DemIndicatorHealingCycleRef=PowerCycle, DemIndicatorRef=WarningIndicator
      DTCClass_DTC_0x11291c (DemDTCClass): DemDTCSeverity=DEM_DTC_SEV_NO_SEVERITY, DemUdsDTC=1124636
      DTC_0x11291c (DemEventParameter):
        DemEventKind = DEM_EVENT_KIND_SWC
        DemDTCClassRef = DTCClass_DTC_0x11291c
        DemExtendedDataClassRef = ExtendedDataClass_83dcefb7
        DemFreezeFrameClassRef = FreezeFrameClass_a7d22c66
        DemFreezeFrameRecNumClassRef = FreezeFrameRecNumClass_f98c8aa7
        DemEventClass:
          DemAgingAllowed = true
          DemAgingCycleCounterThreshold = 40
          DemEventDestination = DEM_DTC_ORIGIN_PRIMARY_MEMORY
          DemEventPriority = 1
          DemEventSignificance = DEM_EVENT_SIGNIFICANCE_FAULT
          DemEventFailureCycleCounterThreshold = 0
          DemAgingCycleRef = PowerCycle
          DemEnableConditionGroupRef = EnableConditionGroup_bbe52cb7
          DemOperationCycleRef = PowerCycle
          DemDebounceAlgorithmClass
            DemDebounceCounterBased: DemDebounceCounterDecrementStepSize=1, DemDebounceCounterIncrementStepSize=1, DemDebounceCounterJumpDown=false, DemDebounceCounterJumpUp=true
          IndicatorAttribute_WarningIndicator (DemIndicatorAttribute): DemIndicatorFailureCycleSource=DEM_FAILURE_CYCLE_EVENT, DemIndicatorHealingCycleRef=PowerCycle, DemIndicatorRef=WarningIndicator
      DTCClass_DTC_0x113197 (DemDTCClass): DemDTCSeverity=DEM_DTC_SEV_NO_SEVERITY, DemUdsDTC=1126807
      DTC_0x113197 (DemEventParameter):
        DemEventKind = DEM_EVENT_KIND_SWC
        DemDTCClassRef = DTCClass_DTC_0x113197
        DemExtendedDataClassRef = ExtendedDataClass_83dcefb7
        DemFreezeFrameClassRef = FreezeFrameClass_d0d51cf0
        DemFreezeFrameRecNumClassRef = FreezeFrameRecNumClass_f98c8aa7
        DemEventClass:
          DemAgingAllowed = true
          DemAgingCycleCounterThreshold = 40
          DemEventDestination = DEM_DTC_ORIGIN_PRIMARY_MEMORY
          DemEventPriority = 1
          DemEventSignificance = DEM_EVENT_SIGNIFICANCE_FAULT
          DemEventFailureCycleCounterThreshold = 0
          DemAgingCycleRef = PowerCycle
          DemEnableConditionGroupRef = EnableConditionGroup_fdfec498
          DemOperationCycleRef = PowerCycle
          DemDebounceAlgorithmClass
            DemDebounceCounterBased: DemDebounceCounterDecrementStepSize=1, DemDebounceCounterIncrementStepSize=1, DemDebounceCounterJumpDown=false, DemDebounceCounterJumpUp=true
          IndicatorAttribute_WarningIndicator (DemIndicatorAttribute): DemIndicatorFailureCycleSource=DEM_FAILURE_CYCLE_EVENT, DemIndicatorHealingCycleRef=PowerCycle, DemIndicatorRef=WarningIndicator
      DTCClass_DTC_0x113297 (DemDTCClass): DemDTCSeverity=DEM_DTC_SEV_NO_SEVERITY, DemUdsDTC=1127063
      DTC_0x113297 (DemEventParameter):
        DemEventKind = DEM_EVENT_KIND_SWC
        DemDTCClassRef = DTCClass_DTC_0x113297
        DemExtendedDataClassRef = ExtendedDataClass_83dcefb7
        DemFreezeFrameClassRef = FreezeFrameClass_5f5b5001
        DemFreezeFrameRecNumClassRef = FreezeFrameRecNumClass_f98c8aa7
        DemEventClass:
          DemAgingAllowed = true
          DemAgingCycleCounterThreshold = 40
          DemEventDestination = DEM_DTC_ORIGIN_PRIMARY_MEMORY
          DemEventPriority = 1
          DemEventSignificance = DEM_EVENT_SIGNIFICANCE_FAULT
          DemEventFailureCycleCounterThreshold = 0
          DemAgingCycleRef = PowerCycle
          DemEnableConditionGroupRef = EnableConditionGroup_58c4940f
          DemOperationCycleRef = PowerCycle
          DemDebounceAlgorithmClass
            DemDebounceCounterBased: DemDebounceCounterDecrementStepSize=1, DemDebounceCounterIncrementStepSize=1, DemDebounceCounterJumpDown=false, DemDebounceCounterJumpUp=true
          IndicatorAttribute_WarningIndicator (DemIndicatorAttribute): DemIndicatorFailureCycleSource=DEM_FAILURE_CYCLE_EVENT, DemIndicatorHealingCycleRef=PowerCycle, DemIndicatorRef=WarningIndicator
      DTCClass_DTC_0x113397 (DemDTCClass): DemDTCSeverity=DEM_DTC_SEV_NO_SEVERITY, DemUdsDTC=1127319
      DTC_0x113397 (DemEventParameter):
        DemEventKind = DEM_EVENT_KIND_SWC
        DemDTCClassRef = DTCClass_DTC_0x113397
        DemExtendedDataClassRef = ExtendedDataClass_83dcefb7
        DemFreezeFrameClassRef = FreezeFrameClass_d96350db
        DemFreezeFrameRecNumClassRef = FreezeFrameRecNumClass_f98c8aa7
        DemEventClass:
          DemAgingAllowed = true
          DemAgingCycleCounterThreshold = 40
          DemEventDestination = DEM_DTC_ORIGIN_PRIMARY_MEMORY
          DemEventPriority = 1
          DemEventSignificance = DEM_EVENT_SIGNIFICANCE_FAULT
          DemEventFailureCycleCounterThreshold = 0
          DemAgingCycleRef = PowerCycle
          DemEnableConditionGroupRef = EnableConditionGroup_fdfec498
          DemOperationCycleRef = PowerCycle
          DemDebounceAlgorithmClass
            DemDebounceCounterBased: DemDebounceCounterDecrementStepSize=1, DemDebounceCounterIncrementStepSize=1, DemDebounceCounterJumpDown=false, DemDebounceCounterJumpUp=true
          IndicatorAttribute_WarningIndicator (DemIndicatorAttribute): DemIndicatorFailureCycleSource=DEM_FAILURE_CYCLE_EVENT, DemIndicatorHealingCycleRef=PowerCycle, DemIndicatorRef=WarningIndicator
      DTCClass_DTC_0x113497 (DemDTCClass): DemDTCSeverity=DEM_DTC_SEV_NO_SEVERITY, DemUdsDTC=1127575
      DTC_0x113497 (DemEventParameter):
        DemEventKind = DEM_EVENT_KIND_SWC
        DemDTCClassRef = DTCClass_DTC_0x113497
        DemExtendedDataClassRef = ExtendedDataClass_83dcefb7
        DemFreezeFrameClassRef = FreezeFrameClass_5f5b5001
        DemFreezeFrameRecNumClassRef = FreezeFrameRecNumClass_f98c8aa7
        DemEventClass:
          DemAgingAllowed = true
          DemAgingCycleCounterThreshold = 40
          DemEventDestination = DEM_DTC_ORIGIN_PRIMARY_MEMORY
          DemEventPriority = 1
          DemEventSignificance = DEM_EVENT_SIGNIFICANCE_FAULT
          DemEventFailureCycleCounterThreshold = 0
          DemAgingCycleRef = PowerCycle
          DemEnableConditionGroupRef = EnableConditionGroup_fdfec498
          DemOperationCycleRef = PowerCycle
          DemDebounceAlgorithmClass
            DemDebounceCounterBased: DemDebounceCounterDecrementStepSize=1, DemDebounceCounterIncrementStepSize=1, DemDebounceCounterJumpDown=false, DemDebounceCounterJumpUp=true
          IndicatorAttribute_WarningIndicator (DemIndicatorAttribute): DemIndicatorFailureCycleSource=DEM_FAILURE_CYCLE_EVENT, DemIndicatorHealingCycleRef=PowerCycle, DemIndicatorRef=WarningIndicator
      DTCClass_DTC_0x113597 (DemDTCClass): DemDTCSeverity=DEM_DTC_SEV_NO_SEVERITY, DemUdsDTC=1127831
      DTC_0x113597 (DemEventParameter):
        DemEventKind = DEM_EVENT_KIND_SWC
        DemDTCClassRef = DTCClass_DTC_0x113597
        DemExtendedDataClassRef = ExtendedDataClass_83dcefb7
        DemFreezeFrameClassRef = FreezeFrameClass_c715a583
        DemFreezeFrameRecNumClassRef = FreezeFrameRecNumClass_f98c8aa7
        DemEventClass:
          DemAgingAllowed = true
          DemAgingCycleCounterThreshold = 40
          DemEventDestination = DEM_DTC_ORIGIN_PRIMARY_MEMORY
          DemEventPriority = 1
          DemEventSignificance = DEM_EVENT_SIGNIFICANCE_FAULT
          DemEventFailureCycleCounterThreshold = 0
          DemAgingCycleRef = PowerCycle
          DemEnableConditionGroupRef = EnableConditionGroup_fdfec498
          DemOperationCycleRef = PowerCycle
          DemDebounceAlgorithmClass
            DemDebounceCounterBased: DemDebounceCounterDecrementStepSize=1, DemDebounceCounterIncrementStepSize=1, DemDebounceCounterJumpDown=false, DemDebounceCounterJumpUp=true
          IndicatorAttribute_WarningIndicator (DemIndicatorAttribute): DemIndicatorFailureCycleSource=DEM_FAILURE_CYCLE_EVENT, DemIndicatorHealingCycleRef=PowerCycle, DemIndicatorRef=WarningIndicator
      DTCClass_DTC_0x113697 (DemDTCClass): DemDTCSeverity=DEM_DTC_SEV_NO_SEVERITY, DemUdsDTC=1128087
      DTC_0x113697 (DemEventParameter):
        DemEventKind = DEM_EVENT_KIND_SWC
        DemDTCClassRef = DTCClass_DTC_0x113697
        DemExtendedDataClassRef = ExtendedDataClass_83dcefb7
        DemFreezeFrameClassRef = FreezeFrameClass_c715a583
        DemFreezeFrameRecNumClassRef = FreezeFrameRecNumClass_f98c8aa7
        DemEventClass:
          DemAgingAllowed = true
          DemAgingCycleCounterThreshold = 40
          DemEventDestination = DEM_DTC_ORIGIN_PRIMARY_MEMORY
          DemEventPriority = 1
          DemEventSignificance = DEM_EVENT_SIGNIFICANCE_FAULT
          DemEventFailureCycleCounterThreshold = 0
          DemAgingCycleRef = PowerCycle
          DemEnableConditionGroupRef = EnableConditionGroup_fdfec498
          DemOperationCycleRef = PowerCycle
          DemDebounceAlgorithmClass
            DemDebounceCounterBased: DemDebounceCounterDecrementStepSize=1, DemDebounceCounterIncrementStepSize=1, DemDebounceCounterJumpDown=false, DemDebounceCounterJumpUp=true
          IndicatorAttribute_WarningIndicator (DemIndicatorAttribute): DemIndicatorFailureCycleSource=DEM_FAILURE_CYCLE_EVENT, DemIndicatorHealingCycleRef=PowerCycle, DemIndicatorRef=WarningIndicator
      DTCClass_DTC_0x113797 (DemDTCClass): DemDTCSeverity=DEM_DTC_SEV_NO_SEVERITY, DemUdsDTC=1128343
      DTC_0x113797 (DemEventParameter):
        DemEventKind = DEM_EVENT_KIND_SWC
        DemDTCClassRef = DTCClass_DTC_0x113797
        DemExtendedDataClassRef = ExtendedDataClass_83dcefb7
        DemFreezeFrameClassRef = FreezeFrameClass_5f5b5001
        DemFreezeFrameRecNumClassRef = FreezeFrameRecNumClass_f98c8aa7
        DemEventClass:
          DemAgingAllowed = true
          DemAgingCycleCounterThreshold = 40
          DemEventDestination = DEM_DTC_ORIGIN_PRIMARY_MEMORY
          DemEventPriority = 1
          DemEventSignificance = DEM_EVENT_SIGNIFICANCE_FAULT
          DemEventFailureCycleCounterThreshold = 0
          DemAgingCycleRef = PowerCycle
          DemEnableConditionGroupRef = EnableConditionGroup_fdfec498
          DemOperationCycleRef = PowerCycle
          DemDebounceAlgorithmClass
            DemDebounceCounterBased: DemDebounceCounterDecrementStepSize=1, DemDebounceCounterIncrementStepSize=1, DemDebounceCounterJumpDown=false, DemDebounceCounterJumpUp=true
          IndicatorAttribute_WarningIndicator (DemIndicatorAttribute): DemIndicatorFailureCycleSource=DEM_FAILURE_CYCLE_EVENT, DemIndicatorHealingCycleRef=PowerCycle, DemIndicatorRef=WarningIndicator
      DTCClass_DTC_0x113897 (DemDTCClass): DemDTCSeverity=DEM_DTC_SEV_NO_SEVERITY, DemUdsDTC=1128599
      DTC_0x113897 (DemEventParameter):
        DemEventKind = DEM_EVENT_KIND_SWC
        DemDTCClassRef = DTCClass_DTC_0x113897
        DemExtendedDataClassRef = ExtendedDataClass_83dcefb7
        DemFreezeFrameClassRef = FreezeFrameClass_5f5b5001
        DemFreezeFrameRecNumClassRef = FreezeFrameRecNumClass_f98c8aa7
        DemEventClass:
          DemAgingAllowed = true
          DemAgingCycleCounterThreshold = 40
          DemEventDestination = DEM_DTC_ORIGIN_PRIMARY_MEMORY
          DemEventPriority = 1
          DemEventSignificance = DEM_EVENT_SIGNIFICANCE_FAULT
          DemEventFailureCycleCounterThreshold = 0
          DemAgingCycleRef = PowerCycle
          DemEnableConditionGroupRef = EnableConditionGroup_983000c1
          DemOperationCycleRef = PowerCycle
          DemDebounceAlgorithmClass
            DemDebounceCounterBased: DemDebounceCounterDecrementStepSize=1, DemDebounceCounterIncrementStepSize=1, DemDebounceCounterJumpDown=false, DemDebounceCounterJumpUp=true
          IndicatorAttribute_WarningIndicator (DemIndicatorAttribute): DemIndicatorFailureCycleSource=DEM_FAILURE_CYCLE_EVENT, DemIndicatorHealingCycleRef=PowerCycle, DemIndicatorRef=WarningIndicator
      DTCClass_DTC_0x113997 (DemDTCClass): DemDTCSeverity=DEM_DTC_SEV_NO_SEVERITY, DemUdsDTC=1128855
      DTC_0x113997 (DemEventParameter):
        DemEventKind = DEM_EVENT_KIND_SWC
        DemDTCClassRef = DTCClass_DTC_0x113997
        DemExtendedDataClassRef = ExtendedDataClass_83dcefb7
        DemFreezeFrameClassRef = FreezeFrameClass_5f5b5001
        DemFreezeFrameRecNumClassRef = FreezeFrameRecNumClass_f98c8aa7
        DemEventClass:
          DemAgingAllowed = true
          DemAgingCycleCounterThreshold = 40
          DemEventDestination = DEM_DTC_ORIGIN_PRIMARY_MEMORY
          DemEventPriority = 1
          DemEventSignificance = DEM_EVENT_SIGNIFICANCE_FAULT
          DemEventFailureCycleCounterThreshold = 0
          DemAgingCycleRef = PowerCycle
          DemEnableConditionGroupRef = EnableConditionGroup_983000c1
          DemOperationCycleRef = PowerCycle
          DemDebounceAlgorithmClass
            DemDebounceCounterBased: DemDebounceCounterDecrementStepSize=1, DemDebounceCounterIncrementStepSize=1, DemDebounceCounterJumpDown=false, DemDebounceCounterJumpUp=true
          IndicatorAttribute_WarningIndicator (DemIndicatorAttribute): DemIndicatorFailureCycleSource=DEM_FAILURE_CYCLE_EVENT, DemIndicatorHealingCycleRef=PowerCycle, DemIndicatorRef=WarningIndicator
      DTCClass_DTC_0x114097 (DemDTCClass): DemDTCSeverity=DEM_DTC_SEV_NO_SEVERITY, DemUdsDTC=1130647
      DTC_0x114097 (DemEventParameter):
        DemEventKind = DEM_EVENT_KIND_SWC
        DemDTCClassRef = DTCClass_DTC_0x114097
        DemExtendedDataClassRef = ExtendedDataClass_83dcefb7
        DemFreezeFrameClassRef = FreezeFrameClass_5f5b5001
        DemFreezeFrameRecNumClassRef = FreezeFrameRecNumClass_f98c8aa7
        DemEventClass:
          DemAgingAllowed = true
          DemAgingCycleCounterThreshold = 40
          DemEventDestination = DEM_DTC_ORIGIN_PRIMARY_MEMORY
          DemEventPriority = 1
          DemEventSignificance = DEM_EVENT_SIGNIFICANCE_FAULT
          DemEventFailureCycleCounterThreshold = 0
          DemAgingCycleRef = PowerCycle
          DemEnableConditionGroupRef = EnableConditionGroup_983000c1
          DemOperationCycleRef = PowerCycle
          DemDebounceAlgorithmClass
            DemDebounceCounterBased: DemDebounceCounterDecrementStepSize=1, DemDebounceCounterIncrementStepSize=1, DemDebounceCounterJumpDown=false, DemDebounceCounterJumpUp=true
          IndicatorAttribute_WarningIndicator (DemIndicatorAttribute): DemIndicatorFailureCycleSource=DEM_FAILURE_CYCLE_EVENT, DemIndicatorHealingCycleRef=PowerCycle, DemIndicatorRef=WarningIndicator
      DTCClass_DTC_0x114197 (DemDTCClass): DemDTCSeverity=DEM_DTC_SEV_NO_SEVERITY, DemUdsDTC=1130903
      DTC_0x114197 (DemEventParameter):
        DemEventKind = DEM_EVENT_KIND_SWC
        DemDTCClassRef = DTCClass_DTC_0x114197
        DemExtendedDataClassRef = ExtendedDataClass_83dcefb7
        DemFreezeFrameClassRef = FreezeFrameClass_5f5b5001
        DemFreezeFrameRecNumClassRef = FreezeFrameRecNumClass_f98c8aa7
        DemEventClass:
          DemAgingAllowed = true
          DemAgingCycleCounterThreshold = 40
          DemEventDestination = DEM_DTC_ORIGIN_PRIMARY_MEMORY
          DemEventPriority = 1
          DemEventSignificance = DEM_EVENT_SIGNIFICANCE_FAULT
          DemEventFailureCycleCounterThreshold = 0
          DemAgingCycleRef = PowerCycle
          DemEnableConditionGroupRef = EnableConditionGroup_983000c1
          DemOperationCycleRef = PowerCycle
          DemDebounceAlgorithmClass
            DemDebounceCounterBased: DemDebounceCounterDecrementStepSize=1, DemDebounceCounterIncrementStepSize=1, DemDebounceCounterJumpDown=false, DemDebounceCounterJumpUp=true
          IndicatorAttribute_WarningIndicator (DemIndicatorAttribute): DemIndicatorFailureCycleSource=DEM_FAILURE_CYCLE_EVENT, DemIndicatorHealingCycleRef=PowerCycle, DemIndicatorRef=WarningIndicator
      DTCClass_DTC_0x114297 (DemDTCClass): DemDTCSeverity=DEM_DTC_SEV_NO_SEVERITY, DemUdsDTC=1131159
      DTC_0x114297 (DemEventParameter):
        DemEventKind = DEM_EVENT_KIND_SWC
        DemDTCClassRef = DTCClass_DTC_0x114297
        DemExtendedDataClassRef = ExtendedDataClass_83dcefb7
        DemFreezeFrameClassRef = FreezeFrameClass_5f5b5001
        DemFreezeFrameRecNumClassRef = FreezeFrameRecNumClass_f98c8aa7
        DemEventClass:
          DemAgingAllowed = true
          DemAgingCycleCounterThreshold = 40
          DemEventDestination = DEM_DTC_ORIGIN_PRIMARY_MEMORY
          DemEventPriority = 1
          DemEventSignificance = DEM_EVENT_SIGNIFICANCE_FAULT
          DemEventFailureCycleCounterThreshold = 0
          DemAgingCycleRef = PowerCycle
          DemEnableConditionGroupRef = EnableConditionGroup_983000c1
          DemOperationCycleRef = PowerCycle
          DemDebounceAlgorithmClass
            DemDebounceCounterBased: DemDebounceCounterDecrementStepSize=1, DemDebounceCounterIncrementStepSize=1, DemDebounceCounterJumpDown=false, DemDebounceCounterJumpUp=true
          IndicatorAttribute_WarningIndicator (DemIndicatorAttribute): DemIndicatorFailureCycleSource=DEM_FAILURE_CYCLE_EVENT, DemIndicatorHealingCycleRef=PowerCycle, DemIndicatorRef=WarningIndicator
      DTCClass_DTC_0x114397 (DemDTCClass): DemDTCSeverity=DEM_DTC_SEV_NO_SEVERITY, DemUdsDTC=1131415
      DTC_0x114397 (DemEventParameter):
        DemEventKind = DEM_EVENT_KIND_SWC
        DemDTCClassRef = DTCClass_DTC_0x114397
        DemExtendedDataClassRef = ExtendedDataClass_83dcefb7
        DemFreezeFrameClassRef = FreezeFrameClass_5f5b5001
        DemFreezeFrameRecNumClassRef = FreezeFrameRecNumClass_f98c8aa7
        DemEventClass:
          DemAgingAllowed = true
          DemAgingCycleCounterThreshold = 40
          DemEventDestination = DEM_DTC_ORIGIN_PRIMARY_MEMORY
          DemEventPriority = 1
          DemEventSignificance = DEM_EVENT_SIGNIFICANCE_FAULT
          DemEventFailureCycleCounterThreshold = 0
          DemAgingCycleRef = PowerCycle
          DemEnableConditionGroupRef = EnableConditionGroup_983000c1
          DemOperationCycleRef = PowerCycle
          DemDebounceAlgorithmClass
            DemDebounceCounterBased: DemDebounceCounterDecrementStepSize=1, DemDebounceCounterIncrementStepSize=1, DemDebounceCounterJumpDown=false, DemDebounceCounterJumpUp=true
          IndicatorAttribute_WarningIndicator (DemIndicatorAttribute): DemIndicatorFailureCycleSource=DEM_FAILURE_CYCLE_EVENT, DemIndicatorHealingCycleRef=PowerCycle, DemIndicatorRef=WarningIndicator
      DTCClass_DTC_0x114497 (DemDTCClass): DemDTCSeverity=DEM_DTC_SEV_NO_SEVERITY, DemUdsDTC=1131671
      DTC_0x114497 (DemEventParameter):
        DemEventKind = DEM_EVENT_KIND_SWC
        DemDTCClassRef = DTCClass_DTC_0x114497
        DemExtendedDataClassRef = ExtendedDataClass_83dcefb7
        DemFreezeFrameClassRef = FreezeFrameClass_5f5b5001
        DemFreezeFrameRecNumClassRef = FreezeFrameRecNumClass_f98c8aa7
        DemEventClass:
          DemAgingAllowed = true
          DemAgingCycleCounterThreshold = 40
          DemEventDestination = DEM_DTC_ORIGIN_PRIMARY_MEMORY
          DemEventPriority = 1
          DemEventSignificance = DEM_EVENT_SIGNIFICANCE_FAULT
          DemEventFailureCycleCounterThreshold = 0
          DemAgingCycleRef = PowerCycle
          DemEnableConditionGroupRef = EnableConditionGroup_983000c1
          DemOperationCycleRef = PowerCycle
          DemDebounceAlgorithmClass
            DemDebounceCounterBased: DemDebounceCounterDecrementStepSize=1, DemDebounceCounterIncrementStepSize=1, DemDebounceCounterJumpDown=false, DemDebounceCounterJumpUp=true
          IndicatorAttribute_WarningIndicator (DemIndicatorAttribute): DemIndicatorFailureCycleSource=DEM_FAILURE_CYCLE_EVENT, DemIndicatorHealingCycleRef=PowerCycle, DemIndicatorRef=WarningIndicator
      DTCClass_DTC_0x114571 (DemDTCClass): DemDTCSeverity=DEM_DTC_SEV_NO_SEVERITY, DemUdsDTC=1131889
      DTC_0x114571 (DemEventParameter):
        DemEventKind = DEM_EVENT_KIND_SWC
        DemDTCClassRef = DTCClass_DTC_0x114571
        DemExtendedDataClassRef = ExtendedDataClass_83dcefb7
        DemFreezeFrameClassRef = FreezeFrameClass_376d31f7
        DemFreezeFrameRecNumClassRef = FreezeFrameRecNumClass_f98c8aa7
        DemEventClass:
          DemAgingAllowed = true
          DemAgingCycleCounterThreshold = 40
          DemEventDestination = DEM_DTC_ORIGIN_PRIMARY_MEMORY
          DemEventPriority = 2
          DemEventSignificance = DEM_EVENT_SIGNIFICANCE_FAULT
          DemEventFailureCycleCounterThreshold = 0
          DemAgingCycleRef = PowerCycle
          DemEnableConditionGroupRef = EnableConditionGroup_fdfec498
          DemOperationCycleRef = PowerCycle
          DemDebounceAlgorithmClass
            DemDebounceCounterBased: DemDebounceCounterDecrementStepSize=1, DemDebounceCounterIncrementStepSize=1, DemDebounceCounterJumpDown=false, DemDebounceCounterJumpUp=true
          IndicatorAttribute_WarningIndicator (DemIndicatorAttribute): DemIndicatorFailureCycleSource=DEM_FAILURE_CYCLE_EVENT, DemIndicatorHealingCycleRef=PowerCycle, DemIndicatorRef=WarningIndicator
      DTCClass_DTC_0x114697 (DemDTCClass): DemDTCSeverity=DEM_DTC_SEV_NO_SEVERITY, DemUdsDTC=1132183
      DTC_0x114697 (DemEventParameter):
        DemEventKind = DEM_EVENT_KIND_SWC
        DemDTCClassRef = DTCClass_DTC_0x114697
        DemExtendedDataClassRef = ExtendedDataClass_83dcefb7
        DemFreezeFrameClassRef = FreezeFrameClass_5f5b5001
        DemFreezeFrameRecNumClassRef = FreezeFrameRecNumClass_f98c8aa7
        DemEventClass:
          DemAgingAllowed = true
          DemAgingCycleCounterThreshold = 40
          DemEventDestination = DEM_DTC_ORIGIN_PRIMARY_MEMORY
          DemEventPriority = 1
          DemEventSignificance = DEM_EVENT_SIGNIFICANCE_FAULT
          DemEventFailureCycleCounterThreshold = 0
          DemAgingCycleRef = PowerCycle
          DemEnableConditionGroupRef = EnableConditionGroup_bbe52cb7
          DemOperationCycleRef = PowerCycle
          DemDebounceAlgorithmClass
            DemDebounceCounterBased: DemDebounceCounterDecrementStepSize=1, DemDebounceCounterIncrementStepSize=1, DemDebounceCounterJumpDown=false, DemDebounceCounterJumpUp=true
          IndicatorAttribute_WarningIndicator (DemIndicatorAttribute): DemIndicatorFailureCycleSource=DEM_FAILURE_CYCLE_EVENT, DemIndicatorHealingCycleRef=PowerCycle, DemIndicatorRef=WarningIndicator
      DTCClass_DTC_0x114792 (DemDTCClass): DemDTCSeverity=DEM_DTC_SEV_NO_SEVERITY, DemUdsDTC=1132434
      DTC_0x114792 (DemEventParameter):
        DemEventKind = DEM_EVENT_KIND_SWC
        DemDTCClassRef = DTCClass_DTC_0x114792
        DemExtendedDataClassRef = ExtendedDataClass_83dcefb7
        DemFreezeFrameClassRef = FreezeFrameClass_5f5b5001
        DemFreezeFrameRecNumClassRef = FreezeFrameRecNumClass_f98c8aa7
        DemEventClass:
          DemAgingAllowed = true
          DemAgingCycleCounterThreshold = 40
          DemEventDestination = DEM_DTC_ORIGIN_PRIMARY_MEMORY
          DemEventPriority = 1
          DemEventSignificance = DEM_EVENT_SIGNIFICANCE_FAULT
          DemEventFailureCycleCounterThreshold = 0
          DemAgingCycleRef = PowerCycle
          DemEnableConditionGroupRef = EnableConditionGroup_fdfec498
          DemOperationCycleRef = PowerCycle
          DemDebounceAlgorithmClass
            DemDebounceCounterBased: DemDebounceCounterDecrementStepSize=1, DemDebounceCounterIncrementStepSize=1, DemDebounceCounterJumpDown=false, DemDebounceCounterJumpUp=true
          IndicatorAttribute_WarningIndicator (DemIndicatorAttribute): DemIndicatorFailureCycleSource=DEM_FAILURE_CYCLE_EVENT, DemIndicatorHealingCycleRef=PowerCycle, DemIndicatorRef=WarningIndicator
      DTCClass_DTC_0x114892 (DemDTCClass): DemDTCSeverity=DEM_DTC_SEV_NO_SEVERITY, DemUdsDTC=1132690
      DTC_0x114892 (DemEventParameter):
        DemEventKind = DEM_EVENT_KIND_SWC
        DemDTCClassRef = DTCClass_DTC_0x114892
        DemExtendedDataClassRef = ExtendedDataClass_83dcefb7
        DemFreezeFrameClassRef = FreezeFrameClass_c715a583
        DemFreezeFrameRecNumClassRef = FreezeFrameRecNumClass_f98c8aa7
        DemEventClass:
          DemAgingAllowed = true
          DemAgingCycleCounterThreshold = 40
          DemEventDestination = DEM_DTC_ORIGIN_PRIMARY_MEMORY
          DemEventPriority = 1
          DemEventSignificance = DEM_EVENT_SIGNIFICANCE_FAULT
          DemEventFailureCycleCounterThreshold = 0
          DemAgingCycleRef = PowerCycle
          DemEnableConditionGroupRef = EnableConditionGroup_fdfec498
          DemOperationCycleRef = PowerCycle
          DemDebounceAlgorithmClass
            DemDebounceCounterBased: DemDebounceCounterDecrementStepSize=1, DemDebounceCounterIncrementStepSize=1, DemDebounceCounterJumpDown=false, DemDebounceCounterJumpUp=true
          IndicatorAttribute_WarningIndicator (DemIndicatorAttribute): DemIndicatorFailureCycleSource=DEM_FAILURE_CYCLE_EVENT, DemIndicatorHealingCycleRef=PowerCycle, DemIndicatorRef=WarningIndicator
      DTCClass_DTC_0x114992 (DemDTCClass): DemDTCSeverity=DEM_DTC_SEV_NO_SEVERITY, DemUdsDTC=1132946
      DTC_0x114992 (DemEventParameter):
        DemEventKind = DEM_EVENT_KIND_SWC
        DemDTCClassRef = DTCClass_DTC_0x114992
        DemExtendedDataClassRef = ExtendedDataClass_83dcefb7
        DemFreezeFrameClassRef = FreezeFrameClass_5f5b5001
        DemFreezeFrameRecNumClassRef = FreezeFrameRecNumClass_f98c8aa7
        DemEventClass:
          DemAgingAllowed = true
          DemAgingCycleCounterThreshold = 40
          DemEventDestination = DEM_DTC_ORIGIN_PRIMARY_MEMORY
          DemEventPriority = 1
          DemEventSignificance = DEM_EVENT_SIGNIFICANCE_FAULT
          DemEventFailureCycleCounterThreshold = 0
          DemAgingCycleRef = PowerCycle
          DemEnableConditionGroupRef = EnableConditionGroup_fdfec498
          DemOperationCycleRef = PowerCycle
          DemDebounceAlgorithmClass
            DemDebounceCounterBased: DemDebounceCounterDecrementStepSize=1, DemDebounceCounterIncrementStepSize=1, DemDebounceCounterJumpDown=false, DemDebounceCounterJumpUp=true
          IndicatorAttribute_WarningIndicator (DemIndicatorAttribute): DemIndicatorFailureCycleSource=DEM_FAILURE_CYCLE_EVENT, DemIndicatorHealingCycleRef=PowerCycle, DemIndicatorRef=WarningIndicator
      DTCClass_DTC_0x115092 (DemDTCClass): DemDTCSeverity=DEM_DTC_SEV_NO_SEVERITY, DemUdsDTC=1134738
      DTC_0x115092 (DemEventParameter):
        DemEventKind = DEM_EVENT_KIND_SWC
        DemDTCClassRef = DTCClass_DTC_0x115092
        DemExtendedDataClassRef = ExtendedDataClass_83dcefb7
        DemFreezeFrameClassRef = FreezeFrameClass_5f5b5001
        DemFreezeFrameRecNumClassRef = FreezeFrameRecNumClass_f98c8aa7
        DemEventClass:
          DemAgingAllowed = true
          DemAgingCycleCounterThreshold = 40
          DemEventDestination = DEM_DTC_ORIGIN_PRIMARY_MEMORY
          DemEventPriority = 2
          DemEventSignificance = DEM_EVENT_SIGNIFICANCE_FAULT
          DemEventFailureCycleCounterThreshold = 0
          DemAgingCycleRef = PowerCycle
          DemEnableConditionGroupRef = EnableConditionGroup_fdfec498
          DemOperationCycleRef = PowerCycle
          DemDebounceAlgorithmClass
            DemDebounceCounterBased: DemDebounceCounterDecrementStepSize=1, DemDebounceCounterIncrementStepSize=1, DemDebounceCounterJumpDown=false, DemDebounceCounterJumpUp=true
          IndicatorAttribute_WarningIndicator (DemIndicatorAttribute): DemIndicatorFailureCycleSource=DEM_FAILURE_CYCLE_EVENT, DemIndicatorHealingCycleRef=PowerCycle, DemIndicatorRef=WarningIndicator
      DTCClass_DTC_0x115192 (DemDTCClass): DemDTCSeverity=DEM_DTC_SEV_NO_SEVERITY, DemUdsDTC=1134994
      DTC_0x115192 (DemEventParameter):
        DemEventKind = DEM_EVENT_KIND_SWC
        DemDTCClassRef = DTCClass_DTC_0x115192
        DemExtendedDataClassRef = ExtendedDataClass_83dcefb7
        DemFreezeFrameClassRef = FreezeFrameClass_5f5b5001
        DemFreezeFrameRecNumClassRef = FreezeFrameRecNumClass_f98c8aa7
        DemEventClass:
          DemAgingAllowed = true
          DemAgingCycleCounterThreshold = 40
          DemEventDestination = DEM_DTC_ORIGIN_PRIMARY_MEMORY
          DemEventPriority = 2
          DemEventSignificance = DEM_EVENT_SIGNIFICANCE_FAULT
          DemEventFailureCycleCounterThreshold = 0
          DemAgingCycleRef = PowerCycle
          DemEnableConditionGroupRef = EnableConditionGroup_fdfec498
          DemOperationCycleRef = PowerCycle
          DemDebounceAlgorithmClass
            DemDebounceCounterBased: DemDebounceCounterDecrementStepSize=1, DemDebounceCounterIncrementStepSize=1, DemDebounceCounterJumpDown=false, DemDebounceCounterJumpUp=true
          IndicatorAttribute_WarningIndicator (DemIndicatorAttribute): DemIndicatorFailureCycleSource=DEM_FAILURE_CYCLE_EVENT, DemIndicatorHealingCycleRef=PowerCycle, DemIndicatorRef=WarningIndicator
      DTCClass_DTC_0x115292 (DemDTCClass): DemDTCSeverity=DEM_DTC_SEV_NO_SEVERITY, DemUdsDTC=1135250
      DTC_0x115292 (DemEventParameter):
        DemEventKind = DEM_EVENT_KIND_SWC
        DemDTCClassRef = DTCClass_DTC_0x115292
        DemExtendedDataClassRef = ExtendedDataClass_83dcefb7
        DemFreezeFrameClassRef = FreezeFrameClass_c715a583
        DemFreezeFrameRecNumClassRef = FreezeFrameRecNumClass_f98c8aa7
        DemEventClass:
          DemAgingAllowed = true
          DemAgingCycleCounterThreshold = 40
          DemEventDestination = DEM_DTC_ORIGIN_PRIMARY_MEMORY
          DemEventPriority = 1
          DemEventSignificance = DEM_EVENT_SIGNIFICANCE_FAULT
          DemEventFailureCycleCounterThreshold = 0
          DemAgingCycleRef = PowerCycle
          DemEnableConditionGroupRef = EnableConditionGroup_fdfec498
          DemOperationCycleRef = PowerCycle
          DemDebounceAlgorithmClass
            DemDebounceCounterBased: DemDebounceCounterDecrementStepSize=1, DemDebounceCounterIncrementStepSize=1, DemDebounceCounterJumpDown=false, DemDebounceCounterJumpUp=true
          IndicatorAttribute_WarningIndicator (DemIndicatorAttribute): DemIndicatorFailureCycleSource=DEM_FAILURE_CYCLE_EVENT, DemIndicatorHealingCycleRef=PowerCycle, DemIndicatorRef=WarningIndicator
      DTCClass_DTC_0x115392 (DemDTCClass): DemDTCSeverity=DEM_DTC_SEV_NO_SEVERITY, DemUdsDTC=1135506
      DTC_0x115392 (DemEventParameter):
        DemEventKind = DEM_EVENT_KIND_SWC
        DemDTCClassRef = DTCClass_DTC_0x115392
        DemExtendedDataClassRef = ExtendedDataClass_83dcefb7
        DemFreezeFrameClassRef = FreezeFrameClass_5f5b5001
        DemFreezeFrameRecNumClassRef = FreezeFrameRecNumClass_f98c8aa7
        DemEventClass:
          DemAgingAllowed = true
          DemAgingCycleCounterThreshold = 40
          DemEventDestination = DEM_DTC_ORIGIN_PRIMARY_MEMORY
          DemEventPriority = 2
          DemEventSignificance = DEM_EVENT_SIGNIFICANCE_FAULT
          DemEventFailureCycleCounterThreshold = 0
          DemAgingCycleRef = PowerCycle
          DemEnableConditionGroupRef = EnableConditionGroup_fdfec498
          DemOperationCycleRef = PowerCycle
          DemDebounceAlgorithmClass
            DemDebounceCounterBased: DemDebounceCounterDecrementStepSize=1, DemDebounceCounterIncrementStepSize=1, DemDebounceCounterJumpDown=false, DemDebounceCounterJumpUp=true
          IndicatorAttribute_WarningIndicator (DemIndicatorAttribute): DemIndicatorFailureCycleSource=DEM_FAILURE_CYCLE_EVENT, DemIndicatorHealingCycleRef=PowerCycle, DemIndicatorRef=WarningIndicator
      DTCClass_DTC_0x115492 (DemDTCClass): DemDTCSeverity=DEM_DTC_SEV_NO_SEVERITY, DemUdsDTC=1135762
      DTC_0x115492 (DemEventParameter):
        DemEventKind = DEM_EVENT_KIND_SWC
        DemDTCClassRef = DTCClass_DTC_0x115492
        DemExtendedDataClassRef = ExtendedDataClass_83dcefb7
        DemFreezeFrameClassRef = FreezeFrameClass_5f5b5001
        DemFreezeFrameRecNumClassRef = FreezeFrameRecNumClass_f98c8aa7
        DemEventClass:
          DemAgingAllowed = true
          DemAgingCycleCounterThreshold = 40
          DemEventDestination = DEM_DTC_ORIGIN_PRIMARY_MEMORY
          DemEventPriority = 2
          DemEventSignificance = DEM_EVENT_SIGNIFICANCE_FAULT
          DemEventFailureCycleCounterThreshold = 0
          DemAgingCycleRef = PowerCycle
          DemEnableConditionGroupRef = EnableConditionGroup_fdfec498
          DemOperationCycleRef = PowerCycle
          DemDebounceAlgorithmClass
            DemDebounceCounterBased: DemDebounceCounterDecrementStepSize=1, DemDebounceCounterIncrementStepSize=1, DemDebounceCounterJumpDown=false, DemDebounceCounterJumpUp=true
          IndicatorAttribute_WarningIndicator (DemIndicatorAttribute): DemIndicatorFailureCycleSource=DEM_FAILURE_CYCLE_EVENT, DemIndicatorHealingCycleRef=PowerCycle, DemIndicatorRef=WarningIndicator
      DTCClass_DTC_0x115592 (DemDTCClass): DemDTCSeverity=DEM_DTC_SEV_NO_SEVERITY, DemUdsDTC=1136018
      DTC_0x115592 (DemEventParameter):
        DemEventKind = DEM_EVENT_KIND_SWC
        DemDTCClassRef = DTCClass_DTC_0x115592
        DemExtendedDataClassRef = ExtendedDataClass_83dcefb7
        DemFreezeFrameClassRef = FreezeFrameClass_5f5b5001
        DemFreezeFrameRecNumClassRef = FreezeFrameRecNumClass_f98c8aa7
        DemEventClass:
          DemAgingAllowed = true
          DemAgingCycleCounterThreshold = 40
          DemEventDestination = DEM_DTC_ORIGIN_PRIMARY_MEMORY
          DemEventPriority = 2
          DemEventSignificance = DEM_EVENT_SIGNIFICANCE_FAULT
          DemEventFailureCycleCounterThreshold = 0
          DemAgingCycleRef = PowerCycle
          DemEnableConditionGroupRef = EnableConditionGroup_fdfec498
          DemOperationCycleRef = PowerCycle
          DemDebounceAlgorithmClass
            DemDebounceCounterBased: DemDebounceCounterDecrementStepSize=1, DemDebounceCounterIncrementStepSize=1, DemDebounceCounterJumpDown=false, DemDebounceCounterJumpUp=true
          IndicatorAttribute_WarningIndicator (DemIndicatorAttribute): DemIndicatorFailureCycleSource=DEM_FAILURE_CYCLE_EVENT, DemIndicatorHealingCycleRef=PowerCycle, DemIndicatorRef=WarningIndicator
      DTCClass_DTC_0x115692 (DemDTCClass): DemDTCSeverity=DEM_DTC_SEV_NO_SEVERITY, DemUdsDTC=1136274
      DTC_0x115692 (DemEventParameter):
        DemEventKind = DEM_EVENT_KIND_SWC
        DemDTCClassRef = DTCClass_DTC_0x115692
        DemExtendedDataClassRef = ExtendedDataClass_83dcefb7
        DemFreezeFrameClassRef = FreezeFrameClass_5f5b5001
        DemFreezeFrameRecNumClassRef = FreezeFrameRecNumClass_f98c8aa7
        DemEventClass:
          DemAgingAllowed = true
          DemAgingCycleCounterThreshold = 40
          DemEventDestination = DEM_DTC_ORIGIN_PRIMARY_MEMORY
          DemEventPriority = 2
          DemEventSignificance = DEM_EVENT_SIGNIFICANCE_FAULT
          DemEventFailureCycleCounterThreshold = 0
          DemAgingCycleRef = PowerCycle
          DemEnableConditionGroupRef = EnableConditionGroup_fdfec498
          DemOperationCycleRef = PowerCycle
          DemDebounceAlgorithmClass
            DemDebounceCounterBased: DemDebounceCounterDecrementStepSize=1, DemDebounceCounterIncrementStepSize=1, DemDebounceCounterJumpDown=false, DemDebounceCounterJumpUp=true
          IndicatorAttribute_WarningIndicator (DemIndicatorAttribute): DemIndicatorFailureCycleSource=DEM_FAILURE_CYCLE_EVENT, DemIndicatorHealingCycleRef=PowerCycle, DemIndicatorRef=WarningIndicator
      DTCClass_DTC_0x11571e (DemDTCClass): DemDTCSeverity=DEM_DTC_SEV_NO_SEVERITY, DemUdsDTC=1136414
      DTC_0x11571e (DemEventParameter):
        DemEventKind = DEM_EVENT_KIND_SWC
        DemDTCClassRef = DTCClass_DTC_0x11571e
        DemExtendedDataClassRef = ExtendedDataClass_83dcefb7
        DemFreezeFrameClassRef = FreezeFrameClass_de0e94c2
        DemFreezeFrameRecNumClassRef = FreezeFrameRecNumClass_f98c8aa7
        DemEventClass:
          DemAgingAllowed = true
          DemAgingCycleCounterThreshold = 40
          DemEventDestination = DEM_DTC_ORIGIN_PRIMARY_MEMORY
          DemEventPriority = 1
          DemEventSignificance = DEM_EVENT_SIGNIFICANCE_FAULT
          DemEventFailureCycleCounterThreshold = 0
          DemAgingCycleRef = PowerCycle
          DemEnableConditionGroupRef = EnableConditionGroup_bbe52cb7
          DemOperationCycleRef = PowerCycle
          DemDebounceAlgorithmClass
            DemDebounceCounterBased: DemDebounceCounterDecrementStepSize=1, DemDebounceCounterIncrementStepSize=1, DemDebounceCounterJumpDown=false, DemDebounceCounterJumpUp=true
          IndicatorAttribute_WarningIndicator (DemIndicatorAttribute): DemIndicatorFailureCycleSource=DEM_FAILURE_CYCLE_EVENT, DemIndicatorHealingCycleRef=PowerCycle, DemIndicatorRef=WarningIndicator
      DTCClass_DTC_0x115816 (DemDTCClass): DemDTCSeverity=DEM_DTC_SEV_NO_SEVERITY, DemUdsDTC=1136662
      DTC_0x115816 (DemEventParameter):
        DemEventKind = DEM_EVENT_KIND_SWC
        DemDTCClassRef = DTCClass_DTC_0x115816
        DemExtendedDataClassRef = ExtendedDataClass_83dcefb7
        DemFreezeFrameClassRef = FreezeFrameClass_d96350db
        DemFreezeFrameRecNumClassRef = FreezeFrameRecNumClass_f98c8aa7
        DemEventClass:
          DemAgingAllowed = true
          DemAgingCycleCounterThreshold = 40
          DemEventDestination = DEM_DTC_ORIGIN_PRIMARY_MEMORY
          DemEventPriority = 1
          DemEventSignificance = DEM_EVENT_SIGNIFICANCE_FAULT
          DemEventFailureCycleCounterThreshold = 0
          DemAgingCycleRef = PowerCycle
          DemEnableConditionGroupRef = EnableConditionGroup_bbe52cb7
          DemOperationCycleRef = PowerCycle
          DemDebounceAlgorithmClass
            DemDebounceCounterBased: DemDebounceCounterDecrementStepSize=1, DemDebounceCounterIncrementStepSize=1, DemDebounceCounterJumpDown=false, DemDebounceCounterJumpUp=true
          IndicatorAttribute_WarningIndicator (DemIndicatorAttribute): DemIndicatorFailureCycleSource=DEM_FAILURE_CYCLE_EVENT, DemIndicatorHealingCycleRef=PowerCycle, DemIndicatorRef=WarningIndicator
      DTCClass_DTC_0x115a92 (DemDTCClass): DemDTCSeverity=DEM_DTC_SEV_NO_SEVERITY, DemUdsDTC=1137298
      DTC_0x115a92 (DemEventParameter):
        DemEventKind = DEM_EVENT_KIND_SWC
        DemDTCClassRef = DTCClass_DTC_0x115a92
        DemExtendedDataClassRef = ExtendedDataClass_83dcefb7
        DemFreezeFrameClassRef = FreezeFrameClass_5f5b5001
        DemFreezeFrameRecNumClassRef = FreezeFrameRecNumClass_f98c8aa7
        DemEventClass:
          DemAgingAllowed = true
          DemAgingCycleCounterThreshold = 40
          DemEventDestination = DEM_DTC_ORIGIN_PRIMARY_MEMORY
          DemEventPriority = 2
          DemEventSignificance = DEM_EVENT_SIGNIFICANCE_FAULT
          DemEventFailureCycleCounterThreshold = 0
          DemAgingCycleRef = PowerCycle
          DemEnableConditionGroupRef = EnableConditionGroup_fdfec498
          DemOperationCycleRef = PowerCycle
          DemDebounceAlgorithmClass
            DemDebounceCounterBased: DemDebounceCounterDecrementStepSize=1, DemDebounceCounterIncrementStepSize=1, DemDebounceCounterJumpDown=false, DemDebounceCounterJumpUp=true
          IndicatorAttribute_WarningIndicator (DemIndicatorAttribute): DemIndicatorFailureCycleSource=DEM_FAILURE_CYCLE_EVENT, DemIndicatorHealingCycleRef=PowerCycle, DemIndicatorRef=WarningIndicator
      DTCClass_DTC_0x115c4b (DemDTCClass): DemDTCSeverity=DEM_DTC_SEV_NO_SEVERITY, DemUdsDTC=1137739
      DTC_0x115c4b (DemEventParameter):
        DemEventKind = DEM_EVENT_KIND_SWC
        DemDTCClassRef = DTCClass_DTC_0x115c4b
        DemExtendedDataClassRef = ExtendedDataClass_83dcefb7
        DemFreezeFrameClassRef = FreezeFrameClass_5f5b5001
        DemFreezeFrameRecNumClassRef = FreezeFrameRecNumClass_f98c8aa7
        DemEventClass:
          DemAgingAllowed = true
          DemAgingCycleCounterThreshold = 40
          DemEventDestination = DEM_DTC_ORIGIN_PRIMARY_MEMORY
          DemEventPriority = 2
          DemEventSignificance = DEM_EVENT_SIGNIFICANCE_FAULT
          DemEventFailureCycleCounterThreshold = 0
          DemAgingCycleRef = PowerCycle
          DemEnableConditionGroupRef = EnableConditionGroup_fdfec498
          DemOperationCycleRef = PowerCycle
          DemDebounceAlgorithmClass
            DemDebounceCounterBased: DemDebounceCounterDecrementStepSize=1, DemDebounceCounterIncrementStepSize=1, DemDebounceCounterJumpDown=false, DemDebounceCounterJumpUp=true
          IndicatorAttribute_WarningIndicator (DemIndicatorAttribute): DemIndicatorFailureCycleSource=DEM_FAILURE_CYCLE_EVENT, DemIndicatorHealingCycleRef=PowerCycle, DemIndicatorRef=WarningIndicator
      DTCClass_DTC_0x115d4b (DemDTCClass): DemDTCSeverity=DEM_DTC_SEV_NO_SEVERITY, DemUdsDTC=1137995
      DTC_0x115d4b (DemEventParameter):
        DemEventKind = DEM_EVENT_KIND_SWC
        DemDTCClassRef = DTCClass_DTC_0x115d4b
        DemExtendedDataClassRef = ExtendedDataClass_83dcefb7
        DemFreezeFrameClassRef = FreezeFrameClass_5f5b5001
        DemFreezeFrameRecNumClassRef = FreezeFrameRecNumClass_f98c8aa7
        DemEventClass:
          DemAgingAllowed = true
          DemAgingCycleCounterThreshold = 40
          DemEventDestination = DEM_DTC_ORIGIN_PRIMARY_MEMORY
          DemEventPriority = 1
          DemEventSignificance = DEM_EVENT_SIGNIFICANCE_FAULT
          DemEventFailureCycleCounterThreshold = 0
          DemAgingCycleRef = PowerCycle
          DemEnableConditionGroupRef = EnableConditionGroup_fdfec498
          DemOperationCycleRef = PowerCycle
          DemDebounceAlgorithmClass
            DemDebounceCounterBased: DemDebounceCounterDecrementStepSize=1, DemDebounceCounterIncrementStepSize=1, DemDebounceCounterJumpDown=false, DemDebounceCounterJumpUp=true
          IndicatorAttribute_WarningIndicator (DemIndicatorAttribute): DemIndicatorFailureCycleSource=DEM_FAILURE_CYCLE_EVENT, DemIndicatorHealingCycleRef=PowerCycle, DemIndicatorRef=WarningIndicator
      DTCClass_DTC_0x115e1a (DemDTCClass): DemDTCSeverity=DEM_DTC_SEV_NO_SEVERITY, DemUdsDTC=1138202
      DTC_0x115e1a (DemEventParameter):
        DemEventKind = DEM_EVENT_KIND_SWC
        DemDTCClassRef = DTCClass_DTC_0x115e1a
        DemExtendedDataClassRef = ExtendedDataClass_83dcefb7
        DemFreezeFrameClassRef = FreezeFrameClass_5f5b5001
        DemFreezeFrameRecNumClassRef = FreezeFrameRecNumClass_f98c8aa7
        DemEventClass:
          DemAgingAllowed = true
          DemAgingCycleCounterThreshold = 40
          DemEventDestination = DEM_DTC_ORIGIN_PRIMARY_MEMORY
          DemEventPriority = 2
          DemEventSignificance = DEM_EVENT_SIGNIFICANCE_FAULT
          DemEventFailureCycleCounterThreshold = 0
          DemAgingCycleRef = PowerCycle
          DemEnableConditionGroupRef = EnableConditionGroup_fdfec498
          DemOperationCycleRef = No_known_corrective_action
          DemDebounceAlgorithmClass
            DemDebounceCounterBased: DemDebounceCounterDecrementStepSize=1, DemDebounceCounterIncrementStepSize=1, DemDebounceCounterJumpDown=false, DemDebounceCounterJumpUp=true
          IndicatorAttribute_WarningIndicator (DemIndicatorAttribute): DemIndicatorFailureCycleSource=DEM_FAILURE_CYCLE_EVENT, DemIndicatorHealingCycleRef=No_known_corrective_action, DemIndicatorRef=WarningIndicator
      DTCClass_DTC_0x116097 (DemDTCClass): DemDTCSeverity=DEM_DTC_SEV_NO_SEVERITY, DemUdsDTC=1138839
      DTC_0x116097 (DemEventParameter):
        DemEventKind = DEM_EVENT_KIND_SWC
        DemDTCClassRef = DTCClass_DTC_0x116097
        DemExtendedDataClassRef = ExtendedDataClass_83dcefb7
        DemFreezeFrameClassRef = FreezeFrameClass_5f5b5001
        DemFreezeFrameRecNumClassRef = FreezeFrameRecNumClass_f98c8aa7
        DemEventClass:
          DemAgingAllowed = true
          DemAgingCycleCounterThreshold = 40
          DemEventDestination = DEM_DTC_ORIGIN_PRIMARY_MEMORY
          DemEventPriority = 1
          DemEventSignificance = DEM_EVENT_SIGNIFICANCE_FAULT
          DemEventFailureCycleCounterThreshold = 0
          DemAgingCycleRef = PowerCycle
          DemEnableConditionGroupRef = EnableConditionGroup_983000c1
          DemOperationCycleRef = No_known_corrective_action
          DemDebounceAlgorithmClass
            DemDebounceCounterBased: DemDebounceCounterDecrementStepSize=1, DemDebounceCounterIncrementStepSize=1, DemDebounceCounterJumpDown=false, DemDebounceCounterJumpUp=true
          IndicatorAttribute_WarningIndicator (DemIndicatorAttribute): DemIndicatorFailureCycleSource=DEM_FAILURE_CYCLE_EVENT, DemIndicatorHealingCycleRef=No_known_corrective_action, DemIndicatorRef=WarningIndicator
      DTCClass_DTC_0x11611c (DemDTCClass): DemDTCSeverity=DEM_DTC_SEV_NO_SEVERITY, DemUdsDTC=1138972
      DTC_0x11611c (DemEventParameter):
        DemEventKind = DEM_EVENT_KIND_SWC
        DemDTCClassRef = DTCClass_DTC_0x11611c
        DemExtendedDataClassRef = ExtendedDataClass_83dcefb7
        DemFreezeFrameClassRef = FreezeFrameClass_5f5b5001
        DemFreezeFrameRecNumClassRef = FreezeFrameRecNumClass_f98c8aa7
        DemEventClass:
          DemAgingAllowed = true
          DemAgingCycleCounterThreshold = 40
          DemEventDestination = DEM_DTC_ORIGIN_PRIMARY_MEMORY
          DemEventPriority = 2
          DemEventSignificance = DEM_EVENT_SIGNIFICANCE_FAULT
          DemEventFailureCycleCounterThreshold = 0
          DemAgingCycleRef = PowerCycle
          DemEnableConditionGroupRef = EnableConditionGroup_fdfec498
          DemOperationCycleRef = PowerCycle
          DemDebounceAlgorithmClass
            DemDebounceCounterBased: DemDebounceCounterDecrementStepSize=1, DemDebounceCounterIncrementStepSize=1, DemDebounceCounterJumpDown=false, DemDebounceCounterJumpUp=true
          IndicatorAttribute_WarningIndicator (DemIndicatorAttribute): DemIndicatorFailureCycleSource=DEM_FAILURE_CYCLE_EVENT, DemIndicatorHealingCycleRef=PowerCycle, DemIndicatorRef=WarningIndicator
      DTCClass_DTC_0x116197 (DemDTCClass): DemDTCSeverity=DEM_DTC_SEV_NO_SEVERITY, DemUdsDTC=1139095
      DTC_0x116197 (DemEventParameter):
        DemEventKind = DEM_EVENT_KIND_SWC
        DemDTCClassRef = DTCClass_DTC_0x116197
        DemExtendedDataClassRef = ExtendedDataClass_83dcefb7
        DemFreezeFrameClassRef = FreezeFrameClass_5f5b5001
        DemFreezeFrameRecNumClassRef = FreezeFrameRecNumClass_f98c8aa7
        DemEventClass:
          DemAgingAllowed = true
          DemAgingCycleCounterThreshold = 40
          DemEventDestination = DEM_DTC_ORIGIN_PRIMARY_MEMORY
          DemEventPriority = 2
          DemEventSignificance = DEM_EVENT_SIGNIFICANCE_FAULT
          DemEventFailureCycleCounterThreshold = 0
          DemAgingCycleRef = PowerCycle
          DemEnableConditionGroupRef = EnableConditionGroup_fdfec498
          DemOperationCycleRef = PowerCycle
          DemDebounceAlgorithmClass
            DemDebounceCounterBased: DemDebounceCounterDecrementStepSize=1, DemDebounceCounterIncrementStepSize=1, DemDebounceCounterJumpDown=false, DemDebounceCounterJumpUp=true
          IndicatorAttribute_WarningIndicator (DemIndicatorAttribute): DemIndicatorFailureCycleSource=DEM_FAILURE_CYCLE_EVENT, DemIndicatorHealingCycleRef=PowerCycle, DemIndicatorRef=WarningIndicator
      DTCClass_DTC_0x11621c (DemDTCClass): DemDTCSeverity=DEM_DTC_SEV_NO_SEVERITY, DemUdsDTC=1139228
      DTC_0x11621c (DemEventParameter):
        DemEventKind = DEM_EVENT_KIND_SWC
        DemDTCClassRef = DTCClass_DTC_0x11621c
        DemExtendedDataClassRef = ExtendedDataClass_83dcefb7
        DemFreezeFrameClassRef = FreezeFrameClass_5f5b5001
        DemFreezeFrameRecNumClassRef = FreezeFrameRecNumClass_f98c8aa7
        DemEventClass:
          DemAgingAllowed = true
          DemAgingCycleCounterThreshold = 40
          DemEventDestination = DEM_DTC_ORIGIN_PRIMARY_MEMORY
          DemEventPriority = 2
          DemEventSignificance = DEM_EVENT_SIGNIFICANCE_FAULT
          DemEventFailureCycleCounterThreshold = 0
          DemAgingCycleRef = PowerCycle
          DemEnableConditionGroupRef = EnableConditionGroup_fdfec498
          DemOperationCycleRef = PowerCycle
          DemDebounceAlgorithmClass
            DemDebounceCounterBased: DemDebounceCounterDecrementStepSize=1, DemDebounceCounterIncrementStepSize=1, DemDebounceCounterJumpDown=false, DemDebounceCounterJumpUp=true
          IndicatorAttribute_WarningIndicator (DemIndicatorAttribute): DemIndicatorFailureCycleSource=DEM_FAILURE_CYCLE_EVENT, DemIndicatorHealingCycleRef=PowerCycle, DemIndicatorRef=WarningIndicator
      DTCClass_DTC_0x116397 (DemDTCClass): DemDTCSeverity=DEM_DTC_SEV_NO_SEVERITY, DemUdsDTC=1139607
      DTC_0x116397 (DemEventParameter):
        DemEventKind = DEM_EVENT_KIND_SWC
        DemDTCClassRef = DTCClass_DTC_0x116397
        DemExtendedDataClassRef = ExtendedDataClass_83dcefb7
        DemFreezeFrameClassRef = FreezeFrameClass_5f5b5001
        DemFreezeFrameRecNumClassRef = FreezeFrameRecNumClass_f98c8aa7
        DemEventClass:
          DemAgingAllowed = true
          DemAgingCycleCounterThreshold = 40
          DemEventDestination = DEM_DTC_ORIGIN_PRIMARY_MEMORY
          DemEventPriority = 1
          DemEventSignificance = DEM_EVENT_SIGNIFICANCE_FAULT
          DemEventFailureCycleCounterThreshold = 0
          DemAgingCycleRef = PowerCycle
          DemEnableConditionGroupRef = EnableConditionGroup_bbe52cb7
          DemOperationCycleRef = PowerCycle
          DemDebounceAlgorithmClass
            DemDebounceCounterBased: DemDebounceCounterDecrementStepSize=1, DemDebounceCounterIncrementStepSize=1, DemDebounceCounterJumpDown=false, DemDebounceCounterJumpUp=true
          IndicatorAttribute_WarningIndicator (DemIndicatorAttribute): DemIndicatorFailureCycleSource=DEM_FAILURE_CYCLE_EVENT, DemIndicatorHealingCycleRef=PowerCycle, DemIndicatorRef=WarningIndicator
      DTCClass_DTC_0x116494 (DemDTCClass): DemDTCSeverity=DEM_DTC_SEV_NO_SEVERITY, DemUdsDTC=1139860
      DTC_0x116494 (DemEventParameter):
        DemEventKind = DEM_EVENT_KIND_SWC
        DemDTCClassRef = DTCClass_DTC_0x116494
        DemExtendedDataClassRef = ExtendedDataClass_83dcefb7
        DemFreezeFrameClassRef = FreezeFrameClass_5f5b5001
        DemFreezeFrameRecNumClassRef = FreezeFrameRecNumClass_f98c8aa7
        DemEventClass:
          DemAgingAllowed = true
          DemAgingCycleCounterThreshold = 40
          DemEventDestination = DEM_DTC_ORIGIN_PRIMARY_MEMORY
          DemEventPriority = 2
          DemEventSignificance = DEM_EVENT_SIGNIFICANCE_FAULT
          DemEventFailureCycleCounterThreshold = 0
          DemAgingCycleRef = PowerCycle
          DemEnableConditionGroupRef = EnableConditionGroup_fdfec498
          DemOperationCycleRef = PowerCycle
          DemDebounceAlgorithmClass
            DemDebounceCounterBased: DemDebounceCounterDecrementStepSize=1, DemDebounceCounterIncrementStepSize=1, DemDebounceCounterJumpDown=false, DemDebounceCounterJumpUp=true
          IndicatorAttribute_WarningIndicator (DemIndicatorAttribute): DemIndicatorFailureCycleSource=DEM_FAILURE_CYCLE_EVENT, DemIndicatorHealingCycleRef=PowerCycle, DemIndicatorRef=WarningIndicator
      DTCClass_DTC_0x116594 (DemDTCClass): DemDTCSeverity=DEM_DTC_SEV_NO_SEVERITY, DemUdsDTC=1140116
      DTC_0x116594 (DemEventParameter):
        DemEventKind = DEM_EVENT_KIND_SWC
        DemDTCClassRef = DTCClass_DTC_0x116594
        DemExtendedDataClassRef = ExtendedDataClass_83dcefb7
        DemFreezeFrameClassRef = FreezeFrameClass_5f5b5001
        DemFreezeFrameRecNumClassRef = FreezeFrameRecNumClass_f98c8aa7
        DemEventClass:
          DemAgingAllowed = true
          DemAgingCycleCounterThreshold = 40
          DemEventDestination = DEM_DTC_ORIGIN_PRIMARY_MEMORY
          DemEventPriority = 2
          DemEventSignificance = DEM_EVENT_SIGNIFICANCE_FAULT
          DemEventFailureCycleCounterThreshold = 0
          DemAgingCycleRef = PowerCycle
          DemEnableConditionGroupRef = EnableConditionGroup_fdfec498
          DemOperationCycleRef = PowerCycle
          DemDebounceAlgorithmClass
            DemDebounceCounterBased: DemDebounceCounterDecrementStepSize=1, DemDebounceCounterIncrementStepSize=1, DemDebounceCounterJumpDown=false, DemDebounceCounterJumpUp=true
          IndicatorAttribute_WarningIndicator (DemIndicatorAttribute): DemIndicatorFailureCycleSource=DEM_FAILURE_CYCLE_EVENT, DemIndicatorHealingCycleRef=PowerCycle, DemIndicatorRef=WarningIndicator
      DTCClass_DTC_0x116617 (DemDTCClass): DemDTCSeverity=DEM_DTC_SEV_NO_SEVERITY, DemUdsDTC=1140247
      DTC_0x116617 (DemEventParameter):
        DemEventKind = DEM_EVENT_KIND_SWC
        DemDTCClassRef = DTCClass_DTC_0x116617
        DemExtendedDataClassRef = ExtendedDataClass_83dcefb7
        DemFreezeFrameClassRef = FreezeFrameClass_5f5b5001
        DemFreezeFrameRecNumClassRef = FreezeFrameRecNumClass_f98c8aa7
        DemEventClass:
          DemAgingAllowed = true
          DemAgingCycleCounterThreshold = 40
          DemEventDestination = DEM_DTC_ORIGIN_PRIMARY_MEMORY
          DemEventPriority = 1
          DemEventSignificance = DEM_EVENT_SIGNIFICANCE_FAULT
          DemEventFailureCycleCounterThreshold = 0
          DemAgingCycleRef = PowerCycle
          DemEnableConditionGroupRef = /InitialEcuC/
          DemOperationCycleRef = PowerCycle
          DemDebounceAlgorithmClass
            DemDebounceCounterBased: DemDebounceCounterDecrementStepSize=1, DemDebounceCounterIncrementStepSize=1, DemDebounceCounterJumpDown=false, DemDebounceCounterJumpUp=true
          IndicatorAttribute_WarningIndicator (DemIndicatorAttribute): DemIndicatorFailureCycleSource=DEM_FAILURE_CYCLE_EVENT, DemIndicatorHealingCycleRef=PowerCycle, DemIndicatorRef=WarningIndicator
      DTCClass_DTC_0x116716 (DemDTCClass): DemDTCSeverity=DEM_DTC_SEV_NO_SEVERITY, DemUdsDTC=1140502
      DTC_0x116716 (DemEventParameter):
        DemEventKind = DEM_EVENT_KIND_SWC
        DemDTCClassRef = DTCClass_DTC_0x116716
        DemExtendedDataClassRef = ExtendedDataClass_83dcefb7
        DemFreezeFrameClassRef = FreezeFrameClass_5f5b5001
        DemFreezeFrameRecNumClassRef = FreezeFrameRecNumClass_f98c8aa7
        DemEventClass:
          DemAgingAllowed = true
          DemAgingCycleCounterThreshold = 40
          DemEventDestination = DEM_DTC_ORIGIN_PRIMARY_MEMORY
          DemEventPriority = 1
          DemEventSignificance = DEM_EVENT_SIGNIFICANCE_FAULT
          DemEventFailureCycleCounterThreshold = 0
          DemAgingCycleRef = PowerCycle
          DemEnableConditionGroupRef = /InitialEcuC/
          DemOperationCycleRef = PowerCycle
          DemDebounceAlgorithmClass
            DemDebounceCounterBased: DemDebounceCounterDecrementStepSize=1, DemDebounceCounterIncrementStepSize=1, DemDebounceCounterJumpDown=false, DemDebounceCounterJumpUp=true
          IndicatorAttribute_WarningIndicator (DemIndicatorAttribute): DemIndicatorFailureCycleSource=DEM_FAILURE_CYCLE_EVENT, DemIndicatorHealingCycleRef=PowerCycle, DemIndicatorRef=WarningIndicator
      DTCClass_DTC_0x116819 (DemDTCClass): DemDTCSeverity=DEM_DTC_SEV_NO_SEVERITY, DemUdsDTC=1140761
      DTC_0x116819 (DemEventParameter):
        DemEventKind = DEM_EVENT_KIND_SWC
        DemDTCClassRef = DTCClass_DTC_0x116819
        DemExtendedDataClassRef = ExtendedDataClass_83dcefb7
        DemFreezeFrameClassRef = FreezeFrameClass_5f5b5001
        DemFreezeFrameRecNumClassRef = FreezeFrameRecNumClass_f98c8aa7
        DemEventClass:
          DemAgingAllowed = true
          DemAgingCycleCounterThreshold = 40
          DemEventDestination = DEM_DTC_ORIGIN_PRIMARY_MEMORY
          DemEventPriority = 2
          DemEventSignificance = DEM_EVENT_SIGNIFICANCE_FAULT
          DemEventFailureCycleCounterThreshold = 0
          DemAgingCycleRef = PowerCycle
          DemEnableConditionGroupRef = /InitialEcuC/
          DemOperationCycleRef = PowerCycle
          DemDebounceAlgorithmClass
            DemDebounceCounterBased: DemDebounceCounterDecrementStepSize=1, DemDebounceCounterIncrementStepSize=1, DemDebounceCounterJumpDown=false, DemDebounceCounterJumpUp=true
          IndicatorAttribute_WarningIndicator (DemIndicatorAttribute): DemIndicatorFailureCycleSource=DEM_FAILURE_CYCLE_EVENT, DemIndicatorHealingCycleRef=PowerCycle, DemIndicatorRef=WarningIndicator
      DTCClass_DTC_0x116996 (DemDTCClass): DemDTCSeverity=DEM_DTC_SEV_NO_SEVERITY, DemUdsDTC=1141142
      DTC_0x116996 (DemEventParameter):
        DemEventKind = DEM_EVENT_KIND_SWC
        DemDTCClassRef = DTCClass_DTC_0x116996
        DemExtendedDataClassRef = ExtendedDataClass_83dcefb7
        DemFreezeFrameClassRef = FreezeFrameClass_5f5b5001
        DemFreezeFrameRecNumClassRef = FreezeFrameRecNumClass_f98c8aa7
        DemEventClass:
          DemAgingAllowed = true
          DemAgingCycleCounterThreshold = 40
          DemEventDestination = DEM_DTC_ORIGIN_PRIMARY_MEMORY
          DemEventPriority = 1
          DemEventSignificance = DEM_EVENT_SIGNIFICANCE_FAULT
          DemEventFailureCycleCounterThreshold = 0
          DemAgingCycleRef = PowerCycle
          DemEnableConditionGroupRef = /InitialEcuC/
          DemOperationCycleRef = PowerCycle
          DemDebounceAlgorithmClass
            DemDebounceCounterBased: DemDebounceCounterDecrementStepSize=1, DemDebounceCounterIncrementStepSize=1, DemDebounceCounterJumpDown=false, DemDebounceCounterJumpUp=true
          IndicatorAttribute_WarningIndicator (DemIndicatorAttribute): DemIndicatorFailureCycleSource=DEM_FAILURE_CYCLE_EVENT, DemIndicatorHealingCycleRef=PowerCycle, DemIndicatorRef=WarningIndicator
      DTCClass_DTC_0x116a96 (DemDTCClass): DemDTCSeverity=DEM_DTC_SEV_NO_SEVERITY, DemUdsDTC=1141398
      DTC_0x116a96 (DemEventParameter):
        DemEventKind = DEM_EVENT_KIND_SWC
        DemDTCClassRef = DTCClass_DTC_0x116a96
        DemExtendedDataClassRef = ExtendedDataClass_83dcefb7
        DemFreezeFrameClassRef = FreezeFrameClass_5f5b5001
        DemFreezeFrameRecNumClassRef = FreezeFrameRecNumClass_f98c8aa7
        DemEventClass:
          DemAgingAllowed = true
          DemAgingCycleCounterThreshold = 40
          DemEventDestination = DEM_DTC_ORIGIN_PRIMARY_MEMORY
          DemEventPriority = 1
          DemEventSignificance = DEM_EVENT_SIGNIFICANCE_FAULT
          DemEventFailureCycleCounterThreshold = 0
          DemAgingCycleRef = PowerCycle
          DemEnableConditionGroupRef = /InitialEcuC/
          DemOperationCycleRef = PowerCycle
          DemDebounceAlgorithmClass
            DemDebounceCounterBased: DemDebounceCounterDecrementStepSize=1, DemDebounceCounterIncrementStepSize=1, DemDebounceCounterJumpDown=false, DemDebounceCounterJumpUp=true
          IndicatorAttribute_WarningIndicator (DemIndicatorAttribute): DemIndicatorFailureCycleSource=DEM_FAILURE_CYCLE_EVENT, DemIndicatorHealingCycleRef=PowerCycle, DemIndicatorRef=WarningIndicator
      DTCClass_DTC_0x116c05 (DemDTCClass): DemDTCSeverity=DEM_DTC_SEV_NO_SEVERITY, DemUdsDTC=1141765
      DTC_0x116c05 (DemEventParameter):
        DemEventKind = DEM_EVENT_KIND_SWC
        DemDTCClassRef = DTCClass_DTC_0x116c05
        DemExtendedDataClassRef = ExtendedDataClass_83dcefb7
        DemFreezeFrameClassRef = FreezeFrameClass_5f5b5001
        DemFreezeFrameRecNumClassRef = FreezeFrameRecNumClass_f98c8aa7
        DemEventClass:
          DemAgingAllowed = true
          DemAgingCycleCounterThreshold = 40
          DemEventDestination = DEM_DTC_ORIGIN_PRIMARY_MEMORY
          DemEventPriority = 1
          DemEventSignificance = DEM_EVENT_SIGNIFICANCE_FAULT
          DemEventFailureCycleCounterThreshold = 0
          DemAgingCycleRef = PowerCycle
          DemEnableConditionGroupRef = /InitialEcuC/
          DemOperationCycleRef = PowerCycle
          DemDebounceAlgorithmClass
            DemDebounceCounterBased: DemDebounceCounterDecrementStepSize=1, DemDebounceCounterIncrementStepSize=1, DemDebounceCounterJumpDown=false, DemDebounceCounterJumpUp=true
          IndicatorAttribute_WarningIndicator (DemIndicatorAttribute): DemIndicatorFailureCycleSource=DEM_FAILURE_CYCLE_EVENT, DemIndicatorHealingCycleRef=PowerCycle, DemIndicatorRef=WarningIndicator
      DTCClass_DTC_0x116d05 (DemDTCClass): DemDTCSeverity=DEM_DTC_SEV_NO_SEVERITY, DemUdsDTC=1142021
      DTC_0x116d05 (DemEventParameter):
        DemEventKind = DEM_EVENT_KIND_SWC
        DemDTCClassRef = DTCClass_DTC_0x116d05
        DemExtendedDataClassRef = ExtendedDataClass_83dcefb7
        DemFreezeFrameClassRef = FreezeFrameClass_5f5b5001
        DemFreezeFrameRecNumClassRef = FreezeFrameRecNumClass_f98c8aa7
        DemEventClass:
          DemAgingAllowed = true
          DemAgingCycleCounterThreshold = 40
          DemEventDestination = DEM_DTC_ORIGIN_PRIMARY_MEMORY
          DemEventPriority = 1
          DemEventSignificance = DEM_EVENT_SIGNIFICANCE_FAULT
          DemEventFailureCycleCounterThreshold = 0
          DemAgingCycleRef = PowerCycle
          DemEnableConditionGroupRef = /InitialEcuC/
          DemOperationCycleRef = PowerCycle
          DemDebounceAlgorithmClass
            DemDebounceCounterBased: DemDebounceCounterDecrementStepSize=1, DemDebounceCounterIncrementStepSize=1, DemDebounceCounterJumpDown=false, DemDebounceCounterJumpUp=true
          IndicatorAttribute_WarningIndicator (DemIndicatorAttribute): DemIndicatorFailureCycleSource=DEM_FAILURE_CYCLE_EVENT, DemIndicatorHealingCycleRef=PowerCycle, DemIndicatorRef=WarningIndicator
      DTCClass_DTC_0x116e05 (DemDTCClass): DemDTCSeverity=DEM_DTC_SEV_NO_SEVERITY, DemUdsDTC=1142277
      DTC_0x116e05 (DemEventParameter):
        DemEventKind = DEM_EVENT_KIND_SWC
        DemDTCClassRef = DTCClass_DTC_0x116e05
        DemExtendedDataClassRef = ExtendedDataClass_83dcefb7
        DemFreezeFrameClassRef = FreezeFrameClass_5f5b5001
        DemFreezeFrameRecNumClassRef = FreezeFrameRecNumClass_f98c8aa7
        DemEventClass:
          DemAgingAllowed = true
          DemAgingCycleCounterThreshold = 40
          DemEventDestination = DEM_DTC_ORIGIN_PRIMARY_MEMORY
          DemEventPriority = 1
          DemEventSignificance = DEM_EVENT_SIGNIFICANCE_FAULT
          DemEventFailureCycleCounterThreshold = 0
          DemAgingCycleRef = PowerCycle
          DemEnableConditionGroupRef = /InitialEcuC/
          DemOperationCycleRef = PowerCycle
          DemDebounceAlgorithmClass
            DemDebounceCounterBased: DemDebounceCounterDecrementStepSize=1, DemDebounceCounterIncrementStepSize=1, DemDebounceCounterJumpDown=false, DemDebounceCounterJumpUp=true
          IndicatorAttribute_WarningIndicator (DemIndicatorAttribute): DemIndicatorFailureCycleSource=DEM_FAILURE_CYCLE_EVENT, DemIndicatorHealingCycleRef=PowerCycle, DemIndicatorRef=WarningIndicator
      DTCClass_DTC_0x116f05 (DemDTCClass): DemDTCSeverity=DEM_DTC_SEV_NO_SEVERITY, DemUdsDTC=1142533
      DTC_0x116f05 (DemEventParameter):
        DemEventKind = DEM_EVENT_KIND_SWC
        DemDTCClassRef = DTCClass_DTC_0x116f05
        DemExtendedDataClassRef = ExtendedDataClass_83dcefb7
        DemFreezeFrameClassRef = FreezeFrameClass_5f5b5001
        DemFreezeFrameRecNumClassRef = FreezeFrameRecNumClass_f98c8aa7
        DemEventClass:
          DemAgingAllowed = true
          DemAgingCycleCounterThreshold = 40
          DemEventDestination = DEM_DTC_ORIGIN_PRIMARY_MEMORY
          DemEventPriority = 1
          DemEventSignificance = DEM_EVENT_SIGNIFICANCE_FAULT
          DemEventFailureCycleCounterThreshold = 0
          DemAgingCycleRef = PowerCycle
          DemEnableConditionGroupRef = /InitialEcuC/
          DemOperationCycleRef = PowerCycle
          DemDebounceAlgorithmClass
            DemDebounceCounterBased: DemDebounceCounterDecrementStepSize=1, DemDebounceCounterIncrementStepSize=1, DemDebounceCounterJumpDown=false, DemDebounceCounterJumpUp=true
          IndicatorAttribute_WarningIndicator (DemIndicatorAttribute): DemIndicatorFailureCycleSource=DEM_FAILURE_CYCLE_EVENT, DemIndicatorHealingCycleRef=PowerCycle, DemIndicatorRef=WarningIndicator
      DTCClass_DTC_0x117097 (DemDTCClass): DemDTCSeverity=DEM_DTC_SEV_NO_SEVERITY, DemUdsDTC=1142935
      DTC_0x117097 (DemEventParameter):
        DemEventKind = DEM_EVENT_KIND_SWC
        DemDTCClassRef = DTCClass_DTC_0x117097
        DemExtendedDataClassRef = ExtendedDataClass_83dcefb7
        DemFreezeFrameClassRef = FreezeFrameClass_5f5b5001
        DemFreezeFrameRecNumClassRef = FreezeFrameRecNumClass_f98c8aa7
        DemEventClass:
          DemAgingAllowed = true
          DemAgingCycleCounterThreshold = 40
          DemEventDestination = DEM_DTC_ORIGIN_PRIMARY_MEMORY
          DemEventPriority = 1
          DemEventSignificance = DEM_EVENT_SIGNIFICANCE_FAULT
          DemEventFailureCycleCounterThreshold = 0
          DemAgingCycleRef = PowerCycle
          DemEnableConditionGroupRef = EnableConditionGroup_fdfec498
          DemOperationCycleRef = PowerCycle
          DemDebounceAlgorithmClass
            DemDebounceCounterBased: DemDebounceCounterDecrementStepSize=1, DemDebounceCounterIncrementStepSize=1, DemDebounceCounterJumpDown=false, DemDebounceCounterJumpUp=true
          IndicatorAttribute_WarningIndicator (DemIndicatorAttribute): DemIndicatorFailureCycleSource=DEM_FAILURE_CYCLE_EVENT, DemIndicatorHealingCycleRef=PowerCycle, DemIndicatorRef=WarningIndicator
      DTCClass_DTC_0x117197 (DemDTCClass): DemDTCSeverity=DEM_DTC_SEV_NO_SEVERITY, DemUdsDTC=1143191
      DTC_0x117197 (DemEventParameter):
        DemEventKind = DEM_EVENT_KIND_SWC
        DemDTCClassRef = DTCClass_DTC_0x117197
        DemExtendedDataClassRef = ExtendedDataClass_83dcefb7
        DemFreezeFrameClassRef = FreezeFrameClass_5f5b5001
        DemFreezeFrameRecNumClassRef = FreezeFrameRecNumClass_f98c8aa7
        DemEventClass:
          DemAgingAllowed = true
          DemAgingCycleCounterThreshold = 40
          DemEventDestination = DEM_DTC_ORIGIN_PRIMARY_MEMORY
          DemEventPriority = 1
          DemEventSignificance = DEM_EVENT_SIGNIFICANCE_FAULT
          DemEventFailureCycleCounterThreshold = 0
          DemAgingCycleRef = PowerCycle
          DemEnableConditionGroupRef = EnableConditionGroup_fdfec498
          DemOperationCycleRef = PowerCycle
          DemDebounceAlgorithmClass
            DemDebounceCounterBased: DemDebounceCounterDecrementStepSize=1, DemDebounceCounterIncrementStepSize=1, DemDebounceCounterJumpDown=false, DemDebounceCounterJumpUp=true
          IndicatorAttribute_WarningIndicator (DemIndicatorAttribute): DemIndicatorFailureCycleSource=DEM_FAILURE_CYCLE_EVENT, DemIndicatorHealingCycleRef=PowerCycle, DemIndicatorRef=WarningIndicator
      DTCClass_DTC_0x117205 (DemDTCClass): DemDTCSeverity=DEM_DTC_SEV_NO_SEVERITY, DemUdsDTC=1143301
      DTC_0x117205 (DemEventParameter):
        DemEventKind = DEM_EVENT_KIND_SWC
        DemDTCClassRef = DTCClass_DTC_0x117205
        DemExtendedDataClassRef = ExtendedDataClass_83dcefb7
        DemFreezeFrameClassRef = FreezeFrameClass_5f5b5001
        DemFreezeFrameRecNumClassRef = FreezeFrameRecNumClass_f98c8aa7
        DemEventClass:
          DemAgingAllowed = true
          DemAgingCycleCounterThreshold = 40
          DemEventDestination = DEM_DTC_ORIGIN_PRIMARY_MEMORY
          DemEventPriority = 1
          DemEventSignificance = DEM_EVENT_SIGNIFICANCE_FAULT
          DemEventFailureCycleCounterThreshold = 0
          DemAgingCycleRef = PowerCycle
          DemEnableConditionGroupRef = /InitialEcuC/
          DemOperationCycleRef = PowerCycle
          DemDebounceAlgorithmClass
            DemDebounceCounterBased: DemDebounceCounterDecrementStepSize=1, DemDebounceCounterIncrementStepSize=1, DemDebounceCounterJumpDown=false, DemDebounceCounterJumpUp=true
          IndicatorAttribute_WarningIndicator (DemIndicatorAttribute): DemIndicatorFailureCycleSource=DEM_FAILURE_CYCLE_EVENT, DemIndicatorHealingCycleRef=PowerCycle, DemIndicatorRef=WarningIndicator
      DTCClass_DTC_0x117305 (DemDTCClass): DemDTCSeverity=DEM_DTC_SEV_NO_SEVERITY, DemUdsDTC=1143557
      DTC_0x117305 (DemEventParameter):
        DemEventKind = DEM_EVENT_KIND_SWC
        DemDTCClassRef = DTCClass_DTC_0x117305
        DemExtendedDataClassRef = ExtendedDataClass_83dcefb7
        DemFreezeFrameClassRef = FreezeFrameClass_5f5b5001
        DemFreezeFrameRecNumClassRef = FreezeFrameRecNumClass_f98c8aa7
        DemEventClass:
          DemAgingAllowed = true
          DemAgingCycleCounterThreshold = 40
          DemEventDestination = DEM_DTC_ORIGIN_PRIMARY_MEMORY
          DemEventPriority = 1
          DemEventSignificance = DEM_EVENT_SIGNIFICANCE_FAULT
          DemEventFailureCycleCounterThreshold = 0
          DemAgingCycleRef = PowerCycle
          DemEnableConditionGroupRef = /InitialEcuC/
          DemOperationCycleRef = PowerCycle
          DemDebounceAlgorithmClass
            DemDebounceCounterBased: DemDebounceCounterDecrementStepSize=1, DemDebounceCounterIncrementStepSize=1, DemDebounceCounterJumpDown=false, DemDebounceCounterJumpUp=true
          IndicatorAttribute_WarningIndicator (DemIndicatorAttribute): DemIndicatorFailureCycleSource=DEM_FAILURE_CYCLE_EVENT, DemIndicatorHealingCycleRef=PowerCycle, DemIndicatorRef=WarningIndicator
      DTCClass_DTC_0x117405 (DemDTCClass): DemDTCSeverity=DEM_DTC_SEV_NO_SEVERITY, DemUdsDTC=1143813
      DTC_0x117405 (DemEventParameter):
        DemEventKind = DEM_EVENT_KIND_SWC
        DemDTCClassRef = DTCClass_DTC_0x117405
        DemExtendedDataClassRef = ExtendedDataClass_83dcefb7
        DemFreezeFrameClassRef = FreezeFrameClass_5f5b5001
        DemFreezeFrameRecNumClassRef = FreezeFrameRecNumClass_f98c8aa7
        DemEventClass:
          DemAgingAllowed = true
          DemAgingCycleCounterThreshold = 40
          DemEventDestination = DEM_DTC_ORIGIN_PRIMARY_MEMORY
          DemEventPriority = 1
          DemEventSignificance = DEM_EVENT_SIGNIFICANCE_FAULT
          DemEventFailureCycleCounterThreshold = 0
          DemAgingCycleRef = PowerCycle
          DemEnableConditionGroupRef = /InitialEcuC/
          DemOperationCycleRef = PowerCycle
          DemDebounceAlgorithmClass
            DemDebounceCounterBased: DemDebounceCounterDecrementStepSize=1, DemDebounceCounterIncrementStepSize=1, DemDebounceCounterJumpDown=false, DemDebounceCounterJumpUp=true
          IndicatorAttribute_WarningIndicator (DemIndicatorAttribute): DemIndicatorFailureCycleSource=DEM_FAILURE_CYCLE_EVENT, DemIndicatorHealingCycleRef=PowerCycle, DemIndicatorRef=WarningIndicator
      DTCClass_DTC_0x117511 (DemDTCClass): DemDTCSeverity=DEM_DTC_SEV_NO_SEVERITY, DemUdsDTC=1144081
      DTC_0x117511 (DemEventParameter):
        DemEventKind = DEM_EVENT_KIND_SWC
        DemDTCClassRef = DTCClass_DTC_0x117511
        DemExtendedDataClassRef = ExtendedDataClass_83dcefb7
        DemFreezeFrameClassRef = FreezeFrameClass_5f5b5001
        DemFreezeFrameRecNumClassRef = FreezeFrameRecNumClass_f98c8aa7
        DemEventClass:
          DemAgingAllowed = true
          DemAgingCycleCounterThreshold = 0
          DemEventDestination = DEM_DTC_ORIGIN_PRIMARY_MEMORY
          DemEventPriority = 0
          DemEventSignificance = DEM_EVENT_SIGNIFICANCE_FAULT
          DemEventFailureCycleCounterThreshold = 0
          DemAgingCycleRef = PowerCycle
          DemEnableConditionGroupRef = EnableConditionGroup_bbe52cb7
          DemOperationCycleRef = PowerCycle
          DemDebounceAlgorithmClass
            DemDebounceCounterBased: DemDebounceCounterDecrementStepSize=1, DemDebounceCounterIncrementStepSize=1, DemDebounceCounterJumpDown=false, DemDebounceCounterJumpUp=true
          IndicatorAttribute_WarningIndicator (DemIndicatorAttribute): DemIndicatorFailureCycleSource=DEM_FAILURE_CYCLE_EVENT, DemIndicatorHealingCycleRef=PowerCycle, DemIndicatorRef=WarningIndicator
      DTCClass_DTC_0x117617 (DemDTCClass): DemDTCSeverity=DEM_DTC_SEV_NO_SEVERITY, DemUdsDTC=1144343
      DTC_0x117617 (DemEventParameter):
        DemEventKind = DEM_EVENT_KIND_SWC
        DemDTCClassRef = DTCClass_DTC_0x117617
        DemExtendedDataClassRef = ExtendedDataClass_83dcefb7
        DemFreezeFrameClassRef = FreezeFrameClass_5f5b5001
        DemFreezeFrameRecNumClassRef = FreezeFrameRecNumClass_f98c8aa7
        DemEventClass:
          DemAgingAllowed = true
          DemAgingCycleCounterThreshold = 40
          DemEventDestination = DEM_DTC_ORIGIN_PRIMARY_MEMORY
          DemEventPriority = 2
          DemEventSignificance = DEM_EVENT_SIGNIFICANCE_FAULT
          DemEventFailureCycleCounterThreshold = 0
          DemAgingCycleRef = PowerCycle
          DemEnableConditionGroupRef = /InitialEcuC/
          DemOperationCycleRef = PowerCycle
          DemDebounceAlgorithmClass
            DemDebounceCounterBased: DemDebounceCounterDecrementStepSize=1, DemDebounceCounterIncrementStepSize=1, DemDebounceCounterJumpDown=false, DemDebounceCounterJumpUp=true
          IndicatorAttribute_WarningIndicator (DemIndicatorAttribute): DemIndicatorFailureCycleSource=DEM_FAILURE_CYCLE_EVENT, DemIndicatorHealingCycleRef=PowerCycle, DemIndicatorRef=WarningIndicator
      DTCClass_DTC_0x117716 (DemDTCClass): DemDTCSeverity=DEM_DTC_SEV_NO_SEVERITY, DemUdsDTC=1144598
      DTC_0x117716 (DemEventParameter):
        DemEventKind = DEM_EVENT_KIND_SWC
        DemDTCClassRef = DTCClass_DTC_0x117716
        DemExtendedDataClassRef = ExtendedDataClass_83dcefb7
        DemFreezeFrameClassRef = FreezeFrameClass_5f5b5001
        DemFreezeFrameRecNumClassRef = FreezeFrameRecNumClass_f98c8aa7
        DemEventClass:
          DemAgingAllowed = true
          DemAgingCycleCounterThreshold = 40
          DemEventDestination = DEM_DTC_ORIGIN_PRIMARY_MEMORY
          DemEventPriority = 2
          DemEventSignificance = DEM_EVENT_SIGNIFICANCE_FAULT
          DemEventFailureCycleCounterThreshold = 0
          DemAgingCycleRef = PowerCycle
          DemEnableConditionGroupRef = /InitialEcuC/
          DemOperationCycleRef = PowerCycle
          DemDebounceAlgorithmClass
            DemDebounceCounterBased: DemDebounceCounterDecrementStepSize=1, DemDebounceCounterIncrementStepSize=1, DemDebounceCounterJumpDown=false, DemDebounceCounterJumpUp=true
          IndicatorAttribute_WarningIndicator (DemIndicatorAttribute): DemIndicatorFailureCycleSource=DEM_FAILURE_CYCLE_EVENT, DemIndicatorHealingCycleRef=PowerCycle, DemIndicatorRef=WarningIndicator
      DTCClass_DTC_0x117819 (DemDTCClass): DemDTCSeverity=DEM_DTC_SEV_NO_SEVERITY, DemUdsDTC=1144857
      DTC_0x117819 (DemEventParameter):
        DemEventKind = DEM_EVENT_KIND_SWC
        DemDTCClassRef = DTCClass_DTC_0x117819
        DemExtendedDataClassRef = ExtendedDataClass_83dcefb7
        DemFreezeFrameClassRef = FreezeFrameClass_5f5b5001
        DemFreezeFrameRecNumClassRef = FreezeFrameRecNumClass_f98c8aa7
        DemEventClass:
          DemAgingAllowed = true
          DemAgingCycleCounterThreshold = 40
          DemEventDestination = DEM_DTC_ORIGIN_PRIMARY_MEMORY
          DemEventPriority = 2
          DemEventSignificance = DEM_EVENT_SIGNIFICANCE_FAULT
          DemEventFailureCycleCounterThreshold = 0
          DemAgingCycleRef = PowerCycle
          DemEnableConditionGroupRef = /InitialEcuC/
          DemOperationCycleRef = PowerCycle
          DemDebounceAlgorithmClass
            DemDebounceCounterBased: DemDebounceCounterDecrementStepSize=1, DemDebounceCounterIncrementStepSize=1, DemDebounceCounterJumpDown=false, DemDebounceCounterJumpUp=true
          IndicatorAttribute_WarningIndicator (DemIndicatorAttribute): DemIndicatorFailureCycleSource=DEM_FAILURE_CYCLE_EVENT, DemIndicatorHealingCycleRef=PowerCycle, DemIndicatorRef=WarningIndicator
      DTCClass_DTC_0x11794b (DemDTCClass): DemDTCSeverity=DEM_DTC_SEV_NO_SEVERITY, DemUdsDTC=1145163
      DTC_0x11794b (DemEventParameter):
        DemEventKind = DEM_EVENT_KIND_SWC
        DemDTCClassRef = DTCClass_DTC_0x11794b
        DemExtendedDataClassRef = ExtendedDataClass_83dcefb7
        DemFreezeFrameClassRef = FreezeFrameClass_5f5b5001
        DemFreezeFrameRecNumClassRef = FreezeFrameRecNumClass_f98c8aa7
        DemEventClass:
          DemAgingAllowed = true
          DemAgingCycleCounterThreshold = 40
          DemEventDestination = DEM_DTC_ORIGIN_PRIMARY_MEMORY
          DemEventPriority = 2
          DemEventSignificance = DEM_EVENT_SIGNIFICANCE_FAULT
          DemEventFailureCycleCounterThreshold = 0
          DemAgingCycleRef = PowerCycle
          DemEnableConditionGroupRef = /InitialEcuC/
          DemOperationCycleRef = PowerCycle
          DemDebounceAlgorithmClass
            DemDebounceCounterBased: DemDebounceCounterDecrementStepSize=1, DemDebounceCounterIncrementStepSize=1, DemDebounceCounterJumpDown=false, DemDebounceCounterJumpUp=true
          IndicatorAttribute_WarningIndicator (DemIndicatorAttribute): DemIndicatorFailureCycleSource=DEM_FAILURE_CYCLE_EVENT, DemIndicatorHealingCycleRef=PowerCycle, DemIndicatorRef=WarningIndicator
      DTCClass_DTC_0x117a4c (DemDTCClass): DemDTCSeverity=DEM_DTC_SEV_NO_SEVERITY, DemUdsDTC=1145420
      DTC_0x117a4c (DemEventParameter):
        DemEventKind = DEM_EVENT_KIND_SWC
        DemDTCClassRef = DTCClass_DTC_0x117a4c
        DemExtendedDataClassRef = ExtendedDataClass_83dcefb7
        DemFreezeFrameClassRef = FreezeFrameClass_5f5b5001
        DemFreezeFrameRecNumClassRef = FreezeFrameRecNumClass_f98c8aa7
        DemEventClass:
          DemAgingAllowed = true
          DemAgingCycleCounterThreshold = 40
          DemEventDestination = DEM_DTC_ORIGIN_PRIMARY_MEMORY
          DemEventPriority = 2
          DemEventSignificance = DEM_EVENT_SIGNIFICANCE_FAULT
          DemEventFailureCycleCounterThreshold = 0
          DemAgingCycleRef = PowerCycle
          DemEnableConditionGroupRef = /InitialEcuC/
          DemOperationCycleRef = PowerCycle
          DemDebounceAlgorithmClass
            DemDebounceCounterBased: DemDebounceCounterDecrementStepSize=1, DemDebounceCounterIncrementStepSize=1, DemDebounceCounterJumpDown=false, DemDebounceCounterJumpUp=true
          IndicatorAttribute_WarningIndicator (DemIndicatorAttribute): DemIndicatorFailureCycleSource=DEM_FAILURE_CYCLE_EVENT, DemIndicatorHealingCycleRef=PowerCycle, DemIndicatorRef=WarningIndicator
      DTCClass_DTC_0x117b94 (DemDTCClass): DemDTCSeverity=DEM_DTC_SEV_NO_SEVERITY, DemUdsDTC=1145748
      DTC_0x117b94 (DemEventParameter):
        DemEventKind = DEM_EVENT_KIND_SWC
        DemDTCClassRef = DTCClass_DTC_0x117b94
        DemExtendedDataClassRef = ExtendedDataClass_83dcefb7
        DemFreezeFrameClassRef = FreezeFrameClass_5f5b5001
        DemFreezeFrameRecNumClassRef = FreezeFrameRecNumClass_f98c8aa7
        DemEventClass:
          DemAgingAllowed = true
          DemAgingCycleCounterThreshold = 40
          DemEventDestination = DEM_DTC_ORIGIN_PRIMARY_MEMORY
          DemEventPriority = 2
          DemEventSignificance = DEM_EVENT_SIGNIFICANCE_FAULT
          DemEventFailureCycleCounterThreshold = 0
          DemAgingCycleRef = PowerCycle
          DemEnableConditionGroupRef = /InitialEcuC/
          DemOperationCycleRef = PowerCycle
          DemDebounceAlgorithmClass
            DemDebounceCounterBased: DemDebounceCounterDecrementStepSize=1, DemDebounceCounterIncrementStepSize=1, DemDebounceCounterJumpDown=false, DemDebounceCounterJumpUp=true
          IndicatorAttribute_WarningIndicator (DemIndicatorAttribute): DemIndicatorFailureCycleSource=DEM_FAILURE_CYCLE_EVENT, DemIndicatorHealingCycleRef=PowerCycle, DemIndicatorRef=WarningIndicator
      DTCClass_DTC_0x117c08 (DemDTCClass): DemDTCSeverity=DEM_DTC_SEV_NO_SEVERITY, DemUdsDTC=1145864
      DTC_0x117c08 (DemEventParameter):
        DemEventKind = DEM_EVENT_KIND_SWC
        DemDTCClassRef = DTCClass_DTC_0x117c08
        DemExtendedDataClassRef = ExtendedDataClass_83dcefb7
        DemFreezeFrameClassRef = FreezeFrameClass_5f5b5001
        DemFreezeFrameRecNumClassRef = FreezeFrameRecNumClass_f98c8aa7
        DemEventClass:
          DemAgingAllowed = true
          DemAgingCycleCounterThreshold = 40
          DemEventDestination = DEM_DTC_ORIGIN_PRIMARY_MEMORY
          DemEventPriority = 2
          DemEventSignificance = DEM_EVENT_SIGNIFICANCE_FAULT
          DemEventFailureCycleCounterThreshold = 0
          DemAgingCycleRef = PowerCycle
          DemEnableConditionGroupRef = EnableConditionGroup_4ffb066f
          DemOperationCycleRef = PowerCycle
          DemDebounceAlgorithmClass
            DemDebounceCounterBased: DemDebounceCounterDecrementStepSize=1, DemDebounceCounterIncrementStepSize=1, DemDebounceCounterJumpDown=false, DemDebounceCounterJumpUp=true
          IndicatorAttribute_WarningIndicator (DemIndicatorAttribute): DemIndicatorFailureCycleSource=DEM_FAILURE_CYCLE_EVENT, DemIndicatorHealingCycleRef=PowerCycle, DemIndicatorRef=WarningIndicator
      DTCClass_DTC_0x117d08 (DemDTCClass): DemDTCSeverity=DEM_DTC_SEV_NO_SEVERITY, DemUdsDTC=1146120
      DTC_0x117d08 (DemEventParameter):
        DemEventKind = DEM_EVENT_KIND_SWC
        DemDTCClassRef = DTCClass_DTC_0x117d08
        DemExtendedDataClassRef = ExtendedDataClass_83dcefb7
        DemFreezeFrameClassRef = FreezeFrameClass_5f5b5001
        DemFreezeFrameRecNumClassRef = FreezeFrameRecNumClass_f98c8aa7
        DemEventClass:
          DemAgingAllowed = true
          DemAgingCycleCounterThreshold = 40
          DemEventDestination = DEM_DTC_ORIGIN_PRIMARY_MEMORY
          DemEventPriority = 2
          DemEventSignificance = DEM_EVENT_SIGNIFICANCE_FAULT
          DemEventFailureCycleCounterThreshold = 0
          DemAgingCycleRef = PowerCycle
          DemEnableConditionGroupRef = EnableConditionGroup_4ffb066f
          DemOperationCycleRef = PowerCycle
          DemDebounceAlgorithmClass
            DemDebounceCounterBased: DemDebounceCounterDecrementStepSize=1, DemDebounceCounterIncrementStepSize=1, DemDebounceCounterJumpDown=false, DemDebounceCounterJumpUp=true
          IndicatorAttribute_WarningIndicator (DemIndicatorAttribute): DemIndicatorFailureCycleSource=DEM_FAILURE_CYCLE_EVENT, DemIndicatorHealingCycleRef=PowerCycle, DemIndicatorRef=WarningIndicator
      DTCClass_DTC_0x117e52 (DemDTCClass): DemDTCSeverity=DEM_DTC_SEV_NO_SEVERITY, DemUdsDTC=1146450
      DTC_0x117e52 (DemEventParameter):
        DemEventKind = DEM_EVENT_KIND_SWC
        DemDTCClassRef = DTCClass_DTC_0x117e52
        DemExtendedDataClassRef = ExtendedDataClass_83dcefb7
        DemFreezeFrameClassRef = FreezeFrameClass_5f5b5001
        DemFreezeFrameRecNumClassRef = FreezeFrameRecNumClass_f98c8aa7
        DemEventClass:
          DemAgingAllowed = true
          DemAgingCycleCounterThreshold = 40
          DemEventDestination = DEM_DTC_ORIGIN_PRIMARY_MEMORY
          DemEventPriority = 2
          DemEventSignificance = DEM_EVENT_SIGNIFICANCE_FAULT
          DemEventFailureCycleCounterThreshold = 0
          DemAgingCycleRef = PowerCycle
          DemEnableConditionGroupRef = EnableConditionGroup_fd8a9b69
          DemOperationCycleRef = PowerCycle
          DemDebounceAlgorithmClass
            DemDebounceCounterBased: DemDebounceCounterDecrementStepSize=1, DemDebounceCounterIncrementStepSize=1, DemDebounceCounterJumpDown=false, DemDebounceCounterJumpUp=true
          IndicatorAttribute_WarningIndicator (DemIndicatorAttribute): DemIndicatorFailureCycleSource=DEM_FAILURE_CYCLE_EVENT, DemIndicatorHealingCycleRef=PowerCycle, DemIndicatorRef=WarningIndicator
      DTCClass_DTC_0x117f08 (DemDTCClass): DemDTCSeverity=DEM_DTC_SEV_NO_SEVERITY, DemUdsDTC=1146632
      DTC_0x117f08 (DemEventParameter):
        DemEventKind = DEM_EVENT_KIND_SWC
        DemDTCClassRef = DTCClass_DTC_0x117f08
        DemExtendedDataClassRef = ExtendedDataClass_83dcefb7
        DemFreezeFrameClassRef = FreezeFrameClass_5f5b5001
        DemFreezeFrameRecNumClassRef = FreezeFrameRecNumClass_f98c8aa7
        DemEventClass:
          DemAgingAllowed = true
          DemAgingCycleCounterThreshold = 40
          DemEventDestination = DEM_DTC_ORIGIN_PRIMARY_MEMORY
          DemEventPriority = 2
          DemEventSignificance = DEM_EVENT_SIGNIFICANCE_FAULT
          DemEventFailureCycleCounterThreshold = 0
          DemAgingCycleRef = PowerCycle
          DemEnableConditionGroupRef = EnableConditionGroup_4ffb066f
          DemOperationCycleRef = PowerCycle
          DemDebounceAlgorithmClass
            DemDebounceCounterBased: DemDebounceCounterDecrementStepSize=1, DemDebounceCounterIncrementStepSize=1, DemDebounceCounterJumpDown=false, DemDebounceCounterJumpUp=true
          IndicatorAttribute_WarningIndicator (DemIndicatorAttribute): DemIndicatorFailureCycleSource=DEM_FAILURE_CYCLE_EVENT, DemIndicatorHealingCycleRef=PowerCycle, DemIndicatorRef=WarningIndicator
      DTCClass_DTC_0x908017 (DemDTCClass): DemDTCSeverity=DEM_DTC_SEV_NO_SEVERITY, DemUdsDTC=9469975
      DTC_0x908017 (DemEventParameter):
        DemEventKind = DEM_EVENT_KIND_SWC
        DemDTCClassRef = DTCClass_DTC_0x908017
        DemExtendedDataClassRef = ExtendedDataClass_83dcefb7
        DemFreezeFrameClassRef = FreezeFrameClass_5f5b5001
        DemFreezeFrameRecNumClassRef = FreezeFrameRecNumClass_f98c8aa7
        DemEventClass:
          DemAgingAllowed = true
          DemAgingCycleCounterThreshold = 40
          DemEventDestination = DEM_DTC_ORIGIN_PRIMARY_MEMORY
          DemEventPriority = 1
          DemEventSignificance = DEM_EVENT_SIGNIFICANCE_FAULT
          DemEventFailureCycleCounterThreshold = 0
          DemAgingCycleRef = PowerCycle
          DemEnableConditionGroupRef = EnableConditionGroup_93df7d19
          DemOperationCycleRef = PowerCycle
          DemDebounceAlgorithmClass
            DemDebounceCounterBased: DemDebounceCounterDecrementStepSize=1, DemDebounceCounterIncrementStepSize=1, DemDebounceCounterJumpDown=false, DemDebounceCounterJumpUp=true
          IndicatorAttribute_WarningIndicator (DemIndicatorAttribute): DemIndicatorFailureCycleSource=DEM_FAILURE_CYCLE_EVENT, DemIndicatorHealingCycleRef=PowerCycle, DemIndicatorRef=WarningIndicator
      DTCClass_DTC_0x908116 (DemDTCClass): DemDTCSeverity=DEM_DTC_SEV_NO_SEVERITY, DemUdsDTC=9470230
      DTC_0x908116 (DemEventParameter):
        DemEventKind = DEM_EVENT_KIND_SWC
        DemDTCClassRef = DTCClass_DTC_0x908116
        DemExtendedDataClassRef = ExtendedDataClass_83dcefb7
        DemFreezeFrameClassRef = FreezeFrameClass_5f5b5001
        DemFreezeFrameRecNumClassRef = FreezeFrameRecNumClass_f98c8aa7
        DemEventClass:
          DemAgingAllowed = true
          DemAgingCycleCounterThreshold = 40
          DemEventDestination = DEM_DTC_ORIGIN_PRIMARY_MEMORY
          DemEventPriority = 1
          DemEventSignificance = DEM_EVENT_SIGNIFICANCE_FAULT
          DemEventFailureCycleCounterThreshold = 0
          DemAgingCycleRef = PowerCycle
          DemEnableConditionGroupRef = EnableConditionGroup_93df7d19
          DemOperationCycleRef = PowerCycle
          DemDebounceAlgorithmClass
            DemDebounceCounterBased: DemDebounceCounterDecrementStepSize=1, DemDebounceCounterIncrementStepSize=1, DemDebounceCounterJumpDown=false, DemDebounceCounterJumpUp=true
          IndicatorAttribute_WarningIndicator (DemIndicatorAttribute): DemIndicatorFailureCycleSource=DEM_FAILURE_CYCLE_EVENT, DemIndicatorHealingCycleRef=PowerCycle, DemIndicatorRef=WarningIndicator
      DTCClass_DTC_0x908255 (DemDTCClass): DemDTCSeverity=DEM_DTC_SEV_NO_SEVERITY, DemUdsDTC=9470549
      DTC_0x908255 (DemEventParameter):
        DemEventKind = DEM_EVENT_KIND_SWC
        DemDTCClassRef = DTCClass_DTC_0x908255
        DemExtendedDataClassRef = ExtendedDataClass_83dcefb7
        DemFreezeFrameClassRef = FreezeFrameClass_5f5b5001
        DemFreezeFrameRecNumClassRef = FreezeFrameRecNumClass_f98c8aa7
        DemEventClass:
          DemAgingAllowed = true
          DemAgingCycleCounterThreshold = 40
          DemEventDestination = DEM_DTC_ORIGIN_PRIMARY_MEMORY
          DemEventPriority = 2
          DemEventSignificance = DEM_EVENT_SIGNIFICANCE_FAULT
          DemEventFailureCycleCounterThreshold = 0
          DemAgingCycleRef = PowerCycle
          DemEnableConditionGroupRef = EnableConditionGroup_fb7bc2c5
          DemOperationCycleRef = PowerCycle
          DemDebounceAlgorithmClass
            DemDebounceCounterBased: DemDebounceCounterDecrementStepSize=1, DemDebounceCounterIncrementStepSize=1, DemDebounceCounterJumpDown=false, DemDebounceCounterJumpUp=true
          IndicatorAttribute_WarningIndicator (DemIndicatorAttribute): DemIndicatorFailureCycleSource=DEM_FAILURE_CYCLE_EVENT, DemIndicatorHealingCycleRef=PowerCycle, DemIndicatorRef=WarningIndicator
      DTCClass_DTC_0x908356 (DemDTCClass): DemDTCSeverity=DEM_DTC_SEV_NO_SEVERITY, DemUdsDTC=9470806
      DTC_0x908356 (DemEventParameter):
        DemEventKind = DEM_EVENT_KIND_SWC
        DemDTCClassRef = DTCClass_DTC_0x908356
        DemExtendedDataClassRef = ExtendedDataClass_83dcefb7
        DemFreezeFrameClassRef = FreezeFrameClass_5f5b5001
        DemFreezeFrameRecNumClassRef = FreezeFrameRecNumClass_f98c8aa7
        DemEventClass:
          DemAgingAllowed = true
          DemAgingCycleCounterThreshold = 40
          DemEventDestination = DEM_DTC_ORIGIN_PRIMARY_MEMORY
          DemEventPriority = 2
          DemEventSignificance = DEM_EVENT_SIGNIFICANCE_FAULT
          DemEventFailureCycleCounterThreshold = 0
          DemAgingCycleRef = PowerCycle
          DemEnableConditionGroupRef = EnableConditionGroup_bbe52cb7
          DemOperationCycleRef = PowerCycle
          DemDebounceAlgorithmClass
            DemDebounceCounterBased: DemDebounceCounterDecrementStepSize=1, DemDebounceCounterIncrementStepSize=1, DemDebounceCounterJumpDown=false, DemDebounceCounterJumpUp=true
          IndicatorAttribute_WarningIndicator (DemIndicatorAttribute): DemIndicatorFailureCycleSource=DEM_FAILURE_CYCLE_EVENT, DemIndicatorHealingCycleRef=PowerCycle, DemIndicatorRef=WarningIndicator
      DTCClass_DTC_0xc07388 (DemDTCClass): DemDTCSeverity=DEM_DTC_SEV_NO_SEVERITY, DemUdsDTC=12612488
      DTC_0xc07388 (DemEventParameter):
        DemEventKind = DEM_EVENT_KIND_SWC
        DemDTCClassRef = DTCClass_DTC_0xc07388
        DemExtendedDataClassRef = ExtendedDataClass_83dcefb7
        DemFreezeFrameClassRef = FreezeFrameClass_5f5b5001
        DemFreezeFrameRecNumClassRef = FreezeFrameRecNumClass_f98c8aa7
        DemEventClass:
          DemAgingAllowed = true
          DemAgingCycleCounterThreshold = 40
          DemEventDestination = DEM_DTC_ORIGIN_PRIMARY_MEMORY
          DemEventPriority = 1
          DemEventSignificance = DEM_EVENT_SIGNIFICANCE_FAULT
          DemEventFailureCycleCounterThreshold = 0
          DemAgingCycleRef = PowerCycle
          DemEnableConditionGroupRef = EnableConditionGroup_c81fc67e
          DemOperationCycleRef = PowerCycle
          DemDebounceAlgorithmClass
            DemDebounceCounterBased: DemDebounceCounterDecrementStepSize=1, DemDebounceCounterIncrementStepSize=1, DemDebounceCounterJumpDown=false, DemDebounceCounterJumpUp=true
          IndicatorAttribute_WarningIndicator (DemIndicatorAttribute): DemIndicatorFailureCycleSource=DEM_FAILURE_CYCLE_EVENT, DemIndicatorHealingCycleRef=PowerCycle, DemIndicatorRef=WarningIndicator
      DTCClass_DTC_0xc07488 (DemDTCClass): DemDTCSeverity=DEM_DTC_SEV_NO_SEVERITY, DemUdsDTC=12612744
      DTC_0xc07488 (DemEventParameter):
        DemEventKind = DEM_EVENT_KIND_SWC
        DemDTCClassRef = DTCClass_DTC_0xc07488
        DemExtendedDataClassRef = ExtendedDataClass_83dcefb7
        DemFreezeFrameClassRef = FreezeFrameClass_5f5b5001
        DemFreezeFrameRecNumClassRef = FreezeFrameRecNumClass_f98c8aa7
        DemEventClass:
          DemAgingAllowed = true
          DemAgingCycleCounterThreshold = 40
          DemEventDestination = DEM_DTC_ORIGIN_PRIMARY_MEMORY
          DemEventPriority = 1
          DemEventSignificance = DEM_EVENT_SIGNIFICANCE_FAULT
          DemEventFailureCycleCounterThreshold = 0
          DemAgingCycleRef = PowerCycle
          DemEnableConditionGroupRef = EnableConditionGroup_c81fc67e
          DemOperationCycleRef = PowerCycle
          DemDebounceAlgorithmClass
            DemDebounceCounterBased: DemDebounceCounterDecrementStepSize=1, DemDebounceCounterIncrementStepSize=1, DemDebounceCounterJumpDown=false, DemDebounceCounterJumpUp=true
          IndicatorAttribute_WarningIndicator (DemIndicatorAttribute): DemIndicatorFailureCycleSource=DEM_FAILURE_CYCLE_EVENT, DemIndicatorHealingCycleRef=PowerCycle, DemIndicatorRef=WarningIndicator
      DTCClass_DTC_0xc10387 (DemDTCClass): DemDTCSeverity=DEM_DTC_SEV_NO_SEVERITY, DemUdsDTC=12649351
      DTC_0xc10387 (DemEventParameter):
        DemEventKind = DEM_EVENT_KIND_SWC
        DemDTCClassRef = DTCClass_DTC_0xc10387
        DemExtendedDataClassRef = ExtendedDataClass_83dcefb7
        DemFreezeFrameClassRef = FreezeFrameClass_5f5b5001
        DemFreezeFrameRecNumClassRef = FreezeFrameRecNumClass_f98c8aa7
        DemEventClass:
          DemAgingAllowed = true
          DemAgingCycleCounterThreshold = 40
          DemEventDestination = DEM_DTC_ORIGIN_PRIMARY_MEMORY
          DemEventPriority = 1
          DemEventSignificance = DEM_EVENT_SIGNIFICANCE_FAULT
          DemEventFailureCycleCounterThreshold = 0
          DemAgingCycleRef = PowerCycle
          DemEnableConditionGroupRef = EnableConditionGroup_f3616881
          DemOperationCycleRef = PowerCycle
          DemDebounceAlgorithmClass
            DemDebounceCounterBased: DemDebounceCounterDecrementStepSize=1, DemDebounceCounterIncrementStepSize=1, DemDebounceCounterJumpDown=false, DemDebounceCounterJumpUp=true
          IndicatorAttribute_WarningIndicator (DemIndicatorAttribute): DemIndicatorFailureCycleSource=DEM_FAILURE_CYCLE_EVENT, DemIndicatorHealingCycleRef=PowerCycle, DemIndicatorRef=WarningIndicator
      DTCClass_DTC_0xc10f87 (DemDTCClass): DemDTCSeverity=DEM_DTC_SEV_NO_SEVERITY, DemUdsDTC=12652423
      DTC_0xc10f87 (DemEventParameter):
        DemEventKind = DEM_EVENT_KIND_SWC
        DemDTCClassRef = DTCClass_DTC_0xc10f87
        DemExtendedDataClassRef = ExtendedDataClass_83dcefb7
        DemFreezeFrameClassRef = FreezeFrameClass_5f5b5001
        DemFreezeFrameRecNumClassRef = FreezeFrameRecNumClass_f98c8aa7
        DemEventClass:
          DemAgingAllowed = true
          DemAgingCycleCounterThreshold = 40
          DemEventDestination = DEM_DTC_ORIGIN_PRIMARY_MEMORY
          DemEventPriority = 2
          DemEventSignificance = DEM_EVENT_SIGNIFICANCE_FAULT
          DemEventFailureCycleCounterThreshold = 0
          DemAgingCycleRef = PowerCycle
          DemEnableConditionGroupRef = EnableConditionGroup_f3616881
          DemOperationCycleRef = PowerCycle
          DemDebounceAlgorithmClass
            DemDebounceCounterBased: DemDebounceCounterDecrementStepSize=1, DemDebounceCounterIncrementStepSize=1, DemDebounceCounterJumpDown=false, DemDebounceCounterJumpUp=true
          IndicatorAttribute_WarningIndicator (DemIndicatorAttribute): DemIndicatorFailureCycleSource=DEM_FAILURE_CYCLE_EVENT, DemIndicatorHealingCycleRef=PowerCycle, DemIndicatorRef=WarningIndicator
      DTCClass_DTC_0xc11087 (DemDTCClass): DemDTCSeverity=DEM_DTC_SEV_NO_SEVERITY, DemUdsDTC=12652679
      DTC_0xc11087 (DemEventParameter):
        DemEventKind = DEM_EVENT_KIND_SWC
        DemDTCClassRef = DTCClass_DTC_0xc11087
        DemExtendedDataClassRef = ExtendedDataClass_83dcefb7
        DemFreezeFrameClassRef = FreezeFrameClass_5f5b5001
        DemFreezeFrameRecNumClassRef = FreezeFrameRecNumClass_f98c8aa7
        DemEventClass:
          DemAgingAllowed = true
          DemAgingCycleCounterThreshold = 40
          DemEventDestination = DEM_DTC_ORIGIN_PRIMARY_MEMORY
          DemEventPriority = 1
          DemEventSignificance = DEM_EVENT_SIGNIFICANCE_FAULT
          DemEventFailureCycleCounterThreshold = 0
          DemAgingCycleRef = PowerCycle
          DemEnableConditionGroupRef = EnableConditionGroup_f3616881
          DemOperationCycleRef = PowerCycle
          DemDebounceAlgorithmClass
            DemDebounceCounterBased: DemDebounceCounterDecrementStepSize=1, DemDebounceCounterIncrementStepSize=1, DemDebounceCounterJumpDown=false, DemDebounceCounterJumpUp=true
          IndicatorAttribute_WarningIndicator (DemIndicatorAttribute): DemIndicatorFailureCycleSource=DEM_FAILURE_CYCLE_EVENT, DemIndicatorHealingCycleRef=PowerCycle, DemIndicatorRef=WarningIndicator
      DTCClass_DTC_0xc11187 (DemDTCClass): DemDTCSeverity=DEM_DTC_SEV_NO_SEVERITY, DemUdsDTC=12652935
      DTC_0xc11187 (DemEventParameter):
        DemEventKind = DEM_EVENT_KIND_SWC
        DemDTCClassRef = DTCClass_DTC_0xc11187
        DemExtendedDataClassRef = ExtendedDataClass_83dcefb7
        DemFreezeFrameClassRef = FreezeFrameClass_5f5b5001
        DemFreezeFrameRecNumClassRef = FreezeFrameRecNumClass_f98c8aa7
        DemEventClass:
          DemAgingAllowed = true
          DemAgingCycleCounterThreshold = 40
          DemEventDestination = DEM_DTC_ORIGIN_PRIMARY_MEMORY
          DemEventPriority = 1
          DemEventSignificance = DEM_EVENT_SIGNIFICANCE_FAULT
          DemEventFailureCycleCounterThreshold = 0
          DemAgingCycleRef = PowerCycle
          DemEnableConditionGroupRef = EnableConditionGroup_f3616881
          DemOperationCycleRef = PowerCycle
          DemDebounceAlgorithmClass
            DemDebounceCounterBased: DemDebounceCounterDecrementStepSize=1, DemDebounceCounterIncrementStepSize=1, DemDebounceCounterJumpDown=false, DemDebounceCounterJumpUp=true
          IndicatorAttribute_WarningIndicator (DemIndicatorAttribute): DemIndicatorFailureCycleSource=DEM_FAILURE_CYCLE_EVENT, DemIndicatorHealingCycleRef=PowerCycle, DemIndicatorRef=WarningIndicator
      DTCClass_DTC_0xc12987 (DemDTCClass): DemDTCSeverity=DEM_DTC_SEV_NO_SEVERITY, DemUdsDTC=12659079
      DTC_0xc12987 (DemEventParameter):
        DemEventKind = DEM_EVENT_KIND_SWC
        DemDTCClassRef = DTCClass_DTC_0xc12987
        DemExtendedDataClassRef = ExtendedDataClass_83dcefb7
        DemFreezeFrameClassRef = FreezeFrameClass_5f5b5001
        DemFreezeFrameRecNumClassRef = FreezeFrameRecNumClass_f98c8aa7
        DemEventClass:
          DemAgingAllowed = true
          DemAgingCycleCounterThreshold = 40
          DemEventDestination = DEM_DTC_ORIGIN_PRIMARY_MEMORY
          DemEventPriority = 1
          DemEventSignificance = DEM_EVENT_SIGNIFICANCE_FAULT
          DemEventFailureCycleCounterThreshold = 0
          DemAgingCycleRef = PowerCycle
          DemEnableConditionGroupRef = EnableConditionGroup_35324f44
          DemOperationCycleRef = PowerCycle
          DemDebounceAlgorithmClass
            DemDebounceCounterBased: DemDebounceCounterDecrementStepSize=1, DemDebounceCounterIncrementStepSize=1, DemDebounceCounterJumpDown=false, DemDebounceCounterJumpUp=true
          IndicatorAttribute_WarningIndicator (DemIndicatorAttribute): DemIndicatorFailureCycleSource=DEM_FAILURE_CYCLE_EVENT, DemIndicatorHealingCycleRef=PowerCycle, DemIndicatorRef=WarningIndicator
      DTCClass_DTC_0xc14087 (DemDTCClass): DemDTCSeverity=DEM_DTC_SEV_NO_SEVERITY, DemUdsDTC=12664967
      DTC_0xc14087 (DemEventParameter):
        DemEventKind = DEM_EVENT_KIND_SWC
        DemDTCClassRef = DTCClass_DTC_0xc14087
        DemExtendedDataClassRef = ExtendedDataClass_83dcefb7
        DemFreezeFrameClassRef = FreezeFrameClass_5f5b5001
        DemFreezeFrameRecNumClassRef = FreezeFrameRecNumClass_f98c8aa7
        DemEventClass:
          DemAgingAllowed = true
          DemAgingCycleCounterThreshold = 40
          DemEventDestination = DEM_DTC_ORIGIN_PRIMARY_MEMORY
          DemEventPriority = 1
          DemEventSignificance = DEM_EVENT_SIGNIFICANCE_FAULT
          DemEventFailureCycleCounterThreshold = 0
          DemAgingCycleRef = PowerCycle
          DemEnableConditionGroupRef = EnableConditionGroup_f3616881
          DemOperationCycleRef = PowerCycle
          DemDebounceAlgorithmClass
            DemDebounceCounterBased: DemDebounceCounterDecrementStepSize=1, DemDebounceCounterIncrementStepSize=1, DemDebounceCounterJumpDown=false, DemDebounceCounterJumpUp=true
          IndicatorAttribute_WarningIndicator (DemIndicatorAttribute): DemIndicatorFailureCycleSource=DEM_FAILURE_CYCLE_EVENT, DemIndicatorHealingCycleRef=PowerCycle, DemIndicatorRef=WarningIndicator
      DTCClass_DTC_0xc14687 (DemDTCClass): DemDTCSeverity=DEM_DTC_SEV_NO_SEVERITY, DemUdsDTC=12666503
      DTC_0xc14687 (DemEventParameter):
        DemEventKind = DEM_EVENT_KIND_SWC
        DemDTCClassRef = DTCClass_DTC_0xc14687
        DemExtendedDataClassRef = ExtendedDataClass_83dcefb7
        DemFreezeFrameClassRef = FreezeFrameClass_5f5b5001
        DemFreezeFrameRecNumClassRef = FreezeFrameRecNumClass_f98c8aa7
        DemEventClass:
          DemAgingAllowed = true
          DemAgingCycleCounterThreshold = 40
          DemEventDestination = DEM_DTC_ORIGIN_PRIMARY_MEMORY
          DemEventPriority = 2
          DemEventSignificance = DEM_EVENT_SIGNIFICANCE_FAULT
          DemEventFailureCycleCounterThreshold = 0
          DemAgingCycleRef = PowerCycle
          DemEnableConditionGroupRef = EnableConditionGroup_f3616881
          DemOperationCycleRef = PowerCycle
          DemDebounceAlgorithmClass
            DemDebounceCounterBased: DemDebounceCounterDecrementStepSize=1, DemDebounceCounterIncrementStepSize=1, DemDebounceCounterJumpDown=false, DemDebounceCounterJumpUp=true
          IndicatorAttribute_WarningIndicator (DemIndicatorAttribute): DemIndicatorFailureCycleSource=DEM_FAILURE_CYCLE_EVENT, DemIndicatorHealingCycleRef=PowerCycle, DemIndicatorRef=WarningIndicator
      DTCClass_DTC_0xc14787 (DemDTCClass): DemDTCSeverity=DEM_DTC_SEV_NO_SEVERITY, DemUdsDTC=12666759
      DTC_0xc14787 (DemEventParameter):
        DemEventKind = DEM_EVENT_KIND_SWC
        DemDTCClassRef = DTCClass_DTC_0xc14787
        DemExtendedDataClassRef = ExtendedDataClass_83dcefb7
        DemFreezeFrameClassRef = FreezeFrameClass_5f5b5001
        DemFreezeFrameRecNumClassRef = FreezeFrameRecNumClass_f98c8aa7
        DemEventClass:
          DemAgingAllowed = true
          DemAgingCycleCounterThreshold = 40
          DemEventDestination = DEM_DTC_ORIGIN_PRIMARY_MEMORY
          DemEventPriority = 2
          DemEventSignificance = DEM_EVENT_SIGNIFICANCE_FAULT
          DemEventFailureCycleCounterThreshold = 0
          DemAgingCycleRef = PowerCycle
          DemEnableConditionGroupRef = EnableConditionGroup_f3616881
          DemOperationCycleRef = PowerCycle
          DemDebounceAlgorithmClass
            DemDebounceCounterBased: DemDebounceCounterDecrementStepSize=1, DemDebounceCounterIncrementStepSize=1, DemDebounceCounterJumpDown=false, DemDebounceCounterJumpUp=true
          IndicatorAttribute_WarningIndicator (DemIndicatorAttribute): DemIndicatorFailureCycleSource=DEM_FAILURE_CYCLE_EVENT, DemIndicatorHealingCycleRef=PowerCycle, DemIndicatorRef=WarningIndicator
      DTCClass_DTC_0xc14887 (DemDTCClass): DemDTCSeverity=DEM_DTC_SEV_NO_SEVERITY, DemUdsDTC=12667015
      DTC_0xc14887 (DemEventParameter):
        DemEventKind = DEM_EVENT_KIND_SWC
        DemDTCClassRef = DTCClass_DTC_0xc14887
        DemExtendedDataClassRef = ExtendedDataClass_83dcefb7
        DemFreezeFrameClassRef = FreezeFrameClass_5f5b5001
        DemFreezeFrameRecNumClassRef = FreezeFrameRecNumClass_f98c8aa7
        DemEventClass:
          DemAgingAllowed = true
          DemAgingCycleCounterThreshold = 40
          DemEventDestination = DEM_DTC_ORIGIN_PRIMARY_MEMORY
          DemEventPriority = 2
          DemEventSignificance = DEM_EVENT_SIGNIFICANCE_FAULT
          DemEventFailureCycleCounterThreshold = 0
          DemAgingCycleRef = PowerCycle
          DemEnableConditionGroupRef = EnableConditionGroup_35324f44
          DemOperationCycleRef = PowerCycle
          DemDebounceAlgorithmClass
            DemDebounceCounterBased: DemDebounceCounterDecrementStepSize=1, DemDebounceCounterIncrementStepSize=1, DemDebounceCounterJumpDown=false, DemDebounceCounterJumpUp=true
          IndicatorAttribute_WarningIndicator (DemIndicatorAttribute): DemIndicatorFailureCycleSource=DEM_FAILURE_CYCLE_EVENT, DemIndicatorHealingCycleRef=PowerCycle, DemIndicatorRef=WarningIndicator
      DTCClass_DTC_0xc16687 (DemDTCClass): DemDTCSeverity=DEM_DTC_SEV_NO_SEVERITY, DemUdsDTC=12674695
      DTC_0xc16687 (DemEventParameter):
        DemEventKind = DEM_EVENT_KIND_SWC
        DemDTCClassRef = DTCClass_DTC_0xc16687
        DemExtendedDataClassRef = ExtendedDataClass_83dcefb7
        DemFreezeFrameClassRef = FreezeFrameClass_5f5b5001
        DemFreezeFrameRecNumClassRef = FreezeFrameRecNumClass_f98c8aa7
        DemEventClass:
          DemAgingAllowed = true
          DemAgingCycleCounterThreshold = 40
          DemEventDestination = DEM_DTC_ORIGIN_PRIMARY_MEMORY
          DemEventPriority = 1
          DemEventSignificance = DEM_EVENT_SIGNIFICANCE_FAULT
          DemEventFailureCycleCounterThreshold = 0
          DemAgingCycleRef = PowerCycle
          DemEnableConditionGroupRef = EnableConditionGroup_f3616881
          DemOperationCycleRef = PowerCycle
          DemDebounceAlgorithmClass
            DemDebounceCounterBased: DemDebounceCounterDecrementStepSize=1, DemDebounceCounterIncrementStepSize=1, DemDebounceCounterJumpDown=false, DemDebounceCounterJumpUp=true
          IndicatorAttribute_WarningIndicator (DemIndicatorAttribute): DemIndicatorFailureCycleSource=DEM_FAILURE_CYCLE_EVENT, DemIndicatorHealingCycleRef=PowerCycle, DemIndicatorRef=WarningIndicator
      DTCClass_DTC_0xc16b87 (DemDTCClass): DemDTCSeverity=DEM_DTC_SEV_NO_SEVERITY, DemUdsDTC=12675975
      DTC_0xc16b87 (DemEventParameter):
        DemEventKind = DEM_EVENT_KIND_SWC
        DemDTCClassRef = DTCClass_DTC_0xc16b87
        DemExtendedDataClassRef = ExtendedDataClass_83dcefb7
        DemFreezeFrameClassRef = FreezeFrameClass_5f5b5001
        DemFreezeFrameRecNumClassRef = FreezeFrameRecNumClass_f98c8aa7
        DemEventClass:
          DemAgingAllowed = true
          DemAgingCycleCounterThreshold = 40
          DemEventDestination = DEM_DTC_ORIGIN_PRIMARY_MEMORY
          DemEventPriority = 2
          DemEventSignificance = DEM_EVENT_SIGNIFICANCE_FAULT
          DemEventFailureCycleCounterThreshold = 0
          DemAgingCycleRef = PowerCycle
          DemEnableConditionGroupRef = EnableConditionGroup_f3616881
          DemOperationCycleRef = PowerCycle
          DemDebounceAlgorithmClass
            DemDebounceCounterBased: DemDebounceCounterDecrementStepSize=1, DemDebounceCounterIncrementStepSize=1, DemDebounceCounterJumpDown=false, DemDebounceCounterJumpUp=true
          IndicatorAttribute_WarningIndicator (DemIndicatorAttribute): DemIndicatorFailureCycleSource=DEM_FAILURE_CYCLE_EVENT, DemIndicatorHealingCycleRef=PowerCycle, DemIndicatorRef=WarningIndicator
      DTCClass_DTC_0xc19687 (DemDTCClass): DemDTCSeverity=DEM_DTC_SEV_NO_SEVERITY, DemUdsDTC=12686983
      DTC_0xc19687 (DemEventParameter):
        DemEventKind = DEM_EVENT_KIND_SWC
        DemDTCClassRef = DTCClass_DTC_0xc19687
        DemExtendedDataClassRef = ExtendedDataClass_83dcefb7
        DemFreezeFrameClassRef = FreezeFrameClass_5f5b5001
        DemFreezeFrameRecNumClassRef = FreezeFrameRecNumClass_f98c8aa7
        DemEventClass:
          DemAgingAllowed = true
          DemAgingCycleCounterThreshold = 40
          DemEventDestination = DEM_DTC_ORIGIN_PRIMARY_MEMORY
          DemEventPriority = 2
          DemEventSignificance = DEM_EVENT_SIGNIFICANCE_FAULT
          DemEventFailureCycleCounterThreshold = 0
          DemAgingCycleRef = PowerCycle
          DemEnableConditionGroupRef = EnableConditionGroup_f3616881
          DemOperationCycleRef = PowerCycle
          DemDebounceAlgorithmClass
            DemDebounceCounterBased: DemDebounceCounterDecrementStepSize=1, DemDebounceCounterIncrementStepSize=1, DemDebounceCounterJumpDown=false, DemDebounceCounterJumpUp=true
          IndicatorAttribute_WarningIndicator (DemIndicatorAttribute): DemIndicatorFailureCycleSource=DEM_FAILURE_CYCLE_EVENT, DemIndicatorHealingCycleRef=PowerCycle, DemIndicatorRef=WarningIndicator
      DTCClass_DTC_0xc19987 (DemDTCClass): DemDTCSeverity=DEM_DTC_SEV_NO_SEVERITY, DemUdsDTC=12687751
      DTC_0xc19987 (DemEventParameter):
        DemEventKind = DEM_EVENT_KIND_SWC
        DemDTCClassRef = DTCClass_DTC_0xc19987
        DemExtendedDataClassRef = ExtendedDataClass_83dcefb7
        DemFreezeFrameClassRef = FreezeFrameClass_5f5b5001
        DemFreezeFrameRecNumClassRef = FreezeFrameRecNumClass_f98c8aa7
        DemEventClass:
          DemAgingAllowed = true
          DemAgingCycleCounterThreshold = 40
          DemEventDestination = DEM_DTC_ORIGIN_PRIMARY_MEMORY
          DemEventPriority = 2
          DemEventSignificance = DEM_EVENT_SIGNIFICANCE_FAULT
          DemEventFailureCycleCounterThreshold = 0
          DemAgingCycleRef = PowerCycle
          DemEnableConditionGroupRef = EnableConditionGroup_f3616881
          DemOperationCycleRef = PowerCycle
          DemDebounceAlgorithmClass
            DemDebounceCounterBased: DemDebounceCounterDecrementStepSize=1, DemDebounceCounterIncrementStepSize=1, DemDebounceCounterJumpDown=false, DemDebounceCounterJumpUp=true
          IndicatorAttribute_WarningIndicator (DemIndicatorAttribute): DemIndicatorFailureCycleSource=DEM_FAILURE_CYCLE_EVENT, DemIndicatorHealingCycleRef=PowerCycle, DemIndicatorRef=WarningIndicator
      DTCClass_DTC_0xc19b87 (DemDTCClass): DemDTCSeverity=DEM_DTC_SEV_NO_SEVERITY, DemUdsDTC=12688263
      DTC_0xc19b87 (DemEventParameter):
        DemEventKind = DEM_EVENT_KIND_SWC
        DemDTCClassRef = DTCClass_DTC_0xc19b87
        DemExtendedDataClassRef = ExtendedDataClass_83dcefb7
        DemFreezeFrameClassRef = FreezeFrameClass_5f5b5001
        DemFreezeFrameRecNumClassRef = FreezeFrameRecNumClass_f98c8aa7
        DemEventClass:
          DemAgingAllowed = true
          DemAgingCycleCounterThreshold = 40
          DemEventDestination = DEM_DTC_ORIGIN_PRIMARY_MEMORY
          DemEventPriority = 1
          DemEventSignificance = DEM_EVENT_SIGNIFICANCE_FAULT
          DemEventFailureCycleCounterThreshold = 0
          DemAgingCycleRef = PowerCycle
          DemEnableConditionGroupRef = EnableConditionGroup_f3616881
          DemOperationCycleRef = PowerCycle
          DemDebounceAlgorithmClass
            DemDebounceCounterBased: DemDebounceCounterDecrementStepSize=1, DemDebounceCounterIncrementStepSize=1, DemDebounceCounterJumpDown=false, DemDebounceCounterJumpUp=true
          IndicatorAttribute_WarningIndicator (DemIndicatorAttribute): DemIndicatorFailureCycleSource=DEM_FAILURE_CYCLE_EVENT, DemIndicatorHealingCycleRef=PowerCycle, DemIndicatorRef=WarningIndicator
      DTCClass_DTC_0xc20087 (DemDTCClass): DemDTCSeverity=DEM_DTC_SEV_NO_SEVERITY, DemUdsDTC=12714119
      DTC_0xc20087 (DemEventParameter):
        DemEventKind = DEM_EVENT_KIND_SWC
        DemDTCClassRef = DTCClass_DTC_0xc20087
        DemExtendedDataClassRef = ExtendedDataClass_83dcefb7
        DemFreezeFrameClassRef = FreezeFrameClass_5f5b5001
        DemFreezeFrameRecNumClassRef = FreezeFrameRecNumClass_f98c8aa7
        DemEventClass:
          DemAgingAllowed = true
          DemAgingCycleCounterThreshold = 40
          DemEventDestination = DEM_DTC_ORIGIN_PRIMARY_MEMORY
          DemEventPriority = 2
          DemEventSignificance = DEM_EVENT_SIGNIFICANCE_FAULT
          DemEventFailureCycleCounterThreshold = 0
          DemAgingCycleRef = PowerCycle
          DemEnableConditionGroupRef = EnableConditionGroup_f3616881
          DemOperationCycleRef = PowerCycle
          DemDebounceAlgorithmClass
            DemDebounceCounterBased: DemDebounceCounterDecrementStepSize=1, DemDebounceCounterIncrementStepSize=1, DemDebounceCounterJumpDown=false, DemDebounceCounterJumpUp=true
          IndicatorAttribute_WarningIndicator (DemIndicatorAttribute): DemIndicatorFailureCycleSource=DEM_FAILURE_CYCLE_EVENT, DemIndicatorHealingCycleRef=PowerCycle, DemIndicatorRef=WarningIndicator
      DTCClass_DTC_0xc20187 (DemDTCClass): DemDTCSeverity=DEM_DTC_SEV_NO_SEVERITY, DemUdsDTC=12714375
      DTC_0xc20187 (DemEventParameter):
        DemEventKind = DEM_EVENT_KIND_SWC
        DemDTCClassRef = DTCClass_DTC_0xc20187
        DemExtendedDataClassRef = ExtendedDataClass_83dcefb7
        DemFreezeFrameClassRef = FreezeFrameClass_5f5b5001
        DemFreezeFrameRecNumClassRef = FreezeFrameRecNumClass_f98c8aa7
        DemEventClass:
          DemAgingAllowed = true
          DemAgingCycleCounterThreshold = 40
          DemEventDestination = DEM_DTC_ORIGIN_PRIMARY_MEMORY
          DemEventPriority = 2
          DemEventSignificance = DEM_EVENT_SIGNIFICANCE_FAULT
          DemEventFailureCycleCounterThreshold = 0
          DemAgingCycleRef = PowerCycle
          DemEnableConditionGroupRef = EnableConditionGroup_f3616881
          DemOperationCycleRef = PowerCycle
          DemDebounceAlgorithmClass
            DemDebounceCounterBased: DemDebounceCounterDecrementStepSize=1, DemDebounceCounterIncrementStepSize=1, DemDebounceCounterJumpDown=false, DemDebounceCounterJumpUp=true
          IndicatorAttribute_WarningIndicator (DemIndicatorAttribute): DemIndicatorFailureCycleSource=DEM_FAILURE_CYCLE_EVENT, DemIndicatorHealingCycleRef=PowerCycle, DemIndicatorRef=WarningIndicator
      DTCClass_DTC_0xc20287 (DemDTCClass): DemDTCSeverity=DEM_DTC_SEV_NO_SEVERITY, DemUdsDTC=12714631
      DTC_0xc20287 (DemEventParameter):
        DemEventKind = DEM_EVENT_KIND_SWC
        DemDTCClassRef = DTCClass_DTC_0xc20287
        DemExtendedDataClassRef = ExtendedDataClass_83dcefb7
        DemFreezeFrameClassRef = FreezeFrameClass_5f5b5001
        DemFreezeFrameRecNumClassRef = FreezeFrameRecNumClass_f98c8aa7
        DemEventClass:
          DemAgingAllowed = true
          DemAgingCycleCounterThreshold = 40
          DemEventDestination = DEM_DTC_ORIGIN_PRIMARY_MEMORY
          DemEventPriority = 2
          DemEventSignificance = DEM_EVENT_SIGNIFICANCE_FAULT
          DemEventFailureCycleCounterThreshold = 0
          DemAgingCycleRef = PowerCycle
          DemEnableConditionGroupRef = EnableConditionGroup_f3616881
          DemOperationCycleRef = PowerCycle
          DemDebounceAlgorithmClass
            DemDebounceCounterBased: DemDebounceCounterDecrementStepSize=1, DemDebounceCounterIncrementStepSize=1, DemDebounceCounterJumpDown=false, DemDebounceCounterJumpUp=true
          IndicatorAttribute_WarningIndicator (DemIndicatorAttribute): DemIndicatorFailureCycleSource=DEM_FAILURE_CYCLE_EVENT, DemIndicatorHealingCycleRef=PowerCycle, DemIndicatorRef=WarningIndicator
      DTCClass_DTC_0xc20700 (DemDTCClass): DemDTCSeverity=DEM_DTC_SEV_NO_SEVERITY, DemUdsDTC=12715776
      DTC_0xc20700 (DemEventParameter):
        DemEventKind = DEM_EVENT_KIND_SWC
        DemDTCClassRef = DTCClass_DTC_0xc20700
        DemExtendedDataClassRef = ExtendedDataClass_83dcefb7
        DemFreezeFrameClassRef = FreezeFrameClass_5f5b5001
        DemFreezeFrameRecNumClassRef = FreezeFrameRecNumClass_f98c8aa7
        DemEventClass:
          DemAgingAllowed = true
          DemAgingCycleCounterThreshold = 40
          DemEventDestination = DEM_DTC_ORIGIN_PRIMARY_MEMORY
          DemEventPriority = 2
          DemEventSignificance = DEM_EVENT_SIGNIFICANCE_FAULT
          DemEventFailureCycleCounterThreshold = 0
          DemAgingCycleRef = PowerCycle
          DemEnableConditionGroupRef = EnableConditionGroup_4ffb066f
          DemOperationCycleRef = PowerCycle
          DemDebounceAlgorithmClass
            DemDebounceCounterBased: DemDebounceCounterDecrementStepSize=1, DemDebounceCounterIncrementStepSize=1, DemDebounceCounterJumpDown=false, DemDebounceCounterJumpUp=true
          IndicatorAttribute_WarningIndicator (DemIndicatorAttribute): DemIndicatorFailureCycleSource=DEM_FAILURE_CYCLE_EVENT, DemIndicatorHealingCycleRef=PowerCycle, DemIndicatorRef=WarningIndicator
      DTCClass_DTC_0xc20787 (DemDTCClass): DemDTCSeverity=DEM_DTC_SEV_NO_SEVERITY, DemUdsDTC=12715911
      DTC_0xc20787 (DemEventParameter):
        DemEventKind = DEM_EVENT_KIND_SWC
        DemDTCClassRef = DTCClass_DTC_0xc20787
        DemExtendedDataClassRef = ExtendedDataClass_83dcefb7
        DemFreezeFrameClassRef = FreezeFrameClass_5f5b5001
        DemFreezeFrameRecNumClassRef = FreezeFrameRecNumClass_f98c8aa7
        DemEventClass:
          DemAgingAllowed = true
          DemAgingCycleCounterThreshold = 40
          DemEventDestination = DEM_DTC_ORIGIN_PRIMARY_MEMORY
          DemEventPriority = 2
          DemEventSignificance = DEM_EVENT_SIGNIFICANCE_FAULT
          DemEventFailureCycleCounterThreshold = 0
          DemAgingCycleRef = PowerCycle
          DemEnableConditionGroupRef = EnableConditionGroup_4ffb066f
          DemOperationCycleRef = PowerCycle
          DemDebounceAlgorithmClass
            DemDebounceCounterBased: DemDebounceCounterDecrementStepSize=1, DemDebounceCounterIncrementStepSize=1, DemDebounceCounterJumpDown=false, DemDebounceCounterJumpUp=true
          IndicatorAttribute_WarningIndicator (DemIndicatorAttribute): DemIndicatorFailureCycleSource=DEM_FAILURE_CYCLE_EVENT, DemIndicatorHealingCycleRef=PowerCycle, DemIndicatorRef=WarningIndicator
      DTCClass_DTC_0xc29887 (DemDTCClass): DemDTCSeverity=DEM_DTC_SEV_NO_SEVERITY, DemUdsDTC=12753031
      DTC_0xc29887 (DemEventParameter):
        DemEventKind = DEM_EVENT_KIND_SWC
        DemDTCClassRef = DTCClass_DTC_0xc29887
        DemExtendedDataClassRef = ExtendedDataClass_83dcefb7
        DemFreezeFrameClassRef = FreezeFrameClass_5f5b5001
        DemFreezeFrameRecNumClassRef = FreezeFrameRecNumClass_f98c8aa7
        DemEventClass:
          DemAgingAllowed = false
          DemAgingCycleCounterThreshold = 0
          DemEventDestination = DEM_DTC_ORIGIN_PRIMARY_MEMORY
          DemEventPriority = 1
          DemEventSignificance = DEM_EVENT_SIGNIFICANCE_FAULT
          DemEventFailureCycleCounterThreshold = 0
          DemAgingCycleRef = PowerCycle
          DemEnableConditionGroupRef = EnableConditionGroup_f3616881
          DemOperationCycleRef = PowerCycle
          DemDebounceAlgorithmClass
            DemDebounceCounterBased: DemDebounceCounterDecrementStepSize=1, DemDebounceCounterIncrementStepSize=1, DemDebounceCounterJumpDown=false, DemDebounceCounterJumpUp=true
          IndicatorAttribute_WarningIndicator (DemIndicatorAttribute): DemIndicatorFailureCycleSource=DEM_FAILURE_CYCLE_EVENT, DemIndicatorHealingCycleRef=PowerCycle, DemIndicatorRef=WarningIndicator
      DTCClass_DTC_0xc29a00 (DemDTCClass): DemDTCSeverity=DEM_DTC_SEV_NO_SEVERITY, DemUdsDTC=12753408
      DTC_0xc29a00 (DemEventParameter):
        DemEventKind = DEM_EVENT_KIND_SWC
        DemDTCClassRef = DTCClass_DTC_0xc29a00
        DemExtendedDataClassRef = ExtendedDataClass_83dcefb7
        DemFreezeFrameClassRef = FreezeFrameClass_5f5b5001
        DemFreezeFrameRecNumClassRef = FreezeFrameRecNumClass_f98c8aa7
        DemEventClass:
          DemAgingAllowed = true
          DemAgingCycleCounterThreshold = 40
          DemEventDestination = DEM_DTC_ORIGIN_PRIMARY_MEMORY
          DemEventPriority = 2
          DemEventSignificance = DEM_EVENT_SIGNIFICANCE_FAULT
          DemEventFailureCycleCounterThreshold = 0
          DemAgingCycleRef = PowerCycle
          DemEnableConditionGroupRef = EnableConditionGroup_4ffb066f
          DemOperationCycleRef = PowerCycle
          DemDebounceAlgorithmClass
            DemDebounceCounterBased: DemDebounceCounterDecrementStepSize=1, DemDebounceCounterIncrementStepSize=1, DemDebounceCounterJumpDown=false, DemDebounceCounterJumpUp=true
          IndicatorAttribute_WarningIndicator (DemIndicatorAttribute): DemIndicatorFailureCycleSource=DEM_FAILURE_CYCLE_EVENT, DemIndicatorHealingCycleRef=PowerCycle, DemIndicatorRef=WarningIndicator
      DTCClass_DTC_0xc29a87 (DemDTCClass): DemDTCSeverity=DEM_DTC_SEV_NO_SEVERITY, DemUdsDTC=12753543
      DTC_0xc29a87 (DemEventParameter):
        DemEventKind = DEM_EVENT_KIND_SWC
        DemDTCClassRef = DTCClass_DTC_0xc29a87
        DemExtendedDataClassRef = ExtendedDataClass_83dcefb7
        DemFreezeFrameClassRef = FreezeFrameClass_5f5b5001
        DemFreezeFrameRecNumClassRef = FreezeFrameRecNumClass_f98c8aa7
        DemEventClass:
          DemAgingAllowed = true
          DemAgingCycleCounterThreshold = 40
          DemEventDestination = DEM_DTC_ORIGIN_PRIMARY_MEMORY
          DemEventPriority = 2
          DemEventSignificance = DEM_EVENT_SIGNIFICANCE_FAULT
          DemEventFailureCycleCounterThreshold = 0
          DemAgingCycleRef = PowerCycle
          DemEnableConditionGroupRef = EnableConditionGroup_4ffb066f
          DemOperationCycleRef = PowerCycle
          DemDebounceAlgorithmClass
            DemDebounceCounterBased: DemDebounceCounterDecrementStepSize=1, DemDebounceCounterIncrementStepSize=1, DemDebounceCounterJumpDown=false, DemDebounceCounterJumpUp=true
          IndicatorAttribute_WarningIndicator (DemIndicatorAttribute): DemIndicatorFailureCycleSource=DEM_FAILURE_CYCLE_EVENT, DemIndicatorHealingCycleRef=PowerCycle, DemIndicatorRef=WarningIndicator
      DTCClass_DTC_0xd10587 (DemDTCClass): DemDTCSeverity=DEM_DTC_SEV_NO_SEVERITY, DemUdsDTC=13698439
      DTC_0xd10587 (DemEventParameter):
        DemEventKind = DEM_EVENT_KIND_SWC
        DemDTCClassRef = DTCClass_DTC_0xd10587
        DemExtendedDataClassRef = ExtendedDataClass_83dcefb7
        DemFreezeFrameClassRef = FreezeFrameClass_5f5b5001
        DemFreezeFrameRecNumClassRef = FreezeFrameRecNumClass_f98c8aa7
        DemEventClass:
          DemAgingAllowed = true
          DemAgingCycleCounterThreshold = 40
          DemEventDestination = DEM_DTC_ORIGIN_PRIMARY_MEMORY
          DemEventPriority = 2
          DemEventSignificance = DEM_EVENT_SIGNIFICANCE_FAULT
          DemEventFailureCycleCounterThreshold = 0
          DemAgingCycleRef = PowerCycle
          DemEnableConditionGroupRef = EnableConditionGroup_35324f44
          DemOperationCycleRef = PowerCycle
          DemDebounceAlgorithmClass
            DemDebounceCounterBased: DemDebounceCounterDecrementStepSize=1, DemDebounceCounterIncrementStepSize=1, DemDebounceCounterJumpDown=false, DemDebounceCounterJumpUp=true
          IndicatorAttribute_WarningIndicator (DemIndicatorAttribute): DemIndicatorFailureCycleSource=DEM_FAILURE_CYCLE_EVENT, DemIndicatorHealingCycleRef=PowerCycle, DemIndicatorRef=WarningIndicator
      DTCClass_DTC_0xd11b87 (DemDTCClass): DemDTCSeverity=DEM_DTC_SEV_NO_SEVERITY, DemUdsDTC=13704071
      DTC_0xd11b87 (DemEventParameter):
        DemEventKind = DEM_EVENT_KIND_SWC
        DemDTCClassRef = DTCClass_DTC_0xd11b87
        DemExtendedDataClassRef = ExtendedDataClass_83dcefb7
        DemFreezeFrameClassRef = FreezeFrameClass_5f5b5001
        DemFreezeFrameRecNumClassRef = FreezeFrameRecNumClass_f98c8aa7
        DemEventClass:
          DemAgingAllowed = true
          DemAgingCycleCounterThreshold = 40
          DemEventDestination = DEM_DTC_ORIGIN_PRIMARY_MEMORY
          DemEventPriority = 2
          DemEventSignificance = DEM_EVENT_SIGNIFICANCE_FAULT
          DemEventFailureCycleCounterThreshold = 0
          DemAgingCycleRef = PowerCycle
          DemEnableConditionGroupRef = EnableConditionGroup_35324f44
          DemOperationCycleRef = PowerCycle
          DemDebounceAlgorithmClass
            DemDebounceCounterBased: DemDebounceCounterDecrementStepSize=1, DemDebounceCounterIncrementStepSize=1, DemDebounceCounterJumpDown=false, DemDebounceCounterJumpUp=true
          IndicatorAttribute_WarningIndicator (DemIndicatorAttribute): DemIndicatorFailureCycleSource=DEM_FAILURE_CYCLE_EVENT, DemIndicatorHealingCycleRef=PowerCycle, DemIndicatorRef=WarningIndicator
      DTCClass_DTC_0xd12688 (DemDTCClass): DemDTCSeverity=DEM_DTC_SEV_NO_SEVERITY, DemUdsDTC=13706888
      DTC_0xd12688 (DemEventParameter):
        DemEventKind = DEM_EVENT_KIND_SWC
        DemDTCClassRef = DTCClass_DTC_0xd12688
        DemExtendedDataClassRef = ExtendedDataClass_83dcefb7
        DemFreezeFrameClassRef = FreezeFrameClass_5f5b5001
        DemFreezeFrameRecNumClassRef = FreezeFrameRecNumClass_f98c8aa7
        DemEventClass:
          DemAgingAllowed = true
          DemAgingCycleCounterThreshold = 40
          DemEventDestination = DEM_DTC_ORIGIN_PRIMARY_MEMORY
          DemEventPriority = 1
          DemEventSignificance = DEM_EVENT_SIGNIFICANCE_FAULT
          DemEventFailureCycleCounterThreshold = 0
          DemAgingCycleRef = PowerCycle
          DemEnableConditionGroupRef = EnableConditionGroup_c81fc67e
          DemOperationCycleRef = PowerCycle
          DemDebounceAlgorithmClass
            DemDebounceCounterBased: DemDebounceCounterDecrementStepSize=1, DemDebounceCounterIncrementStepSize=1, DemDebounceCounterJumpDown=false, DemDebounceCounterJumpUp=true
          IndicatorAttribute_WarningIndicator (DemIndicatorAttribute): DemIndicatorFailureCycleSource=DEM_FAILURE_CYCLE_EVENT, DemIndicatorHealingCycleRef=PowerCycle, DemIndicatorRef=WarningIndicator
      DTCClass_DTC_0xd13787 (DemDTCClass): DemDTCSeverity=DEM_DTC_SEV_NO_SEVERITY, DemUdsDTC=13711239
      DTC_0xd13787 (DemEventParameter):
        DemEventKind = DEM_EVENT_KIND_SWC
        DemDTCClassRef = DTCClass_DTC_0xd13787
        DemExtendedDataClassRef = ExtendedDataClass_83dcefb7
        DemFreezeFrameClassRef = FreezeFrameClass_5f5b5001
        DemFreezeFrameRecNumClassRef = FreezeFrameRecNumClass_f98c8aa7
        DemEventClass:
          DemAgingAllowed = true
          DemAgingCycleCounterThreshold = 40
          DemEventDestination = DEM_DTC_ORIGIN_PRIMARY_MEMORY
          DemEventPriority = 2
          DemEventSignificance = DEM_EVENT_SIGNIFICANCE_FAULT
          DemEventFailureCycleCounterThreshold = 0
          DemAgingCycleRef = PowerCycle
          DemEnableConditionGroupRef = EnableConditionGroup_f3616881
          DemOperationCycleRef = PowerCycle
          DemDebounceAlgorithmClass
            DemDebounceCounterBased: DemDebounceCounterDecrementStepSize=1, DemDebounceCounterIncrementStepSize=1, DemDebounceCounterJumpDown=false, DemDebounceCounterJumpUp=true
          IndicatorAttribute_WarningIndicator (DemIndicatorAttribute): DemIndicatorFailureCycleSource=DEM_FAILURE_CYCLE_EVENT, DemIndicatorHealingCycleRef=PowerCycle, DemIndicatorRef=WarningIndicator
    DemGeneral:
      DemAgingCycleCounterProcessing = DEM_PROCESS_AGINGCTR_INTERN
      DemDebounceCounterBasedSupport = true
      DemEnableConditionSupport = true
      DemPTOSupport = false
      DemDtcStatusAvailabilityMask = 9
      DemTypeOfFreezeFrameRecordNumeration = DEM_FF_RECNUM_CONFIGURED
      14 x DemDidClass:
        VCU_AccPealparameter: DemDidIdentifier=7425, DemDidDataClassRef=DID_0x1d01_VCU_VehicleSpeed, DemDidDataClassRef=DID_0x1d01_Accelerator_pedal_sensor_1_voltage, DemDidDataClassRef=DID_0x1d01_Accelerator_pedal_sensor_2_voltage, DemDidDataClassRef=DID_0x1d01_VCU_AccelerationPedal
        AC_charging_parameter: DemDidIdentifier=7429, DemDidDataClassRef=DID_0x1d05_POD_OBC_InputACVoltage, DemDidDataClassRef=DID_0x1d05_VCU_OBC_ChargeCurrentCommand, DemDidDataClassRef=DID_0x1d05_POD_OBC_OutputDCChargeCurrent, DemDidDataClassRef=DID_0x1d05_POD_OBC_OutputDCChargeVoltage
        Electronic_lock_state: DemDidIdentifier=7431, DemDidDataClassRef=DID_0x1d07_Electronic_lock_state
        VCU_HV_InterLock_PWM_pfrequency: DemDidIdentifier=7432, DemDidDataClassRef=DID_0x1d08_VCU_HVIL
        VCU_control_S2_status: DemDidIdentifier=7433, DemDidDataClassRef=DID_0x1d09_New_Bit_Field
        VCU_control_main_relay: DemDidIdentifier=7441, DemDidDataClassRef=DID_0x1d11_Mainrealy1, DemDidDataClassRef=DID_0x1d11_Mainrelay2
        Vehicle_State: DemDidIdentifier=61856, DemDidDataClassRef=DID_0xf1a0_Ignition_Switch_Signal
        Battery_Voltage: DemDidIdentifier=61857, DemDidDataClassRef=DID_0xf1a1_Battery_Voltage
        Total_Odometer: DemDidIdentifier=61858, DemDidDataClassRef=DID_0xf1a2_Total_Odometer
        Vehicle_speed: DemDidIdentifier=61859, DemDidDataClassRef=DID_0xf1a3_Vehicle_speed
        Date_And_Time: DemDidIdentifier=61860, DemDidDataClassRef=DID_0xf1a4_Date_And_Time_Second, DemDidDataClassRef=DID_0xf1a4_Date_And_Time_Minute, DemDidDataClassRef=DID_0xf1a4_Date_And_Time_Hour, DemDidDataClassRef=DID_0xf1a4_Date_And_Time_Day, DemDidDataClassRef=DID_0xf1a4_Date_And_Time_Month, DemDidDataClassRef=DID_0xf1a4_Date_And_Time_Year
        VCU_HVStatus: DemDidIdentifier=61861, DemDidDataClassRef=DID_0xf1a5_VCU_HVStatus
        SOC: DemDidIdentifier=61862, DemDidDataClassRef=DID_0xf1a6_SOC
        Gear: DemDidIdentifier=61863, DemDidDataClassRef=DID_0xf1a7_Gear
      77 x DemEnableCondition:
        ms
        after
        being
        waked
        up
        The
        battery
        voltage
        is
        normal
        V
        to
        No
        active
        service
        Note
        If
        any
        of
        the_001
        enable
        conditions
        or
        trigger
        not
        met
        during
        fault
        confirmation
        process
        diagnosis
        shall
        be
        completed
        When
        all
        are
        performed
        again
        PT
        CAN
        Busoff
        status
        bussoff
        DC
        busoff_001
        serviceNote
        All_001
        following
        simultaneously
        and
        last
        for
        T_Delay
        VCU
        in
        wake
        condition
        Enable_001
        Conditions_001
        does
        meet
        requirements
        reset
        start
        timing
        In_001
        Confirmed
        DTC
        criteria
        timer
        if_001
        do
        recovered
        Reset_001
        Being_001
        CH
      ExtendedDataClass_83dcefb7 (DemExtendedDataClass): DemExtendedDataRecordClassRef=ExtendedData
      11 x DemEnableConditionGroup, all with DemEnableConditionRef=If, DemEnableConditionRef=Note, DemEnableConditionRef=active, DemEnableConditionRef=are, DemEnableConditionRef=or, DemEnableConditionRef=process, DemEnableConditionRef=service:
        EnableConditionGroup_fb7bc2c5: DemEnableConditionRef=No, DemEnableConditionRef=The, DemEnableConditionRef=V, DemEnableConditionRef=V, DemEnableConditionRef=When, DemEnableConditionRef=after, DemEnableConditionRef=again, DemEnableConditionRef=all, DemEnableConditionRef=any, DemEnableConditionRef=battery, DemEnableConditionRef=be, DemEnableConditionRef=being, DemEnableConditionRef=completed, DemEnableConditionRef=conditions, DemEnableConditionRef=conditions, DemEnableConditionRef=conditions, DemEnableConditionRef=confirmation, DemEnableConditionRef=diagnosis, DemEnableConditionRef=diagnosis, DemEnableConditionRef=during, DemEnableConditionRef=enable, DemEnableConditionRef=fault, DemEnableConditionRef=fault, DemEnableConditionRef=fault, DemEnableConditionRef=for, DemEnableConditionRef=is, DemEnableConditionRef=is, DemEnableConditionRef=is, DemEnableConditionRef=met, DemEnableConditionRef=met, DemEnableConditionRef=ms, DemEnableConditionRef=ms, DemEnableConditionRef=normal, DemEnableConditionRef=not, DemEnableConditionRef=of, DemEnableConditionRef=performed, DemEnableConditionRef=shall, DemEnableConditionRef=the_001, DemEnableConditionRef=the_001, DemEnableConditionRef=the_001, DemEnableConditionRef=the_001, DemEnableConditionRef=the_001, DemEnableConditionRef=to, DemEnableConditionRef=trigger, DemEnableConditionRef=up, DemEnableConditionRef=voltage, DemEnableConditionRef=waked
        EnableConditionGroup_35324f44: DemEnableConditionRef=All_001, DemEnableConditionRef=Busoff, DemEnableConditionRef=CAN, DemEnableConditionRef=CH, DemEnableConditionRef=Conditions_001, DemEnableConditionRef=Conditions_001, DemEnableConditionRef=Confirmed, DemEnableConditionRef=Confirmed, DemEnableConditionRef=DTC, DemEnableConditionRef=DTC, DemEnableConditionRef=Enable_001, DemEnableConditionRef=Enable_001, DemEnableConditionRef=In_001, DemEnableConditionRef=No, DemEnableConditionRef=No, DemEnableConditionRef=Reset_001, DemEnableConditionRef=T_Delay, DemEnableConditionRef=T_Delay, DemEnableConditionRef=T_Delay, DemEnableConditionRef=The, DemEnableConditionRef=V, DemEnableConditionRef=V, DemEnableConditionRef=VCU, DemEnableConditionRef=again, DemEnableConditionRef=again, DemEnableConditionRef=and, DemEnableConditionRef=and, DemEnableConditionRef=and, DemEnableConditionRef=any, DemEnableConditionRef=any, DemEnableConditionRef=battery, DemEnableConditionRef=condition, DemEnableConditionRef=conditions, DemEnableConditionRef=criteria, DemEnableConditionRef=criteria, DemEnableConditionRef=do, DemEnableConditionRef=does, DemEnableConditionRef=fault, DemEnableConditionRef=following, DemEnableConditionRef=for, DemEnableConditionRef=if_001, DemEnableConditionRef=in, DemEnableConditionRef=in, DemEnableConditionRef=in, DemEnableConditionRef=is, DemEnableConditionRef=is, DemEnableConditionRef=last, DemEnableConditionRef=meet, DemEnableConditionRef=meet, DemEnableConditionRef=met, DemEnableConditionRef=ms, DemEnableConditionRef=normal, DemEnableConditionRef=not, DemEnableConditionRef=not, DemEnableConditionRef=of, DemEnableConditionRef=of, DemEnableConditionRef=recovered, DemEnableConditionRef=requirements, DemEnableConditionRef=requirements, DemEnableConditionRef=reset, DemEnableConditionRef=simultaneously, DemEnableConditionRef=start, DemEnableConditionRef=start, DemEnableConditionRef=status, DemEnableConditionRef=status, DemEnableConditionRef=the_001, DemEnableConditionRef=the_001, DemEnableConditionRef=the_001, DemEnableConditionRef=the_001, DemEnableConditionRef=the_001, DemEnableConditionRef=the_001, DemEnableConditionRef=the_001, DemEnableConditionRef=the_001, DemEnableConditionRef=timer, DemEnableConditionRef=timing, DemEnableConditionRef=timing, DemEnableConditionRef=to, DemEnableConditionRef=to, DemEnableConditionRef=to, DemEnableConditionRef=up, DemEnableConditionRef=voltage, DemEnableConditionRef=wake
        EnableConditionGroup_f3616881: DemEnableConditionRef=All_001, DemEnableConditionRef=Busoff, DemEnableConditionRef=CAN, DemEnableConditionRef=Conditions_001, DemEnableConditionRef=Conditions_001, DemEnableConditionRef=Confirmed, DemEnableConditionRef=Confirmed, DemEnableConditionRef=DTC, DemEnableConditionRef=DTC, DemEnableConditionRef=Enable_001, DemEnableConditionRef=Enable_001, DemEnableConditionRef=In_001, DemEnableConditionRef=No, DemEnableConditionRef=No, DemEnableConditionRef=PT, DemEnableConditionRef=Reset_001, DemEnableConditionRef=T_Delay, DemEnableConditionRef=T_Delay, DemEnableConditionRef=T_Delay, DemEnableConditionRef=The, DemEnableConditionRef=V, DemEnableConditionRef=V, DemEnableConditionRef=VCU, DemEnableConditionRef=again, DemEnableConditionRef=again, DemEnableConditionRef=and, DemEnableConditionRef=and, DemEnableConditionRef=and, DemEnableConditionRef=any, DemEnableConditionRef=any, DemEnableConditionRef=battery, DemEnableConditionRef=condition, DemEnableConditionRef=conditions, DemEnableConditionRef=criteria, DemEnableConditionRef=criteria, DemEnableConditionRef=do, DemEnableConditionRef=does, DemEnableConditionRef=fault, DemEnableConditionRef=following, DemEnableConditionRef=for, DemEnableConditionRef=if_001, DemEnableConditionRef=in, DemEnableConditionRef=in, DemEnableConditionRef=in, DemEnableConditionRef=is, DemEnableConditionRef=is, DemEnableConditionRef=last, DemEnableConditionRef=meet, DemEnableConditionRef=meet, DemEnableConditionRef=met, DemEnableConditionRef=ms, DemEnableConditionRef=normal, DemEnableConditionRef=not, DemEnableConditionRef=not, DemEnableConditionRef=of, DemEnableConditionRef=of, DemEnableConditionRef=recovered, DemEnableConditionRef=requirements, DemEnableConditionRef=requirements, DemEnableConditionRef=reset, DemEnableConditionRef=simultaneously, DemEnableConditionRef=start, DemEnableConditionRef=start, DemEnableConditionRef=status, DemEnableConditionRef=status, DemEnableConditionRef=the_001, DemEnableConditionRef=the_001, DemEnableConditionRef=the_001, DemEnableConditionRef=the_001, DemEnableConditionRef=the_001, DemEnableConditionRef=the_001, DemEnableConditionRef=the_001, DemEnableConditionRef=the_001, DemEnableConditionRef=timer, DemEnableConditionRef=timing, DemEnableConditionRef=timing, DemEnableConditionRef=to, DemEnableConditionRef=to, DemEnableConditionRef=to, DemEnableConditionRef=up, DemEnableConditionRef=voltage, DemEnableConditionRef=wake
        EnableConditionGroup_bbe52cb7: DemEnableConditionRef=No, DemEnableConditionRef=The, DemEnableConditionRef=V, DemEnableConditionRef=V, DemEnableConditionRef=When, DemEnableConditionRef=after, DemEnableConditionRef=again, DemEnableConditionRef=all, DemEnableConditionRef=any, DemEnableConditionRef=battery, DemEnableConditionRef=be, DemEnableConditionRef=being, DemEnableConditionRef=completed, DemEnableConditionRef=conditions, DemEnableConditionRef=conditions, DemEnableConditionRef=conditions, DemEnableConditionRef=confirmation, DemEnableConditionRef=diagnosis, DemEnableConditionRef=diagnosis, DemEnableConditionRef=during, DemEnableConditionRef=enable, DemEnableConditionRef=fault, DemEnableConditionRef=fault, DemEnableConditionRef=fault, DemEnableConditionRef=is, DemEnableConditionRef=is, DemEnableConditionRef=is, DemEnableConditionRef=met, DemEnableConditionRef=met, DemEnableConditionRef=ms, DemEnableConditionRef=normal, DemEnableConditionRef=not, DemEnableConditionRef=of, DemEnableConditionRef=performed, DemEnableConditionRef=shall, DemEnableConditionRef=the_001, DemEnableConditionRef=the_001, DemEnableConditionRef=the_001, DemEnableConditionRef=the_001, DemEnableConditionRef=the_001, DemEnableConditionRef=to, DemEnableConditionRef=trigger, DemEnableConditionRef=up, DemEnableConditionRef=voltage, DemEnableConditionRef=waked
        EnableConditionGroup_fd8a9b69: DemEnableConditionRef=No, DemEnableConditionRef=The, DemEnableConditionRef=V, DemEnableConditionRef=V, DemEnableConditionRef=When, DemEnableConditionRef=again, DemEnableConditionRef=all, DemEnableConditionRef=any, DemEnableConditionRef=battery, DemEnableConditionRef=be, DemEnableConditionRef=completed, DemEnableConditionRef=conditions, DemEnableConditionRef=conditions, DemEnableConditionRef=conditions, DemEnableConditionRef=confirmation, DemEnableConditionRef=diagnosis, DemEnableConditionRef=diagnosis, DemEnableConditionRef=during, DemEnableConditionRef=enable, DemEnableConditionRef=fault, DemEnableConditionRef=fault, DemEnableConditionRef=fault, DemEnableConditionRef=is, DemEnableConditionRef=is, DemEnableConditionRef=is, DemEnableConditionRef=met, DemEnableConditionRef=met, DemEnableConditionRef=normal, DemEnableConditionRef=not, DemEnableConditionRef=of, DemEnableConditionRef=performed, DemEnableConditionRef=shall, DemEnableConditionRef=the_001, DemEnableConditionRef=the_001, DemEnableConditionRef=the_001, DemEnableConditionRef=the_001, DemEnableConditionRef=the_001, DemEnableConditionRef=to, DemEnableConditionRef=trigger, DemEnableConditionRef=voltage
        EnableConditionGroup_983000c1: DemEnableConditionRef=CAN, DemEnableConditionRef=DC, DemEnableConditionRef=No, DemEnableConditionRef=No, DemEnableConditionRef=The, DemEnableConditionRef=V, DemEnableConditionRef=V, DemEnableConditionRef=When, DemEnableConditionRef=after, DemEnableConditionRef=again, DemEnableConditionRef=all, DemEnableConditionRef=any, DemEnableConditionRef=battery, DemEnableConditionRef=be, DemEnableConditionRef=being, DemEnableConditionRef=busoff_001, DemEnableConditionRef=completed, DemEnableConditionRef=conditions, DemEnableConditionRef=conditions, DemEnableConditionRef=conditions, DemEnableConditionRef=confirmation, DemEnableConditionRef=diagnosis, DemEnableConditionRef=diagnosis, DemEnableConditionRef=during, DemEnableConditionRef=enable, DemEnableConditionRef=fault, DemEnableConditionRef=fault, DemEnableConditionRef=fault, DemEnableConditionRef=is, DemEnableConditionRef=is, DemEnableConditionRef=is, DemEnableConditionRef=met, DemEnableConditionRef=met, DemEnableConditionRef=ms, DemEnableConditionRef=normal, DemEnableConditionRef=not, DemEnableConditionRef=of, DemEnableConditionRef=performed, DemEnableConditionRef=shall, DemEnableConditionRef=status, DemEnableConditionRef=the_001, DemEnableConditionRef=the_001, DemEnableConditionRef=the_001, DemEnableConditionRef=the_001, DemEnableConditionRef=the_001, DemEnableConditionRef=to, DemEnableConditionRef=trigger, DemEnableConditionRef=up, DemEnableConditionRef=voltage, DemEnableConditionRef=waked
        EnableConditionGroup_4ffb066f: DemEnableConditionRef=All_001, DemEnableConditionRef=Conditions_001, DemEnableConditionRef=Conditions_001, DemEnableConditionRef=Confirmed, DemEnableConditionRef=Confirmed, DemEnableConditionRef=DTC, DemEnableConditionRef=DTC, DemEnableConditionRef=Enable_001, DemEnableConditionRef=Enable_001, DemEnableConditionRef=In_001, DemEnableConditionRef=No, DemEnableConditionRef=Reset_001, DemEnableConditionRef=T_Delay, DemEnableConditionRef=T_Delay, DemEnableConditionRef=T_Delay, DemEnableConditionRef=The, DemEnableConditionRef=V, DemEnableConditionRef=V, DemEnableConditionRef=VCU, DemEnableConditionRef=again, DemEnableConditionRef=again, DemEnableConditionRef=and, DemEnableConditionRef=and, DemEnableConditionRef=and, DemEnableConditionRef=any, DemEnableConditionRef=any, DemEnableConditionRef=battery, DemEnableConditionRef=condition, DemEnableConditionRef=conditions, DemEnableConditionRef=criteria, DemEnableConditionRef=criteria, DemEnableConditionRef=do, DemEnableConditionRef=does, DemEnableConditionRef=fault, DemEnableConditionRef=following, DemEnableConditionRef=for, DemEnableConditionRef=if_001, DemEnableConditionRef=in, DemEnableConditionRef=in, DemEnableConditionRef=in, DemEnableConditionRef=is, DemEnableConditionRef=is, DemEnableConditionRef=last, DemEnableConditionRef=meet, DemEnableConditionRef=meet, DemEnableConditionRef=met, DemEnableConditionRef=ms, DemEnableConditionRef=normal, DemEnableConditionRef=not, DemEnableConditionRef=not, DemEnableConditionRef=of, DemEnableConditionRef=of, DemEnableConditionRef=recovered, DemEnableConditionRef=requirements, DemEnableConditionRef=requirements, DemEnableConditionRef=reset, DemEnableConditionRef=simultaneously, DemEnableConditionRef=start, DemEnableConditionRef=start, DemEnableConditionRef=status, DemEnableConditionRef=the_001, DemEnableConditionRef=the_001, DemEnableConditionRef=the_001, DemEnableConditionRef=the_001, DemEnableConditionRef=the_001, DemEnableConditionRef=the_001, DemEnableConditionRef=the_001, DemEnableConditionRef=the_001, DemEnableConditionRef=timer, DemEnableConditionRef=timing, DemEnableConditionRef=timing, DemEnableConditionRef=to, DemEnableConditionRef=to, DemEnableConditionRef=to, DemEnableConditionRef=up, DemEnableConditionRef=voltage, DemEnableConditionRef=wake
        EnableConditionGroup_fdfec498: DemEnableConditionRef=Busoff, DemEnableConditionRef=CAN, DemEnableConditionRef=No, DemEnableConditionRef=No, DemEnableConditionRef=PT, DemEnableConditionRef=The, DemEnableConditionRef=V, DemEnableConditionRef=V, DemEnableConditionRef=When, DemEnableConditionRef=after, DemEnableConditionRef=again, DemEnableConditionRef=all, DemEnableConditionRef=any, DemEnableConditionRef=battery, DemEnableConditionRef=be, DemEnableConditionRef=being, DemEnableConditionRef=completed, DemEnableConditionRef=conditions, DemEnableConditionRef=conditions, DemEnableConditionRef=conditions, DemEnableConditionRef=confirmation, DemEnableConditionRef=diagnosis, DemEnableConditionRef=diagnosis, DemEnableConditionRef=during, DemEnableConditionRef=enable, DemEnableConditionRef=fault, DemEnableConditionRef=fault, DemEnableConditionRef=fault, DemEnableConditionRef=is, DemEnableConditionRef=is, DemEnableConditionRef=is, DemEnableConditionRef=met, DemEnableConditionRef=met, DemEnableConditionRef=ms, DemEnableConditionRef=normal, DemEnableConditionRef=not, DemEnableConditionRef=of, DemEnableConditionRef=performed, DemEnableConditionRef=shall, DemEnableConditionRef=status, DemEnableConditionRef=the_001, DemEnableConditionRef=the_001, DemEnableConditionRef=the_001, DemEnableConditionRef=the_001, DemEnableConditionRef=the_001, DemEnableConditionRef=to, DemEnableConditionRef=trigger, DemEnableConditionRef=up, DemEnableConditionRef=voltage, DemEnableConditionRef=waked
        EnableConditionGroup_93df7d19: DemEnableConditionRef=No, DemEnableConditionRef=When, DemEnableConditionRef=after, DemEnableConditionRef=again, DemEnableConditionRef=all, DemEnableConditionRef=any, DemEnableConditionRef=be, DemEnableConditionRef=being, DemEnableConditionRef=completed, DemEnableConditionRef=conditions, DemEnableConditionRef=conditions, DemEnableConditionRef=conditions, DemEnableConditionRef=confirmation, DemEnableConditionRef=diagnosis, DemEnableConditionRef=diagnosis, DemEnableConditionRef=during, DemEnableConditionRef=enable, DemEnableConditionRef=fault, DemEnableConditionRef=fault, DemEnableConditionRef=fault, DemEnableConditionRef=is, DemEnableConditionRef=is, DemEnableConditionRef=met, DemEnableConditionRef=met, DemEnableConditionRef=ms, DemEnableConditionRef=not, DemEnableConditionRef=of, DemEnableConditionRef=performed, DemEnableConditionRef=shall, DemEnableConditionRef=the_001, DemEnableConditionRef=the_001, DemEnableConditionRef=the_001, DemEnableConditionRef=the_001, DemEnableConditionRef=the_001, DemEnableConditionRef=trigger, DemEnableConditionRef=up, DemEnableConditionRef=waked
        EnableConditionGroup_58c4940f: DemEnableConditionRef=CAN, DemEnableConditionRef=No, DemEnableConditionRef=PT, DemEnableConditionRef=The, DemEnableConditionRef=V, DemEnableConditionRef=V, DemEnableConditionRef=When, DemEnableConditionRef=after, DemEnableConditionRef=again, DemEnableConditionRef=all, DemEnableConditionRef=any, DemEnableConditionRef=battery, DemEnableConditionRef=be, DemEnableConditionRef=being, DemEnableConditionRef=bussoff, DemEnableConditionRef=completed, DemEnableConditionRef=conditions, DemEnableConditionRef=conditions, DemEnableConditionRef=conditions, DemEnableConditionRef=confirmation, DemEnableConditionRef=diagnosis, DemEnableConditionRef=diagnosis, DemEnableConditionRef=during, DemEnableConditionRef=enable, DemEnableConditionRef=fault, DemEnableConditionRef=fault, DemEnableConditionRef=fault, DemEnableConditionRef=is, DemEnableConditionRef=is, DemEnableConditionRef=is, DemEnableConditionRef=met, DemEnableConditionRef=met, DemEnableConditionRef=ms, DemEnableConditionRef=normal, DemEnableConditionRef=not, DemEnableConditionRef=of, DemEnableConditionRef=performed, DemEnableConditionRef=shall, DemEnableConditionRef=the_001, DemEnableConditionRef=the_001, DemEnableConditionRef=the_001, DemEnableConditionRef=the_001, DemEnableConditionRef=the_001, DemEnableConditionRef=to, DemEnableConditionRef=trigger, DemEnableConditionRef=up, DemEnableConditionRef=voltage, DemEnableConditionRef=waked
        EnableConditionGroup_c81fc67e: DemEnableConditionRef=All_001, DemEnableConditionRef=Being_001, DemEnableConditionRef=Conditions_001, DemEnableConditionRef=Conditions_001, DemEnableConditionRef=Confirmed, DemEnableConditionRef=Confirmed, DemEnableConditionRef=DTC, DemEnableConditionRef=DTC, DemEnableConditionRef=Enable_001, DemEnableConditionRef=Enable_001, DemEnableConditionRef=In_001, DemEnableConditionRef=No, DemEnableConditionRef=Reset_001, DemEnableConditionRef=T_Delay, DemEnableConditionRef=T_Delay, DemEnableConditionRef=T_Delay, DemEnableConditionRef=The, DemEnableConditionRef=V, DemEnableConditionRef=V, DemEnableConditionRef=again, DemEnableConditionRef=again, DemEnableConditionRef=and, DemEnableConditionRef=and, DemEnableConditionRef=and, DemEnableConditionRef=any, DemEnableConditionRef=any, DemEnableConditionRef=battery, DemEnableConditionRef=condition, DemEnableConditionRef=conditions, DemEnableConditionRef=criteria, DemEnableConditionRef=criteria, DemEnableConditionRef=do, DemEnableConditionRef=does, DemEnableConditionRef=fault, DemEnableConditionRef=following, DemEnableConditionRef=for, DemEnableConditionRef=if_001, DemEnableConditionRef=in, DemEnableConditionRef=in, DemEnableConditionRef=is, DemEnableConditionRef=last, DemEnableConditionRef=meet, DemEnableConditionRef=meet, DemEnableConditionRef=met, DemEnableConditionRef=ms, DemEnableConditionRef=normal, DemEnableConditionRef=not, DemEnableConditionRef=not, DemEnableConditionRef=of, DemEnableConditionRef=of, DemEnableConditionRef=recovered, DemEnableConditionRef=requirements, DemEnableConditionRef=requirements, DemEnableConditionRef=reset, DemEnableConditionRef=simultaneously, DemEnableConditionRef=start, DemEnableConditionRef=start, DemEnableConditionRef=the_001, DemEnableConditionRef=the_001, DemEnableConditionRef=the_001, DemEnableConditionRef=the_001, DemEnableConditionRef=the_001, DemEnableConditionRef=the_001, DemEnableConditionRef=the_001, DemEnableConditionRef=timer, DemEnableConditionRef=timing, DemEnableConditionRef=timing, DemEnableConditionRef=to, DemEnableConditionRef=to, DemEnableConditionRef=to, DemEnableConditionRef=up, DemEnableConditionRef=voltage, DemEnableConditionRef=waked
      ExtendedData (DemExtendedDataRecordClass):
        DemExtendedDataRecordNumber = 1
        DemExtendedDataRecordTrigger = DEM_RECORD_TRIGGER_TESTFAILED
        DemExtendedDataRecordUpdate = DEM_UPDATE_RECORD_YES
        DemDataClassRef = ExtendedData_Fault_Ocurrence_Counter
        DemDataClassRef = ExtendedData_Fault_Aged_Counter
        DemDataClassRef = ExtendedData_Fault_Aging_Counter
      7 x DemFreezeFrameClass, all with DemDidClassRef=DemGeneral/Vehicle_State, DemDidClassRef=DemGeneral/Battery_Voltage, DemDidClassRef=DemGeneral/Total_Odometer, DemDidClassRef=DemGeneral/Vehicle_speed, DemDidClassRef=DemGeneral/Date_And_Time, DemDidClassRef=DemGeneral/VCU_HVStatus, DemDidClassRef=DemGeneral/SOC, DemDidClassRef=DemGeneral/Gear:
        FreezeFrameClass_376d31f7: DemDidClassRef=DemGeneral/Electronic_lock_state
        FreezeFrameClass_5f5b5001
        FreezeFrameClass_a7d22c66: DemDidClassRef=DemGeneral/VCU_HV_InterLock_PWM_pfrequency
        FreezeFrameClass_c715a583: DemDidClassRef=DemGeneral/VCU_control_main_relay
        FreezeFrameClass_d0d51cf0: DemDidClassRef=DemGeneral/VCU_control_S2_status
        FreezeFrameClass_d96350db: DemDidClassRef=DemGeneral/AC_charging_parameter
        FreezeFrameClass_de0e94c2: DemDidClassRef=DemGeneral/VCU_AccPealparameter
      FreezeFrameRecNumClass_f98c8aa7 (DemFreezeFrameRecNumClass):
        DemFreezeFrameRecordNumber = 1
        DemFreezeFrameRecordTrigger = DEM_RECORD_TRIGGER_TESTFAILED
        DemFreezeFrameRecordUpdate = DEM_UPDATE_RECORD_YES
        DemFreezeFrameRecordNumber = 2
        DemFreezeFrameRecordTrigger = DEM_RECORD_TRIGGER_TESTFAILED
        DemFreezeFrameRecordUpdate = DEM_UPDATE_RECORD_YES
      WarningIndicator (DemIndicator)
      PowerCycle (DemOperationCycle): DemOperationCycleType=DEM_OPCYC_POWER
      No_known_corrective_action (DemOperationCycle): DemOperationCycleType=DEM_OPCYC_OTHER
      29 x DemDataClass, all with DemDataElementUsePort=USE_DATA_CLIENT_SERVER_PORT, DemDataElementStoreNonVolatile=true:
        DID_0xf1a4_Date_And_Time_Day: DemDataElementDataSize=1, DemDataElementDataType=UINT8
        DID_0xf1a4_Date_And_Time_Hour: DemDataElementDataSize=1, DemDataElementDataType=UINT8
        DID_0xf1a4_Date_And_Time_Minute: DemDataElementDataSize=1, DemDataElementDataType=UINT8
        DID_0xf1a4_Date_And_Time_Month: DemDataElementDataSize=1, DemDataElementDataType=UINT8
        DID_0xf1a4_Date_And_Time_Second: DemDataElementDataSize=1, DemDataElementDataType=UINT8
        DID_0xf1a4_Date_And_Time_Year: DemDataElementDataSize=1, DemDataElementDataType=UINT8
        DID_0x1d07_Electronic_lock_state: DemDataElementDataSize=1, DemDataElementDataType=UINT8
        ExtendedData_Fault_Aged_Counter: DemDataElementDataSize=1, DemDataElementDataType=UINT8
        ExtendedData_Fault_Aging_Counter: DemDataElementDataSize=1, DemDataElementDataType=UINT8
        ExtendedData_Fault_Ocurrence_Counter: DemDataElementDataSize=1, DemDataElementDataType=UINT8
        DID_0xf1a7_Gear: DemDataElementDataSize=1, DemDataElementDataType=UINT8
        DID_0xf1a0_Ignition_Switch_Signal: DemDataElementDataSize=1, DemDataElementDataType=UINT8
        DID_0x1d11_Mainrealy1: DemDataElementDataSize=1, DemDataElementDataType=UINT8
        DID_0x1d11_Mainrelay2: DemDataElementDataSize=1, DemDataElementDataType=UINT8
        DID_0x1d09_New_Bit_Field: DemDataElementDataSize=1, DemDataElementDataType=UINT8
        DID_0x1d08_VCU_HVIL: DemDataElementDataSize=1, DemDataElementDataType=UINT8
        DID_0xf1a5_VCU_HVStatus: DemDataElementDataSize=1, DemDataElementDataType=UINT8
        DID_0x1d01_Accelerator_pedal_sensor_1_voltage: DemDataElementDataSize=2, DemDataElementDataType=UINT16, DemDataElementEndianness=BIG_ENDIAN
        DID_0x1d01_Accelerator_pedal_sensor_2_voltage: DemDataElementDataSize=2, DemDataElementDataType=UINT16, DemDataElementEndianness=BIG_ENDIAN
        DID_0xf1a1_Battery_Voltage: DemDataElementDataSize=2, DemDataElementDataType=UINT16, DemDataElementEndianness=BIG_ENDIAN
        DID_0x1d05_POD_OBC_InputACVoltage: DemDataElementDataSize=2, DemDataElementDataType=UINT16, DemDataElementEndianness=BIG_ENDIAN
        DID_0x1d05_POD_OBC_OutputDCChargeCurrent: DemDataElementDataSize=2, DemDataElementDataType=UINT16, DemDataElementEndianness=BIG_ENDIAN
        DID_0x1d05_POD_OBC_OutputDCChargeVoltage: DemDataElementDataSize=2, DemDataElementDataType=UINT16, DemDataElementEndianness=BIG_ENDIAN
        DID_0xf1a6_SOC: DemDataElementDataSize=2, DemDataElementDataType=UINT16, DemDataElementEndianness=BIG_ENDIAN
        DID_0x1d01_VCU_AccelerationPedal: DemDataElementDataSize=2, DemDataElementDataType=UINT16, DemDataElementEndianness=BIG_ENDIAN
        DID_0x1d05_VCU_OBC_ChargeCurrentCommand: DemDataElementDataSize=2, DemDataElementDataType=UINT16, DemDataElementEndianness=BIG_ENDIAN
        DID_0x1d01_VCU_VehicleSpeed: DemDataElementDataSize=2, DemDataElementDataType=UINT16, DemDataElementEndianness=BIG_ENDIAN
        DID_0xf1a3_Vehicle_speed: DemDataElementDataSize=2, DemDataElementDataType=UINT16, DemDataElementEndianness=BIG_ENDIAN
        DID_0xf1a2_Total_Odometer: DemDataElementDataSize=3, DemDataElementDataType=UINT8_N, DemDataElementEndianness=opaque
