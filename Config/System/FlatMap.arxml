AUTOSAR XML (schema 00049)
package /COM/VECTOR/CFG/WORKFLOW/SYSDESC/SYNC
  flat map FLATMAP
    flat instance descriptor SWC1: upstream-reference=EcuSwComposition.SWC1, ecu-extract-reference=COMPOSITIONTYPE.SWC1
    flat instance descriptor PowerMng_SWC: upstream-reference=EcuSwComposition.PowerMng_SWC, ecu-extract-reference=COMPOSITIONTYPE.PowerMng_SWC
