AUTOSAR XML (schema 00049)
package /COM/VECTOR/CFG/WORKFLOW/SYSDESC/SYNC
  flat map FLATMAP
    120 x flat instance descriptor:
      SWC1: upstream-reference=EcuSwComposition.SWC1, ecu-extract-reference=COMPOSITIONTYPE.SWC1
      PowerMng_SWC: upstream-reference=EcuSwComposition.PowerMng_SWC, ecu-extract-reference=COMPOSITIONTYPE.PowerMng_SWC
      VcuRxMsg1_Sig0: upstream-reference=EcuSwComposition.VcuRxMsg1_Sig0.VcuRxMsg1_Sig0, ecu-extract-reference=COMPOSITIONTYPE.VcuRxMsg1_Sig0.VcuRxMsg1_Sig0
      VcuRxMsg1_Sig0_001: upstream-reference=EcuSwComposition.VcuRxMsg1_Sig0, ecu-extract-reference=COMPOSITIONTYPE.VcuRxMsg1_Sig0
      VcuRxMsg1_Sig2: upstream-reference=EcuSwComposition.VcuRxMsg1_Sig2.VcuRxMsg1_Sig2, ecu-extract-reference=COMPOSITIONTYPE.VcuRxMsg1_Sig2.VcuRxMsg1_Sig2
      VcuRxMsg1_Sig2_001: upstream-reference=EcuSwComposition.VcuRxMsg1_Sig2, ecu-extract-reference=COMPOSITIONTYPE.VcuRxMsg1_Sig2
      VcuRxMsg1_Sig1: upstream-reference=EcuSwComposition.VcuRxMsg1_Sig1.VcuRxMsg1_Sig1, ecu-extract-reference=COMPOSITIONTYPE.VcuRxMsg1_Sig1.VcuRxMsg1_Sig1
      VcuRxMsg1_Sig1_001: upstream-reference=EcuSwComposition.VcuRxMsg1_Sig1, ecu-extract-reference=COMPOSITIONTYPE.VcuRxMsg1_Sig1
      VcuRxMsg2_Sig3: upstream-reference=EcuSwComposition.VcuRxMsg2_Sig3.VcuRxMsg2_Sig3, ecu-extract-reference=COMPOSITIONTYPE.VcuRxMsg2_Sig3.VcuRxMsg2_Sig3
      VcuRxMsg2_Sig3_001: upstream-reference=EcuSwComposition.VcuRxMsg2_Sig3, ecu-extract-reference=COMPOSITIONTYPE.VcuRxMsg2_Sig3
      VcuRxMsg1_Sig3: upstream-reference=EcuSwComposition.VcuRxMsg1_Sig3.VcuRxMsg1_Sig3, ecu-extract-reference=COMPOSITIONTYPE.VcuRxMsg1_Sig3.VcuRxMsg1_Sig3
      VcuRxMsg1_Sig3_001: upstream-reference=EcuSwComposition.VcuRxMsg1_Sig3, ecu-extract-reference=COMPOSITIONTYPE.VcuRxMsg1_Sig3
      VcuRxMsg2_Sig0: upstream-reference=EcuSwComposition.VcuRxMsg2_Sig0.VcuRxMsg2_Sig0, ecu-extract-reference=COMPOSITIONTYPE.VcuRxMsg2_Sig0.VcuRxMsg2_Sig0
      VcuRxMsg2_Sig0_001: upstream-reference=EcuSwComposition.VcuRxMsg2_Sig0, ecu-extract-reference=COMPOSITIONTYPE.VcuRxMsg2_Sig0
      VcuRxMsg2_Sig2: upstream-reference=EcuSwComposition.VcuRxMsg2_Sig2.VcuRxMsg2_Sig2, ecu-extract-reference=COMPOSITIONTYPE.VcuRxMsg2_Sig2.VcuRxMsg2_Sig2
      VcuRxMsg2_Sig2_001: upstream-reference=EcuSwComposition.VcuRxMsg2_Sig2, ecu-extract-reference=COMPOSITIONTYPE.VcuRxMsg2_Sig2
      VcuRxMsg2_Sig1: upstream-reference=EcuSwComposition.VcuRxMsg2_Sig1.VcuRxMsg2_Sig1, ecu-extract-reference=COMPOSITIONTYPE.VcuRxMsg2_Sig1.VcuRxMsg2_Sig1
      VcuRxMsg2_Sig1_001: upstream-reference=EcuSwComposition.VcuRxMsg2_Sig1, ecu-extract-reference=COMPOSITIONTYPE.VcuRxMsg2_Sig1
      VcuTxMsg1_Sig1: upstream-reference=EcuSwComposition.VcuTxMsg1_Sig1.VcuTxMsg1_Sig1, ecu-extract-reference=COMPOSITIONTYPE.VcuTxMsg1_Sig1.VcuTxMsg1_Sig1
      VcuTxMsg1_Sig1_001: upstream-reference=EcuSwComposition.VcuTxMsg1_Sig1, ecu-extract-reference=COMPOSITIONTYPE.VcuTxMsg1_Sig1
      VcuTxMsg2_Sig1: upstream-reference=EcuSwComposition.VcuTxMsg2_Sig1.VcuTxMsg2_Sig1, ecu-extract-reference=COMPOSITIONTYPE.VcuTxMsg2_Sig1.VcuTxMsg2_Sig1
      VcuTxMsg2_Sig1_001: upstream-reference=EcuSwComposition.VcuTxMsg2_Sig1, ecu-extract-reference=COMPOSITIONTYPE.VcuTxMsg2_Sig1
      VcuTxMsg2_Sig2: upstream-reference=EcuSwComposition.VcuTxMsg2_Sig2.VcuTxMsg2_Sig2, ecu-extract-reference=COMPOSITIONTYPE.VcuTxMsg2_Sig2.VcuTxMsg2_Sig2
      VcuTxMsg2_Sig2_001: upstream-reference=EcuSwComposition.VcuTxMsg2_Sig2, ecu-extract-reference=COMPOSITIONTYPE.VcuTxMsg2_Sig2
      VcuTxMsg1_Sig3: upstream-reference=EcuSwComposition.VcuTxMsg1_Sig3.VcuTxMsg1_Sig3, ecu-extract-reference=COMPOSITIONTYPE.VcuTxMsg1_Sig3.VcuTxMsg1_Sig3
      VcuTxMsg1_Sig3_001: upstream-reference=EcuSwComposition.VcuTxMsg1_Sig3, ecu-extract-reference=COMPOSITIONTYPE.VcuTxMsg1_Sig3
      VcuTxMsg2_Sig0: upstream-reference=EcuSwComposition.VcuTxMsg2_Sig0.VcuTxMsg2_Sig0, ecu-extract-reference=COMPOSITIONTYPE.VcuTxMsg2_Sig0.VcuTxMsg2_Sig0
      VcuTxMsg2_Sig0_001: upstream-reference=EcuSwComposition.VcuTxMsg2_Sig0, ecu-extract-reference=COMPOSITIONTYPE.VcuTxMsg2_Sig0
      VcuTxMsg2_Sig3: upstream-reference=EcuSwComposition.VcuTxMsg2_Sig3.VcuTxMsg2_Sig3, ecu-extract-reference=COMPOSITIONTYPE.VcuTxMsg2_Sig3.VcuTxMsg2_Sig3
      VcuTxMsg2_Sig3_001: upstream-reference=EcuSwComposition.VcuTxMsg2_Sig3, ecu-extract-reference=COMPOSITIONTYPE.VcuTxMsg2_Sig3
      VcuTxMsg1_Sig2: upstream-reference=EcuSwComposition.VcuTxMsg1_Sig2.VcuTxMsg1_Sig2, ecu-extract-reference=COMPOSITIONTYPE.VcuTxMsg1_Sig2.VcuTxMsg1_Sig2
      VcuTxMsg1_Sig2_001: upstream-reference=EcuSwComposition.VcuTxMsg1_Sig2, ecu-extract-reference=COMPOSITIONTYPE.VcuTxMsg1_Sig2
      VcuTxMsg1_Sig0: upstream-reference=EcuSwComposition.VcuTxMsg1_Sig0.VcuTxMsg1_Sig0, ecu-extract-reference=COMPOSITIONTYPE.VcuTxMsg1_Sig0.VcuTxMsg1_Sig0
      VcuTxMsg1_Sig0_001: upstream-reference=EcuSwComposition.VcuTxMsg1_Sig0, ecu-extract-reference=COMPOSITIONTYPE.VcuTxMsg1_Sig0
      Com_SWC: upstream-reference=EcuSwComposition.Com_SWC, ecu-extract-reference=COMPOSITIONTYPE.Com_SWC
      NvM_SWC: upstream-reference=EcuSwComposition.NvM_SWC, ecu-extract-reference=COMPOSITIONTYPE.NvM_SWC
      NvM_SWC_NVBlockDescriptor_UserData1: upstream-reference=COMPOSITIONTYPE.NvM_SWC.NVBlockDescriptor_UserData1
      NvM_SWC_NVBlockDescriptor_UserData2: upstream-reference=COMPOSITIONTYPE.NvM_SWC.NVBlockDescriptor_UserData2
      SWC1NvMService_AC3_SRBS_NvBlockNeed_UserData3NvM_PS_SWC1NvBlockNeed_UserData3: upstream-reference=COMPOSITIONTYPE.SWC1.NvBlockNeed_UserData3, ecu-extract-reference=SWC1NvMService_AC3_SRBS_NvBlockNeed_UserData3NvM_PS_SWC1NvBlockNeed_UserData3
      SWC1NvBlockNeed_UserData3: upstream-reference=COMPOSITIONTYPE.SWC1.NvBlockNeed_UserData3
      DIAG_SWC: upstream-reference=EcuSwComposition.DIAG_SWC, ecu-extract-reference=COMPOSITIONTYPE.DIAG_SWC
      DIAG_SWC_NvBlockNeed_DiagDID_00: upstream-reference=COMPOSITIONTYPE.DIAG_SWC.NvBlockNeed_DiagDID_00
      IoHwAb_SWC: upstream-reference=EcuSwComposition.IoHwAb_SWC, ecu-extract-reference=COMPOSITIONTYPE.IoHwAb_SWC
      EXT1_Valid: upstream-reference=EcuSwComposition.EXT1_Valid.EXT1_Valid, ecu-extract-reference=COMPOSITIONTYPE.EXT1_Valid.EXT1_Valid
      EXT1_Valid_001: upstream-reference=EcuSwComposition.EXT1_Valid, ecu-extract-reference=COMPOSITIONTYPE.EXT1_Valid
      EXT3_Valid: upstream-reference=EcuSwComposition.EXT3_Valid.EXT3_Valid, ecu-extract-reference=COMPOSITIONTYPE.EXT3_Valid.EXT3_Valid
      EXT3_Valid_001: upstream-reference=EcuSwComposition.EXT3_Valid, ecu-extract-reference=COMPOSITIONTYPE.EXT3_Valid
      EXT_A_IN4: upstream-reference=EcuSwComposition.EXT_A_IN4.EXT_A_IN4, ecu-extract-reference=COMPOSITIONTYPE.EXT_A_IN4.EXT_A_IN4
      EXT_A_IN4_001: upstream-reference=EcuSwComposition.EXT_A_IN4, ecu-extract-reference=COMPOSITIONTYPE.EXT_A_IN4
      EXT2_Valid: upstream-reference=EcuSwComposition.EXT2_Valid.EXT2_Valid, ecu-extract-reference=COMPOSITIONTYPE.EXT2_Valid.EXT2_Valid
      EXT2_Valid_001: upstream-reference=EcuSwComposition.EXT2_Valid, ecu-extract-reference=COMPOSITIONTYPE.EXT2_Valid
      EXT4_Valid: upstream-reference=EcuSwComposition.EXT4_Valid.EXT4_Valid, ecu-extract-reference=COMPOSITIONTYPE.EXT4_Valid.EXT4_Valid
      EXT4_Valid_001: upstream-reference=EcuSwComposition.EXT4_Valid, ecu-extract-reference=COMPOSITIONTYPE.EXT4_Valid
      EXT_A_IN1: upstream-reference=EcuSwComposition.EXT_A_IN1.EXT_A_IN1, ecu-extract-reference=COMPOSITIONTYPE.EXT_A_IN1.EXT_A_IN1
      EXT_A_IN1_001: upstream-reference=EcuSwComposition.EXT_A_IN1, ecu-extract-reference=COMPOSITIONTYPE.EXT_A_IN1
      EXT_A_IN2: upstream-reference=EcuSwComposition.EXT_A_IN2.EXT_A_IN2, ecu-extract-reference=COMPOSITIONTYPE.EXT_A_IN2.EXT_A_IN2
      EXT_A_IN2_001: upstream-reference=EcuSwComposition.EXT_A_IN2, ecu-extract-reference=COMPOSITIONTYPE.EXT_A_IN2
      EXT_A_IN3: upstream-reference=EcuSwComposition.EXT_A_IN3.EXT_A_IN3, ecu-extract-reference=COMPOSITIONTYPE.EXT_A_IN3.EXT_A_IN3
      EXT_A_IN3_001: upstream-reference=EcuSwComposition.EXT_A_IN3, ecu-extract-reference=COMPOSITIONTYPE.EXT_A_IN3
      EXT10_Valid: upstream-reference=EcuSwComposition.EXT10_Valid.EXT10_Valid, ecu-extract-reference=COMPOSITIONTYPE.EXT10_Valid.EXT10_Valid
      EXT10_Valid_001: upstream-reference=EcuSwComposition.EXT10_Valid, ecu-extract-reference=COMPOSITIONTYPE.EXT10_Valid
      EXT12_Valid: upstream-reference=EcuSwComposition.EXT12_Valid.EXT12_Valid, ecu-extract-reference=COMPOSITIONTYPE.EXT12_Valid.EXT12_Valid
      EXT12_Valid_001: upstream-reference=EcuSwComposition.EXT12_Valid, ecu-extract-reference=COMPOSITIONTYPE.EXT12_Valid
      EXT15_Valid: upstream-reference=EcuSwComposition.EXT15_Valid.EXT15_Valid, ecu-extract-reference=COMPOSITIONTYPE.EXT15_Valid.EXT15_Valid
      EXT15_Valid_001: upstream-reference=EcuSwComposition.EXT15_Valid, ecu-extract-reference=COMPOSITIONTYPE.EXT15_Valid
      EXT5_Valid: upstream-reference=EcuSwComposition.EXT5_Valid.EXT5_Valid, ecu-extract-reference=COMPOSITIONTYPE.EXT5_Valid.EXT5_Valid
      EXT5_Valid_001: upstream-reference=EcuSwComposition.EXT5_Valid, ecu-extract-reference=COMPOSITIONTYPE.EXT5_Valid
      EXT_A_IN15: upstream-reference=EcuSwComposition.EXT_A_IN15.EXT_A_IN15, ecu-extract-reference=COMPOSITIONTYPE.EXT_A_IN15.EXT_A_IN15
      EXT_A_IN15_001: upstream-reference=EcuSwComposition.EXT_A_IN15, ecu-extract-reference=COMPOSITIONTYPE.EXT_A_IN15
      EXT7_Valid: upstream-reference=EcuSwComposition.EXT7_Valid.EXT7_Valid, ecu-extract-reference=COMPOSITIONTYPE.EXT7_Valid.EXT7_Valid
      EXT7_Valid_001: upstream-reference=EcuSwComposition.EXT7_Valid, ecu-extract-reference=COMPOSITIONTYPE.EXT7_Valid
      EXT_A_IN13: upstream-reference=EcuSwComposition.EXT_A_IN13.EXT_A_IN13, ecu-extract-reference=COMPOSITIONTYPE.EXT_A_IN13.EXT_A_IN13
      EXT_A_IN13_001: upstream-reference=EcuSwComposition.EXT_A_IN13, ecu-extract-reference=COMPOSITIONTYPE.EXT_A_IN13
      EXT_A_IN5: upstream-reference=EcuSwComposition.EXT_A_IN5.EXT_A_IN5, ecu-extract-reference=COMPOSITIONTYPE.EXT_A_IN5.EXT_A_IN5
      EXT_A_IN5_001: upstream-reference=EcuSwComposition.EXT_A_IN5, ecu-extract-reference=COMPOSITIONTYPE.EXT_A_IN5
      EXT6_Valid: upstream-reference=EcuSwComposition.EXT6_Valid.EXT6_Valid, ecu-extract-reference=COMPOSITIONTYPE.EXT6_Valid.EXT6_Valid
      EXT6_Valid_001: upstream-reference=EcuSwComposition.EXT6_Valid, ecu-extract-reference=COMPOSITIONTYPE.EXT6_Valid
      EXT_A_IN12: upstream-reference=EcuSwComposition.EXT_A_IN12.EXT_A_IN12, ecu-extract-reference=COMPOSITIONTYPE.EXT_A_IN12.EXT_A_IN12
      EXT_A_IN12_001: upstream-reference=EcuSwComposition.EXT_A_IN12, ecu-extract-reference=COMPOSITIONTYPE.EXT_A_IN12
      EXT_A_IN7: upstream-reference=EcuSwComposition.EXT_A_IN7.EXT_A_IN7, ecu-extract-reference=COMPOSITIONTYPE.EXT_A_IN7.EXT_A_IN7
      EXT_A_IN7_001: upstream-reference=EcuSwComposition.EXT_A_IN7, ecu-extract-reference=COMPOSITIONTYPE.EXT_A_IN7
      EXT13_Valid: upstream-reference=EcuSwComposition.EXT13_Valid.EXT13_Valid, ecu-extract-reference=COMPOSITIONTYPE.EXT13_Valid.EXT13_Valid
      EXT13_Valid_001: upstream-reference=EcuSwComposition.EXT13_Valid, ecu-extract-reference=COMPOSITIONTYPE.EXT13_Valid
      EXT_A_IN9: upstream-reference=EcuSwComposition.EXT_A_IN9.EXT_A_IN9, ecu-extract-reference=COMPOSITIONTYPE.EXT_A_IN9.EXT_A_IN9
      EXT_A_IN9_001: upstream-reference=EcuSwComposition.EXT_A_IN9, ecu-extract-reference=COMPOSITIONTYPE.EXT_A_IN9
      EXT9_Valid: upstream-reference=EcuSwComposition.EXT9_Valid.EXT9_Valid, ecu-extract-reference=COMPOSITIONTYPE.EXT9_Valid.EXT9_Valid
      EXT9_Valid_001: upstream-reference=EcuSwComposition.EXT9_Valid, ecu-extract-reference=COMPOSITIONTYPE.EXT9_Valid
      EXT8_Valid: upstream-reference=EcuSwComposition.EXT8_Valid.EXT8_Valid, ecu-extract-reference=COMPOSITIONTYPE.EXT8_Valid.EXT8_Valid
      EXT8_Valid_001: upstream-reference=EcuSwComposition.EXT8_Valid, ecu-extract-reference=COMPOSITIONTYPE.EXT8_Valid
      EXT11_Valid: upstream-reference=EcuSwComposition.EXT11_Valid.EXT11_Valid, ecu-extract-reference=COMPOSITIONTYPE.EXT11_Valid.EXT11_Valid
      EXT11_Valid_001: upstream-reference=EcuSwComposition.EXT11_Valid, ecu-extract-reference=COMPOSITIONTYPE.EXT11_Valid
      EXT_A_IN6: upstream-reference=EcuSwComposition.EXT_A_IN6.EXT_A_IN6, ecu-extract-reference=COMPOSITIONTYPE.EXT_A_IN6.EXT_A_IN6
      EXT_A_IN6_001: upstream-reference=EcuSwComposition.EXT_A_IN6, ecu-extract-reference=COMPOSITIONTYPE.EXT_A_IN6
      EXT16_Valid: upstream-reference=EcuSwComposition.EXT16_Valid.EXT16_Valid, ecu-extract-reference=COMPOSITIONTYPE.EXT16_Valid.EXT16_Valid
      EXT16_Valid_001: upstream-reference=EcuSwComposition.EXT16_Valid, ecu-extract-reference=COMPOSITIONTYPE.EXT16_Valid
      EXT14_Valid: upstream-reference=EcuSwComposition.EXT14_Valid.EXT14_Valid, ecu-extract-reference=COMPOSITIONTYPE.EXT14_Valid.EXT14_Valid
      EXT14_Valid_001: upstream-reference=EcuSwComposition.EXT14_Valid, ecu-extract-reference=COMPOSITIONTYPE.EXT14_Valid
      EXT_A_IN16: upstream-reference=EcuSwComposition.EXT_A_IN16.EXT_A_IN16, ecu-extract-reference=COMPOSITIONTYPE.EXT_A_IN16.EXT_A_IN16
      EXT_A_IN16_001: upstream-reference=EcuSwComposition.EXT_A_IN16, ecu-extract-reference=COMPOSITIONTYPE.EXT_A_IN16
      EXT_A_IN11: upstream-reference=EcuSwComposition.EXT_A_IN11.EXT_A_IN11, ecu-extract-reference=COMPOSITIONTYPE.EXT_A_IN11.EXT_A_IN11
      EXT_A_IN11_001: upstream-reference=EcuSwComposition.EXT_A_IN11, ecu-extract-reference=COMPOSITIONTYPE.EXT_A_IN11
      EXT_A_IN8: upstream-reference=EcuSwComposition.EXT_A_IN8.EXT_A_IN8, ecu-extract-reference=COMPOSITIONTYPE.EXT_A_IN8.EXT_A_IN8
      EXT_A_IN8_001: upstream-reference=EcuSwComposition.EXT_A_IN8, ecu-extract-reference=COMPOSITIONTYPE.EXT_A_IN8
      EXT_A_IN14: upstream-reference=EcuSwComposition.EXT_A_IN14.EXT_A_IN14, ecu-extract-reference=COMPOSITIONTYPE.EXT_A_IN14.EXT_A_IN14
      EXT_A_IN14_001: upstream-reference=EcuSwComposition.EXT_A_IN14, ecu-extract-reference=COMPOSITIONTYPE.EXT_A_IN14
      EXT_A_IN10: upstream-reference=EcuSwComposition.EXT_A_IN10.EXT_A_IN10, ecu-extract-reference=COMPOSITIONTYPE.EXT_A_IN10.EXT_A_IN10
      EXT_A_IN10_001: upstream-reference=EcuSwComposition.EXT_A_IN10, ecu-extract-reference=COMPOSITIONTYPE.EXT_A_IN10
      ECC_PMP2_SpdSet: upstream-reference=EcuSwComposition.ECC_PMP2_SpdSet.ECC_PMP2_SpdSet, ecu-extract-reference=COMPOSITIONTYPE.ECC_PMP2_SpdSet.ECC_PMP2_SpdSet
      ECC_PMP2_SpdSet_001: upstream-reference=EcuSwComposition.ECC_PMP2_SpdSet, ecu-extract-reference=COMPOSITIONTYPE.ECC_PMP2_SpdSet
      ECC_PMP3_SpdSet: upstream-reference=EcuSwComposition.ECC_PMP3_SpdSet.ECC_PMP3_SpdSet, ecu-extract-reference=COMPOSITIONTYPE.ECC_PMP3_SpdSet.ECC_PMP3_SpdSet
      ECC_PMP3_SpdSet_001: upstream-reference=EcuSwComposition.ECC_PMP3_SpdSet, ecu-extract-reference=COMPOSITIONTYPE.ECC_PMP3_SpdSet
      DIAG_SWC_NvMService_AC3_SRBS_NvBlockNeed_AttemptCounterNvM_PS_DIAG_SWC_NvBlockNeed_AttemptCounter: upstream-reference=COMPOSITIONTYPE.DIAG_SWC.NvBlockNeed_AttemptCounter, ecu-extract-reference=DIAG_SWC_NvMService_AC3_SRBS_NvBlockNeed_AttemptCounterNvM_PS_DIAG_SWC_NvBlockNeed_AttemptCounter
      DIAG_SWC_NvBlockNeed_AttemptCounter: upstream-reference=COMPOSITIONTYPE.DIAG_SWC.NvBlockNeed_AttemptCounter
      Core2App_SWC: upstream-reference=EcuSwComposition.Core2App_SWC, ecu-extract-reference=COMPOSITIONTYPE.Core2App_SWC
      Core1App_SWC: upstream-reference=EcuSwComposition.Core1App_SWC, ecu-extract-reference=COMPOSITIONTYPE.Core1App_SWC
      DIAG_SWC_NvBlockNeed_DID_F193: upstream-reference=COMPOSITIONTYPE.DIAG_SWC.NvBlockNeed_DID_F193
      SG_IBS_Status_06_Signal_Group: upstream-reference=EcuSwComposition.SG_IBS_Status_06_Signal_Group.SG_IBS_Status_06_Signal_Group, ecu-extract-reference=COMPOSITIONTYPE.SG_IBS_Status_06_Signal_Group.SG_IBS_Status_06_Signal_Group
      SG_IBS_Status_06_Signal_Group_001: upstream-reference=EcuSwComposition.SG_IBS_Status_06_Signal_Group, ecu-extract-reference=COMPOSITIONTYPE.SG_IBS_Status_06_Signal_Group
      SG_VCU_BMS_Signal_Group: upstream-reference=EcuSwComposition.SG_VCU_BMS_Signal_Group.SG_VCU_BMS_Signal_Group, ecu-extract-reference=COMPOSITIONTYPE.SG_VCU_BMS_Signal_Group.SG_VCU_BMS_Signal_Group
      SG_VCU_BMS_Signal_Group_001: upstream-reference=EcuSwComposition.SG_VCU_BMS_Signal_Group, ecu-extract-reference=COMPOSITIONTYPE.SG_VCU_BMS_Signal_Group
