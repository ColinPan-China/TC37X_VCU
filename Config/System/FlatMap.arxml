AUTOSAR XML (schema 00049)
package /COM/VECTOR/CFG/WORKFLOW/SYSDESC/SYNC
  flat map FLATMAP
    43 x flat instance descriptor:
      SWC1: upstream-reference=EcuSwComposition.SWC1, ecu-extract-reference=COMPOSITIONTYPE.SWC1
      PowerMng_SWC: upstream-reference=EcuSwComposition.PowerMng_SWC, ecu-extract-reference=COMPOSITIONTYPE.PowerMng_SWC
      VcuRxMsg1_Sig0: upstream-reference=EcuSwComposition.VcuRxMsg1_Sig0.VcuRxMsg1_Sig0, ecu-extract-reference=COMPOSITIONTYPE.VcuRxMsg1_Sig0.VcuRxMsg1_Sig0
      VcuRxMsg1_Sig0_001: upstream-reference=EcuSwComposition.VcuRxMsg1_Sig0, ecu-extract-reference=COMPOSITIONTYPE.VcuRxMsg1_Sig0
      VcuRxMsg1_Sig2: upstream-reference=EcuSwComposition.VcuRxMsg1_Sig2.VcuRxMsg1_Sig2, ecu-extract-reference=COMPOSITIONTYPE.VcuRxMsg1_Sig2.VcuRxMsg1_Sig2
      VcuRxMsg1_Sig2_001: upstream-reference=EcuSwComposition.VcuRxMsg1_Sig2, ecu-extract-reference=COMPOSITIONTYPE.VcuRxMsg1_Sig2
      VcuRxMsg1_Sig1: upstream-reference=EcuSwComposition.VcuRxMsg1_Sig1.VcuRxMsg1_Sig1, ecu-extract-reference=COMPOSITIONTYPE.VcuRxMsg1_Sig1.VcuRxMsg1_Sig1
      VcuRxMsg1_Sig1_001: upstream-reference=EcuSwComposition.VcuRxMsg1_Sig1, ecu-extract-reference=COMPOSITIONTYPE.VcuRxMsg1_Sig1
      VcuRxMsg2_Sig3: upstream-reference=EcuSwComposition.VcuRxMsg2_Sig3.VcuRxMsg2_Sig3, ecu-extract-reference=COMPOSITIONTYPE.VcuRxMsg2_Sig3.VcuRxMsg2_Sig3
      VcuRxMsg2_Sig3_001: upstream-reference=EcuSwComposition.VcuRxMsg2_Sig3, ecu-extract-reference=COMPOSITIONTYPE.VcuRxMsg2_Sig3
      VcuRxMsg1_Sig3: upstream-reference=EcuSwComposition.VcuRxMsg1_Sig3.VcuRxMsg1_Sig3, ecu-extract-reference=COMPOSITIONTYPE.VcuRxMsg1_Sig3.VcuRxMsg1_Sig3
      VcuRxMsg1_Sig3_001: upstream-reference=EcuSwComposition.VcuRxMsg1_Sig3, ecu-extract-reference=COMPOSITIONTYPE.VcuRxMsg1_Sig3
      VcuRxMsg2_Sig0: upstream-reference=EcuSwComposition.VcuRxMsg2_Sig0.VcuRxMsg2_Sig0, ecu-extract-reference=COMPOSITIONTYPE.VcuRxMsg2_Sig0.VcuRxMsg2_Sig0
      VcuRxMsg2_Sig0_001: upstream-reference=EcuSwComposition.VcuRxMsg2_Sig0, ecu-extract-reference=COMPOSITIONTYPE.VcuRxMsg2_Sig0
      VcuRxMsg2_Sig2: upstream-reference=EcuSwComposition.VcuRxMsg2_Sig2.VcuRxMsg2_Sig2, ecu-extract-reference=COMPOSITIONTYPE.VcuRxMsg2_Sig2.VcuRxMsg2_Sig2
      VcuRxMsg2_Sig2_001: upstream-reference=EcuSwComposition.VcuRxMsg2_Sig2, ecu-extract-reference=COMPOSITIONTYPE.VcuRxMsg2_Sig2
      VcuRxMsg2_Sig1: upstream-reference=EcuSwComposition.VcuRxMsg2_Sig1.VcuRxMsg2_Sig1, ecu-extract-reference=COMPOSITIONTYPE.VcuRxMsg2_Sig1.VcuRxMsg2_Sig1
      VcuRxMsg2_Sig1_001: upstream-reference=EcuSwComposition.VcuRxMsg2_Sig1, ecu-extract-reference=COMPOSITIONTYPE.VcuRxMsg2_Sig1
      VcuTxMsg1_Sig1: upstream-reference=EcuSwComposition.VcuTxMsg1_Sig1.VcuTxMsg1_Sig1, ecu-extract-reference=COMPOSITIONTYPE.VcuTxMsg1_Sig1.VcuTxMsg1_Sig1
      VcuTxMsg1_Sig1_001: upstream-reference=EcuSwComposition.VcuTxMsg1_Sig1, ecu-extract-reference=COMPOSITIONTYPE.VcuTxMsg1_Sig1
      VcuTxMsg2_Sig1: upstream-reference=EcuSwComposition.VcuTxMsg2_Sig1.VcuTxMsg2_Sig1, ecu-extract-reference=COMPOSITIONTYPE.VcuTxMsg2_Sig1.VcuTxMsg2_Sig1
      VcuTxMsg2_Sig1_001: upstream-reference=EcuSwComposition.VcuTxMsg2_Sig1, ecu-extract-reference=COMPOSITIONTYPE.VcuTxMsg2_Sig1
      VcuTxMsg2_Sig2: upstream-reference=EcuSwComposition.VcuTxMsg2_Sig2.VcuTxMsg2_Sig2, ecu-extract-reference=COMPOSITIONTYPE.VcuTxMsg2_Sig2.VcuTxMsg2_Sig2
      VcuTxMsg2_Sig2_001: upstream-reference=EcuSwComposition.VcuTxMsg2_Sig2, ecu-extract-reference=COMPOSITIONTYPE.VcuTxMsg2_Sig2
      VcuTxMsg1_Sig3: upstream-reference=EcuSwComposition.VcuTxMsg1_Sig3.VcuTxMsg1_Sig3, ecu-extract-reference=COMPOSITIONTYPE.VcuTxMsg1_Sig3.VcuTxMsg1_Sig3
      VcuTxMsg1_Sig3_001: upstream-reference=EcuSwComposition.VcuTxMsg1_Sig3, ecu-extract-reference=COMPOSITIONTYPE.VcuTxMsg1_Sig3
      VcuTxMsg2_Sig0: upstream-reference=EcuSwComposition.VcuTxMsg2_Sig0.VcuTxMsg2_Sig0, ecu-extract-reference=COMPOSITIONTYPE.VcuTxMsg2_Sig0.VcuTxMsg2_Sig0
      VcuTxMsg2_Sig0_001: upstream-reference=EcuSwComposition.VcuTxMsg2_Sig0, ecu-extract-reference=COMPOSITIONTYPE.VcuTxMsg2_Sig0
      VcuTxMsg2_Sig3: upstream-reference=EcuSwComposition.VcuTxMsg2_Sig3.VcuTxMsg2_Sig3, ecu-extract-reference=COMPOSITIONTYPE.VcuTxMsg2_Sig3.VcuTxMsg2_Sig3
      VcuTxMsg2_Sig3_001: upstream-reference=EcuSwComposition.VcuTxMsg2_Sig3, ecu-extract-reference=COMPOSITIONTYPE.VcuTxMsg2_Sig3
      VcuTxMsg1_Sig2: upstream-reference=EcuSwComposition.VcuTxMsg1_Sig2.VcuTxMsg1_Sig2, ecu-extract-reference=COMPOSITIONTYPE.VcuTxMsg1_Sig2.VcuTxMsg1_Sig2
      VcuTxMsg1_Sig2_001: upstream-reference=EcuSwComposition.VcuTxMsg1_Sig2, ecu-extract-reference=COMPOSITIONTYPE.VcuTxMsg1_Sig2
      VcuTxMsg1_Sig0: upstream-reference=EcuSwComposition.VcuTxMsg1_Sig0.VcuTxMsg1_Sig0, ecu-extract-reference=COMPOSITIONTYPE.VcuTxMsg1_Sig0.VcuTxMsg1_Sig0
      VcuTxMsg1_Sig0_001: upstream-reference=EcuSwComposition.VcuTxMsg1_Sig0, ecu-extract-reference=COMPOSITIONTYPE.VcuTxMsg1_Sig0
      Com_SWC: upstream-reference=EcuSwComposition.Com_SWC, ecu-extract-reference=COMPOSITIONTYPE.Com_SWC
      NvM_SWC: upstream-reference=EcuSwComposition.NvM_SWC, ecu-extract-reference=COMPOSITIONTYPE.NvM_SWC
      NvM_SWC_NVBlockDescriptor_UserData1: upstream-reference=COMPOSITIONTYPE.NvM_SWC.NVBlockDescriptor_UserData1
      NvM_SWC_NVBlockDescriptor_UserData2: upstream-reference=COMPOSITIONTYPE.NvM_SWC.NVBlockDescriptor_UserData2
      SWC1NvMService_AC3_SRBS_NvBlockNeed_UserData3NvM_PS_SWC1NvBlockNeed_UserData3: upstream-reference=COMPOSITIONTYPE.SWC1.NvBlockNeed_UserData3, ecu-extract-reference=SWC1NvMService_AC3_SRBS_NvBlockNeed_UserData3NvM_PS_SWC1NvBlockNeed_UserData3
      SWC1NvBlockNeed_UserData3: upstream-reference=COMPOSITIONTYPE.SWC1.NvBlockNeed_UserData3
      DIAG_SWC: upstream-reference=EcuSwComposition.DIAG_SWC, ecu-extract-reference=COMPOSITIONTYPE.DIAG_SWC
      DIAG_SWC_NvBlockNeed_DiagDID_00: upstream-reference=COMPOSITIONTYPE.DIAG_SWC.NvBlockNeed_DiagDID_00
      IoHwAb_SWC: upstream-reference=EcuSwComposition.IoHwAb_SWC, ecu-extract-reference=COMPOSITIONTYPE.IoHwAb_SWC
