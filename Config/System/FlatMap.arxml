AUTOSAR XML (schema 00049)
package /COM/VECTOR/CFG/WORKFLOW/SYSDESC/SYNC
  flat map FLATMAP
    543 x flat instance descriptor:
      Core1App_SWC: upstream-reference=EcuSwComposition.Core1App_SWC, ecu-extract-reference=COMPOSITIONTYPE.Core1App_SWC
      Core2App_SWC: upstream-reference=EcuSwComposition.Core2App_SWC, ecu-extract-reference=COMPOSITIONTYPE.Core2App_SWC
      IoHwAb: upstream-reference=EcuSwComposition.IoHwAb, ecu-extract-reference=COMPOSITIONTYPE.IoHwAb
      CCS_OutputVoltage: upstream-reference=EcuSwComposition.CCS_OutputVoltage.CCS_OutputVoltage, ecu-extract-reference=COMPOSITIONTYPE.CCS_OutputVoltage.CCS_OutputVoltage
      CCS_OutputVoltage_001: upstream-reference=EcuSwComposition.CCS_OutputVoltage, ecu-extract-reference=COMPOSITIONTYPE.CCS_OutputVoltage
      CEM_BatteryChargeRequireTimeout: upstream-reference=EcuSwComposition.CEM_BatteryChargeRequireTimeout.CEM_BatteryChargeRequireTimeout, ecu-extract-reference=COMPOSITIONTYPE.CEM_BatteryChargeRequireTimeout.CEM_BatteryChargeRequireTimeout
      CEM_BatteryChargeRequireTimeout_001: upstream-reference=EcuSwComposition.CEM_BatteryChargeRequireTimeout, ecu-extract-reference=COMPOSITIONTYPE.CEM_BatteryChargeRequireTimeout
      CHM_ProtocolVersion: upstream-reference=EcuSwComposition.CHM_ProtocolVersion.CHM_ProtocolVersion, ecu-extract-reference=COMPOSITIONTYPE.CHM_ProtocolVersion.CHM_ProtocolVersion
      CHM_ProtocolVersion_001: upstream-reference=EcuSwComposition.CHM_ProtocolVersion, ecu-extract-reference=COMPOSITIONTYPE.CHM_ProtocolVersion
      CML_OutputCurrentMax: upstream-reference=EcuSwComposition.CML_OutputCurrentMax.CML_OutputCurrentMax, ecu-extract-reference=COMPOSITIONTYPE.CML_OutputCurrentMax.CML_OutputCurrentMax
      CML_OutputCurrentMax_001: upstream-reference=EcuSwComposition.CML_OutputCurrentMax, ecu-extract-reference=COMPOSITIONTYPE.CML_OutputCurrentMax
      BHM_AllowChargeVoltageMax: upstream-reference=EcuSwComposition.BHM_AllowChargeVoltageMax.BHM_AllowChargeVoltageMax, ecu-extract-reference=COMPOSITIONTYPE.BHM_AllowChargeVoltageMax.BHM_AllowChargeVoltageMax
      BHM_AllowChargeVoltageMax_001: upstream-reference=EcuSwComposition.BHM_AllowChargeVoltageMax, ecu-extract-reference=COMPOSITIONTYPE.BHM_AllowChargeVoltageMax
      BRO_BMSChargeReady: upstream-reference=EcuSwComposition.BRO_BMSChargeReady.BRO_BMSChargeReady, ecu-extract-reference=COMPOSITIONTYPE.BRO_BMSChargeReady.BRO_BMSChargeReady
      BRO_BMSChargeReady_001: upstream-reference=EcuSwComposition.BRO_BMSChargeReady, ecu-extract-reference=COMPOSITIONTYPE.BRO_BMSChargeReady
      BCL_ChargeMode: upstream-reference=EcuSwComposition.BCL_ChargeMode.BCL_ChargeMode, ecu-extract-reference=COMPOSITIONTYPE.BCL_ChargeMode.BCL_ChargeMode
      BCL_ChargeMode_001: upstream-reference=EcuSwComposition.BCL_ChargeMode, ecu-extract-reference=COMPOSITIONTYPE.BCL_ChargeMode
      BCL_CurrentRequire: upstream-reference=EcuSwComposition.BCL_CurrentRequire.BCL_CurrentRequire, ecu-extract-reference=COMPOSITIONTYPE.BCL_CurrentRequire.BCL_CurrentRequire
      BCL_CurrentRequire_001: upstream-reference=EcuSwComposition.BCL_CurrentRequire, ecu-extract-reference=COMPOSITIONTYPE.BCL_CurrentRequire
      BCL_VolltageRequire: upstream-reference=EcuSwComposition.BCL_VolltageRequire.BCL_VolltageRequire, ecu-extract-reference=COMPOSITIONTYPE.BCL_VolltageRequire.BCL_VolltageRequire
      BCL_VolltageRequire_001: upstream-reference=EcuSwComposition.BCL_VolltageRequire, ecu-extract-reference=COMPOSITIONTYPE.BCL_VolltageRequire
      BSM_BatteryCurrentState: upstream-reference=EcuSwComposition.BSM_BatteryCurrentState.BSM_BatteryCurrentState, ecu-extract-reference=COMPOSITIONTYPE.BSM_BatteryCurrentState.BSM_BatteryCurrentState
      BSM_BatteryCurrentState_001: upstream-reference=EcuSwComposition.BSM_BatteryCurrentState, ecu-extract-reference=COMPOSITIONTYPE.BSM_BatteryCurrentState
      BSM_BatteryOutpuConnectorState: upstream-reference=EcuSwComposition.BSM_BatteryOutpuConnectorState.BSM_BatteryOutpuConnectorState, ecu-extract-reference=COMPOSITIONTYPE.BSM_BatteryOutpuConnectorState.BSM_BatteryOutpuConnectorState
      BSM_BatteryOutpuConnectorState_001: upstream-reference=EcuSwComposition.BSM_BatteryOutpuConnectorState, ecu-extract-reference=COMPOSITIONTYPE.BSM_BatteryOutpuConnectorState
      BSM_BatteryTempState: upstream-reference=EcuSwComposition.BSM_BatteryTempState.BSM_BatteryTempState, ecu-extract-reference=COMPOSITIONTYPE.BSM_BatteryTempState.BSM_BatteryTempState
      BSM_BatteryTempState_001: upstream-reference=EcuSwComposition.BSM_BatteryTempState, ecu-extract-reference=COMPOSITIONTYPE.BSM_BatteryTempState
      BSM_BatteryVoltageState: upstream-reference=EcuSwComposition.BSM_BatteryVoltageState.BSM_BatteryVoltageState, ecu-extract-reference=COMPOSITIONTYPE.BSM_BatteryVoltageState.BSM_BatteryVoltageState
      BSM_BatteryVoltageState_001: upstream-reference=EcuSwComposition.BSM_BatteryVoltageState, ecu-extract-reference=COMPOSITIONTYPE.BSM_BatteryVoltageState
      BSM_ChargeEnable: upstream-reference=EcuSwComposition.BSM_ChargeEnable.BSM_ChargeEnable, ecu-extract-reference=COMPOSITIONTYPE.BSM_ChargeEnable.BSM_ChargeEnable
      BSM_ChargeEnable_001: upstream-reference=EcuSwComposition.BSM_ChargeEnable, ecu-extract-reference=COMPOSITIONTYPE.BSM_ChargeEnable
      BSM_InsulationState: upstream-reference=EcuSwComposition.BSM_InsulationState.BSM_InsulationState, ecu-extract-reference=COMPOSITIONTYPE.BSM_InsulationState.BSM_InsulationState
      BSM_InsulationState_001: upstream-reference=EcuSwComposition.BSM_InsulationState, ecu-extract-reference=COMPOSITIONTYPE.BSM_InsulationState
      BSM_SOC: upstream-reference=EcuSwComposition.BSM_SOC.BSM_SOC, ecu-extract-reference=COMPOSITIONTYPE.BSM_SOC.BSM_SOC
      BSM_SOC_001: upstream-reference=EcuSwComposition.BSM_SOC, ecu-extract-reference=COMPOSITIONTYPE.BSM_SOC
      BST_AbortAchiveSingleVolt: upstream-reference=EcuSwComposition.BST_AbortAchiveSingleVolt.BST_AbortAchiveSingleVolt, ecu-extract-reference=COMPOSITIONTYPE.BST_AbortAchiveSingleVolt.BST_AbortAchiveSingleVolt
      BST_AbortAchiveSingleVolt_001: upstream-reference=EcuSwComposition.BST_AbortAchiveSingleVolt, ecu-extract-reference=COMPOSITIONTYPE.BST_AbortAchiveSingleVolt
      BST_AbortAchiveSOC: upstream-reference=EcuSwComposition.BST_AbortAchiveSOC.BST_AbortAchiveSOC, ecu-extract-reference=COMPOSITIONTYPE.BST_AbortAchiveSOC.BST_AbortAchiveSOC
      BST_AbortAchiveSOC_001: upstream-reference=EcuSwComposition.BST_AbortAchiveSOC, ecu-extract-reference=COMPOSITIONTYPE.BST_AbortAchiveSOC
      BST_AbortAchiveTotalVolt: upstream-reference=EcuSwComposition.BST_AbortAchiveTotalVolt.BST_AbortAchiveTotalVolt, ecu-extract-reference=COMPOSITIONTYPE.BST_AbortAchiveTotalVolt.BST_AbortAchiveTotalVolt
      BST_AbortAchiveTotalVolt_001: upstream-reference=EcuSwComposition.BST_AbortAchiveTotalVolt, ecu-extract-reference=COMPOSITIONTYPE.BST_AbortAchiveTotalVolt
      BST_Abortdet2Voltexception: upstream-reference=EcuSwComposition.BST_Abortdet2Voltexception.BST_Abortdet2Voltexception, ecu-extract-reference=COMPOSITIONTYPE.BST_Abortdet2Voltexception.BST_Abortdet2Voltexception
      BST_Abortdet2Voltexception_001: upstream-reference=EcuSwComposition.BST_Abortdet2Voltexception, ecu-extract-reference=COMPOSITIONTYPE.BST_Abortdet2Voltexception
      BST_AbortErrorCurrent: upstream-reference=EcuSwComposition.BST_AbortErrorCurrent.BST_AbortErrorCurrent, ecu-extract-reference=COMPOSITIONTYPE.BST_AbortErrorCurrent.BST_AbortErrorCurrent
      BST_AbortErrorCurrent_001: upstream-reference=EcuSwComposition.BST_AbortErrorCurrent, ecu-extract-reference=COMPOSITIONTYPE.BST_AbortErrorCurrent
      BST_AbortErrorVoltage: upstream-reference=EcuSwComposition.BST_AbortErrorVoltage.BST_AbortErrorVoltage, ecu-extract-reference=COMPOSITIONTYPE.BST_AbortErrorVoltage.BST_AbortErrorVoltage
      BST_AbortErrorVoltage_001: upstream-reference=EcuSwComposition.BST_AbortErrorVoltage, ecu-extract-reference=COMPOSITIONTYPE.BST_AbortErrorVoltage
      BST_AbortFaultBatteryTemp: upstream-reference=EcuSwComposition.BST_AbortFaultBatteryTemp.BST_AbortFaultBatteryTemp, ecu-extract-reference=COMPOSITIONTYPE.BST_AbortFaultBatteryTemp.BST_AbortFaultBatteryTemp
      BST_AbortFaultBatteryTemp_001: upstream-reference=EcuSwComposition.BST_AbortFaultBatteryTemp, ecu-extract-reference=COMPOSITIONTYPE.BST_AbortFaultBatteryTemp
      BST_AbortFaultBMSTemp: upstream-reference=EcuSwComposition.BST_AbortFaultBMSTemp.BST_AbortFaultBMSTemp, ecu-extract-reference=COMPOSITIONTYPE.BST_AbortFaultBMSTemp.BST_AbortFaultBMSTemp
      BST_AbortFaultBMSTemp_001: upstream-reference=EcuSwComposition.BST_AbortFaultBMSTemp, ecu-extract-reference=COMPOSITIONTYPE.BST_AbortFaultBMSTemp
      BST_AbortFaultConnector: upstream-reference=EcuSwComposition.BST_AbortFaultConnector.BST_AbortFaultConnector, ecu-extract-reference=COMPOSITIONTYPE.BST_AbortFaultConnector.BST_AbortFaultConnector
      BST_AbortFaultConnector_001: upstream-reference=EcuSwComposition.BST_AbortFaultConnector, ecu-extract-reference=COMPOSITIONTYPE.BST_AbortFaultConnector
      BST_AbortFaultConnectorTemp: upstream-reference=EcuSwComposition.BST_AbortFaultConnectorTemp.BST_AbortFaultConnectorTemp, ecu-extract-reference=COMPOSITIONTYPE.BST_AbortFaultConnectorTemp.BST_AbortFaultConnectorTemp
      BST_AbortFaultConnectorTemp_001: upstream-reference=EcuSwComposition.BST_AbortFaultConnectorTemp, ecu-extract-reference=COMPOSITIONTYPE.BST_AbortFaultConnectorTemp
      BST_AbortFaultInsulation: upstream-reference=EcuSwComposition.BST_AbortFaultInsulation.BST_AbortFaultInsulation, ecu-extract-reference=COMPOSITIONTYPE.BST_AbortFaultInsulation.BST_AbortFaultInsulation
      BST_AbortFaultInsulation_001: upstream-reference=EcuSwComposition.BST_AbortFaultInsulation, ecu-extract-reference=COMPOSITIONTYPE.BST_AbortFaultInsulation
      BST_AbortFaultOther: upstream-reference=EcuSwComposition.BST_AbortFaultOther.BST_AbortFaultOther, ecu-extract-reference=COMPOSITIONTYPE.BST_AbortFaultOther.BST_AbortFaultOther
      BST_AbortFaultOther_001: upstream-reference=EcuSwComposition.BST_AbortFaultOther, ecu-extract-reference=COMPOSITIONTYPE.BST_AbortFaultOther
      BST_AbortHVrelayfault: upstream-reference=EcuSwComposition.BST_AbortHVrelayfault.BST_AbortHVrelayfault, ecu-extract-reference=COMPOSITIONTYPE.BST_AbortHVrelayfault.BST_AbortHVrelayfault
      BST_AbortHVrelayfault_001: upstream-reference=EcuSwComposition.BST_AbortHVrelayfault, ecu-extract-reference=COMPOSITIONTYPE.BST_AbortHVrelayfault
      BST_Abortmanoperate: upstream-reference=EcuSwComposition.BST_Abortmanoperate.BST_Abortmanoperate, ecu-extract-reference=COMPOSITIONTYPE.BST_Abortmanoperate.BST_Abortmanoperate
      BST_Abortmanoperate_001: upstream-reference=EcuSwComposition.BST_Abortmanoperate, ecu-extract-reference=COMPOSITIONTYPE.BST_Abortmanoperate
      BEM_ChargeAbortTimeout: upstream-reference=EcuSwComposition.BEM_ChargeAbortTimeout.BEM_ChargeAbortTimeout, ecu-extract-reference=COMPOSITIONTYPE.BEM_ChargeAbortTimeout.BEM_ChargeAbortTimeout
      BEM_ChargeAbortTimeout_001: upstream-reference=EcuSwComposition.BEM_ChargeAbortTimeout, ecu-extract-reference=COMPOSITIONTYPE.BEM_ChargeAbortTimeout
      BEM_ChargeFinishTimeout: upstream-reference=EcuSwComposition.BEM_ChargeFinishTimeout.BEM_ChargeFinishTimeout, ecu-extract-reference=COMPOSITIONTYPE.BEM_ChargeFinishTimeout.BEM_ChargeFinishTimeout
      BEM_ChargeFinishTimeout_001: upstream-reference=EcuSwComposition.BEM_ChargeFinishTimeout, ecu-extract-reference=COMPOSITIONTYPE.BEM_ChargeFinishTimeout
      BEM_ChargerIdTimeout0: upstream-reference=EcuSwComposition.BEM_ChargerIdTimeout0.BEM_ChargerIdTimeout0, ecu-extract-reference=COMPOSITIONTYPE.BEM_ChargerIdTimeout0.BEM_ChargerIdTimeout0
      BEM_ChargerIdTimeout0_001: upstream-reference=EcuSwComposition.BEM_ChargerIdTimeout0, ecu-extract-reference=COMPOSITIONTYPE.BEM_ChargerIdTimeout0
      BEM_ChargerIdTimeout1: upstream-reference=EcuSwComposition.BEM_ChargerIdTimeout1.BEM_ChargerIdTimeout1, ecu-extract-reference=COMPOSITIONTYPE.BEM_ChargerIdTimeout1.BEM_ChargerIdTimeout1
      BEM_ChargerIdTimeout1_001: upstream-reference=EcuSwComposition.BEM_ChargerIdTimeout1, ecu-extract-reference=COMPOSITIONTYPE.BEM_ChargerIdTimeout1
      BEM_ChargeStateTimeout: upstream-reference=EcuSwComposition.BEM_ChargeStateTimeout.BEM_ChargeStateTimeout, ecu-extract-reference=COMPOSITIONTYPE.BEM_ChargeStateTimeout.BEM_ChargeStateTimeout
      BEM_ChargeStateTimeout_001: upstream-reference=EcuSwComposition.BEM_ChargeStateTimeout, ecu-extract-reference=COMPOSITIONTYPE.BEM_ChargeStateTimeout
      BEM_ChargeStatisticsTimeout: upstream-reference=EcuSwComposition.BEM_ChargeStatisticsTimeout.BEM_ChargeStatisticsTimeout, ecu-extract-reference=COMPOSITIONTYPE.BEM_ChargeStatisticsTimeout.BEM_ChargeStatisticsTimeout
      BEM_ChargeStatisticsTimeout_001: upstream-reference=EcuSwComposition.BEM_ChargeStatisticsTimeout, ecu-extract-reference=COMPOSITIONTYPE.BEM_ChargeStatisticsTimeout
      BEM_TimesyncOrPowerTimeout: upstream-reference=EcuSwComposition.BEM_TimesyncOrPowerTimeout.BEM_TimesyncOrPowerTimeout, ecu-extract-reference=COMPOSITIONTYPE.BEM_TimesyncOrPowerTimeout.BEM_TimesyncOrPowerTimeout
      BEM_TimesyncOrPowerTimeout_001: upstream-reference=EcuSwComposition.BEM_TimesyncOrPowerTimeout, ecu-extract-reference=COMPOSITIONTYPE.BEM_TimesyncOrPowerTimeout
      CML_OutputCurrentMin: upstream-reference=EcuSwComposition.CML_OutputCurrentMin.CML_OutputCurrentMin, ecu-extract-reference=COMPOSITIONTYPE.CML_OutputCurrentMin.CML_OutputCurrentMin
      CML_OutputCurrentMin_001: upstream-reference=EcuSwComposition.CML_OutputCurrentMin, ecu-extract-reference=COMPOSITIONTYPE.CML_OutputCurrentMin
      CML_OutputVoltageMin: upstream-reference=EcuSwComposition.CML_OutputVoltageMin.CML_OutputVoltageMin, ecu-extract-reference=COMPOSITIONTYPE.CML_OutputVoltageMin.CML_OutputVoltageMin
      CML_OutputVoltageMin_001: upstream-reference=EcuSwComposition.CML_OutputVoltageMin, ecu-extract-reference=COMPOSITIONTYPE.CML_OutputVoltageMin
      CML_OutpuVoltageMax: upstream-reference=EcuSwComposition.CML_OutpuVoltageMax.CML_OutpuVoltageMax, ecu-extract-reference=COMPOSITIONTYPE.CML_OutpuVoltageMax.CML_OutpuVoltageMax
      CML_OutpuVoltageMax_001: upstream-reference=EcuSwComposition.CML_OutpuVoltageMax, ecu-extract-reference=COMPOSITIONTYPE.CML_OutpuVoltageMax
      CRM_RecognitionResult: upstream-reference=EcuSwComposition.CRM_RecognitionResult.CRM_RecognitionResult, ecu-extract-reference=COMPOSITIONTYPE.CRM_RecognitionResult.CRM_RecognitionResult
      CRM_RecognitionResult_001: upstream-reference=EcuSwComposition.CRM_RecognitionResult, ecu-extract-reference=COMPOSITIONTYPE.CRM_RecognitionResult
      CRO_ChargerReady: upstream-reference=EcuSwComposition.CRO_ChargerReady.CRO_ChargerReady, ecu-extract-reference=COMPOSITIONTYPE.CRO_ChargerReady.CRO_ChargerReady
      CRO_ChargerReady_001: upstream-reference=EcuSwComposition.CRO_ChargerReady, ecu-extract-reference=COMPOSITIONTYPE.CRO_ChargerReady
      CST_AbortAchiveCondition: upstream-reference=EcuSwComposition.CST_AbortAchiveCondition.CST_AbortAchiveCondition, ecu-extract-reference=COMPOSITIONTYPE.CST_AbortAchiveCondition.CST_AbortAchiveCondition
      CST_AbortAchiveCondition_001: upstream-reference=EcuSwComposition.CST_AbortAchiveCondition, ecu-extract-reference=COMPOSITIONTYPE.CST_AbortAchiveCondition
      CSD_ChargerNo: upstream-reference=EcuSwComposition.CSD_ChargerNo.CSD_ChargerNo, ecu-extract-reference=COMPOSITIONTYPE.CSD_ChargerNo.CSD_ChargerNo
      CSD_ChargerNo_001: upstream-reference=EcuSwComposition.CSD_ChargerNo, ecu-extract-reference=COMPOSITIONTYPE.CSD_ChargerNo
      BCP_AllowChargeVoltageMax: upstream-reference=EcuSwComposition.BCP_AllowChargeVoltageMax.BCP_AllowChargeVoltageMax, ecu-extract-reference=COMPOSITIONTYPE.BCP_AllowChargeVoltageMax.BCP_AllowChargeVoltageMax
      BCP_AllowChargeVoltageMax_001: upstream-reference=EcuSwComposition.BCP_AllowChargeVoltageMax, ecu-extract-reference=COMPOSITIONTYPE.BCP_AllowChargeVoltageMax
      BCP_AllowTempMax: upstream-reference=EcuSwComposition.BCP_AllowTempMax.BCP_AllowTempMax, ecu-extract-reference=COMPOSITIONTYPE.BCP_AllowTempMax.BCP_AllowTempMax
      BCP_AllowTempMax_001: upstream-reference=EcuSwComposition.BCP_AllowTempMax, ecu-extract-reference=COMPOSITIONTYPE.BCP_AllowTempMax
      BCP_BatteryChargeVoltageMax: upstream-reference=EcuSwComposition.BCP_BatteryChargeVoltageMax.BCP_BatteryChargeVoltageMax, ecu-extract-reference=COMPOSITIONTYPE.BCP_BatteryChargeVoltageMax.BCP_BatteryChargeVoltageMax
      BCP_BatteryChargeVoltageMax_001: upstream-reference=EcuSwComposition.BCP_BatteryChargeVoltageMax, ecu-extract-reference=COMPOSITIONTYPE.BCP_BatteryChargeVoltageMax
      BCP_BatteryNominalEnergy: upstream-reference=EcuSwComposition.BCP_BatteryNominalEnergy.BCP_BatteryNominalEnergy, ecu-extract-reference=COMPOSITIONTYPE.BCP_BatteryNominalEnergy.BCP_BatteryNominalEnergy
      BCP_BatteryNominalEnergy_001: upstream-reference=EcuSwComposition.BCP_BatteryNominalEnergy, ecu-extract-reference=COMPOSITIONTYPE.BCP_BatteryNominalEnergy
      BCP_BatteryTotalVoltage: upstream-reference=EcuSwComposition.BCP_BatteryTotalVoltage.BCP_BatteryTotalVoltage, ecu-extract-reference=COMPOSITIONTYPE.BCP_BatteryTotalVoltage.BCP_BatteryTotalVoltage
      BCP_BatteryTotalVoltage_001: upstream-reference=EcuSwComposition.BCP_BatteryTotalVoltage, ecu-extract-reference=COMPOSITIONTYPE.BCP_BatteryTotalVoltage
      BCP_ChargeCurrentMax: upstream-reference=EcuSwComposition.BCP_ChargeCurrentMax.BCP_ChargeCurrentMax, ecu-extract-reference=COMPOSITIONTYPE.BCP_ChargeCurrentMax.BCP_ChargeCurrentMax
      BCP_ChargeCurrentMax_001: upstream-reference=EcuSwComposition.BCP_ChargeCurrentMax, ecu-extract-reference=COMPOSITIONTYPE.BCP_ChargeCurrentMax
      BCP_SOC: upstream-reference=EcuSwComposition.BCP_SOC.BCP_SOC, ecu-extract-reference=COMPOSITIONTYPE.BCP_SOC.BCP_SOC
      BCP_SOC_001: upstream-reference=EcuSwComposition.BCP_SOC, ecu-extract-reference=COMPOSITIONTYPE.BCP_SOC
      BCS_BatteryVoltMax: upstream-reference=EcuSwComposition.BCS_BatteryVoltMax.BCS_BatteryVoltMax, ecu-extract-reference=COMPOSITIONTYPE.BCS_BatteryVoltMax.BCS_BatteryVoltMax
      BCS_BatteryVoltMax_001: upstream-reference=EcuSwComposition.BCS_BatteryVoltMax, ecu-extract-reference=COMPOSITIONTYPE.BCS_BatteryVoltMax
      BCS_BatteryVoltMaxGroup: upstream-reference=EcuSwComposition.BCS_BatteryVoltMaxGroup.BCS_BatteryVoltMaxGroup, ecu-extract-reference=COMPOSITIONTYPE.BCS_BatteryVoltMaxGroup.BCS_BatteryVoltMaxGroup
      BCS_BatteryVoltMaxGroup_001: upstream-reference=EcuSwComposition.BCS_BatteryVoltMaxGroup, ecu-extract-reference=COMPOSITIONTYPE.BCS_BatteryVoltMaxGroup
      BCS_ChargeCurrentMeasure: upstream-reference=EcuSwComposition.BCS_ChargeCurrentMeasure.BCS_ChargeCurrentMeasure, ecu-extract-reference=COMPOSITIONTYPE.BCS_ChargeCurrentMeasure.BCS_ChargeCurrentMeasure
      BCS_ChargeCurrentMeasure_001: upstream-reference=EcuSwComposition.BCS_ChargeCurrentMeasure, ecu-extract-reference=COMPOSITIONTYPE.BCS_ChargeCurrentMeasure
      BCS_ChargeVoltageMeasure: upstream-reference=EcuSwComposition.BCS_ChargeVoltageMeasure.BCS_ChargeVoltageMeasure, ecu-extract-reference=COMPOSITIONTYPE.BCS_ChargeVoltageMeasure.BCS_ChargeVoltageMeasure
      BCS_ChargeVoltageMeasure_001: upstream-reference=EcuSwComposition.BCS_ChargeVoltageMeasure, ecu-extract-reference=COMPOSITIONTYPE.BCS_ChargeVoltageMeasure
      BCS_EstimatedTimeRemaining: upstream-reference=EcuSwComposition.BCS_EstimatedTimeRemaining.BCS_EstimatedTimeRemaining, ecu-extract-reference=COMPOSITIONTYPE.BCS_EstimatedTimeRemaining.BCS_EstimatedTimeRemaining
      BCS_EstimatedTimeRemaining_001: upstream-reference=EcuSwComposition.BCS_EstimatedTimeRemaining, ecu-extract-reference=COMPOSITIONTYPE.BCS_EstimatedTimeRemaining
      BCS_SOC: upstream-reference=EcuSwComposition.BCS_SOC.BCS_SOC, ecu-extract-reference=COMPOSITIONTYPE.BCS_SOC.BCS_SOC
      BCS_SOC_001: upstream-reference=EcuSwComposition.BCS_SOC, ecu-extract-reference=COMPOSITIONTYPE.BCS_SOC
      BRM_BatteryChargeTimes: upstream-reference=EcuSwComposition.BRM_BatteryChargeTimes.BRM_BatteryChargeTimes, ecu-extract-reference=COMPOSITIONTYPE.BRM_BatteryChargeTimes.BRM_BatteryChargeTimes
      BRM_BatteryChargeTimes_001: upstream-reference=EcuSwComposition.BRM_BatteryChargeTimes, ecu-extract-reference=COMPOSITIONTYPE.BRM_BatteryChargeTimes
      BRM_BatteryProductDay: upstream-reference=EcuSwComposition.BRM_BatteryProductDay.BRM_BatteryProductDay, ecu-extract-reference=COMPOSITIONTYPE.BRM_BatteryProductDay.BRM_BatteryProductDay
      BRM_BatteryProductDay_001: upstream-reference=EcuSwComposition.BRM_BatteryProductDay, ecu-extract-reference=COMPOSITIONTYPE.BRM_BatteryProductDay
      BRM_BatteryProductMonth: upstream-reference=EcuSwComposition.BRM_BatteryProductMonth.BRM_BatteryProductMonth, ecu-extract-reference=COMPOSITIONTYPE.BRM_BatteryProductMonth.BRM_BatteryProductMonth
      BRM_BatteryProductMonth_001: upstream-reference=EcuSwComposition.BRM_BatteryProductMonth, ecu-extract-reference=COMPOSITIONTYPE.BRM_BatteryProductMonth
      BRM_BatteryProductYear: upstream-reference=EcuSwComposition.BRM_BatteryProductYear.BRM_BatteryProductYear, ecu-extract-reference=COMPOSITIONTYPE.BRM_BatteryProductYear.BRM_BatteryProductYear
      BRM_BatteryProductYear_001: upstream-reference=EcuSwComposition.BRM_BatteryProductYear, ecu-extract-reference=COMPOSITIONTYPE.BRM_BatteryProductYear
      BRM_BatteryProperty: upstream-reference=EcuSwComposition.BRM_BatteryProperty.BRM_BatteryProperty, ecu-extract-reference=COMPOSITIONTYPE.BRM_BatteryProperty.BRM_BatteryProperty
      BRM_BatteryProperty_001: upstream-reference=EcuSwComposition.BRM_BatteryProperty, ecu-extract-reference=COMPOSITIONTYPE.BRM_BatteryProperty
      BRM_BatterySN: upstream-reference=EcuSwComposition.BRM_BatterySN.BRM_BatterySN, ecu-extract-reference=COMPOSITIONTYPE.BRM_BatterySN.BRM_BatterySN
      BRM_BatterySN_001: upstream-reference=EcuSwComposition.BRM_BatterySN, ecu-extract-reference=COMPOSITIONTYPE.BRM_BatterySN
      BRM_BatterySystemRatedCapacity: upstream-reference=EcuSwComposition.BRM_BatterySystemRatedCapacity.BRM_BatterySystemRatedCapacity, ecu-extract-reference=COMPOSITIONTYPE.BRM_BatterySystemRatedCapacity.BRM_BatterySystemRatedCapacity
      BRM_BatterySystemRatedCapacity_001: upstream-reference=EcuSwComposition.BRM_BatterySystemRatedCapacity, ecu-extract-reference=COMPOSITIONTYPE.BRM_BatterySystemRatedCapacity
      BRM_BatterySystemRatedVoltage: upstream-reference=EcuSwComposition.BRM_BatterySystemRatedVoltage.BRM_BatterySystemRatedVoltage, ecu-extract-reference=COMPOSITIONTYPE.BRM_BatterySystemRatedVoltage.BRM_BatterySystemRatedVoltage
      BRM_BatterySystemRatedVoltage_001: upstream-reference=EcuSwComposition.BRM_BatterySystemRatedVoltage, ecu-extract-reference=COMPOSITIONTYPE.BRM_BatterySystemRatedVoltage
      BRM_BatteryType: upstream-reference=EcuSwComposition.BRM_BatteryType.BRM_BatteryType, ecu-extract-reference=COMPOSITIONTYPE.BRM_BatteryType.BRM_BatteryType
      BRM_BatteryType_001: upstream-reference=EcuSwComposition.BRM_BatteryType, ecu-extract-reference=COMPOSITIONTYPE.BRM_BatteryType
      BRM_Manufacturer: upstream-reference=EcuSwComposition.BRM_Manufacturer.BRM_Manufacturer, ecu-extract-reference=COMPOSITIONTYPE.BRM_Manufacturer.BRM_Manufacturer
      BRM_Manufacturer_001: upstream-reference=EcuSwComposition.BRM_Manufacturer, ecu-extract-reference=COMPOSITIONTYPE.BRM_Manufacturer
      BRM_ProtocolVersion: upstream-reference=EcuSwComposition.BRM_ProtocolVersion.BRM_ProtocolVersion, ecu-extract-reference=COMPOSITIONTYPE.BRM_ProtocolVersion.BRM_ProtocolVersion
      BRM_ProtocolVersion_001: upstream-reference=EcuSwComposition.BRM_ProtocolVersion, ecu-extract-reference=COMPOSITIONTYPE.BRM_ProtocolVersion
      BRM_VehicleIdByte1_8: upstream-reference=EcuSwComposition.BRM_VehicleIdByte1_8.BRM_VehicleIdByte1_8, ecu-extract-reference=COMPOSITIONTYPE.BRM_VehicleIdByte1_8.BRM_VehicleIdByte1_8
      BRM_VehicleIdByte1_9: upstream-reference=EcuSwComposition.BRM_VehicleIdByte1_8, ecu-extract-reference=COMPOSITIONTYPE.BRM_VehicleIdByte1_8
      BRM_VehicleIdByte17: upstream-reference=EcuSwComposition.BRM_VehicleIdByte17.BRM_VehicleIdByte17, ecu-extract-reference=COMPOSITIONTYPE.BRM_VehicleIdByte17.BRM_VehicleIdByte17
      BRM_VehicleIdByte17_001: upstream-reference=EcuSwComposition.BRM_VehicleIdByte17, ecu-extract-reference=COMPOSITIONTYPE.BRM_VehicleIdByte17
      BRM_VehicleIdByte9_16: upstream-reference=EcuSwComposition.BRM_VehicleIdByte9_16.BRM_VehicleIdByte9_16, ecu-extract-reference=COMPOSITIONTYPE.BRM_VehicleIdByte9_16.BRM_VehicleIdByte9_16
      BRM_VehicleIdByte9_17: upstream-reference=EcuSwComposition.BRM_VehicleIdByte9_16, ecu-extract-reference=COMPOSITIONTYPE.BRM_VehicleIdByte9_16
      BSD_AbortSOC: upstream-reference=EcuSwComposition.BSD_AbortSOC.BSD_AbortSOC, ecu-extract-reference=COMPOSITIONTYPE.BSD_AbortSOC.BSD_AbortSOC
      BSD_AbortSOC_001: upstream-reference=EcuSwComposition.BSD_AbortSOC, ecu-extract-reference=COMPOSITIONTYPE.BSD_AbortSOC
      BSD_BatteryTempMax: upstream-reference=EcuSwComposition.BSD_BatteryTempMax.BSD_BatteryTempMax, ecu-extract-reference=COMPOSITIONTYPE.BSD_BatteryTempMax.BSD_BatteryTempMax
      BSD_BatteryTempMax_001: upstream-reference=EcuSwComposition.BSD_BatteryTempMax, ecu-extract-reference=COMPOSITIONTYPE.BSD_BatteryTempMax
      BSD_BatteryTempMin: upstream-reference=EcuSwComposition.BSD_BatteryTempMin.BSD_BatteryTempMin, ecu-extract-reference=COMPOSITIONTYPE.BSD_BatteryTempMin.BSD_BatteryTempMin
      BSD_BatteryTempMin_001: upstream-reference=EcuSwComposition.BSD_BatteryTempMin, ecu-extract-reference=COMPOSITIONTYPE.BSD_BatteryTempMin
      BSD_BatteryVoltageMax: upstream-reference=EcuSwComposition.BSD_BatteryVoltageMax.BSD_BatteryVoltageMax, ecu-extract-reference=COMPOSITIONTYPE.BSD_BatteryVoltageMax.BSD_BatteryVoltageMax
      BSD_BatteryVoltageMax_001: upstream-reference=EcuSwComposition.BSD_BatteryVoltageMax, ecu-extract-reference=COMPOSITIONTYPE.BSD_BatteryVoltageMax
      BSD_BatteryVoltageMin: upstream-reference=EcuSwComposition.BSD_BatteryVoltageMin.BSD_BatteryVoltageMin, ecu-extract-reference=COMPOSITIONTYPE.BSD_BatteryVoltageMin.BSD_BatteryVoltageMin
      BSD_BatteryVoltageMin_001: upstream-reference=EcuSwComposition.BSD_BatteryVoltageMin, ecu-extract-reference=COMPOSITIONTYPE.BSD_BatteryVoltageMin
      BSM_BatteryTempMax: upstream-reference=EcuSwComposition.BSM_BatteryTempMax.BSM_BatteryTempMax, ecu-extract-reference=COMPOSITIONTYPE.BSM_BatteryTempMax.BSM_BatteryTempMax
      BSM_BatteryTempMax_001: upstream-reference=EcuSwComposition.BSM_BatteryTempMax, ecu-extract-reference=COMPOSITIONTYPE.BSM_BatteryTempMax
      BSM_BatteryTempMaxNo: upstream-reference=EcuSwComposition.BSM_BatteryTempMaxNo.BSM_BatteryTempMaxNo, ecu-extract-reference=COMPOSITIONTYPE.BSM_BatteryTempMaxNo.BSM_BatteryTempMaxNo
      BSM_BatteryTempMaxNo_001: upstream-reference=EcuSwComposition.BSM_BatteryTempMaxNo, ecu-extract-reference=COMPOSITIONTYPE.BSM_BatteryTempMaxNo
      BSM_BatteryTempMin: upstream-reference=EcuSwComposition.BSM_BatteryTempMin.BSM_BatteryTempMin, ecu-extract-reference=COMPOSITIONTYPE.BSM_BatteryTempMin.BSM_BatteryTempMin
      BSM_BatteryTempMin_001: upstream-reference=EcuSwComposition.BSM_BatteryTempMin, ecu-extract-reference=COMPOSITIONTYPE.BSM_BatteryTempMin
      BSM_BatteryTempMinNo: upstream-reference=EcuSwComposition.BSM_BatteryTempMinNo.BSM_BatteryTempMinNo, ecu-extract-reference=COMPOSITIONTYPE.BSM_BatteryTempMinNo.BSM_BatteryTempMinNo
      BSM_BatteryTempMinNo_001: upstream-reference=EcuSwComposition.BSM_BatteryTempMinNo, ecu-extract-reference=COMPOSITIONTYPE.BSM_BatteryTempMinNo
      BSM_BatteryVoltageMaxNo: upstream-reference=EcuSwComposition.BSM_BatteryVoltageMaxNo.BSM_BatteryVoltageMaxNo, ecu-extract-reference=COMPOSITIONTYPE.BSM_BatteryVoltageMaxNo.BSM_BatteryVoltageMaxNo
      BSM_BatteryVoltageMaxNo_001: upstream-reference=EcuSwComposition.BSM_BatteryVoltageMaxNo, ecu-extract-reference=COMPOSITIONTYPE.BSM_BatteryVoltageMaxNo
      CTS_Year: upstream-reference=EcuSwComposition.CTS_Year.CTS_Year, ecu-extract-reference=COMPOSITIONTYPE.CTS_Year.CTS_Year
      CTS_Year_001: upstream-reference=EcuSwComposition.CTS_Year, ecu-extract-reference=COMPOSITIONTYPE.CTS_Year
      CCS_OutputCurrent: upstream-reference=EcuSwComposition.CCS_OutputCurrent.CCS_OutputCurrent, ecu-extract-reference=COMPOSITIONTYPE.CCS_OutputCurrent.CCS_OutputCurrent
      CCS_OutputCurrent_001: upstream-reference=EcuSwComposition.CCS_OutputCurrent, ecu-extract-reference=COMPOSITIONTYPE.CCS_OutputCurrent
      CGW_VIN0: upstream-reference=EcuSwComposition.CGW_VIN0, ecu-extract-reference=COMPOSITIONTYPE.CGW_VIN0
      CGW_VIN2: upstream-reference=EcuSwComposition.CGW_VIN2, ecu-extract-reference=COMPOSITIONTYPE.CGW_VIN2
      CGW_VIN13: upstream-reference=EcuSwComposition.CGW_VIN13, ecu-extract-reference=COMPOSITIONTYPE.CGW_VIN13
      CGW_VIN14: upstream-reference=EcuSwComposition.CGW_VIN14, ecu-extract-reference=COMPOSITIONTYPE.CGW_VIN14
      CGW_VIN4: upstream-reference=EcuSwComposition.CGW_VIN4, ecu-extract-reference=COMPOSITIONTYPE.CGW_VIN4
      CGW_VIN12: upstream-reference=EcuSwComposition.CGW_VIN12, ecu-extract-reference=COMPOSITIONTYPE.CGW_VIN12
      CGW_VIN15: upstream-reference=EcuSwComposition.CGW_VIN15, ecu-extract-reference=COMPOSITIONTYPE.CGW_VIN15
      CGW_VIN16: upstream-reference=EcuSwComposition.CGW_VIN16, ecu-extract-reference=COMPOSITIONTYPE.CGW_VIN16
      CGW_VIN8: upstream-reference=EcuSwComposition.CGW_VIN8, ecu-extract-reference=COMPOSITIONTYPE.CGW_VIN8
      CGW_VIN3: upstream-reference=EcuSwComposition.CGW_VIN3, ecu-extract-reference=COMPOSITIONTYPE.CGW_VIN3
      CGW_VIN10: upstream-reference=EcuSwComposition.CGW_VIN10, ecu-extract-reference=COMPOSITIONTYPE.CGW_VIN10
      CGW_VIN6: upstream-reference=EcuSwComposition.CGW_VIN6, ecu-extract-reference=COMPOSITIONTYPE.CGW_VIN6
      CGW_VIN1: upstream-reference=EcuSwComposition.CGW_VIN1, ecu-extract-reference=COMPOSITIONTYPE.CGW_VIN1
      CGW_VIN11: upstream-reference=EcuSwComposition.CGW_VIN11, ecu-extract-reference=COMPOSITIONTYPE.CGW_VIN11
      CGW_VIN5: upstream-reference=EcuSwComposition.CGW_VIN5, ecu-extract-reference=COMPOSITIONTYPE.CGW_VIN5
      CGW_VIN9: upstream-reference=EcuSwComposition.CGW_VIN9, ecu-extract-reference=COMPOSITIONTYPE.CGW_VIN9
      CGW_VIN7: upstream-reference=EcuSwComposition.CGW_VIN7, ecu-extract-reference=COMPOSITIONTYPE.CGW_VIN7
      CGW_VERSION1: upstream-reference=EcuSwComposition.CGW_VERSION1, ecu-extract-reference=COMPOSITIONTYPE.CGW_VERSION1
      CGW_VERSION2: upstream-reference=EcuSwComposition.CGW_VERSION2, ecu-extract-reference=COMPOSITIONTYPE.CGW_VERSION2
      FRC_Vl_OV: upstream-reference=EcuSwComposition.FRC_Vl_OV.FRC_Vl_OV, ecu-extract-reference=COMPOSITIONTYPE.FRC_Vl_OV.FRC_Vl_OV
      FRC_Vl_OV_001: upstream-reference=EcuSwComposition.FRC_Vl_OV, ecu-extract-reference=COMPOSITIONTYPE.FRC_Vl_OV
      FRC_Vl_UV: upstream-reference=EcuSwComposition.FRC_Vl_UV.FRC_Vl_UV, ecu-extract-reference=COMPOSITIONTYPE.FRC_Vl_UV.FRC_Vl_UV
      FRC_Vl_UV_001: upstream-reference=EcuSwComposition.FRC_Vl_UV, ecu-extract-reference=COMPOSITIONTYPE.FRC_Vl_UV
      FRC_ComFtonNet: upstream-reference=EcuSwComposition.FRC_ComFtonNet.FRC_ComFtonNet, ecu-extract-reference=COMPOSITIONTYPE.FRC_ComFtonNet.FRC_ComFtonNet
      FRC_ComFtonNet_001: upstream-reference=EcuSwComposition.FRC_ComFtonNet, ecu-extract-reference=COMPOSITIONTYPE.FRC_ComFtonNet
      SG_SGW_PT_01_SigGroup: upstream-reference=EcuSwComposition.SG_SGW_PT_01_SigGroup.SG_SGW_PT_01_SigGroup, ecu-extract-reference=COMPOSITIONTYPE.SG_SGW_PT_01_SigGroup.SG_SGW_PT_01_SigGroup
      SG_SGW_PT_01_SigGroup_001: upstream-reference=EcuSwComposition.SG_SGW_PT_01_SigGroup, ecu-extract-reference=COMPOSITIONTYPE.SG_SGW_PT_01_SigGroup
      SG_POD_DCDC_02_SigGroup: upstream-reference=EcuSwComposition.SG_POD_DCDC_02_SigGroup.SG_POD_DCDC_02_SigGroup, ecu-extract-reference=COMPOSITIONTYPE.SG_POD_DCDC_02_SigGroup.SG_POD_DCDC_02_SigGroup
      SG_POD_DCDC_02_SigGroup_001: upstream-reference=EcuSwComposition.SG_POD_DCDC_02_SigGroup, ecu-extract-reference=COMPOSITIONTYPE.SG_POD_DCDC_02_SigGroup
      SG_SGW_Time_SigGroup: upstream-reference=EcuSwComposition.SG_SGW_Time_SigGroup.SG_SGW_Time_SigGroup, ecu-extract-reference=COMPOSITIONTYPE.SG_SGW_Time_SigGroup.SG_SGW_Time_SigGroup
      SG_SGW_Time_SigGroup_001: upstream-reference=EcuSwComposition.SG_SGW_Time_SigGroup, ecu-extract-reference=COMPOSITIONTYPE.SG_SGW_Time_SigGroup
      SG_CGW_01_SigGroup: upstream-reference=EcuSwComposition.SG_CGW_01_SigGroup.SG_CGW_01_SigGroup, ecu-extract-reference=COMPOSITIONTYPE.SG_CGW_01_SigGroup.SG_CGW_01_SigGroup
      SG_CGW_01_SigGroup_001: upstream-reference=EcuSwComposition.SG_CGW_01_SigGroup, ecu-extract-reference=COMPOSITIONTYPE.SG_CGW_01_SigGroup
      SG_IBS_VCU_MotorControl_SigGroup: upstream-reference=EcuSwComposition.SG_IBS_VCU_MotorControl_SigGroup.SG_IBS_VCU_MotorControl_SigGroup, ecu-extract-reference=COMPOSITIONTYPE.SG_IBS_VCU_MotorControl_SigGroup.SG_IBS_VCU_MotorControl_SigGroup
      SG_IBS_VCU_MotorControl_SigGroup_001: upstream-reference=EcuSwComposition.SG_IBS_VCU_MotorControl_SigGroup, ecu-extract-reference=COMPOSITIONTYPE.SG_IBS_VCU_MotorControl_SigGroup
      SG_SGW_04_SigGroup: upstream-reference=EcuSwComposition.SG_SGW_04_SigGroup.SG_SGW_04_SigGroup, ecu-extract-reference=COMPOSITIONTYPE.SG_SGW_04_SigGroup.SG_SGW_04_SigGroup
      SG_SGW_04_SigGroup_001: upstream-reference=EcuSwComposition.SG_SGW_04_SigGroup, ecu-extract-reference=COMPOSITIONTYPE.SG_SGW_04_SigGroup
      SG_PRND_SigGroup: upstream-reference=EcuSwComposition.SG_PRND_SigGroup.SG_PRND_SigGroup, ecu-extract-reference=COMPOSITIONTYPE.SG_PRND_SigGroup.SG_PRND_SigGroup
      SG_PRND_SigGroup_001: upstream-reference=EcuSwComposition.SG_PRND_SigGroup, ecu-extract-reference=COMPOSITIONTYPE.SG_PRND_SigGroup
      SG_DCM_FR_SigGroup: upstream-reference=EcuSwComposition.SG_DCM_FR_SigGroup.SG_DCM_FR_SigGroup, ecu-extract-reference=COMPOSITIONTYPE.SG_DCM_FR_SigGroup.SG_DCM_FR_SigGroup
      SG_DCM_FR_SigGroup_001: upstream-reference=EcuSwComposition.SG_DCM_FR_SigGroup, ecu-extract-reference=COMPOSITIONTYPE.SG_DCM_FR_SigGroup
      SG_CGW_VIN3VER_SigGroup: upstream-reference=EcuSwComposition.SG_CGW_VIN3VER_SigGroup.SG_CGW_VIN3VER_SigGroup, ecu-extract-reference=COMPOSITIONTYPE.SG_CGW_VIN3VER_SigGroup.SG_CGW_VIN3VER_SigGroup
      SG_CGW_VIN3VER_SigGroup_001: upstream-reference=EcuSwComposition.SG_CGW_VIN3VER_SigGroup, ecu-extract-reference=COMPOSITIONTYPE.SG_CGW_VIN3VER_SigGroup
      SG_BMS_ErrorInfo_SigGroup: upstream-reference=EcuSwComposition.SG_BMS_ErrorInfo_SigGroup.SG_BMS_ErrorInfo_SigGroup, ecu-extract-reference=COMPOSITIONTYPE.SG_BMS_ErrorInfo_SigGroup.SG_BMS_ErrorInfo_SigGroup
      SG_BMS_ErrorInfo_SigGroup_001: upstream-reference=EcuSwComposition.SG_BMS_ErrorInfo_SigGroup, ecu-extract-reference=COMPOSITIONTYPE.SG_BMS_ErrorInfo_SigGroup
      SG_CGW_VIN2_SigGroup: upstream-reference=EcuSwComposition.SG_CGW_VIN2_SigGroup.SG_CGW_VIN2_SigGroup, ecu-extract-reference=COMPOSITIONTYPE.SG_CGW_VIN2_SigGroup.SG_CGW_VIN2_SigGroup
      SG_CGW_VIN2_SigGroup_001: upstream-reference=EcuSwComposition.SG_CGW_VIN2_SigGroup, ecu-extract-reference=COMPOSITIONTYPE.SG_CGW_VIN2_SigGroup
      SG_BMS_status_02_SigGroup: upstream-reference=EcuSwComposition.SG_BMS_status_02_SigGroup.SG_BMS_status_02_SigGroup, ecu-extract-reference=COMPOSITIONTYPE.SG_BMS_status_02_SigGroup.SG_BMS_status_02_SigGroup
      SG_BMS_status_02_SigGroup_001: upstream-reference=EcuSwComposition.SG_BMS_status_02_SigGroup, ecu-extract-reference=COMPOSITIONTYPE.SG_BMS_status_02_SigGroup
      SG_SGW_17_SigGroup: upstream-reference=EcuSwComposition.SG_SGW_17_SigGroup.SG_SGW_17_SigGroup, ecu-extract-reference=COMPOSITIONTYPE.SG_SGW_17_SigGroup.SG_SGW_17_SigGroup
      SG_SGW_17_SigGroup_001: upstream-reference=EcuSwComposition.SG_SGW_17_SigGroup, ecu-extract-reference=COMPOSITIONTYPE.SG_SGW_17_SigGroup
      SG_BMS_PRO_SigGroup: upstream-reference=EcuSwComposition.SG_BMS_PRO_SigGroup.SG_BMS_PRO_SigGroup, ecu-extract-reference=COMPOSITIONTYPE.SG_BMS_PRO_SigGroup.SG_BMS_PRO_SigGroup
      SG_BMS_PRO_SigGroup_001: upstream-reference=EcuSwComposition.SG_BMS_PRO_SigGroup, ecu-extract-reference=COMPOSITIONTYPE.SG_BMS_PRO_SigGroup
      SG_ACU_01_SigGroup: upstream-reference=EcuSwComposition.SG_ACU_01_SigGroup.SG_ACU_01_SigGroup, ecu-extract-reference=COMPOSITIONTYPE.SG_ACU_01_SigGroup.SG_ACU_01_SigGroup
      SG_ACU_01_SigGroup_001: upstream-reference=EcuSwComposition.SG_ACU_01_SigGroup, ecu-extract-reference=COMPOSITIONTYPE.SG_ACU_01_SigGroup
      SG_ADCU_DA_SigGroup: upstream-reference=EcuSwComposition.SG_ADCU_DA_SigGroup.SG_ADCU_DA_SigGroup, ecu-extract-reference=COMPOSITIONTYPE.SG_ADCU_DA_SigGroup.SG_ADCU_DA_SigGroup
      SG_ADCU_DA_SigGroup_001: upstream-reference=EcuSwComposition.SG_ADCU_DA_SigGroup, ecu-extract-reference=COMPOSITIONTYPE.SG_ADCU_DA_SigGroup
      SG_POD_Status_02_SigGroup: upstream-reference=EcuSwComposition.SG_POD_Status_02_SigGroup.SG_POD_Status_02_SigGroup, ecu-extract-reference=COMPOSITIONTYPE.SG_POD_Status_02_SigGroup.SG_POD_Status_02_SigGroup
      SG_POD_Status_02_SigGroup_001: upstream-reference=EcuSwComposition.SG_POD_Status_02_SigGroup, ecu-extract-reference=COMPOSITIONTYPE.SG_POD_Status_02_SigGroup
      SG_CGW_VIN1_SigGroup: upstream-reference=EcuSwComposition.SG_CGW_VIN1_SigGroup.SG_CGW_VIN1_SigGroup, ecu-extract-reference=COMPOSITIONTYPE.SG_CGW_VIN1_SigGroup.SG_CGW_VIN1_SigGroup
      SG_CGW_VIN1_SigGroup_001: upstream-reference=EcuSwComposition.SG_CGW_VIN1_SigGroup, ecu-extract-reference=COMPOSITIONTYPE.SG_CGW_VIN1_SigGroup
      SG_IVI_01_SigGroup: upstream-reference=EcuSwComposition.SG_IVI_01_SigGroup.SG_IVI_01_SigGroup, ecu-extract-reference=COMPOSITIONTYPE.SG_IVI_01_SigGroup.SG_IVI_01_SigGroup
      SG_IVI_01_SigGroup_001: upstream-reference=EcuSwComposition.SG_IVI_01_SigGroup, ecu-extract-reference=COMPOSITIONTYPE.SG_IVI_01_SigGroup
      SG_MCU_02_SigGroup: upstream-reference=EcuSwComposition.SG_MCU_02_SigGroup.SG_MCU_02_SigGroup, ecu-extract-reference=COMPOSITIONTYPE.SG_MCU_02_SigGroup.SG_MCU_02_SigGroup
      SG_MCU_02_SigGroup_001: upstream-reference=EcuSwComposition.SG_MCU_02_SigGroup, ecu-extract-reference=COMPOSITIONTYPE.SG_MCU_02_SigGroup
      SG_MCU_Temperature_02_SigGroup: upstream-reference=EcuSwComposition.SG_MCU_Temperature_02_SigGroup.SG_MCU_Temperature_02_SigGroup, ecu-extract-reference=COMPOSITIONTYPE.SG_MCU_Temperature_02_SigGroup.SG_MCU_Temperature_02_SigGroup
      SG_MCU_Temperature_02_SigGroup_001: upstream-reference=EcuSwComposition.SG_MCU_Temperature_02_SigGroup, ecu-extract-reference=COMPOSITIONTYPE.SG_MCU_Temperature_02_SigGroup
      SG_BMS_Charge_01_SigGroup: upstream-reference=EcuSwComposition.SG_BMS_Charge_01_SigGroup.SG_BMS_Charge_01_SigGroup, ecu-extract-reference=COMPOSITIONTYPE.SG_BMS_Charge_01_SigGroup.SG_BMS_Charge_01_SigGroup
      SG_BMS_Charge_01_SigGroup_001: upstream-reference=EcuSwComposition.SG_BMS_Charge_01_SigGroup, ecu-extract-reference=COMPOSITIONTYPE.SG_BMS_Charge_01_SigGroup
      SG_CGW_02_SigGroup: upstream-reference=EcuSwComposition.SG_CGW_02_SigGroup.SG_CGW_02_SigGroup, ecu-extract-reference=COMPOSITIONTYPE.SG_CGW_02_SigGroup.SG_CGW_02_SigGroup
      SG_CGW_02_SigGroup_001: upstream-reference=EcuSwComposition.SG_CGW_02_SigGroup, ecu-extract-reference=COMPOSITIONTYPE.SG_CGW_02_SigGroup
      SG_POD_OBC_STATUS_02_SigGroup: upstream-reference=EcuSwComposition.SG_POD_OBC_STATUS_02_SigGroup.SG_POD_OBC_STATUS_02_SigGroup, ecu-extract-reference=COMPOSITIONTYPE.SG_POD_OBC_STATUS_02_SigGroup.SG_POD_OBC_STATUS_02_SigGroup
      SG_POD_OBC_STATUS_02_SigGroup_001: upstream-reference=EcuSwComposition.SG_POD_OBC_STATUS_02_SigGroup, ecu-extract-reference=COMPOSITIONTYPE.SG_POD_OBC_STATUS_02_SigGroup
      SG_BMS_TCU_SigGroup: upstream-reference=EcuSwComposition.SG_BMS_TCU_SigGroup.SG_BMS_TCU_SigGroup, ecu-extract-reference=COMPOSITIONTYPE.SG_BMS_TCU_SigGroup.SG_BMS_TCU_SigGroup
      SG_BMS_TCU_SigGroup_001: upstream-reference=EcuSwComposition.SG_BMS_TCU_SigGroup, ecu-extract-reference=COMPOSITIONTYPE.SG_BMS_TCU_SigGroup
      SG_ADCU_APS_02_SigGroup: upstream-reference=EcuSwComposition.SG_ADCU_APS_02_SigGroup.SG_ADCU_APS_02_SigGroup, ecu-extract-reference=COMPOSITIONTYPE.SG_ADCU_APS_02_SigGroup.SG_ADCU_APS_02_SigGroup
      SG_ADCU_APS_02_SigGroup_001: upstream-reference=EcuSwComposition.SG_ADCU_APS_02_SigGroup, ecu-extract-reference=COMPOSITIONTYPE.SG_ADCU_APS_02_SigGroup
      SG_MCU_FailureCode_SigGroup: upstream-reference=EcuSwComposition.SG_MCU_FailureCode_SigGroup.SG_MCU_FailureCode_SigGroup, ecu-extract-reference=COMPOSITIONTYPE.SG_MCU_FailureCode_SigGroup.SG_MCU_FailureCode_SigGroup
      SG_MCU_FailureCode_SigGroup_001: upstream-reference=EcuSwComposition.SG_MCU_FailureCode_SigGroup, ecu-extract-reference=COMPOSITIONTYPE.SG_MCU_FailureCode_SigGroup
      SG_IVI_OdometerInfor_SigGroup: upstream-reference=EcuSwComposition.SG_IVI_OdometerInfor_SigGroup.SG_IVI_OdometerInfor_SigGroup, ecu-extract-reference=COMPOSITIONTYPE.SG_IVI_OdometerInfor_SigGroup.SG_IVI_OdometerInfor_SigGroup
      SG_IVI_OdometerInfor_SigGroup_001: upstream-reference=EcuSwComposition.SG_IVI_OdometerInfor_SigGroup, ecu-extract-reference=COMPOSITIONTYPE.SG_IVI_OdometerInfor_SigGroup
      SG_DCM_RL_SigGroup: upstream-reference=EcuSwComposition.SG_DCM_RL_SigGroup.SG_DCM_RL_SigGroup, ecu-extract-reference=COMPOSITIONTYPE.SG_DCM_RL_SigGroup.SG_DCM_RL_SigGroup
      SG_DCM_RL_SigGroup_001: upstream-reference=EcuSwComposition.SG_DCM_RL_SigGroup, ecu-extract-reference=COMPOSITIONTYPE.SG_DCM_RL_SigGroup
      SG_MCU_Temperature_01_SigGroup: upstream-reference=EcuSwComposition.SG_MCU_Temperature_01_SigGroup.SG_MCU_Temperature_01_SigGroup, ecu-extract-reference=COMPOSITIONTYPE.SG_MCU_Temperature_01_SigGroup.SG_MCU_Temperature_01_SigGroup
      SG_MCU_Temperature_01_SigGroup_001: upstream-reference=EcuSwComposition.SG_MCU_Temperature_01_SigGroup, ecu-extract-reference=COMPOSITIONTYPE.SG_MCU_Temperature_01_SigGroup
      SG_POD_DCDC_01_SigGroup: upstream-reference=EcuSwComposition.SG_POD_DCDC_01_SigGroup.SG_POD_DCDC_01_SigGroup, ecu-extract-reference=COMPOSITIONTYPE.SG_POD_DCDC_01_SigGroup.SG_POD_DCDC_01_SigGroup
      SG_POD_DCDC_01_SigGroup_001: upstream-reference=EcuSwComposition.SG_POD_DCDC_01_SigGroup, ecu-extract-reference=COMPOSITIONTYPE.SG_POD_DCDC_01_SigGroup
      SG_BMS_BatInfor_02_SigGroup: upstream-reference=EcuSwComposition.SG_BMS_BatInfor_02_SigGroup.SG_BMS_BatInfor_02_SigGroup, ecu-extract-reference=COMPOSITIONTYPE.SG_BMS_BatInfor_02_SigGroup.SG_BMS_BatInfor_02_SigGroup
      SG_BMS_BatInfor_02_SigGroup_001: upstream-reference=EcuSwComposition.SG_BMS_BatInfor_02_SigGroup, ecu-extract-reference=COMPOSITIONTYPE.SG_BMS_BatInfor_02_SigGroup
      SG_BMS_status_03_SigGroup: upstream-reference=EcuSwComposition.SG_BMS_status_03_SigGroup.SG_BMS_status_03_SigGroup, ecu-extract-reference=COMPOSITIONTYPE.SG_BMS_status_03_SigGroup.SG_BMS_status_03_SigGroup
      SG_BMS_status_03_SigGroup_001: upstream-reference=EcuSwComposition.SG_BMS_status_03_SigGroup, ecu-extract-reference=COMPOSITIONTYPE.SG_BMS_status_03_SigGroup
      SG_DCM_FR_02_SigGroup: upstream-reference=EcuSwComposition.SG_DCM_FR_02_SigGroup.SG_DCM_FR_02_SigGroup, ecu-extract-reference=COMPOSITIONTYPE.SG_DCM_FR_02_SigGroup.SG_DCM_FR_02_SigGroup
      SG_DCM_FR_02_SigGroup_001: upstream-reference=EcuSwComposition.SG_DCM_FR_02_SigGroup, ecu-extract-reference=COMPOSITIONTYPE.SG_DCM_FR_02_SigGroup
      SG_IBS_Torque_SigGroup: upstream-reference=EcuSwComposition.SG_IBS_Torque_SigGroup.SG_IBS_Torque_SigGroup, ecu-extract-reference=COMPOSITIONTYPE.SG_IBS_Torque_SigGroup.SG_IBS_Torque_SigGroup
      SG_IBS_Torque_SigGroup_001: upstream-reference=EcuSwComposition.SG_IBS_Torque_SigGroup, ecu-extract-reference=COMPOSITIONTYPE.SG_IBS_Torque_SigGroup
      SG_POD_OBC_CHRGSTATION_SigGroup: upstream-reference=EcuSwComposition.SG_POD_OBC_CHRGSTATION_SigGroup.SG_POD_OBC_CHRGSTATION_SigGroup, ecu-extract-reference=COMPOSITIONTYPE.SG_POD_OBC_CHRGSTATION_SigGroup.SG_POD_OBC_CHRGSTATION_SigGroup
      SG_POD_OBC_CHRGSTATION_SigGroup_001: upstream-reference=EcuSwComposition.SG_POD_OBC_CHRGSTATION_SigGroup, ecu-extract-reference=COMPOSITIONTYPE.SG_POD_OBC_CHRGSTATION_SigGroup
      SG_POD_OBC_STATUS_03_SigGroup: upstream-reference=EcuSwComposition.SG_POD_OBC_STATUS_03_SigGroup.SG_POD_OBC_STATUS_03_SigGroup, ecu-extract-reference=COMPOSITIONTYPE.SG_POD_OBC_STATUS_03_SigGroup.SG_POD_OBC_STATUS_03_SigGroup
      SG_POD_OBC_STATUS_03_SigGroup_001: upstream-reference=EcuSwComposition.SG_POD_OBC_STATUS_03_SigGroup, ecu-extract-reference=COMPOSITIONTYPE.SG_POD_OBC_STATUS_03_SigGroup
      SG_POD_OBC_STATUS_04_SigGroup: upstream-reference=EcuSwComposition.SG_POD_OBC_STATUS_04_SigGroup.SG_POD_OBC_STATUS_04_SigGroup, ecu-extract-reference=COMPOSITIONTYPE.SG_POD_OBC_STATUS_04_SigGroup.SG_POD_OBC_STATUS_04_SigGroup
      SG_POD_OBC_STATUS_04_SigGroup_001: upstream-reference=EcuSwComposition.SG_POD_OBC_STATUS_04_SigGroup, ecu-extract-reference=COMPOSITIONTYPE.SG_POD_OBC_STATUS_04_SigGroup
      SG_ACU_02_SigGroup: upstream-reference=EcuSwComposition.SG_ACU_02_SigGroup.SG_ACU_02_SigGroup, ecu-extract-reference=COMPOSITIONTYPE.SG_ACU_02_SigGroup.SG_ACU_02_SigGroup
      SG_ACU_02_SigGroup_001: upstream-reference=EcuSwComposition.SG_ACU_02_SigGroup, ecu-extract-reference=COMPOSITIONTYPE.SG_ACU_02_SigGroup
      SG_POD_Status_01_SigGroup: upstream-reference=EcuSwComposition.SG_POD_Status_01_SigGroup.SG_POD_Status_01_SigGroup, ecu-extract-reference=COMPOSITIONTYPE.SG_POD_Status_01_SigGroup.SG_POD_Status_01_SigGroup
      SG_POD_Status_01_SigGroup_001: upstream-reference=EcuSwComposition.SG_POD_Status_01_SigGroup, ecu-extract-reference=COMPOSITIONTYPE.SG_POD_Status_01_SigGroup
      SG_BMS_VersionInfor_SigGroup: upstream-reference=EcuSwComposition.SG_BMS_VersionInfor_SigGroup.SG_BMS_VersionInfor_SigGroup, ecu-extract-reference=COMPOSITIONTYPE.SG_BMS_VersionInfor_SigGroup.SG_BMS_VersionInfor_SigGroup
      SG_BMS_VersionInfor_SigGroup_001: upstream-reference=EcuSwComposition.SG_BMS_VersionInfor_SigGroup, ecu-extract-reference=COMPOSITIONTYPE.SG_BMS_VersionInfor_SigGroup
      SG_BMS_BatInfor_01_SigGroup: upstream-reference=EcuSwComposition.SG_BMS_BatInfor_01_SigGroup.SG_BMS_BatInfor_01_SigGroup, ecu-extract-reference=COMPOSITIONTYPE.SG_BMS_BatInfor_01_SigGroup.SG_BMS_BatInfor_01_SigGroup
      SG_BMS_BatInfor_01_SigGroup_001: upstream-reference=EcuSwComposition.SG_BMS_BatInfor_01_SigGroup, ecu-extract-reference=COMPOSITIONTYPE.SG_BMS_BatInfor_01_SigGroup
      SG_MCU_DeratingStatus_SigGroup: upstream-reference=EcuSwComposition.SG_MCU_DeratingStatus_SigGroup.SG_MCU_DeratingStatus_SigGroup, ecu-extract-reference=COMPOSITIONTYPE.SG_MCU_DeratingStatus_SigGroup.SG_MCU_DeratingStatus_SigGroup
      SG_MCU_DeratingStatus_SigGroup_001: upstream-reference=EcuSwComposition.SG_MCU_DeratingStatus_SigGroup, ecu-extract-reference=COMPOSITIONTYPE.SG_MCU_DeratingStatus_SigGroup
      SG_SGW_VCU_01_SigGroup: upstream-reference=EcuSwComposition.SG_SGW_VCU_01_SigGroup.SG_SGW_VCU_01_SigGroup, ecu-extract-reference=COMPOSITIONTYPE.SG_SGW_VCU_01_SigGroup.SG_SGW_VCU_01_SigGroup
      SG_SGW_VCU_01_SigGroup_001: upstream-reference=EcuSwComposition.SG_SGW_VCU_01_SigGroup, ecu-extract-reference=COMPOSITIONTYPE.SG_SGW_VCU_01_SigGroup
      SG_SGW_IBS_01_SigGroup: upstream-reference=EcuSwComposition.SG_SGW_IBS_01_SigGroup.SG_SGW_IBS_01_SigGroup, ecu-extract-reference=COMPOSITIONTYPE.SG_SGW_IBS_01_SigGroup.SG_SGW_IBS_01_SigGroup
      SG_SGW_IBS_01_SigGroup_001: upstream-reference=EcuSwComposition.SG_SGW_IBS_01_SigGroup, ecu-extract-reference=COMPOSITIONTYPE.SG_SGW_IBS_01_SigGroup
      SG_DCM_RR_SigGroup: upstream-reference=EcuSwComposition.SG_DCM_RR_SigGroup.SG_DCM_RR_SigGroup, ecu-extract-reference=COMPOSITIONTYPE.SG_DCM_RR_SigGroup.SG_DCM_RR_SigGroup
      SG_DCM_RR_SigGroup_001: upstream-reference=EcuSwComposition.SG_DCM_RR_SigGroup, ecu-extract-reference=COMPOSITIONTYPE.SG_DCM_RR_SigGroup
      SG_BMS_DIRelayState_SigGroup: upstream-reference=EcuSwComposition.SG_BMS_DIRelayState_SigGroup.SG_BMS_DIRelayState_SigGroup, ecu-extract-reference=COMPOSITIONTYPE.SG_BMS_DIRelayState_SigGroup.SG_BMS_DIRelayState_SigGroup
      SG_BMS_DIRelayState_SigGroup_001: upstream-reference=EcuSwComposition.SG_BMS_DIRelayState_SigGroup, ecu-extract-reference=COMPOSITIONTYPE.SG_BMS_DIRelayState_SigGroup
      SG_TCU_02_SigGroup: upstream-reference=EcuSwComposition.SG_TCU_02_SigGroup.SG_TCU_02_SigGroup, ecu-extract-reference=COMPOSITIONTYPE.SG_TCU_02_SigGroup.SG_TCU_02_SigGroup
      SG_TCU_02_SigGroup_001: upstream-reference=EcuSwComposition.SG_TCU_02_SigGroup, ecu-extract-reference=COMPOSITIONTYPE.SG_TCU_02_SigGroup
      SG_SGW_16_SigGroup: upstream-reference=EcuSwComposition.SG_SGW_16_SigGroup.SG_SGW_16_SigGroup, ecu-extract-reference=COMPOSITIONTYPE.SG_SGW_16_SigGroup.SG_SGW_16_SigGroup
      SG_SGW_16_SigGroup_001: upstream-reference=EcuSwComposition.SG_SGW_16_SigGroup, ecu-extract-reference=COMPOSITIONTYPE.SG_SGW_16_SigGroup
      SG_APTC_TCU_SigGroup: upstream-reference=EcuSwComposition.SG_APTC_TCU_SigGroup.SG_APTC_TCU_SigGroup, ecu-extract-reference=COMPOSITIONTYPE.SG_APTC_TCU_SigGroup.SG_APTC_TCU_SigGroup
      SG_APTC_TCU_SigGroup_001: upstream-reference=EcuSwComposition.SG_APTC_TCU_SigGroup, ecu-extract-reference=COMPOSITIONTYPE.SG_APTC_TCU_SigGroup
      SG_TCU_01_SigGroup: upstream-reference=EcuSwComposition.SG_TCU_01_SigGroup.SG_TCU_01_SigGroup, ecu-extract-reference=COMPOSITIONTYPE.SG_TCU_01_SigGroup.SG_TCU_01_SigGroup
      SG_TCU_01_SigGroup_001: upstream-reference=EcuSwComposition.SG_TCU_01_SigGroup, ecu-extract-reference=COMPOSITIONTYPE.SG_TCU_01_SigGroup
      SG_BMS_BatInfor_03_SigGroup: upstream-reference=EcuSwComposition.SG_BMS_BatInfor_03_SigGroup.SG_BMS_BatInfor_03_SigGroup, ecu-extract-reference=COMPOSITIONTYPE.SG_BMS_BatInfor_03_SigGroup.SG_BMS_BatInfor_03_SigGroup
      SG_BMS_BatInfor_03_SigGroup_001: upstream-reference=EcuSwComposition.SG_BMS_BatInfor_03_SigGroup, ecu-extract-reference=COMPOSITIONTYPE.SG_BMS_BatInfor_03_SigGroup
      SG_BMS_Charge_03_SigGroup: upstream-reference=EcuSwComposition.SG_BMS_Charge_03_SigGroup.SG_BMS_Charge_03_SigGroup, ecu-extract-reference=COMPOSITIONTYPE.SG_BMS_Charge_03_SigGroup.SG_BMS_Charge_03_SigGroup
      SG_BMS_Charge_03_SigGroup_001: upstream-reference=EcuSwComposition.SG_BMS_Charge_03_SigGroup, ecu-extract-reference=COMPOSITIONTYPE.SG_BMS_Charge_03_SigGroup
      SG_BMS_Charge_02_SigGroup: upstream-reference=EcuSwComposition.SG_BMS_Charge_02_SigGroup.SG_BMS_Charge_02_SigGroup, ecu-extract-reference=COMPOSITIONTYPE.SG_BMS_Charge_02_SigGroup.SG_BMS_Charge_02_SigGroup
      SG_BMS_Charge_02_SigGroup_001: upstream-reference=EcuSwComposition.SG_BMS_Charge_02_SigGroup, ecu-extract-reference=COMPOSITIONTYPE.SG_BMS_Charge_02_SigGroup
      SG_EVCOM_State_01_SigGroup: upstream-reference=EcuSwComposition.SG_EVCOM_State_01_SigGroup.SG_EVCOM_State_01_SigGroup, ecu-extract-reference=COMPOSITIONTYPE.SG_EVCOM_State_01_SigGroup.SG_EVCOM_State_01_SigGroup
      SG_EVCOM_State_01_SigGroup_001: upstream-reference=EcuSwComposition.SG_EVCOM_State_01_SigGroup, ecu-extract-reference=COMPOSITIONTYPE.SG_EVCOM_State_01_SigGroup
      SG_VCU_HMIsignals_02_SigGroup: upstream-reference=EcuSwComposition.SG_VCU_HMIsignals_02_SigGroup.SG_VCU_HMIsignals_02_SigGroup, ecu-extract-reference=COMPOSITIONTYPE.SG_VCU_HMIsignals_02_SigGroup.SG_VCU_HMIsignals_02_SigGroup
      SG_VCU_HMIsignals_02_SigGroup_001: upstream-reference=EcuSwComposition.SG_VCU_HMIsignals_02_SigGroup, ecu-extract-reference=COMPOSITIONTYPE.SG_VCU_HMIsignals_02_SigGroup
      SG_VCU_TCU_SigGroup: upstream-reference=EcuSwComposition.SG_VCU_TCU_SigGroup.SG_VCU_TCU_SigGroup, ecu-extract-reference=COMPOSITIONTYPE.SG_VCU_TCU_SigGroup.SG_VCU_TCU_SigGroup
      SG_VCU_TCU_SigGroup_001: upstream-reference=EcuSwComposition.SG_VCU_TCU_SigGroup, ecu-extract-reference=COMPOSITIONTYPE.SG_VCU_TCU_SigGroup
      SG_VCU_IBS_01_SigGroup: upstream-reference=EcuSwComposition.SG_VCU_IBS_01_SigGroup.SG_VCU_IBS_01_SigGroup, ecu-extract-reference=COMPOSITIONTYPE.SG_VCU_IBS_01_SigGroup.SG_VCU_IBS_01_SigGroup
      SG_VCU_IBS_01_SigGroup_001: upstream-reference=EcuSwComposition.SG_VCU_IBS_01_SigGroup, ecu-extract-reference=COMPOSITIONTYPE.SG_VCU_IBS_01_SigGroup
      SG_VCU_03_SigGroup: upstream-reference=EcuSwComposition.SG_VCU_03_SigGroup.SG_VCU_03_SigGroup, ecu-extract-reference=COMPOSITIONTYPE.SG_VCU_03_SigGroup.SG_VCU_03_SigGroup
      SG_VCU_03_SigGroup_001: upstream-reference=EcuSwComposition.SG_VCU_03_SigGroup, ecu-extract-reference=COMPOSITIONTYPE.SG_VCU_03_SigGroup
      SG_VCU_BMS_SigGroup: upstream-reference=EcuSwComposition.SG_VCU_BMS_SigGroup.SG_VCU_BMS_SigGroup, ecu-extract-reference=COMPOSITIONTYPE.SG_VCU_BMS_SigGroup.SG_VCU_BMS_SigGroup
      SG_VCU_BMS_SigGroup_001: upstream-reference=EcuSwComposition.SG_VCU_BMS_SigGroup, ecu-extract-reference=COMPOSITIONTYPE.SG_VCU_BMS_SigGroup
      SG_VCU_DiagInfor_SigGroup: upstream-reference=EcuSwComposition.SG_VCU_DiagInfor_SigGroup.SG_VCU_DiagInfor_SigGroup, ecu-extract-reference=COMPOSITIONTYPE.SG_VCU_DiagInfor_SigGroup.SG_VCU_DiagInfor_SigGroup
      SG_VCU_DiagInfor_SigGroup_001: upstream-reference=EcuSwComposition.SG_VCU_DiagInfor_SigGroup, ecu-extract-reference=COMPOSITIONTYPE.SG_VCU_DiagInfor_SigGroup
      SG_VCU_05_SigGroup: upstream-reference=EcuSwComposition.SG_VCU_05_SigGroup.SG_VCU_05_SigGroup, ecu-extract-reference=COMPOSITIONTYPE.SG_VCU_05_SigGroup.SG_VCU_05_SigGroup
      SG_VCU_05_SigGroup_001: upstream-reference=EcuSwComposition.SG_VCU_05_SigGroup, ecu-extract-reference=COMPOSITIONTYPE.SG_VCU_05_SigGroup
      SG_VCU_Chassis_01_SigGroup: upstream-reference=EcuSwComposition.SG_VCU_Chassis_01_SigGroup.SG_VCU_Chassis_01_SigGroup, ecu-extract-reference=COMPOSITIONTYPE.SG_VCU_Chassis_01_SigGroup.SG_VCU_Chassis_01_SigGroup
      SG_VCU_Chassis_01_SigGroup_001: upstream-reference=EcuSwComposition.SG_VCU_Chassis_01_SigGroup, ecu-extract-reference=COMPOSITIONTYPE.SG_VCU_Chassis_01_SigGroup
      SG_VCU_MCU_02_SigGroup: upstream-reference=EcuSwComposition.SG_VCU_MCU_02_SigGroup.SG_VCU_MCU_02_SigGroup, ecu-extract-reference=COMPOSITIONTYPE.SG_VCU_MCU_02_SigGroup.SG_VCU_MCU_02_SigGroup
      SG_VCU_MCU_02_SigGroup_001: upstream-reference=EcuSwComposition.SG_VCU_MCU_02_SigGroup, ecu-extract-reference=COMPOSITIONTYPE.SG_VCU_MCU_02_SigGroup
      SG_VCU_SynReq_01_SigGroup: upstream-reference=EcuSwComposition.SG_VCU_SynReq_01_SigGroup.SG_VCU_SynReq_01_SigGroup, ecu-extract-reference=COMPOSITIONTYPE.SG_VCU_SynReq_01_SigGroup.SG_VCU_SynReq_01_SigGroup
      SG_VCU_SynReq_01_SigGroup_001: upstream-reference=EcuSwComposition.SG_VCU_SynReq_01_SigGroup, ecu-extract-reference=COMPOSITIONTYPE.SG_VCU_SynReq_01_SigGroup
      SG_VCU_MCU_05_SigGroup: upstream-reference=EcuSwComposition.SG_VCU_MCU_05_SigGroup.SG_VCU_MCU_05_SigGroup, ecu-extract-reference=COMPOSITIONTYPE.SG_VCU_MCU_05_SigGroup.SG_VCU_MCU_05_SigGroup
      SG_VCU_MCU_05_SigGroup_001: upstream-reference=EcuSwComposition.SG_VCU_MCU_05_SigGroup, ecu-extract-reference=COMPOSITIONTYPE.SG_VCU_MCU_05_SigGroup
      SG_VCU_POD_SigGroup: upstream-reference=EcuSwComposition.SG_VCU_POD_SigGroup.SG_VCU_POD_SigGroup, ecu-extract-reference=COMPOSITIONTYPE.SG_VCU_POD_SigGroup.SG_VCU_POD_SigGroup
      SG_VCU_POD_SigGroup_001: upstream-reference=EcuSwComposition.SG_VCU_POD_SigGroup, ecu-extract-reference=COMPOSITIONTYPE.SG_VCU_POD_SigGroup
      SG_VCU_06_SigGroup: upstream-reference=EcuSwComposition.SG_VCU_06_SigGroup.SG_VCU_06_SigGroup, ecu-extract-reference=COMPOSITIONTYPE.SG_VCU_06_SigGroup.SG_VCU_06_SigGroup
      SG_VCU_06_SigGroup_001: upstream-reference=EcuSwComposition.SG_VCU_06_SigGroup, ecu-extract-reference=COMPOSITIONTYPE.SG_VCU_06_SigGroup
      SG_VCU_02_SigGroup: upstream-reference=EcuSwComposition.SG_VCU_02_SigGroup.SG_VCU_02_SigGroup, ecu-extract-reference=COMPOSITIONTYPE.SG_VCU_02_SigGroup.SG_VCU_02_SigGroup
      SG_VCU_02_SigGroup_001: upstream-reference=EcuSwComposition.SG_VCU_02_SigGroup, ecu-extract-reference=COMPOSITIONTYPE.SG_VCU_02_SigGroup
      SG_VCU_04_SigGroup: upstream-reference=EcuSwComposition.SG_VCU_04_SigGroup.SG_VCU_04_SigGroup, ecu-extract-reference=COMPOSITIONTYPE.SG_VCU_04_SigGroup.SG_VCU_04_SigGroup
      SG_VCU_04_SigGroup_001: upstream-reference=EcuSwComposition.SG_VCU_04_SigGroup, ecu-extract-reference=COMPOSITIONTYPE.SG_VCU_04_SigGroup
      SG_VCU_PlugInChrgInfo_SigGroup: upstream-reference=EcuSwComposition.SG_VCU_PlugInChrgInfo_SigGroup.SG_VCU_PlugInChrgInfo_SigGroup, ecu-extract-reference=COMPOSITIONTYPE.SG_VCU_PlugInChrgInfo_SigGroup.SG_VCU_PlugInChrgInfo_SigGroup
      SG_VCU_PlugInChrgInfo_SigGroup_001: upstream-reference=EcuSwComposition.SG_VCU_PlugInChrgInfo_SigGroup, ecu-extract-reference=COMPOSITIONTYPE.SG_VCU_PlugInChrgInfo_SigGroup
      SG_VCU_DCDC_SigGroup: upstream-reference=EcuSwComposition.SG_VCU_DCDC_SigGroup.SG_VCU_DCDC_SigGroup, ecu-extract-reference=COMPOSITIONTYPE.SG_VCU_DCDC_SigGroup.SG_VCU_DCDC_SigGroup
      SG_VCU_DCDC_SigGroup_001: upstream-reference=EcuSwComposition.SG_VCU_DCDC_SigGroup, ecu-extract-reference=COMPOSITIONTYPE.SG_VCU_DCDC_SigGroup
      SG_VCU_AccPedal_SigGroup: upstream-reference=EcuSwComposition.SG_VCU_AccPedal_SigGroup.SG_VCU_AccPedal_SigGroup, ecu-extract-reference=COMPOSITIONTYPE.SG_VCU_AccPedal_SigGroup.SG_VCU_AccPedal_SigGroup
      SG_VCU_AccPedal_SigGroup_001: upstream-reference=EcuSwComposition.SG_VCU_AccPedal_SigGroup, ecu-extract-reference=COMPOSITIONTYPE.SG_VCU_AccPedal_SigGroup
      SG_VCU_HMIsignals_01_SigGroup: upstream-reference=EcuSwComposition.SG_VCU_HMIsignals_01_SigGroup.SG_VCU_HMIsignals_01_SigGroup, ecu-extract-reference=COMPOSITIONTYPE.SG_VCU_HMIsignals_01_SigGroup.SG_VCU_HMIsignals_01_SigGroup
      SG_VCU_HMIsignals_01_SigGroup_001: upstream-reference=EcuSwComposition.SG_VCU_HMIsignals_01_SigGroup, ecu-extract-reference=COMPOSITIONTYPE.SG_VCU_HMIsignals_01_SigGroup
      SG_MCU_01_SigGroup: upstream-reference=EcuSwComposition.SG_MCU_01_SigGroup.SG_MCU_01_SigGroup, ecu-extract-reference=COMPOSITIONTYPE.SG_MCU_01_SigGroup.SG_MCU_01_SigGroup
      SG_MCU_01_SigGroup_001: upstream-reference=EcuSwComposition.SG_MCU_01_SigGroup, ecu-extract-reference=COMPOSITIONTYPE.SG_MCU_01_SigGroup
      SG_VCU_MCU_03_SigGroup: upstream-reference=EcuSwComposition.SG_VCU_MCU_03_SigGroup.SG_VCU_MCU_03_SigGroup, ecu-extract-reference=COMPOSITIONTYPE.SG_VCU_MCU_03_SigGroup.SG_VCU_MCU_03_SigGroup
      SG_VCU_MCU_03_SigGroup_001: upstream-reference=EcuSwComposition.SG_VCU_MCU_03_SigGroup, ecu-extract-reference=COMPOSITIONTYPE.SG_VCU_MCU_03_SigGroup
      SG_SGW_FVSynchronization_01_SigGrou: upstream-reference=EcuSwComposition.SG_SGW_FVSynchronization_01_SigGrou_1.SG_SGW_FVSynchronization_01_SigGrou, ecu-extract-reference=COMPOSITIONTYPE.SG_SGW_FVSynchronization_01_SigGrou_1.SG_SGW_FVSynchronization_01_SigGrou
      SG_SGW_FVSynchronization_01_SigGrou_1: upstream-reference=EcuSwComposition.SG_SGW_FVSynchronization_01_SigGrou_1, ecu-extract-reference=COMPOSITIONTYPE.SG_SGW_FVSynchronization_01_SigGrou_1
      SG_ACU_info_SigGroup: upstream-reference=EcuSwComposition.SG_ACU_info_SigGroup_1.SG_ACU_info_SigGroup, ecu-extract-reference=COMPOSITIONTYPE.SG_ACU_info_SigGroup_1.SG_ACU_info_SigGroup
      SG_ACU_info_SigGroup_1: upstream-reference=EcuSwComposition.SG_ACU_info_SigGroup_1, ecu-extract-reference=COMPOSITIONTYPE.SG_ACU_info_SigGroup_1
      SG_ADCU_ACC_02_SigGroup: upstream-reference=EcuSwComposition.SG_ADCU_ACC_02_SigGroup_1.SG_ADCU_ACC_02_SigGroup, ecu-extract-reference=COMPOSITIONTYPE.SG_ADCU_ACC_02_SigGroup_1.SG_ADCU_ACC_02_SigGroup
      SG_ADCU_ACC_02_SigGroup_1: upstream-reference=EcuSwComposition.SG_ADCU_ACC_02_SigGroup_1, ecu-extract-reference=COMPOSITIONTYPE.SG_ADCU_ACC_02_SigGroup_1
      SG_ADCU_APS_01_SigGroup: upstream-reference=EcuSwComposition.SG_ADCU_APS_01_SigGroup_1.SG_ADCU_APS_01_SigGroup, ecu-extract-reference=COMPOSITIONTYPE.SG_ADCU_APS_01_SigGroup_1.SG_ADCU_APS_01_SigGroup
      SG_ADCU_APS_01_SigGroup_1: upstream-reference=EcuSwComposition.SG_ADCU_APS_01_SigGroup_1, ecu-extract-reference=COMPOSITIONTYPE.SG_ADCU_APS_01_SigGroup_1
      SG_BCM_05_SigGroup: upstream-reference=EcuSwComposition.SG_BCM_05_SigGroup_1.SG_BCM_05_SigGroup, ecu-extract-reference=COMPOSITIONTYPE.SG_BCM_05_SigGroup_1.SG_BCM_05_SigGroup
      SG_BCM_05_SigGroup_1: upstream-reference=EcuSwComposition.SG_BCM_05_SigGroup_1, ecu-extract-reference=COMPOSITIONTYPE.SG_BCM_05_SigGroup_1
      SG_BCM_06_SigGroup: upstream-reference=EcuSwComposition.SG_BCM_06_SigGroup_1.SG_BCM_06_SigGroup, ecu-extract-reference=COMPOSITIONTYPE.SG_BCM_06_SigGroup_1.SG_BCM_06_SigGroup
      SG_BCM_06_SigGroup_1: upstream-reference=EcuSwComposition.SG_BCM_06_SigGroup_1, ecu-extract-reference=COMPOSITIONTYPE.SG_BCM_06_SigGroup_1
      SG_ADCU_AEB_01_SigGroup: upstream-reference=EcuSwComposition.SG_ADCU_AEB_01_SigGroup.SG_ADCU_AEB_01_SigGroup, ecu-extract-reference=COMPOSITIONTYPE.SG_ADCU_AEB_01_SigGroup.SG_ADCU_AEB_01_SigGroup
      SG_ADCU_AEB_01_SigGroup_001: upstream-reference=EcuSwComposition.SG_ADCU_AEB_01_SigGroup, ecu-extract-reference=COMPOSITIONTYPE.SG_ADCU_AEB_01_SigGroup
      SG_BMS_CellTemp_SigGroup: upstream-reference=EcuSwComposition.SG_BMS_CellTemp_SigGroup_1.SG_BMS_CellTemp_SigGroup, ecu-extract-reference=COMPOSITIONTYPE.SG_BMS_CellTemp_SigGroup_1.SG_BMS_CellTemp_SigGroup
      SG_BMS_CellTemp_SigGroup_1: upstream-reference=EcuSwComposition.SG_BMS_CellTemp_SigGroup_1, ecu-extract-reference=COMPOSITIONTYPE.SG_BMS_CellTemp_SigGroup_1
      SG_BMS_CellVoltage_SigGroup: upstream-reference=EcuSwComposition.SG_BMS_CellVoltage_SigGroup_1.SG_BMS_CellVoltage_SigGroup, ecu-extract-reference=COMPOSITIONTYPE.SG_BMS_CellVoltage_SigGroup_1.SG_BMS_CellVoltage_SigGroup
      SG_BMS_CellVoltage_SigGroup_1: upstream-reference=EcuSwComposition.SG_BMS_CellVoltage_SigGroup_1, ecu-extract-reference=COMPOSITIONTYPE.SG_BMS_CellVoltage_SigGroup_1
      SG_BMS_status_01_SigGroup: upstream-reference=EcuSwComposition.SG_BMS_status_01_SigGroup_1.SG_BMS_status_01_SigGroup, ecu-extract-reference=COMPOSITIONTYPE.SG_BMS_status_01_SigGroup_1.SG_BMS_status_01_SigGroup
      SG_BMS_status_01_SigGroup_1: upstream-reference=EcuSwComposition.SG_BMS_status_01_SigGroup_1, ecu-extract-reference=COMPOSITIONTYPE.SG_BMS_status_01_SigGroup_1
      SG_DCM_FL_02_SigGroup: upstream-reference=EcuSwComposition.SG_DCM_FL_02_SigGroup_1.SG_DCM_FL_02_SigGroup, ecu-extract-reference=COMPOSITIONTYPE.SG_DCM_FL_02_SigGroup_1.SG_DCM_FL_02_SigGroup
      SG_DCM_FL_02_SigGroup_1: upstream-reference=EcuSwComposition.SG_DCM_FL_02_SigGroup_1, ecu-extract-reference=COMPOSITIONTYPE.SG_DCM_FL_02_SigGroup_1
      SG_IBS_APS_SigGroup: upstream-reference=EcuSwComposition.SG_IBS_APS_SigGroup_1.SG_IBS_APS_SigGroup, ecu-extract-reference=COMPOSITIONTYPE.SG_IBS_APS_SigGroup_1.SG_IBS_APS_SigGroup
      SG_IBS_APS_SigGroup_1: upstream-reference=EcuSwComposition.SG_IBS_APS_SigGroup_1, ecu-extract-reference=COMPOSITIONTYPE.SG_IBS_APS_SigGroup_1
      SG_IBS_Status_02_SigGroup: upstream-reference=EcuSwComposition.SG_IBS_Status_02_SigGroup_1.SG_IBS_Status_02_SigGroup, ecu-extract-reference=COMPOSITIONTYPE.SG_IBS_Status_02_SigGroup_1.SG_IBS_Status_02_SigGroup
      SG_IBS_Status_02_SigGroup_1: upstream-reference=EcuSwComposition.SG_IBS_Status_02_SigGroup_1, ecu-extract-reference=COMPOSITIONTYPE.SG_IBS_Status_02_SigGroup_1
      SG_IBS_Status_03_SigGroup: upstream-reference=EcuSwComposition.SG_IBS_Status_03_SigGroup_1.SG_IBS_Status_03_SigGroup, ecu-extract-reference=COMPOSITIONTYPE.SG_IBS_Status_03_SigGroup_1.SG_IBS_Status_03_SigGroup
      SG_IBS_Status_03_SigGroup_1: upstream-reference=EcuSwComposition.SG_IBS_Status_03_SigGroup_1, ecu-extract-reference=COMPOSITIONTYPE.SG_IBS_Status_03_SigGroup_1
      SG_IBS_Status_04_SigGroup: upstream-reference=EcuSwComposition.SG_IBS_Status_04_SigGroup_1.SG_IBS_Status_04_SigGroup, ecu-extract-reference=COMPOSITIONTYPE.SG_IBS_Status_04_SigGroup_1.SG_IBS_Status_04_SigGroup
      SG_IBS_Status_04_SigGroup_1: upstream-reference=EcuSwComposition.SG_IBS_Status_04_SigGroup_1, ecu-extract-reference=COMPOSITIONTYPE.SG_IBS_Status_04_SigGroup_1
      SG_IBS_Status_05_SigGroup: upstream-reference=EcuSwComposition.SG_IBS_Status_05_SigGroup_1.SG_IBS_Status_05_SigGroup, ecu-extract-reference=COMPOSITIONTYPE.SG_IBS_Status_05_SigGroup_1.SG_IBS_Status_05_SigGroup
      SG_IBS_Status_05_SigGroup_1: upstream-reference=EcuSwComposition.SG_IBS_Status_05_SigGroup_1, ecu-extract-reference=COMPOSITIONTYPE.SG_IBS_Status_05_SigGroup_1
      SG_IBS_Status_06_SigGroup: upstream-reference=EcuSwComposition.SG_IBS_Status_06_SigGroup_1.SG_IBS_Status_06_SigGroup, ecu-extract-reference=COMPOSITIONTYPE.SG_IBS_Status_06_SigGroup_1.SG_IBS_Status_06_SigGroup
      SG_IBS_Status_06_SigGroup_1: upstream-reference=EcuSwComposition.SG_IBS_Status_06_SigGroup_1, ecu-extract-reference=COMPOSITIONTYPE.SG_IBS_Status_06_SigGroup_1
      SG_IBS_WheelSpeed_01_SigGroup: upstream-reference=EcuSwComposition.SG_IBS_WheelSpeed_01_SigGroup_1.SG_IBS_WheelSpeed_01_SigGroup, ecu-extract-reference=COMPOSITIONTYPE.SG_IBS_WheelSpeed_01_SigGroup_1.SG_IBS_WheelSpeed_01_SigGroup
      SG_IBS_WheelSpeed_01_SigGroup_1: upstream-reference=EcuSwComposition.SG_IBS_WheelSpeed_01_SigGroup_1, ecu-extract-reference=COMPOSITIONTYPE.SG_IBS_WheelSpeed_01_SigGroup_1
      SG_IBS_WheelSpeed_02_SigGroup: upstream-reference=EcuSwComposition.SG_IBS_WheelSpeed_02_SigGroup_1.SG_IBS_WheelSpeed_02_SigGroup, ecu-extract-reference=COMPOSITIONTYPE.SG_IBS_WheelSpeed_02_SigGroup_1.SG_IBS_WheelSpeed_02_SigGroup
      SG_IBS_WheelSpeed_02_SigGroup_1: upstream-reference=EcuSwComposition.SG_IBS_WheelSpeed_02_SigGroup_1, ecu-extract-reference=COMPOSITIONTYPE.SG_IBS_WheelSpeed_02_SigGroup_1
      SG_SGW_01_SigGroup: upstream-reference=EcuSwComposition.SG_SGW_01_SigGroup_1.SG_SGW_01_SigGroup, ecu-extract-reference=COMPOSITIONTYPE.SG_SGW_01_SigGroup_1.SG_SGW_01_SigGroup
      SG_SGW_01_SigGroup_1: upstream-reference=EcuSwComposition.SG_SGW_01_SigGroup_1, ecu-extract-reference=COMPOSITIONTYPE.SG_SGW_01_SigGroup_1
      SG_BMS_status_04_SigGroup: upstream-reference=EcuSwComposition.SG_BMS_status_04_SigGroup.SG_BMS_status_04_SigGroup, ecu-extract-reference=COMPOSITIONTYPE.SG_BMS_status_04_SigGroup.SG_BMS_status_04_SigGroup
      SG_BMS_status_04_SigGroup_001: upstream-reference=EcuSwComposition.SG_BMS_status_04_SigGroup, ecu-extract-reference=COMPOSITIONTYPE.SG_BMS_status_04_SigGroup
      SG_IBS_Status_01_SigGroup: upstream-reference=EcuSwComposition.SG_IBS_Status_01_SigGroup.SG_IBS_Status_01_SigGroup, ecu-extract-reference=COMPOSITIONTYPE.SG_IBS_Status_01_SigGroup.SG_IBS_Status_01_SigGroup
      SG_IBS_Status_01_SigGroup_001: upstream-reference=EcuSwComposition.SG_IBS_Status_01_SigGroup, ecu-extract-reference=COMPOSITIONTYPE.SG_IBS_Status_01_SigGroup
      SG_IBS_ACC_SigGroup: upstream-reference=EcuSwComposition.SG_IBS_ACC_SigGroup_1.SG_IBS_ACC_SigGroup, ecu-extract-reference=COMPOSITIONTYPE.SG_IBS_ACC_SigGroup_1.SG_IBS_ACC_SigGroup
      SG_IBS_ACC_SigGroup_1: upstream-reference=EcuSwComposition.SG_IBS_ACC_SigGroup_1, ecu-extract-reference=COMPOSITIONTYPE.SG_IBS_ACC_SigGroup_1
      VCU_BS_IndicatorLightSts_LIN00: upstream-reference=EcuSwComposition.VCU_BS_IndicatorLightSts_LIN00, ecu-extract-reference=COMPOSITIONTYPE.VCU_BS_IndicatorLightSts_LIN00
      VCU_IBS_EBDFault: upstream-reference=EcuSwComposition.VCU_IBS_EBDFault_LIN00.VCU_IBS_EBDFault_LIN, ecu-extract-reference=COMPOSITIONTYPE.VCU_IBS_EBDFault_LIN00.VCU_IBS_EBDFault_LIN
      VCU_IBS_EBDFault_LIN00: upstream-reference=EcuSwComposition.VCU_IBS_EBDFault_LIN00, ecu-extract-reference=COMPOSITIONTYPE.VCU_IBS_EBDFault_LIN00
      VCU_IBS_RollerbenchMode: upstream-reference=EcuSwComposition.VCU_IBS_RollerbenchMode_LIN00.VCU_IBS_RollerbenchMode_LIN, ecu-extract-reference=COMPOSITIONTYPE.VCU_IBS_RollerbenchMode_LIN00.VCU_IBS_RollerbenchMode_LIN
      VCU_IBS_RollerbenchMode_LIN00: upstream-reference=EcuSwComposition.VCU_IBS_RollerbenchMode_LIN00, ecu-extract-reference=COMPOSITIONTYPE.VCU_IBS_RollerbenchMode_LIN00
      VCU_BCM_FLSeatBeltRemindReq: upstream-reference=EcuSwComposition.VCU_BCM_FLSeatBeltRemindReq_LIN00.VCU_BCM_FLSeatBeltRemindReq_LIN, ecu-extract-reference=COMPOSITIONTYPE.VCU_BCM_FLSeatBeltRemindReq_LIN00.VCU_BCM_FLSeatBeltRemindReq_LIN
      VCU_BCM_FLSeatBeltRemindReq_LIN00: upstream-reference=EcuSwComposition.VCU_BCM_FLSeatBeltRemindReq_LIN00, ecu-extract-reference=COMPOSITIONTYPE.VCU_BCM_FLSeatBeltRemindReq_LIN00
      VCU_DCM_RR_DoorRRSts: upstream-reference=EcuSwComposition.VCU_DCM_RR_DoorRRSts_LIN00.VCU_DCM_RR_DoorRRSts_LIN, ecu-extract-reference=COMPOSITIONTYPE.VCU_DCM_RR_DoorRRSts_LIN00.VCU_DCM_RR_DoorRRSts_LIN
      VCU_DCM_RR_DoorRRSts_LIN00: upstream-reference=EcuSwComposition.VCU_DCM_RR_DoorRRSts_LIN00, ecu-extract-reference=COMPOSITIONTYPE.VCU_DCM_RR_DoorRRSts_LIN00
      VCU_DCM_FL_DoorFLSts: upstream-reference=EcuSwComposition.VCU_DCM_FL_DoorFLSts_LIN00.VCU_DCM_FL_DoorFLSts_LIN, ecu-extract-reference=COMPOSITIONTYPE.VCU_DCM_FL_DoorFLSts_LIN00.VCU_DCM_FL_DoorFLSts_LIN
      VCU_DCM_FL_DoorFLSts_LIN00: upstream-reference=EcuSwComposition.VCU_DCM_FL_DoorFLSts_LIN00, ecu-extract-reference=COMPOSITIONTYPE.VCU_DCM_FL_DoorFLSts_LIN00
      VCU_BCM_RLSeatBeltRemindReq: upstream-reference=EcuSwComposition.VCU_BCM_RLSeatBeltRemindReq_LIN00.VCU_BCM_RLSeatBeltRemindReq_LIN, ecu-extract-reference=COMPOSITIONTYPE.VCU_BCM_RLSeatBeltRemindReq_LIN00.VCU_BCM_RLSeatBeltRemindReq_LIN
      VCU_BCM_RLSeatBeltRemindReq_LIN00: upstream-reference=EcuSwComposition.VCU_BCM_RLSeatBeltRemindReq_LIN00, ecu-extract-reference=COMPOSITIONTYPE.VCU_BCM_RLSeatBeltRemindReq_LIN00
      VCU_Batt_U0_Max_LIN00: upstream-reference=EcuSwComposition.VCU_Batt_U0_Max_LIN00, ecu-extract-reference=COMPOSITIONTYPE.VCU_Batt_U0_Max_LIN00
      VCU_BattNomC20_LIN00: upstream-reference=EcuSwComposition.VCU_BattNomC20_LIN00, ecu-extract-reference=COMPOSITIONTYPE.VCU_BattNomC20_LIN00
      VCU_ACU_DriverWarningLampSts: upstream-reference=EcuSwComposition.VCU_ACU_DriverWarningLampSts_LIN00.VCU_ACU_DriverWarningLampSts_LIN, ecu-extract-reference=COMPOSITIONTYPE.VCU_ACU_DriverWarningLampSts_LIN00.VCU_ACU_DriverWarningLampSts_LIN
      VCU_ACU_DriverWarningLampSts_LIN00: upstream-reference=EcuSwComposition.VCU_ACU_DriverWarningLampSts_LIN00, ecu-extract-reference=COMPOSITIONTYPE.VCU_ACU_DriverWarningLampSts_LIN00
      VCU_ACU_PassengerWarningLampSts: upstream-reference=EcuSwComposition.VCU_ACU_PassengerWarningLampSts_LIN00.VCU_ACU_PassengerWarningLampSts_LIN, ecu-extract-reference=COMPOSITIONTYPE.VCU_ACU_PassengerWarningLampSts_LIN00.VCU_ACU_PassengerWarningLampSts_LIN
      VCU_ACU_PassengerWarningLampSts_LIN00: upstream-reference=EcuSwComposition.VCU_ACU_PassengerWarningLampSts_LIN00, ecu-extract-reference=COMPOSITIONTYPE.VCU_ACU_PassengerWarningLampSts_LIN00
      VCU_ACU_PassengerAirbagSts: upstream-reference=EcuSwComposition.VCU_ACU_PassengerAirbagSts_LIN00.VCU_ACU_PassengerAirbagSts_LIN, ecu-extract-reference=COMPOSITIONTYPE.VCU_ACU_PassengerAirbagSts_LIN00.VCU_ACU_PassengerAirbagSts_LIN
      VCU_ACU_PassengerAirbagSts_LIN00: upstream-reference=EcuSwComposition.VCU_ACU_PassengerAirbagSts_LIN00, ecu-extract-reference=COMPOSITIONTYPE.VCU_ACU_PassengerAirbagSts_LIN00
      VCU_DCDCFail_LIN: upstream-reference=EcuSwComposition.VCU_DCDCFail_LIN_LIN00.VCU_DCDCFail_LIN_LIN, ecu-extract-reference=COMPOSITIONTYPE.VCU_DCDCFail_LIN_LIN00.VCU_DCDCFail_LIN_LIN
      VCU_DCDCFail_LIN_LIN00: upstream-reference=EcuSwComposition.VCU_DCDCFail_LIN_LIN00, ecu-extract-reference=COMPOSITIONTYPE.VCU_DCDCFail_LIN_LIN00
      VCU_Batt_U0_Min_LIN00: upstream-reference=EcuSwComposition.VCU_Batt_U0_Min_LIN00, ecu-extract-reference=COMPOSITIONTYPE.VCU_Batt_U0_Min_LIN00
      VCU_HVBatCriFail_LIN: upstream-reference=EcuSwComposition.VCU_HVBatCriFail_LIN_LIN00.VCU_HVBatCriFail_LIN_LIN, ecu-extract-reference=COMPOSITIONTYPE.VCU_HVBatCriFail_LIN_LIN00.VCU_HVBatCriFail_LIN_LIN
      VCU_HVBatCriFail_LIN_LIN00: upstream-reference=EcuSwComposition.VCU_HVBatCriFail_LIN_LIN00, ecu-extract-reference=COMPOSITIONTYPE.VCU_HVBatCriFail_LIN_LIN00
      VCU_IBSClrDiagInf_LIN00: upstream-reference=EcuSwComposition.VCU_IBSClrDiagInf_LIN00, ecu-extract-reference=COMPOSITIONTYPE.VCU_IBSClrDiagInf_LIN00
      VCU_DCM_FR_DoorFRSts: upstream-reference=EcuSwComposition.VCU_DCM_FR_DoorFRSts_LIN00.VCU_DCM_FR_DoorFRSts_LIN, ecu-extract-reference=COMPOSITIONTYPE.VCU_DCM_FR_DoorFRSts_LIN00.VCU_DCM_FR_DoorFRSts_LIN
      VCU_DCM_FR_DoorFRSts_LIN00: upstream-reference=EcuSwComposition.VCU_DCM_FR_DoorFRSts_LIN00, ecu-extract-reference=COMPOSITIONTYPE.VCU_DCM_FR_DoorFRSts_LIN00
      VCU_BCM_FRSeatBeltRemindReq: upstream-reference=EcuSwComposition.VCU_BCM_FRSeatBeltRemindReq_LIN00.VCU_BCM_FRSeatBeltRemindReq_LIN, ecu-extract-reference=COMPOSITIONTYPE.VCU_BCM_FRSeatBeltRemindReq_LIN00.VCU_BCM_FRSeatBeltRemindReq_LIN
      VCU_BCM_FRSeatBeltRemindReq_LIN00: upstream-reference=EcuSwComposition.VCU_BCM_FRSeatBeltRemindReq_LIN00, ecu-extract-reference=COMPOSITIONTYPE.VCU_BCM_FRSeatBeltRemindReq_LIN00
      VCU_BattType_LIN00: upstream-reference=EcuSwComposition.VCU_BattType_LIN00, ecu-extract-reference=COMPOSITIONTYPE.VCU_BattType_LIN00
      VCU_HVBatOvrTemp_LIN: upstream-reference=EcuSwComposition.VCU_HVBatOvrTemp_LIN_LIN00.VCU_HVBatOvrTemp_LIN_LIN, ecu-extract-reference=COMPOSITIONTYPE.VCU_HVBatOvrTemp_LIN_LIN00.VCU_HVBatOvrTemp_LIN_LIN
      VCU_HVBatOvrTemp_LIN_LIN00: upstream-reference=EcuSwComposition.VCU_HVBatOvrTemp_LIN_LIN00, ecu-extract-reference=COMPOSITIONTYPE.VCU_HVBatOvrTemp_LIN_LIN00
      VCU_DCM_RL_DoorRLSts: upstream-reference=EcuSwComposition.VCU_DCM_RL_DoorRLSts_LIN00.VCU_DCM_RL_DoorRLSts_LIN, ecu-extract-reference=COMPOSITIONTYPE.VCU_DCM_RL_DoorRLSts_LIN00.VCU_DCM_RL_DoorRLSts_LIN
      VCU_DCM_RL_DoorRLSts_LIN00: upstream-reference=EcuSwComposition.VCU_DCM_RL_DoorRLSts_LIN00, ecu-extract-reference=COMPOSITIONTYPE.VCU_DCM_RL_DoorRLSts_LIN00
      VCU_IBS_BrakeFluidWarning: upstream-reference=EcuSwComposition.VCU_IBS_BrakeFluidWarning_LIN00.VCU_IBS_BrakeFluidWarning_LIN, ecu-extract-reference=COMPOSITIONTYPE.VCU_IBS_BrakeFluidWarning_LIN00.VCU_IBS_BrakeFluidWarning_LIN
      VCU_IBS_BrakeFluidWarning_LIN00: upstream-reference=EcuSwComposition.VCU_IBS_BrakeFluidWarning_LIN00, ecu-extract-reference=COMPOSITIONTYPE.VCU_IBS_BrakeFluidWarning_LIN00
      VCU_CGW_VehicleState: upstream-reference=EcuSwComposition.VCU_CGW_VehicleState_LIN00.VCU_CGW_VehicleState_LIN, ecu-extract-reference=COMPOSITIONTYPE.VCU_CGW_VehicleState_LIN00.VCU_CGW_VehicleState_LIN
      VCU_CGW_VehicleState_LIN00: upstream-reference=EcuSwComposition.VCU_CGW_VehicleState_LIN00, ecu-extract-reference=COMPOSITIONTYPE.VCU_CGW_VehicleState_LIN00
      VCU_IBS_SystemStatus: upstream-reference=EcuSwComposition.VCU_IBS_SystemStatus_LIN00.VCU_IBS_SystemStatus_LIN, ecu-extract-reference=COMPOSITIONTYPE.VCU_IBS_SystemStatus_LIN00.VCU_IBS_SystemStatus_LIN
      VCU_IBS_SystemStatus_LIN00: upstream-reference=EcuSwComposition.VCU_IBS_SystemStatus_LIN00, ecu-extract-reference=COMPOSITIONTYPE.VCU_IBS_SystemStatus_LIN00
      VCU_HstTempDataRqTrg_LIN00: upstream-reference=EcuSwComposition.VCU_HstTempDataRqTrg_LIN00, ecu-extract-reference=COMPOSITIONTYPE.VCU_HstTempDataRqTrg_LIN00
      VCU_BCM_RRSeatBeltRemindReq: upstream-reference=EcuSwComposition.VCU_BCM_RRSeatBeltRemindReq_LIN00.VCU_BCM_RRSeatBeltRemindReq_LIN, ecu-extract-reference=COMPOSITIONTYPE.VCU_BCM_RRSeatBeltRemindReq_LIN00.VCU_BCM_RRSeatBeltRemindReq_LIN
      VCU_BCM_RRSeatBeltRemindReq_LIN00: upstream-reference=EcuSwComposition.VCU_BCM_RRSeatBeltRemindReq_LIN00, ecu-extract-reference=COMPOSITIONTYPE.VCU_BCM_RRSeatBeltRemindReq_LIN00
      VCU_IVI_VrState: upstream-reference=EcuSwComposition.VCU_IVI_VrState_LIN00.VCU_IVI_VrState_LIN, ecu-extract-reference=COMPOSITIONTYPE.VCU_IVI_VrState_LIN00.VCU_IVI_VrState_LIN
      VCU_IVI_VrState_LIN00: upstream-reference=EcuSwComposition.VCU_IVI_VrState_LIN00, ecu-extract-reference=COMPOSITIONTYPE.VCU_IVI_VrState_LIN00
      VCU_ACU_WarningLampSts: upstream-reference=EcuSwComposition.VCU_ACU_WarningLampSts_LIN00.VCU_ACU_WarningLampSts_LIN, ecu-extract-reference=COMPOSITIONTYPE.VCU_ACU_WarningLampSts_LIN00.VCU_ACU_WarningLampSts_LIN
      VCU_ACU_WarningLampSts_LIN00: upstream-reference=EcuSwComposition.VCU_ACU_WarningLampSts_LIN00, ecu-extract-reference=COMPOSITIONTYPE.VCU_ACU_WarningLampSts_LIN00
      VCU_DriveMotOvrTemp_LIN: upstream-reference=EcuSwComposition.VCU_DriveMotOvrTemp_LIN_LIN00.VCU_DriveMotOvrTemp_LIN_LIN, ecu-extract-reference=COMPOSITIONTYPE.VCU_DriveMotOvrTemp_LIN_LIN00.VCU_DriveMotOvrTemp_LIN_LIN
      VCU_DriveMotOvrTemp_LIN_LIN00: upstream-reference=EcuSwComposition.VCU_DriveMotOvrTemp_LIN_LIN00, ecu-extract-reference=COMPOSITIONTYPE.VCU_DriveMotOvrTemp_LIN_LIN00
      VCU_IVI_BulbCheckSts: upstream-reference=EcuSwComposition.VCU_IVI_BulbCheckStsLIN01.VCU_IVI_BulbCheckStsLIN01, ecu-extract-reference=COMPOSITIONTYPE.VCU_IVI_BulbCheckStsLIN01.VCU_IVI_BulbCheckStsLIN01
      VCU_IVI_BulbCheckStsLIN01: upstream-reference=EcuSwComposition.VCU_IVI_BulbCheckStsLIN01, ecu-extract-reference=COMPOSITIONTYPE.VCU_IVI_BulbCheckStsLIN01
      Resp_Error: upstream-reference=EcuSwComposition.Resp_Error_LIN01.Resp_Error_LIN01, ecu-extract-reference=COMPOSITIONTYPE.Resp_Error_LIN01.Resp_Error_LIN01
      Resp_Error_LIN01: upstream-reference=EcuSwComposition.Resp_Error_LIN01, ecu-extract-reference=COMPOSITIONTYPE.Resp_Error_LIN01
      SOH: upstream-reference=EcuSwComposition.SOH_LIN01.SOH_LIN01, ecu-extract-reference=COMPOSITIONTYPE.SOH_LIN01.SOH_LIN01
      SOH_LIN01: upstream-reference=EcuSwComposition.SOH_LIN01, ecu-extract-reference=COMPOSITIONTYPE.SOH_LIN01
      I_BATT: upstream-reference=EcuSwComposition.I_BATT_LIN01.I_BATT_LIN01, ecu-extract-reference=COMPOSITIONTYPE.I_BATT_LIN01.I_BATT_LIN01
      I_BATT_LIN01: upstream-reference=EcuSwComposition.I_BATT_LIN01, ecu-extract-reference=COMPOSITIONTYPE.I_BATT_LIN01
      U_BATT: upstream-reference=EcuSwComposition.U_BATT_LIN01.U_BATT_LIN01, ecu-extract-reference=COMPOSITIONTYPE.U_BATT_LIN01.U_BATT_LIN01
      U_BATT_LIN01: upstream-reference=EcuSwComposition.U_BATT_LIN01, ecu-extract-reference=COMPOSITIONTYPE.U_BATT_LIN01
      IBATT_QUIESCENT: upstream-reference=EcuSwComposition.IBATT_QUIESCENT_LIN01.IBATT_QUIESCENT_LIN01, ecu-extract-reference=COMPOSITIONTYPE.IBATT_QUIESCENT_LIN01.IBATT_QUIESCENT_LIN01
      IBATT_QUIESCENT_LIN01: upstream-reference=EcuSwComposition.IBATT_QUIESCENT_LIN01, ecu-extract-reference=COMPOSITIONTYPE.IBATT_QUIESCENT_LIN01
      I_RANGE: upstream-reference=EcuSwComposition.I_RANGE_LIN01.I_RANGE_LIN01, ecu-extract-reference=COMPOSITIONTYPE.I_RANGE_LIN01.I_RANGE_LIN01
      I_RANGE_LIN01: upstream-reference=EcuSwComposition.I_RANGE_LIN01, ecu-extract-reference=COMPOSITIONTYPE.I_RANGE_LIN01
      SOC: upstream-reference=EcuSwComposition.SOC_LIN01.SOC_LIN01, ecu-extract-reference=COMPOSITIONTYPE.SOC_LIN01.SOC_LIN01
      SOC_LIN01: upstream-reference=EcuSwComposition.SOC_LIN01, ecu-extract-reference=COMPOSITIONTYPE.SOC_LIN01
      T_BATT: upstream-reference=EcuSwComposition.T_BATT_LIN01.T_BATT_LIN01, ecu-extract-reference=COMPOSITIONTYPE.T_BATT_LIN01.T_BATT_LIN01
      T_BATT_LIN01: upstream-reference=EcuSwComposition.T_BATT_LIN01, ecu-extract-reference=COMPOSITIONTYPE.T_BATT_LIN01
      ChargeCurrWU_Ena: upstream-reference=EcuSwComposition.ChargeCurrWU_Ena_LIN01.ChargeCurrWU_Ena_LIN01, ecu-extract-reference=COMPOSITIONTYPE.ChargeCurrWU_Ena_LIN01.ChargeCurrWU_Ena_LIN01
      ChargeCurrWU_Ena_LIN01: upstream-reference=EcuSwComposition.ChargeCurrWU_Ena_LIN01, ecu-extract-reference=COMPOSITIONTYPE.ChargeCurrWU_Ena_LIN01
      SOCWU_Ena: upstream-reference=EcuSwComposition.SOCWU_Ena_LIN01.SOCWU_Ena_LIN01, ecu-extract-reference=COMPOSITIONTYPE.SOCWU_Ena_LIN01.SOCWU_Ena_LIN01
      SOCWU_Ena_LIN01: upstream-reference=EcuSwComposition.SOCWU_Ena_LIN01, ecu-extract-reference=COMPOSITIONTYPE.SOCWU_Ena_LIN01
      DisChargeCurrWU_Treshold: upstream-reference=EcuSwComposition.DisChargeCurrWU_Treshold_LIN01.DisChargeCurrWU_Treshold_LIN01, ecu-extract-reference=COMPOSITIONTYPE.DisChargeCurrWU_Treshold_LIN01.DisChargeCurrWU_Treshold_LIN01
      DisChargeCurrWU_Treshold_LIN01: upstream-reference=EcuSwComposition.DisChargeCurrWU_Treshold_LIN01, ecu-extract-reference=COMPOSITIONTYPE.DisChargeCurrWU_Treshold_LIN01
      SOCWU_Treshold: upstream-reference=EcuSwComposition.SOCWU_Treshold_LIN01.SOCWU_Treshold_LIN01, ecu-extract-reference=COMPOSITIONTYPE.SOCWU_Treshold_LIN01.SOCWU_Treshold_LIN01
      SOCWU_Treshold_LIN01: upstream-reference=EcuSwComposition.SOCWU_Treshold_LIN01, ecu-extract-reference=COMPOSITIONTYPE.SOCWU_Treshold_LIN01
      DisChargeCurrWU_Ena: upstream-reference=EcuSwComposition.DisChargeCurrWU_Ena_LIN01.DisChargeCurrWU_Ena_LIN01, ecu-extract-reference=COMPOSITIONTYPE.DisChargeCurrWU_Ena_LIN01.DisChargeCurrWU_Ena_LIN01
      DisChargeCurrWU_Ena_LIN01: upstream-reference=EcuSwComposition.DisChargeCurrWU_Ena_LIN01, ecu-extract-reference=COMPOSITIONTYPE.DisChargeCurrWU_Ena_LIN01
      ChargeCurrWU_Treshold: upstream-reference=EcuSwComposition.ChargeCurrWU_Treshold_LIN01.ChargeCurrWU_Treshold_LIN01, ecu-extract-reference=COMPOSITIONTYPE.ChargeCurrWU_Treshold_LIN01.ChargeCurrWU_Treshold_LIN01
      ChargeCurrWU_Treshold_LIN01: upstream-reference=EcuSwComposition.ChargeCurrWU_Treshold_LIN01, ecu-extract-reference=COMPOSITIONTYPE.ChargeCurrWU_Treshold_LIN01
      SOF_V2: upstream-reference=EcuSwComposition.SOF_V2_LIN01.SOF_V2_LIN01, ecu-extract-reference=COMPOSITIONTYPE.SOF_V2_LIN01.SOF_V2_LIN01
      SOF_V2_LIN01: upstream-reference=EcuSwComposition.SOF_V2_LIN01, ecu-extract-reference=COMPOSITIONTYPE.SOF_V2_LIN01
      SOF_V1: upstream-reference=EcuSwComposition.SOF_V1_LIN01.SOF_V1_LIN01, ecu-extract-reference=COMPOSITIONTYPE.SOF_V1_LIN01.SOF_V1_LIN01
      SOF_V1_LIN01: upstream-reference=EcuSwComposition.SOF_V1_LIN01, ecu-extract-reference=COMPOSITIONTYPE.SOF_V1_LIN01
      SG_IVI_03_SigGroup: upstream-reference=EcuSwComposition.SG_IVI_03_SigGroup.SG_IVI_03_SigGroup, ecu-extract-reference=COMPOSITIONTYPE.SG_IVI_03_SigGroup.SG_IVI_03_SigGroup
      SG_IVI_03_SigGroup_001: upstream-reference=EcuSwComposition.SG_IVI_03_SigGroup, ecu-extract-reference=COMPOSITIONTYPE.SG_IVI_03_SigGroup
      SG_VCU_HMIsignals_03_SigGroup: upstream-reference=EcuSwComposition.SG_VCU_HMIsignals_03_SigGroup.SG_VCU_HMIsignals_03_SigGroup, ecu-extract-reference=COMPOSITIONTYPE.SG_VCU_HMIsignals_03_SigGroup.SG_VCU_HMIsignals_03_SigGroup
      SG_VCU_HMIsignals_03_SigGroup_001: upstream-reference=EcuSwComposition.SG_VCU_HMIsignals_03_SigGroup, ecu-extract-reference=COMPOSITIONTYPE.SG_VCU_HMIsignals_03_SigGroup
      BST_AbortChargparameter: upstream-reference=EcuSwComposition.BST_AbortChargparameter.BST_AbortChargparameter, ecu-extract-reference=COMPOSITIONTYPE.BST_AbortChargparameter.BST_AbortChargparameter
      BST_AbortChargparameter_001: upstream-reference=EcuSwComposition.BST_AbortChargparameter, ecu-extract-reference=COMPOSITIONTYPE.BST_AbortChargparameter
      SG_EPS_CONV_SigGroup: upstream-reference=EcuSwComposition.SG_EPS_CONV_SigGroup.SG_EPS_CONV_SigGroup, ecu-extract-reference=COMPOSITIONTYPE.SG_EPS_CONV_SigGroup.SG_EPS_CONV_SigGroup
      SG_EPS_CONV_SigGroup_001: upstream-reference=EcuSwComposition.SG_EPS_CONV_SigGroup, ecu-extract-reference=COMPOSITIONTYPE.SG_EPS_CONV_SigGroup
      HookCallout: upstream-reference=EcuSwComposition.HookCallout, ecu-extract-reference=COMPOSITIONTYPE.HookCallout
      CtAp_CANHandler: upstream-reference=EcuSwComposition.CtAp_CANHandler, ecu-extract-reference=COMPOSITIONTYPE.CtAp_CANHandler
      CtAp_RngEstimn: upstream-reference=EcuSwComposition.CtAp_RngEstimn, ecu-extract-reference=COMPOSITIONTYPE.CtAp_RngEstimn
      CtAp_ElSSDiag: upstream-reference=EcuSwComposition.CtAp_LvMgmt.CtAp_ElSSDiag, ecu-extract-reference=COMPOSITIONTYPE.CtAp_ElSSDiag
      CtAp_WakeUpRsn: upstream-reference=EcuSwComposition.CtAp_LvMgmt.CtAp_WakeUpRsn, ecu-extract-reference=COMPOSITIONTYPE.CtAp_WakeUpRsn
      CtAp_LvBattMgmt: upstream-reference=EcuSwComposition.CtAp_LvMgmt.CtAp_LvBattMgmt, ecu-extract-reference=COMPOSITIONTYPE.CtAp_LvBattMgmt
      CtAp_BMSMgmt: upstream-reference=EcuSwComposition.CtAp_HvMgmt.CtAp_BMSMgmt, ecu-extract-reference=COMPOSITIONTYPE.CtAp_BMSMgmt
      CtAp_DCDCMgmt: upstream-reference=EcuSwComposition.CtAp_HvMgmt.CtAp_DCDCMgmt, ecu-extract-reference=COMPOSITIONTYPE.CtAp_DCDCMgmt
      CtAp_DCFCMgmt: upstream-reference=EcuSwComposition.CtAp_HvMgmt.CtAp_DCFCMgmt, ecu-extract-reference=COMPOSITIONTYPE.CtAp_DCFCMgmt
      CtAp_MCUMgmt: upstream-reference=EcuSwComposition.CtAp_HvMgmt.CtAp_MCUMgmt, ecu-extract-reference=COMPOSITIONTYPE.CtAp_MCUMgmt
      CtAp_TCUMgmt: upstream-reference=EcuSwComposition.CtAp_HvMgmt.CtAp_TCUMgmt, ecu-extract-reference=COMPOSITIONTYPE.CtAp_TCUMgmt
      CtAp_CnsCalcn: upstream-reference=EcuSwComposition.CtAp_EgyMgmt.CtAp_CnsCalcn, ecu-extract-reference=COMPOSITIONTYPE.CtAp_CnsCalcn
      CtAp_PwrLim: upstream-reference=EcuSwComposition.CtAp_EgyMgmt.CtAp_PwrLim, ecu-extract-reference=COMPOSITIONTYPE.CtAp_PwrLim
      CtAp_ComMErr: upstream-reference=EcuSwComposition.CtAp_ComMErr, ecu-extract-reference=COMPOSITIONTYPE.CtAp_ComMErr
      CtAp_DrvMod: upstream-reference=EcuSwComposition.CtAp_ModMgmt.CtAp_DrvMod, ecu-extract-reference=COMPOSITIONTYPE.CtAp_DrvMod
      CtAp_VehStat: upstream-reference=EcuSwComposition.CtAp_ModMgmt.CtAp_VehStat, ecu-extract-reference=COMPOSITIONTYPE.CtAp_VehStat
      CtAp_VehSpd: upstream-reference=EcuSwComposition.CtAp_VehMot.CtAp_VehSpd, ecu-extract-reference=COMPOSITIONTYPE.CtAp_VehSpd
      CtAp_AccCal: upstream-reference=EcuSwComposition.CtAp_VehMot.CtAp_AccCal, ecu-extract-reference=COMPOSITIONTYPE.CtAp_AccCal
      CtAp_SlopEst: upstream-reference=EcuSwComposition.CtAp_VehMot.CtAp_SlopEst, ecu-extract-reference=COMPOSITIONTYPE.CtAp_SlopEst
      CtAp_ResEst: upstream-reference=EcuSwComposition.CtAp_VehMot.CtAp_ResEst, ecu-extract-reference=COMPOSITIONTYPE.CtAp_ResEst
      CtAp_S2Mgmt: upstream-reference=EcuSwComposition.CtAp_OBCMgmt.CtAp_S2Mgmt, ecu-extract-reference=COMPOSITIONTYPE.CtAp_S2Mgmt
      CtAp_OBCStsMgmt: upstream-reference=EcuSwComposition.CtAp_OBCMgmt.CtAp_OBCStsMgmt, ecu-extract-reference=COMPOSITIONTYPE.CtAp_OBCStsMgmt
      CtAp_EmMgmt: upstream-reference=EcuSwComposition.CtAp_OBCMgmt.CtAp_EmMgmt, ecu-extract-reference=COMPOSITIONTYPE.CtAp_EmMgmt
      CtAp_ACParMgmt: upstream-reference=EcuSwComposition.CtAp_OBCMgmt.CtAp_ACParMgmt, ecu-extract-reference=COMPOSITIONTYPE.CtAp_ACParMgmt
      CtAp_ChrgStat: upstream-reference=EcuSwComposition.CtAp_ChrMgmt.CtAp_ChrgStat, ecu-extract-reference=COMPOSITIONTYPE.CtAp_ChrgStat
      CtAp_ChrgEgyCal: upstream-reference=EcuSwComposition.CtAp_ChrMgmt.CtAp_ChrgEgyCal, ecu-extract-reference=COMPOSITIONTYPE.CtAp_ChrgEgyCal
      CtAp_ChrgSdl: upstream-reference=EcuSwComposition.CtAp_ChrMgmt.CtAp_ChrgSdl, ecu-extract-reference=COMPOSITIONTYPE.CtAp_ChrgSdl
      CtAp_ChrgPreHeat: upstream-reference=EcuSwComposition.CtAp_ChrMgmt.CtAp_ChrgPreHeat, ecu-extract-reference=COMPOSITIONTYPE.CtAp_ChrgPreHeat
      CtAp_FctSftyGear: upstream-reference=EcuSwComposition.CtAp_FctSftyMon.CtAp_FctSftyGear, ecu-extract-reference=COMPOSITIONTYPE.CtAp_FctSftyGear
      CtAp_FctSftyTorq: upstream-reference=EcuSwComposition.CtAp_FctSftyMon.CtAp_FctSftyTorq, ecu-extract-reference=COMPOSITIONTYPE.CtAp_FctSftyTorq
      CtAp_PdlAlys: upstream-reference=EcuSwComposition.CtAp_ChassisMgmt.CtAp_PdlAlys, ecu-extract-reference=COMPOSITIONTYPE.CtAp_PdlAlys
      CtAp_BrkMgmt: upstream-reference=EcuSwComposition.CtAp_ChassisMgmt.CtAp_BrkMgmt, ecu-extract-reference=COMPOSITIONTYPE.CtAp_BrkMgmt
      CtAp_AccrPedlDrv: upstream-reference=EcuSwComposition.CtAp_ChassisMgmt.CtAp_AccrPedlDrv, ecu-extract-reference=COMPOSITIONTYPE.CtAp_AccrPedlDrv
      CtAp_DrvAsscCtrl: upstream-reference=EcuSwComposition.CtAp_ChassisMgmt.CtAp_DrvAsscCtrl, ecu-extract-reference=COMPOSITIONTYPE.CtAp_DrvAsscCtrl
      CtAp_VehStabyCtrl: upstream-reference=EcuSwComposition.CtAp_ChassisMgmt.CtAp_VehStabyCtrl, ecu-extract-reference=COMPOSITIONTYPE.CtAp_VehStabyCtrl
      CtAp_CrpCtrl: upstream-reference=EcuSwComposition.CtAp_ChassisMgmt.CtAp_CrpCtrl, ecu-extract-reference=COMPOSITIONTYPE.CtAp_CrpCtrl
      CtAp_CoastCtrl: upstream-reference=EcuSwComposition.CtAp_ChassisMgmt.CtAp_CoastCtrl, ecu-extract-reference=COMPOSITIONTYPE.CtAp_CoastCtrl
      CtAp_DrvTorqCoor: upstream-reference=EcuSwComposition.CtAp_ChassisMgmt.CtAp_DrvTorqCoor, ecu-extract-reference=COMPOSITIONTYPE.CtAp_DrvTorqCoor
      CtAp_OnePedCtrl: upstream-reference=EcuSwComposition.CtAp_ChassisMgmt.CtAp_OnePedCtrl, ecu-extract-reference=COMPOSITIONTYPE.CtAp_OnePedCtrl
      CtAp_SpdLmt: upstream-reference=EcuSwComposition.CtAp_TorqPahMgmt.CtAp_SpdLmt, ecu-extract-reference=COMPOSITIONTYPE.CtAp_SpdLmt
      CtAp_TorqFil: upstream-reference=EcuSwComposition.CtAp_TorqPahMgmt.CtAp_TorqFil, ecu-extract-reference=COMPOSITIONTYPE.CtAp_TorqFil
      CtAp_TorqCrossZr: upstream-reference=EcuSwComposition.CtAp_TorqPahMgmt.CtAp_TorqCrossZr, ecu-extract-reference=COMPOSITIONTYPE.CtAp_TorqCrossZr
      CtAp_TorqCoor: upstream-reference=EcuSwComposition.CtAp_TorqPahMgmt.CtAp_TorqCoor, ecu-extract-reference=COMPOSITIONTYPE.CtAp_TorqCoor
      CtAp_TorqDamp: upstream-reference=EcuSwComposition.CtAp_TorqPahMgmt.CtAp_TorqDamp, ecu-extract-reference=COMPOSITIONTYPE.CtAp_TorqDamp
      CtAp_TorqModMap: upstream-reference=EcuSwComposition.CtAp_TorqPahMgmt.CtAp_TorqModMap, ecu-extract-reference=COMPOSITIONTYPE.CtAp_TorqModMap
      CtAp_TrsmProtd: upstream-reference=EcuSwComposition.CtAp_TorqPahMgmt.CtAp_TrsmProtd, ecu-extract-reference=COMPOSITIONTYPE.CtAp_TrsmProtd
      CtAp_TorqLmt: upstream-reference=EcuSwComposition.CtAp_TorqPahMgmt.CtAp_TorqLmt, ecu-extract-reference=COMPOSITIONTYPE.CtAp_TorqLmt
      CtAp_HVSfty: upstream-reference=EcuSwComposition.CtAp_ErrMgmt.CtAp_HVSfty, ecu-extract-reference=COMPOSITIONTYPE.CtAp_HVSfty
      CtAp_FltReactn: upstream-reference=EcuSwComposition.CtAp_ErrMgmt.CtAp_FltReactn, ecu-extract-reference=COMPOSITIONTYPE.CtAp_FltReactn
      CtAp_ChrgMod: upstream-reference=EcuSwComposition.CtAp_DCChrMgmt.CtAp_ChrgMod, ecu-extract-reference=COMPOSITIONTYPE.CtAp_ChrgMod
      CtAp_DCParMgmt: upstream-reference=EcuSwComposition.CtAp_DCChrMgmt.CtAp_DCParMgmt, ecu-extract-reference=COMPOSITIONTYPE.CtAp_DCParMgmt
      CtAp_ChrgSeqCtrl: upstream-reference=EcuSwComposition.CtAp_DCChrMgmt.CtAp_ChrgSeqCtrl, ecu-extract-reference=COMPOSITIONTYPE.CtAp_ChrgSeqCtrl
      CtAp_ChrgComM: upstream-reference=EcuSwComposition.CtAp_DCChrMgmt.CtAp_ChrgComM, ecu-extract-reference=COMPOSITIONTYPE.CtAp_ChrgComM
      CtAp_GearCal: upstream-reference=EcuSwComposition.CtAp_GearMgmt.CtAp_GearCal, ecu-extract-reference=COMPOSITIONTYPE.CtAp_GearCal
      CtAp_HWHandler: upstream-reference=EcuSwComposition.CtAp_HWHandler, ecu-extract-reference=COMPOSITIONTYPE.CtAp_HWHandler
      CtAp_LINHandler: upstream-reference=EcuSwComposition.CtAp_LINHandler, ecu-extract-reference=COMPOSITIONTYPE.CtAp_LINHandler
      CtAp_DCComM: upstream-reference=EcuSwComposition.CtAp_DCComM, ecu-extract-reference=COMPOSITIONTYPE.CtAp_DCComM
      CtAp_DiagnosisApp: upstream-reference=EcuSwComposition.CtAp_DiagnosisApp, ecu-extract-reference=COMPOSITIONTYPE.CtAp_DiagnosisApp
