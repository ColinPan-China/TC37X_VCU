AUTOSAR XML (schema 00049)
package /COM/VECTOR/CFG/WORKFLOW/SYSDESC/SYNC
  flat map FLATMAP
    260 x flat instance descriptor:
      SWC1: upstream-reference=EcuSwComposition.SWC1, ecu-extract-reference=COMPOSITIONTYPE.SWC1
      PowerMng_SWC: upstream-reference=EcuSwComposition.PowerMng_SWC, ecu-extract-reference=COMPOSITIONTYPE.PowerMng_SWC
      VcuRxMsg1_Sig0: upstream-reference=EcuSwComposition.VcuRxMsg1_Sig0.VcuRxMsg1_Sig0, ecu-extract-reference=COMPOSITIONTYPE.VcuRxMsg1_Sig0.VcuRxMsg1_Sig0
      VcuRxMsg1_Sig0_001: upstream-reference=EcuSwComposition.VcuRxMsg1_Sig0, ecu-extract-reference=COMPOSITIONTYPE.VcuRxMsg1_Sig0
      VcuRxMsg1_Sig2: upstream-reference=EcuSwComposition.VcuRxMsg1_Sig2.VcuRxMsg1_Sig2, ecu-extract-reference=COMPOSITIONTYPE.VcuRxMsg1_Sig2.VcuRxMsg1_Sig2
      VcuRxMsg1_Sig2_001: upstream-reference=EcuSwComposition.VcuRxMsg1_Sig2, ecu-extract-reference=COMPOSITIONTYPE.VcuRxMsg1_Sig2
      VcuRxMsg1_Sig1: upstream-reference=EcuSwComposition.VcuRxMsg1_Sig1.VcuRxMsg1_Sig1, ecu-extract-reference=COMPOSITIONTYPE.VcuRxMsg1_Sig1.VcuRxMsg1_Sig1
      VcuRxMsg1_Sig1_001: upstream-reference=EcuSwComposition.VcuRxMsg1_Sig1, ecu-extract-reference=COMPOSITIONTYPE.VcuRxMsg1_Sig1
      VcuRxMsg2_Sig3: upstream-reference=EcuSwComposition.VcuRxMsg2_Sig3.VcuRxMsg2_Sig3, ecu-extract-reference=COMPOSITIONTYPE.VcuRxMsg2_Sig3.VcuRxMsg2_Sig3
      VcuRxMsg2_Sig3_001: upstream-reference=EcuSwComposition.VcuRxMsg2_Sig3, ecu-extract-reference=COMPOSITIONTYPE.VcuRxMsg2_Sig3
      VcuRxMsg1_Sig3: upstream-reference=EcuSwComposition.VcuRxMsg1_Sig3.VcuRxMsg1_Sig3, ecu-extract-reference=COMPOSITIONTYPE.VcuRxMsg1_Sig3.VcuRxMsg1_Sig3
      VcuRxMsg1_Sig3_001: upstream-reference=EcuSwComposition.VcuRxMsg1_Sig3, ecu-extract-reference=COMPOSITIONTYPE.VcuRxMsg1_Sig3
      VcuRxMsg2_Sig0: upstream-reference=EcuSwComposition.VcuRxMsg2_Sig0.VcuRxMsg2_Sig0, ecu-extract-reference=COMPOSITIONTYPE.VcuRxMsg2_Sig0.VcuRxMsg2_Sig0
      VcuRxMsg2_Sig0_001: upstream-reference=EcuSwComposition.VcuRxMsg2_Sig0, ecu-extract-reference=COMPOSITIONTYPE.VcuRxMsg2_Sig0
      VcuRxMsg2_Sig2: upstream-reference=EcuSwComposition.VcuRxMsg2_Sig2.VcuRxMsg2_Sig2, ecu-extract-reference=COMPOSITIONTYPE.VcuRxMsg2_Sig2.VcuRxMsg2_Sig2
      VcuRxMsg2_Sig2_001: upstream-reference=EcuSwComposition.VcuRxMsg2_Sig2, ecu-extract-reference=COMPOSITIONTYPE.VcuRxMsg2_Sig2
      VcuRxMsg2_Sig1: upstream-reference=EcuSwComposition.VcuRxMsg2_Sig1.VcuRxMsg2_Sig1, ecu-extract-reference=COMPOSITIONTYPE.VcuRxMsg2_Sig1.VcuRxMsg2_Sig1
      VcuRxMsg2_Sig1_001: upstream-reference=EcuSwComposition.VcuRxMsg2_Sig1, ecu-extract-reference=COMPOSITIONTYPE.VcuRxMsg2_Sig1
      VcuTxMsg1_Sig1: upstream-reference=EcuSwComposition.VcuTxMsg1_Sig1.VcuTxMsg1_Sig1, ecu-extract-reference=COMPOSITIONTYPE.VcuTxMsg1_Sig1.VcuTxMsg1_Sig1
      VcuTxMsg1_Sig1_001: upstream-reference=EcuSwComposition.VcuTxMsg1_Sig1, ecu-extract-reference=COMPOSITIONTYPE.VcuTxMsg1_Sig1
      VcuTxMsg2_Sig1: upstream-reference=EcuSwComposition.VcuTxMsg2_Sig1.VcuTxMsg2_Sig1, ecu-extract-reference=COMPOSITIONTYPE.VcuTxMsg2_Sig1.VcuTxMsg2_Sig1
      VcuTxMsg2_Sig1_001: upstream-reference=EcuSwComposition.VcuTxMsg2_Sig1, ecu-extract-reference=COMPOSITIONTYPE.VcuTxMsg2_Sig1
      VcuTxMsg2_Sig2: upstream-reference=EcuSwComposition.VcuTxMsg2_Sig2.VcuTxMsg2_Sig2, ecu-extract-reference=COMPOSITIONTYPE.VcuTxMsg2_Sig2.VcuTxMsg2_Sig2
      VcuTxMsg2_Sig2_001: upstream-reference=EcuSwComposition.VcuTxMsg2_Sig2, ecu-extract-reference=COMPOSITIONTYPE.VcuTxMsg2_Sig2
      VcuTxMsg1_Sig3: upstream-reference=EcuSwComposition.VcuTxMsg1_Sig3.VcuTxMsg1_Sig3, ecu-extract-reference=COMPOSITIONTYPE.VcuTxMsg1_Sig3.VcuTxMsg1_Sig3
      VcuTxMsg1_Sig3_001: upstream-reference=EcuSwComposition.VcuTxMsg1_Sig3, ecu-extract-reference=COMPOSITIONTYPE.VcuTxMsg1_Sig3
      VcuTxMsg2_Sig0: upstream-reference=EcuSwComposition.VcuTxMsg2_Sig0.VcuTxMsg2_Sig0, ecu-extract-reference=COMPOSITIONTYPE.VcuTxMsg2_Sig0.VcuTxMsg2_Sig0
      VcuTxMsg2_Sig0_001: upstream-reference=EcuSwComposition.VcuTxMsg2_Sig0, ecu-extract-reference=COMPOSITIONTYPE.VcuTxMsg2_Sig0
      VcuTxMsg2_Sig3: upstream-reference=EcuSwComposition.VcuTxMsg2_Sig3.VcuTxMsg2_Sig3, ecu-extract-reference=COMPOSITIONTYPE.VcuTxMsg2_Sig3.VcuTxMsg2_Sig3
      VcuTxMsg2_Sig3_001: upstream-reference=EcuSwComposition.VcuTxMsg2_Sig3, ecu-extract-reference=COMPOSITIONTYPE.VcuTxMsg2_Sig3
      VcuTxMsg1_Sig2: upstream-reference=EcuSwComposition.VcuTxMsg1_Sig2.VcuTxMsg1_Sig2, ecu-extract-reference=COMPOSITIONTYPE.VcuTxMsg1_Sig2.VcuTxMsg1_Sig2
      VcuTxMsg1_Sig2_001: upstream-reference=EcuSwComposition.VcuTxMsg1_Sig2, ecu-extract-reference=COMPOSITIONTYPE.VcuTxMsg1_Sig2
      VcuTxMsg1_Sig0: upstream-reference=EcuSwComposition.VcuTxMsg1_Sig0.VcuTxMsg1_Sig0, ecu-extract-reference=COMPOSITIONTYPE.VcuTxMsg1_Sig0.VcuTxMsg1_Sig0
      VcuTxMsg1_Sig0_001: upstream-reference=EcuSwComposition.VcuTxMsg1_Sig0, ecu-extract-reference=COMPOSITIONTYPE.VcuTxMsg1_Sig0
      Com_SWC: upstream-reference=EcuSwComposition.Com_SWC, ecu-extract-reference=COMPOSITIONTYPE.Com_SWC
      NvM_SWC: upstream-reference=EcuSwComposition.NvM_SWC, ecu-extract-reference=COMPOSITIONTYPE.NvM_SWC
      NvM_SWC_NVBlockDescriptor_UserData1: upstream-reference=COMPOSITIONTYPE.NvM_SWC.NVBlockDescriptor_UserData1
      NvM_SWC_NVBlockDescriptor_UserData2: upstream-reference=COMPOSITIONTYPE.NvM_SWC.NVBlockDescriptor_UserData2
      SWC1NvMService_AC3_SRBS_NvBlockNeed_UserData3NvM_PS_SWC1NvBlockNeed_UserData3: upstream-reference=COMPOSITIONTYPE.SWC1.NvBlockNeed_UserData3, ecu-extract-reference=SWC1NvMService_AC3_SRBS_NvBlockNeed_UserData3NvM_PS_SWC1NvBlockNeed_UserData3
      SWC1NvBlockNeed_UserData3: upstream-reference=COMPOSITIONTYPE.SWC1.NvBlockNeed_UserData3
      DIAG_SWC: upstream-reference=EcuSwComposition.DIAG_SWC, ecu-extract-reference=COMPOSITIONTYPE.DIAG_SWC
      DIAG_SWC_NvBlockNeed_DiagDID_00: upstream-reference=COMPOSITIONTYPE.DIAG_SWC.NvBlockNeed_DiagDID_00
      IoHwAb_SWC: upstream-reference=EcuSwComposition.IoHwAb_SWC, ecu-extract-reference=COMPOSITIONTYPE.IoHwAb_SWC
      EXT1_Valid: upstream-reference=EcuSwComposition.EXT1_Valid.EXT1_Valid, ecu-extract-reference=COMPOSITIONTYPE.EXT1_Valid.EXT1_Valid
      EXT1_Valid_001: upstream-reference=EcuSwComposition.EXT1_Valid, ecu-extract-reference=COMPOSITIONTYPE.EXT1_Valid
      EXT3_Valid: upstream-reference=EcuSwComposition.EXT3_Valid.EXT3_Valid, ecu-extract-reference=COMPOSITIONTYPE.EXT3_Valid.EXT3_Valid
      EXT3_Valid_001: upstream-reference=EcuSwComposition.EXT3_Valid, ecu-extract-reference=COMPOSITIONTYPE.EXT3_Valid
      EXT_A_IN4: upstream-reference=EcuSwComposition.EXT_A_IN4.EXT_A_IN4, ecu-extract-reference=COMPOSITIONTYPE.EXT_A_IN4.EXT_A_IN4
      EXT_A_IN4_001: upstream-reference=EcuSwComposition.EXT_A_IN4, ecu-extract-reference=COMPOSITIONTYPE.EXT_A_IN4
      EXT2_Valid: upstream-reference=EcuSwComposition.EXT2_Valid.EXT2_Valid, ecu-extract-reference=COMPOSITIONTYPE.EXT2_Valid.EXT2_Valid
      EXT2_Valid_001: upstream-reference=EcuSwComposition.EXT2_Valid, ecu-extract-reference=COMPOSITIONTYPE.EXT2_Valid
      EXT4_Valid: upstream-reference=EcuSwComposition.EXT4_Valid.EXT4_Valid, ecu-extract-reference=COMPOSITIONTYPE.EXT4_Valid.EXT4_Valid
      EXT4_Valid_001: upstream-reference=EcuSwComposition.EXT4_Valid, ecu-extract-reference=COMPOSITIONTYPE.EXT4_Valid
      EXT_A_IN1: upstream-reference=EcuSwComposition.EXT_A_IN1.EXT_A_IN1, ecu-extract-reference=COMPOSITIONTYPE.EXT_A_IN1.EXT_A_IN1
      EXT_A_IN1_001: upstream-reference=EcuSwComposition.EXT_A_IN1, ecu-extract-reference=COMPOSITIONTYPE.EXT_A_IN1
      EXT_A_IN2: upstream-reference=EcuSwComposition.EXT_A_IN2.EXT_A_IN2, ecu-extract-reference=COMPOSITIONTYPE.EXT_A_IN2.EXT_A_IN2
      EXT_A_IN2_001: upstream-reference=EcuSwComposition.EXT_A_IN2, ecu-extract-reference=COMPOSITIONTYPE.EXT_A_IN2
      EXT_A_IN3: upstream-reference=EcuSwComposition.EXT_A_IN3.EXT_A_IN3, ecu-extract-reference=COMPOSITIONTYPE.EXT_A_IN3.EXT_A_IN3
      EXT_A_IN3_001: upstream-reference=EcuSwComposition.EXT_A_IN3, ecu-extract-reference=COMPOSITIONTYPE.EXT_A_IN3
      EXT10_Valid: upstream-reference=EcuSwComposition.EXT10_Valid.EXT10_Valid, ecu-extract-reference=COMPOSITIONTYPE.EXT10_Valid.EXT10_Valid
      EXT10_Valid_001: upstream-reference=EcuSwComposition.EXT10_Valid, ecu-extract-reference=COMPOSITIONTYPE.EXT10_Valid
      EXT12_Valid: upstream-reference=EcuSwComposition.EXT12_Valid.EXT12_Valid, ecu-extract-reference=COMPOSITIONTYPE.EXT12_Valid.EXT12_Valid
      EXT12_Valid_001: upstream-reference=EcuSwComposition.EXT12_Valid, ecu-extract-reference=COMPOSITIONTYPE.EXT12_Valid
      EXT15_Valid: upstream-reference=EcuSwComposition.EXT15_Valid.EXT15_Valid, ecu-extract-reference=COMPOSITIONTYPE.EXT15_Valid.EXT15_Valid
      EXT15_Valid_001: upstream-reference=EcuSwComposition.EXT15_Valid, ecu-extract-reference=COMPOSITIONTYPE.EXT15_Valid
      EXT5_Valid: upstream-reference=EcuSwComposition.EXT5_Valid.EXT5_Valid, ecu-extract-reference=COMPOSITIONTYPE.EXT5_Valid.EXT5_Valid
      EXT5_Valid_001: upstream-reference=EcuSwComposition.EXT5_Valid, ecu-extract-reference=COMPOSITIONTYPE.EXT5_Valid
      EXT_A_IN15: upstream-reference=EcuSwComposition.EXT_A_IN15.EXT_A_IN15, ecu-extract-reference=COMPOSITIONTYPE.EXT_A_IN15.EXT_A_IN15
      EXT_A_IN15_001: upstream-reference=EcuSwComposition.EXT_A_IN15, ecu-extract-reference=COMPOSITIONTYPE.EXT_A_IN15
      EXT7_Valid: upstream-reference=EcuSwComposition.EXT7_Valid.EXT7_Valid, ecu-extract-reference=COMPOSITIONTYPE.EXT7_Valid.EXT7_Valid
      EXT7_Valid_001: upstream-reference=EcuSwComposition.EXT7_Valid, ecu-extract-reference=COMPOSITIONTYPE.EXT7_Valid
      EXT_A_IN13: upstream-reference=EcuSwComposition.EXT_A_IN13.EXT_A_IN13, ecu-extract-reference=COMPOSITIONTYPE.EXT_A_IN13.EXT_A_IN13
      EXT_A_IN13_001: upstream-reference=EcuSwComposition.EXT_A_IN13, ecu-extract-reference=COMPOSITIONTYPE.EXT_A_IN13
      EXT_A_IN5: upstream-reference=EcuSwComposition.EXT_A_IN5.EXT_A_IN5, ecu-extract-reference=COMPOSITIONTYPE.EXT_A_IN5.EXT_A_IN5
      EXT_A_IN5_001: upstream-reference=EcuSwComposition.EXT_A_IN5, ecu-extract-reference=COMPOSITIONTYPE.EXT_A_IN5
      EXT6_Valid: upstream-reference=EcuSwComposition.EXT6_Valid.EXT6_Valid, ecu-extract-reference=COMPOSITIONTYPE.EXT6_Valid.EXT6_Valid
      EXT6_Valid_001: upstream-reference=EcuSwComposition.EXT6_Valid, ecu-extract-reference=COMPOSITIONTYPE.EXT6_Valid
      EXT_A_IN12: upstream-reference=EcuSwComposition.EXT_A_IN12.EXT_A_IN12, ecu-extract-reference=COMPOSITIONTYPE.EXT_A_IN12.EXT_A_IN12
      EXT_A_IN12_001: upstream-reference=EcuSwComposition.EXT_A_IN12, ecu-extract-reference=COMPOSITIONTYPE.EXT_A_IN12
      EXT_A_IN7: upstream-reference=EcuSwComposition.EXT_A_IN7.EXT_A_IN7, ecu-extract-reference=COMPOSITIONTYPE.EXT_A_IN7.EXT_A_IN7
      EXT_A_IN7_001: upstream-reference=EcuSwComposition.EXT_A_IN7, ecu-extract-reference=COMPOSITIONTYPE.EXT_A_IN7
      EXT13_Valid: upstream-reference=EcuSwComposition.EXT13_Valid.EXT13_Valid, ecu-extract-reference=COMPOSITIONTYPE.EXT13_Valid.EXT13_Valid
      EXT13_Valid_001: upstream-reference=EcuSwComposition.EXT13_Valid, ecu-extract-reference=COMPOSITIONTYPE.EXT13_Valid
      EXT_A_IN9: upstream-reference=EcuSwComposition.EXT_A_IN9.EXT_A_IN9, ecu-extract-reference=COMPOSITIONTYPE.EXT_A_IN9.EXT_A_IN9
      EXT_A_IN9_001: upstream-reference=EcuSwComposition.EXT_A_IN9, ecu-extract-reference=COMPOSITIONTYPE.EXT_A_IN9
      EXT9_Valid: upstream-reference=EcuSwComposition.EXT9_Valid.EXT9_Valid, ecu-extract-reference=COMPOSITIONTYPE.EXT9_Valid.EXT9_Valid
      EXT9_Valid_001: upstream-reference=EcuSwComposition.EXT9_Valid, ecu-extract-reference=COMPOSITIONTYPE.EXT9_Valid
      EXT8_Valid: upstream-reference=EcuSwComposition.EXT8_Valid.EXT8_Valid, ecu-extract-reference=COMPOSITIONTYPE.EXT8_Valid.EXT8_Valid
      EXT8_Valid_001: upstream-reference=EcuSwComposition.EXT8_Valid, ecu-extract-reference=COMPOSITIONTYPE.EXT8_Valid
      EXT11_Valid: upstream-reference=EcuSwComposition.EXT11_Valid.EXT11_Valid, ecu-extract-reference=COMPOSITIONTYPE.EXT11_Valid.EXT11_Valid
      EXT11_Valid_001: upstream-reference=EcuSwComposition.EXT11_Valid, ecu-extract-reference=COMPOSITIONTYPE.EXT11_Valid
      EXT_A_IN6: upstream-reference=EcuSwComposition.EXT_A_IN6.EXT_A_IN6, ecu-extract-reference=COMPOSITIONTYPE.EXT_A_IN6.EXT_A_IN6
      EXT_A_IN6_001: upstream-reference=EcuSwComposition.EXT_A_IN6, ecu-extract-reference=COMPOSITIONTYPE.EXT_A_IN6
      EXT16_Valid: upstream-reference=EcuSwComposition.EXT16_Valid.EXT16_Valid, ecu-extract-reference=COMPOSITIONTYPE.EXT16_Valid.EXT16_Valid
      EXT16_Valid_001: upstream-reference=EcuSwComposition.EXT16_Valid, ecu-extract-reference=COMPOSITIONTYPE.EXT16_Valid
      EXT14_Valid: upstream-reference=EcuSwComposition.EXT14_Valid.EXT14_Valid, ecu-extract-reference=COMPOSITIONTYPE.EXT14_Valid.EXT14_Valid
      EXT14_Valid_001: upstream-reference=EcuSwComposition.EXT14_Valid, ecu-extract-reference=COMPOSITIONTYPE.EXT14_Valid
      EXT_A_IN16: upstream-reference=EcuSwComposition.EXT_A_IN16.EXT_A_IN16, ecu-extract-reference=COMPOSITIONTYPE.EXT_A_IN16.EXT_A_IN16
      EXT_A_IN16_001: upstream-reference=EcuSwComposition.EXT_A_IN16, ecu-extract-reference=COMPOSITIONTYPE.EXT_A_IN16
      EXT_A_IN11: upstream-reference=EcuSwComposition.EXT_A_IN11.EXT_A_IN11, ecu-extract-reference=COMPOSITIONTYPE.EXT_A_IN11.EXT_A_IN11
      EXT_A_IN11_001: upstream-reference=EcuSwComposition.EXT_A_IN11, ecu-extract-reference=COMPOSITIONTYPE.EXT_A_IN11
      EXT_A_IN8: upstream-reference=EcuSwComposition.EXT_A_IN8.EXT_A_IN8, ecu-extract-reference=COMPOSITIONTYPE.EXT_A_IN8.EXT_A_IN8
      EXT_A_IN8_001: upstream-reference=EcuSwComposition.EXT_A_IN8, ecu-extract-reference=COMPOSITIONTYPE.EXT_A_IN8
      EXT_A_IN14: upstream-reference=EcuSwComposition.EXT_A_IN14.EXT_A_IN14, ecu-extract-reference=COMPOSITIONTYPE.EXT_A_IN14.EXT_A_IN14
      EXT_A_IN14_001: upstream-reference=EcuSwComposition.EXT_A_IN14, ecu-extract-reference=COMPOSITIONTYPE.EXT_A_IN14
      EXT_A_IN10: upstream-reference=EcuSwComposition.EXT_A_IN10.EXT_A_IN10, ecu-extract-reference=COMPOSITIONTYPE.EXT_A_IN10.EXT_A_IN10
      EXT_A_IN10_001: upstream-reference=EcuSwComposition.EXT_A_IN10, ecu-extract-reference=COMPOSITIONTYPE.EXT_A_IN10
      ECC_PMP2_SpdSet: upstream-reference=EcuSwComposition.ECC_PMP2_SpdSet.ECC_PMP2_SpdSet, ecu-extract-reference=COMPOSITIONTYPE.ECC_PMP2_SpdSet.ECC_PMP2_SpdSet
      ECC_PMP2_SpdSet_001: upstream-reference=EcuSwComposition.ECC_PMP2_SpdSet, ecu-extract-reference=COMPOSITIONTYPE.ECC_PMP2_SpdSet
      ECC_PMP3_SpdSet: upstream-reference=EcuSwComposition.ECC_PMP3_SpdSet.ECC_PMP3_SpdSet, ecu-extract-reference=COMPOSITIONTYPE.ECC_PMP3_SpdSet.ECC_PMP3_SpdSet
      ECC_PMP3_SpdSet_001: upstream-reference=EcuSwComposition.ECC_PMP3_SpdSet, ecu-extract-reference=COMPOSITIONTYPE.ECC_PMP3_SpdSet
      DIAG_SWC_NvMService_AC3_SRBS_NvBlockNeed_AttemptCounterNvM_PS_DIAG_SWC_NvBlockNeed_AttemptCounter: upstream-reference=COMPOSITIONTYPE.DIAG_SWC.NvBlockNeed_AttemptCounter, ecu-extract-reference=DIAG_SWC_NvMService_AC3_SRBS_NvBlockNeed_AttemptCounterNvM_PS_DIAG_SWC_NvBlockNeed_AttemptCounter
      DIAG_SWC_NvBlockNeed_AttemptCounter: upstream-reference=COMPOSITIONTYPE.DIAG_SWC.NvBlockNeed_AttemptCounter
      AN30: upstream-reference=EcuSwComposition.AN30.AN30, ecu-extract-reference=COMPOSITIONTYPE.AN30.AN30
      AN30_001: upstream-reference=EcuSwComposition.AN30, ecu-extract-reference=COMPOSITIONTYPE.AN30
      AN22: upstream-reference=EcuSwComposition.AN22.AN22, ecu-extract-reference=COMPOSITIONTYPE.AN22.AN22
      AN22_001: upstream-reference=EcuSwComposition.AN22, ecu-extract-reference=COMPOSITIONTYPE.AN22
      AN27: upstream-reference=EcuSwComposition.AN27.AN27, ecu-extract-reference=COMPOSITIONTYPE.AN27.AN27
      AN27_001: upstream-reference=EcuSwComposition.AN27, ecu-extract-reference=COMPOSITIONTYPE.AN27
      AN10: upstream-reference=EcuSwComposition.AN10.AN10, ecu-extract-reference=COMPOSITIONTYPE.AN10.AN10
      AN10_001: upstream-reference=EcuSwComposition.AN10, ecu-extract-reference=COMPOSITIONTYPE.AN10
      AN24: upstream-reference=EcuSwComposition.AN24.AN24, ecu-extract-reference=COMPOSITIONTYPE.AN24.AN24
      AN24_001: upstream-reference=EcuSwComposition.AN24, ecu-extract-reference=COMPOSITIONTYPE.AN24
      AN13: upstream-reference=EcuSwComposition.AN13.AN13, ecu-extract-reference=COMPOSITIONTYPE.AN13.AN13
      AN13_001: upstream-reference=EcuSwComposition.AN13, ecu-extract-reference=COMPOSITIONTYPE.AN13
      AN8: upstream-reference=EcuSwComposition.AN8.AN8, ecu-extract-reference=COMPOSITIONTYPE.AN8.AN8
      AN8_001: upstream-reference=EcuSwComposition.AN8, ecu-extract-reference=COMPOSITIONTYPE.AN8
      AN0: upstream-reference=EcuSwComposition.AN0.AN0, ecu-extract-reference=COMPOSITIONTYPE.AN0.AN0
      AN0_001: upstream-reference=EcuSwComposition.AN0, ecu-extract-reference=COMPOSITIONTYPE.AN0
      AN26: upstream-reference=EcuSwComposition.AN26.AN26, ecu-extract-reference=COMPOSITIONTYPE.AN26.AN26
      AN26_001: upstream-reference=EcuSwComposition.AN26, ecu-extract-reference=COMPOSITIONTYPE.AN26
      AN29: upstream-reference=EcuSwComposition.AN29.AN29, ecu-extract-reference=COMPOSITIONTYPE.AN29.AN29
      AN29_001: upstream-reference=EcuSwComposition.AN29, ecu-extract-reference=COMPOSITIONTYPE.AN29
      AN3: upstream-reference=EcuSwComposition.AN3.AN3, ecu-extract-reference=COMPOSITIONTYPE.AN3.AN3
      AN3_001: upstream-reference=EcuSwComposition.AN3, ecu-extract-reference=COMPOSITIONTYPE.AN3
      AN19: upstream-reference=EcuSwComposition.AN19.AN19, ecu-extract-reference=COMPOSITIONTYPE.AN19.AN19
      AN19_001: upstream-reference=EcuSwComposition.AN19, ecu-extract-reference=COMPOSITIONTYPE.AN19
      AN14: upstream-reference=EcuSwComposition.AN14.AN14, ecu-extract-reference=COMPOSITIONTYPE.AN14.AN14
      AN14_001: upstream-reference=EcuSwComposition.AN14, ecu-extract-reference=COMPOSITIONTYPE.AN14
      AN42: upstream-reference=EcuSwComposition.AN42.AN42, ecu-extract-reference=COMPOSITIONTYPE.AN42.AN42
      AN42_001: upstream-reference=EcuSwComposition.AN42, ecu-extract-reference=COMPOSITIONTYPE.AN42
      AN25: upstream-reference=EcuSwComposition.AN25.AN25, ecu-extract-reference=COMPOSITIONTYPE.AN25.AN25
      AN25_001: upstream-reference=EcuSwComposition.AN25, ecu-extract-reference=COMPOSITIONTYPE.AN25
      AN12: upstream-reference=EcuSwComposition.AN12.AN12, ecu-extract-reference=COMPOSITIONTYPE.AN12.AN12
      AN12_001: upstream-reference=EcuSwComposition.AN12, ecu-extract-reference=COMPOSITIONTYPE.AN12
      AN9: upstream-reference=EcuSwComposition.AN9.AN9, ecu-extract-reference=COMPOSITIONTYPE.AN9.AN9
      AN9_001: upstream-reference=EcuSwComposition.AN9, ecu-extract-reference=COMPOSITIONTYPE.AN9
      AN31: upstream-reference=EcuSwComposition.AN31.AN31, ecu-extract-reference=COMPOSITIONTYPE.AN31.AN31
      AN31_001: upstream-reference=EcuSwComposition.AN31, ecu-extract-reference=COMPOSITIONTYPE.AN31
      AN18: upstream-reference=EcuSwComposition.AN18.AN18, ecu-extract-reference=COMPOSITIONTYPE.AN18.AN18
      AN18_001: upstream-reference=EcuSwComposition.AN18, ecu-extract-reference=COMPOSITIONTYPE.AN18
      AN5: upstream-reference=EcuSwComposition.AN5.AN5, ecu-extract-reference=COMPOSITIONTYPE.AN5.AN5
      AN5_001: upstream-reference=EcuSwComposition.AN5, ecu-extract-reference=COMPOSITIONTYPE.AN5
      AN20: upstream-reference=EcuSwComposition.AN20.AN20, ecu-extract-reference=COMPOSITIONTYPE.AN20.AN20
      AN20_001: upstream-reference=EcuSwComposition.AN20, ecu-extract-reference=COMPOSITIONTYPE.AN20
      AN43: upstream-reference=EcuSwComposition.AN43.AN43, ecu-extract-reference=COMPOSITIONTYPE.AN43.AN43
      AN43_001: upstream-reference=EcuSwComposition.AN43, ecu-extract-reference=COMPOSITIONTYPE.AN43
      AN15: upstream-reference=EcuSwComposition.AN15.AN15, ecu-extract-reference=COMPOSITIONTYPE.AN15.AN15
      AN15_001: upstream-reference=EcuSwComposition.AN15, ecu-extract-reference=COMPOSITIONTYPE.AN15
      AN46: upstream-reference=EcuSwComposition.AN46.AN46, ecu-extract-reference=COMPOSITIONTYPE.AN46.AN46
      AN46_001: upstream-reference=EcuSwComposition.AN46, ecu-extract-reference=COMPOSITIONTYPE.AN46
      AN32: upstream-reference=EcuSwComposition.AN32.AN32, ecu-extract-reference=COMPOSITIONTYPE.AN32.AN32
      AN32_001: upstream-reference=EcuSwComposition.AN32, ecu-extract-reference=COMPOSITIONTYPE.AN32
      AN34: upstream-reference=EcuSwComposition.AN34.AN34, ecu-extract-reference=COMPOSITIONTYPE.AN34.AN34
      AN34_001: upstream-reference=EcuSwComposition.AN34, ecu-extract-reference=COMPOSITIONTYPE.AN34
      AN36: upstream-reference=EcuSwComposition.AN36.AN36, ecu-extract-reference=COMPOSITIONTYPE.AN36.AN36
      AN36_001: upstream-reference=EcuSwComposition.AN36, ecu-extract-reference=COMPOSITIONTYPE.AN36
      AN41: upstream-reference=EcuSwComposition.AN41.AN41, ecu-extract-reference=COMPOSITIONTYPE.AN41.AN41
      AN41_001: upstream-reference=EcuSwComposition.AN41, ecu-extract-reference=COMPOSITIONTYPE.AN41
      AN44: upstream-reference=EcuSwComposition.AN44.AN44, ecu-extract-reference=COMPOSITIONTYPE.AN44.AN44
      AN44_001: upstream-reference=EcuSwComposition.AN44, ecu-extract-reference=COMPOSITIONTYPE.AN44
      AN6: upstream-reference=EcuSwComposition.AN6.AN6, ecu-extract-reference=COMPOSITIONTYPE.AN6.AN6
      AN6_001: upstream-reference=EcuSwComposition.AN6, ecu-extract-reference=COMPOSITIONTYPE.AN6
      AN2: upstream-reference=EcuSwComposition.AN2.AN2, ecu-extract-reference=COMPOSITIONTYPE.AN2.AN2
      AN2_001: upstream-reference=EcuSwComposition.AN2, ecu-extract-reference=COMPOSITIONTYPE.AN2
      AN7: upstream-reference=EcuSwComposition.AN7.AN7, ecu-extract-reference=COMPOSITIONTYPE.AN7.AN7
      AN7_001: upstream-reference=EcuSwComposition.AN7, ecu-extract-reference=COMPOSITIONTYPE.AN7
      AN11: upstream-reference=EcuSwComposition.AN11.AN11, ecu-extract-reference=COMPOSITIONTYPE.AN11.AN11
      AN11_001: upstream-reference=EcuSwComposition.AN11, ecu-extract-reference=COMPOSITIONTYPE.AN11
      AN40: upstream-reference=EcuSwComposition.AN40.AN40, ecu-extract-reference=COMPOSITIONTYPE.AN40.AN40
      AN40_001: upstream-reference=EcuSwComposition.AN40, ecu-extract-reference=COMPOSITIONTYPE.AN40
      AN47: upstream-reference=EcuSwComposition.AN47.AN47, ecu-extract-reference=COMPOSITIONTYPE.AN47.AN47
      AN47_001: upstream-reference=EcuSwComposition.AN47, ecu-extract-reference=COMPOSITIONTYPE.AN47
      AN1: upstream-reference=EcuSwComposition.AN1.AN1, ecu-extract-reference=COMPOSITIONTYPE.AN1.AN1
      AN1_001: upstream-reference=EcuSwComposition.AN1, ecu-extract-reference=COMPOSITIONTYPE.AN1
      AN28: upstream-reference=EcuSwComposition.AN28.AN28, ecu-extract-reference=COMPOSITIONTYPE.AN28.AN28
      AN28_001: upstream-reference=EcuSwComposition.AN28, ecu-extract-reference=COMPOSITIONTYPE.AN28
      AN37: upstream-reference=EcuSwComposition.AN37.AN37, ecu-extract-reference=COMPOSITIONTYPE.AN37.AN37
      AN37_001: upstream-reference=EcuSwComposition.AN37, ecu-extract-reference=COMPOSITIONTYPE.AN37
      AN21: upstream-reference=EcuSwComposition.AN21.AN21, ecu-extract-reference=COMPOSITIONTYPE.AN21.AN21
      AN21_001: upstream-reference=EcuSwComposition.AN21, ecu-extract-reference=COMPOSITIONTYPE.AN21
      AN33: upstream-reference=EcuSwComposition.AN33.AN33, ecu-extract-reference=COMPOSITIONTYPE.AN33.AN33
      AN33_001: upstream-reference=EcuSwComposition.AN33, ecu-extract-reference=COMPOSITIONTYPE.AN33
      AN23: upstream-reference=EcuSwComposition.AN23.AN23, ecu-extract-reference=COMPOSITIONTYPE.AN23.AN23
      AN23_001: upstream-reference=EcuSwComposition.AN23, ecu-extract-reference=COMPOSITIONTYPE.AN23
      AN4: upstream-reference=EcuSwComposition.AN4.AN4, ecu-extract-reference=COMPOSITIONTYPE.AN4.AN4
      AN4_001: upstream-reference=EcuSwComposition.AN4, ecu-extract-reference=COMPOSITIONTYPE.AN4
      AN16: upstream-reference=EcuSwComposition.AN16.AN16, ecu-extract-reference=COMPOSITIONTYPE.AN16.AN16
      AN16_001: upstream-reference=EcuSwComposition.AN16, ecu-extract-reference=COMPOSITIONTYPE.AN16
      AN17: upstream-reference=EcuSwComposition.AN17.AN17, ecu-extract-reference=COMPOSITIONTYPE.AN17.AN17
      AN17_001: upstream-reference=EcuSwComposition.AN17, ecu-extract-reference=COMPOSITIONTYPE.AN17
      AN35: upstream-reference=EcuSwComposition.AN35.AN35, ecu-extract-reference=COMPOSITIONTYPE.AN35.AN35
      AN35_001: upstream-reference=EcuSwComposition.AN35, ecu-extract-reference=COMPOSITIONTYPE.AN35
      AN45: upstream-reference=EcuSwComposition.AN45.AN45, ecu-extract-reference=COMPOSITIONTYPE.AN45.AN45
      AN45_001: upstream-reference=EcuSwComposition.AN45, ecu-extract-reference=COMPOSITIONTYPE.AN45
      AN38: upstream-reference=EcuSwComposition.AN38.AN38, ecu-extract-reference=COMPOSITIONTYPE.AN38.AN38
      AN38_001: upstream-reference=EcuSwComposition.AN38, ecu-extract-reference=COMPOSITIONTYPE.AN38
      AN39: upstream-reference=EcuSwComposition.AN39.AN39, ecu-extract-reference=COMPOSITIONTYPE.AN39.AN39
      AN39_001: upstream-reference=EcuSwComposition.AN39, ecu-extract-reference=COMPOSITIONTYPE.AN39
      IoHwAb: upstream-reference=EcuSwComposition.IoHwAb, ecu-extract-reference=COMPOSITIONTYPE.IoHwAb
      Tle888qk_Out23_En: upstream-reference=EcuSwComposition.Tle888qk_Out23_En.Tle888qk_Out23_En, ecu-extract-reference=COMPOSITIONTYPE.Tle888qk_Out23_En.Tle888qk_Out23_En
      Tle888qk_Out23_En_001: upstream-reference=EcuSwComposition.Tle888qk_Out23_En, ecu-extract-reference=COMPOSITIONTYPE.Tle888qk_Out23_En
      Tle888qk_Out22_En: upstream-reference=EcuSwComposition.Tle888qk_Out22_En.Tle888qk_Out22_En, ecu-extract-reference=COMPOSITIONTYPE.Tle888qk_Out22_En.Tle888qk_Out22_En
      Tle888qk_Out22_En_001: upstream-reference=EcuSwComposition.Tle888qk_Out22_En, ecu-extract-reference=COMPOSITIONTYPE.Tle888qk_Out22_En
      Tle888qk_Out21_En: upstream-reference=EcuSwComposition.Tle888qk_Out21_En.Tle888qk_Out21_En, ecu-extract-reference=COMPOSITIONTYPE.Tle888qk_Out21_En.Tle888qk_Out21_En
      Tle888qk_Out21_En_001: upstream-reference=EcuSwComposition.Tle888qk_Out21_En, ecu-extract-reference=COMPOSITIONTYPE.Tle888qk_Out21_En
      Bts7xx_HS3_En: upstream-reference=EcuSwComposition.Bts7xx_HS3_En.Bts7xx_HS3_En, ecu-extract-reference=COMPOSITIONTYPE.Bts7xx_HS3_En.Bts7xx_HS3_En
      Bts7xx_HS3_En_001: upstream-reference=EcuSwComposition.Bts7xx_HS3_En, ecu-extract-reference=COMPOSITIONTYPE.Bts7xx_HS3_En
      Bts7xx_HS1_En: upstream-reference=EcuSwComposition.Bts7xx_HS1_En.Bts7xx_HS1_En, ecu-extract-reference=COMPOSITIONTYPE.Bts7xx_HS1_En.Bts7xx_HS1_En
      Bts7xx_HS1_En_001: upstream-reference=EcuSwComposition.Bts7xx_HS1_En, ecu-extract-reference=COMPOSITIONTYPE.Bts7xx_HS1_En
      Bts7xx_HS4_En: upstream-reference=EcuSwComposition.Bts7xx_HS4_En.Bts7xx_HS4_En, ecu-extract-reference=COMPOSITIONTYPE.Bts7xx_HS4_En.Bts7xx_HS4_En
      Bts7xx_HS4_En_001: upstream-reference=EcuSwComposition.Bts7xx_HS4_En, ecu-extract-reference=COMPOSITIONTYPE.Bts7xx_HS4_En
      Bts7xx_HS2_En: upstream-reference=EcuSwComposition.Bts7xx_HS2_En.Bts7xx_HS2_En, ecu-extract-reference=COMPOSITIONTYPE.Bts7xx_HS2_En.Bts7xx_HS2_En
      Bts7xx_HS2_En_001: upstream-reference=EcuSwComposition.Bts7xx_HS2_En, ecu-extract-reference=COMPOSITIONTYPE.Bts7xx_HS2_En
      Tle888qk_Out24_En: upstream-reference=EcuSwComposition.Tle888qk_Out24_En.Tle888qk_Out24_En, ecu-extract-reference=COMPOSITIONTYPE.Tle888qk_Out24_En.Tle888qk_Out24_En
      Tle888qk_Out24_En_001: upstream-reference=EcuSwComposition.Tle888qk_Out24_En, ecu-extract-reference=COMPOSITIONTYPE.Tle888qk_Out24_En
      Tle9201_Dir: upstream-reference=EcuSwComposition.Tle9201_Dir.Tle9201_Dir, ecu-extract-reference=COMPOSITIONTYPE.Tle9201_Dir.Tle9201_Dir
      Tle9201_Dir_001: upstream-reference=EcuSwComposition.Tle9201_Dir, ecu-extract-reference=COMPOSITIONTYPE.Tle9201_Dir
      Tle9201_Pwm: upstream-reference=EcuSwComposition.Tle9201_Pwm.Tle9201_Pwm, ecu-extract-reference=COMPOSITIONTYPE.Tle9201_Pwm.Tle9201_Pwm
      Tle9201_Pwm_001: upstream-reference=EcuSwComposition.Tle9201_Pwm, ecu-extract-reference=COMPOSITIONTYPE.Tle9201_Pwm
      Tle9201_Dis: upstream-reference=EcuSwComposition.Tle9201_Dis.Tle9201_Dis, ecu-extract-reference=COMPOSITIONTYPE.Tle9201_Dis.Tle9201_Dis
      Tle9201_Dis_001: upstream-reference=EcuSwComposition.Tle9201_Dis, ecu-extract-reference=COMPOSITIONTYPE.Tle9201_Dis
      Tle4252d_en: upstream-reference=EcuSwComposition.Tle4252d_en.Tle4252d_en, ecu-extract-reference=COMPOSITIONTYPE.Tle4252d_en.Tle4252d_en
      Tle4252d_en_001: upstream-reference=EcuSwComposition.Tle4252d_en, ecu-extract-reference=COMPOSITIONTYPE.Tle4252d_en
      Tle888qk_Out22BriCfg: upstream-reference=EcuSwComposition.Tle888qk_Out22BriCfg.Tle888qk_Out22BriCfg, ecu-extract-reference=COMPOSITIONTYPE.Tle888qk_Out22BriCfg.Tle888qk_Out22BriCfg
      Tle888qk_Out22BriCfg_001: upstream-reference=EcuSwComposition.Tle888qk_Out22BriCfg, ecu-extract-reference=COMPOSITIONTYPE.Tle888qk_Out22BriCfg
      Tle888qk_Out23BriCfg: upstream-reference=EcuSwComposition.Tle888qk_Out23BriCfg.Tle888qk_Out23BriCfg, ecu-extract-reference=COMPOSITIONTYPE.Tle888qk_Out23BriCfg.Tle888qk_Out23BriCfg
      Tle888qk_Out23BriCfg_001: upstream-reference=EcuSwComposition.Tle888qk_Out23BriCfg, ecu-extract-reference=COMPOSITIONTYPE.Tle888qk_Out23BriCfg
      Tle888qk_Out21BriCfg: upstream-reference=EcuSwComposition.Tle888qk_Out21BriCfg.Tle888qk_Out21BriCfg, ecu-extract-reference=COMPOSITIONTYPE.Tle888qk_Out21BriCfg.Tle888qk_Out21BriCfg
      Tle888qk_Out21BriCfg_001: upstream-reference=EcuSwComposition.Tle888qk_Out21BriCfg, ecu-extract-reference=COMPOSITIONTYPE.Tle888qk_Out21BriCfg
      Tle888qk_Out24BriCfg: upstream-reference=EcuSwComposition.Tle888qk_Out24BriCfg.Tle888qk_Out24BriCfg, ecu-extract-reference=COMPOSITIONTYPE.Tle888qk_Out24BriCfg.Tle888qk_Out24BriCfg
      Tle888qk_Out24BriCfg_001: upstream-reference=EcuSwComposition.Tle888qk_Out24BriCfg, ecu-extract-reference=COMPOSITIONTYPE.Tle888qk_Out24BriCfg
      Ext_IN2: upstream-reference=EcuSwComposition.Ext_IN2.Ext_IN2, ecu-extract-reference=COMPOSITIONTYPE.Ext_IN2.Ext_IN2
      Ext_IN2_001: upstream-reference=EcuSwComposition.Ext_IN2, ecu-extract-reference=COMPOSITIONTYPE.Ext_IN2
      EXT_PWM_IN1_Duty: upstream-reference=EcuSwComposition.EXT_PWM_IN1_Duty.EXT_PWM_IN1_Duty, ecu-extract-reference=COMPOSITIONTYPE.EXT_PWM_IN1_Duty.EXT_PWM_IN1_Duty
      EXT_PWM_IN1_Duty_001: upstream-reference=EcuSwComposition.EXT_PWM_IN1_Duty, ecu-extract-reference=COMPOSITIONTYPE.EXT_PWM_IN1_Duty
      EXT_PWM_IN2_Duty: upstream-reference=EcuSwComposition.EXT_PWM_IN2_Duty.EXT_PWM_IN2_Duty, ecu-extract-reference=COMPOSITIONTYPE.EXT_PWM_IN2_Duty.EXT_PWM_IN2_Duty
      EXT_PWM_IN2_Duty_001: upstream-reference=EcuSwComposition.EXT_PWM_IN2_Duty, ecu-extract-reference=COMPOSITIONTYPE.EXT_PWM_IN2_Duty
      EXT_PWM_IN2_Period: upstream-reference=EcuSwComposition.EXT_PWM_IN2_Period.EXT_PWM_IN2_Period, ecu-extract-reference=COMPOSITIONTYPE.EXT_PWM_IN2_Period.EXT_PWM_IN2_Period
      EXT_PWM_IN2_Period_001: upstream-reference=EcuSwComposition.EXT_PWM_IN2_Period, ecu-extract-reference=COMPOSITIONTYPE.EXT_PWM_IN2_Period
      EXT_PWM_IN1_Period: upstream-reference=EcuSwComposition.EXT_PWM_IN1_Period.EXT_PWM_IN1_Period, ecu-extract-reference=COMPOSITIONTYPE.EXT_PWM_IN1_Period.EXT_PWM_IN1_Period
      EXT_PWM_IN1_Period_001: upstream-reference=EcuSwComposition.EXT_PWM_IN1_Period, ecu-extract-reference=COMPOSITIONTYPE.EXT_PWM_IN1_Period
      Tle888qk_Lout1_En: upstream-reference=EcuSwComposition.Tle888qk_Lout1_En.Tle888qk_Lout1_En, ecu-extract-reference=COMPOSITIONTYPE.Tle888qk_Lout1_En.Tle888qk_Lout1_En
      Tle888qk_Lout1_En_001: upstream-reference=EcuSwComposition.Tle888qk_Lout1_En, ecu-extract-reference=COMPOSITIONTYPE.Tle888qk_Lout1_En
      Tle888qk_Lout8_En: upstream-reference=EcuSwComposition.Tle888qk_Lout8_En.Tle888qk_Lout8_En, ecu-extract-reference=COMPOSITIONTYPE.Tle888qk_Lout8_En.Tle888qk_Lout8_En
      Tle888qk_Lout8_En_001: upstream-reference=EcuSwComposition.Tle888qk_Lout8_En, ecu-extract-reference=COMPOSITIONTYPE.Tle888qk_Lout8_En
      Tle888qk_Lout14_En: upstream-reference=EcuSwComposition.Tle888qk_Lout14_En.Tle888qk_Lout14_En, ecu-extract-reference=COMPOSITIONTYPE.Tle888qk_Lout14_En.Tle888qk_Lout14_En
      Tle888qk_Lout14_En_001: upstream-reference=EcuSwComposition.Tle888qk_Lout14_En, ecu-extract-reference=COMPOSITIONTYPE.Tle888qk_Lout14_En
      Tle888qk_Lout16_En: upstream-reference=EcuSwComposition.Tle888qk_Lout16_En.Tle888qk_Lout16_En, ecu-extract-reference=COMPOSITIONTYPE.Tle888qk_Lout16_En.Tle888qk_Lout16_En
      Tle888qk_Lout16_En_001: upstream-reference=EcuSwComposition.Tle888qk_Lout16_En, ecu-extract-reference=COMPOSITIONTYPE.Tle888qk_Lout16_En
