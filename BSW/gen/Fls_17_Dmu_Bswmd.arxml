AUTOSAR XML (schema 4-2-2)
# Copyright (C) Infineon Technologies (2020)
# All rights reserved.
package /AUTOSAR_Fls_17_Dmu/BswModuleDescriptions
  bsw module description Fls: category=BSW_MODULE, module-id=92  # FLS Driver
    provided-entrys:
      Fls_Init
      Fls_Erase
      Fls_Write
      Fls_Compare
      Fls_Cancel
      Fls_SetMode
      Fls_MainFunction
      Fls_Read
      Fls_GetStatus
      Fls_GetJobResult
      Fls_ReadWordsSync
      Fls_CompareWordsSync
      Fls_VerifyErase
      Fls_VerifySectorErase
      Fls_GetNotifCaller
      Fls_CancelNonEraseJobs
      Fls_GetOperStatus
      Fls_IsHardeningRequired
      Fls_ControlTimeoutDet
      Fls_BlankCheck
      Fls_InitCheck
    bsw module dependency DetDependency: target-module-id=15, required-entrys=[Det_ReportError, Det_ReportRuntimeError]
    bsw module dependency McalLibDependency: target-module-id=255, required-entrys=Mcal_WriteCpuEndInitProtReg
    bsw internal behavior FlsBehavior
      20 x bsw called entity:
        Fls_Init: reentrancy-level=NON-REENTRANT, implemented-entry=Fls_Init
        Fls_InitCheck: reentrancy-level=NON-REENTRANT, implemented-entry=Fls_InitCheck
        Fls_Erase: reentrancy-level=NON-REENTRANT, implemented-entry=Fls_Erase
        Fls_Write: reentrancy-level=NON-REENTRANT, implemented-entry=Fls_Write
        Fls_Compare: reentrancy-level=NON-REENTRANT, implemented-entry=Fls_Compare
        Fls_Cancel: reentrancy-level=NON-REENTRANT, implemented-entry=Fls_Cancel
        Fls_SetMode: reentrancy-level=NON-REENTRANT, implemented-entry=Fls_SetMode
        Fls_Read: reentrancy-level=NON-REENTRANT, implemented-entry=Fls_Read
        Fls_GetStatus: reentrancy-level=SINGLE-CORE-REENTRANT, implemented-entry=Fls_GetStatus
        Fls_GetJobResult: reentrancy-level=SINGLE-CORE-REENTRANT, implemented-entry=Fls_GetJobResult
        Fls_ReadWordsSync: reentrancy-level=NON-REENTRANT, implemented-entry=Fls_ReadWordsSync
        Fls_CompareWordsSync: reentrancy-level=NON-REENTRANT, implemented-entry=Fls_CompareWordsSync
        Fls_VerifyErase: reentrancy-level=NON-REENTRANT, implemented-entry=Fls_VerifyErase
        Fls_VerifySectorErase: reentrancy-level=NON-REENTRANT, implemented-entry=Fls_VerifySectorErase
        Fls_GetNotifCaller: reentrancy-level=NON-REENTRANT, implemented-entry=Fls_GetNotifCaller
        Fls_CancelNonEraseJobs: reentrancy-level=NON-REENTRANT, implemented-entry=Fls_CancelNonEraseJobs
        Fls_GetOperStatus: reentrancy-level=NON-REENTRANT, implemented-entry=Fls_GetOperStatus
        Fls_BlankCheck: reentrancy-level=NON-REENTRANT, implemented-entry=Fls_BlankCheck
        Fls_IsHardeningRequired: reentrancy-level=NON-REENTRANT, implemented-entry=Fls_IsHardeningRequired
        Fls_ControlTimeoutDet: reentrancy-level=NON-REENTRANT, implemented-entry=Fls_ControlTimeoutDet
      bsw schedulable entity Fls_MainFunction: minimum-start-interval=10.0, reentrancy-level=NON-REENTRANT, implemented-entry=Fls_MainFunction
      bsw timing event TimingEvent_Fls_MainFunction: starts-on-event=Fls_MainFunction, period=0.01
package /AUTOSAR_Fls_17_Dmu/BswModuleEntrys
  21 x bsw module entry, all with execution-context=TASK, sw-service-impl-policy=STANDARD:
    Fls_Init: service-id=0, is-reentrant=false, is-synchronous=true, call-type=REGULAR
      sw service arg ConfigPtr: category=DATA_REFERENCE, sw-pointer-target-props={target-category=TYPE_REFERENCE, implementation-data-type=Fls_17_Dmu_ConfigType}
    Fls_InitCheck: service-id=43, is-reentrant=false, is-synchronous=true, call-type=REGULAR
      return type Return: implementation-data-type=Std_ReturnType
      sw service arg ConfigPtr: category=DATA_REFERENCE, sw-pointer-target-props={target-category=TYPE_REFERENCE, implementation-data-type=Fls_17_Dmu_ConfigType}
    Fls_Erase: service-id=1, is-reentrant=false, is-synchronous=false, call-type=REGULAR
      return type Return: implementation-data-type=Std_ReturnType
      sw service arg TargetAddress: implementation-data-type=Fls_17_Dmu_AddressType
      sw service arg Length: implementation-data-type=Fls_17_Dmu_LengthType
    Fls_Write: service-id=2, is-reentrant=false, is-synchronous=false, call-type=REGULAR
      return type Return: implementation-data-type=Std_ReturnType
      sw service arg TargetAddress: implementation-data-type=Fls_17_Dmu_AddressType
      sw service arg SourceAddressPtr: category=DATA_REFERENCE, sw-pointer-target-props={target-category=TYPE_REFERENCE, implementation-data-type=uint8}
      sw service arg Length: implementation-data-type=Fls_17_Dmu_LengthType
    Fls_Compare: service-id=8, is-reentrant=false, is-synchronous=false, call-type=REGULAR
      return type Return: implementation-data-type=Std_ReturnType
      sw service arg SourceAddress: implementation-data-type=Fls_17_Dmu_AddressType
      sw service arg TargetAddressPtr: category=DATA_REFERENCE, sw-pointer-target-props={target-category=TYPE_REFERENCE, implementation-data-type=uint8}
      sw service arg Length: implementation-data-type=Fls_17_Dmu_LengthType
    Fls_Cancel: service-id=3, is-reentrant=false, is-synchronous=true, call-type=REGULAR
    Fls_BlankCheck: service-id=10, is-reentrant=false, is-synchronous=false, call-type=REGULAR
      return type Return: implementation-data-type=Std_ReturnType
      sw service arg TargetAddress: implementation-data-type=Fls_17_Dmu_AddressType
      sw service arg Length: implementation-data-type=Fls_17_Dmu_LengthType
    Fls_SetMode: service-id=9, is-reentrant=false, is-synchronous=true, call-type=REGULAR
      sw service arg Mode: implementation-data-type=MemIf_ModeType
    Fls_GetStatus: service-id=4, is-reentrant=true, is-synchronous=true, call-type=REGULAR
      return type Return: implementation-data-type=MemIf_StatusType
    Fls_GetJobResult: service-id=5, is-reentrant=true, is-synchronous=true, call-type=REGULAR
      return type Return: implementation-data-type=MemIf_JobResultType
    Fls_IsHardeningRequired: service-id=44, is-reentrant=false, is-synchronous=true, call-type=REGULAR
      return type Return: implementation-data-type=Std_ReturnType
      sw service arg TargetAddress: implementation-data-type=Fls_17_Dmu_AddressType
      sw service arg Length: implementation-data-type=Fls_17_Dmu_LengthType
    Fls_MainFunction: service-id=6, is-reentrant=false, is-synchronous=true, call-type=SCHEDULED
    Fls_Read: service-id=7, is-reentrant=false, is-synchronous=false, call-type=REGULAR
      return type Return: implementation-data-type=Std_ReturnType
      sw service arg SourceAddress: implementation-data-type=Fls_17_Dmu_AddressType
      sw service arg TargetAddressPtr: category=DATA_REFERENCE, sw-pointer-target-props={target-category=TYPE_REFERENCE, implementation-data-type=uint8}
      sw service arg Length: implementation-data-type=Fls_17_Dmu_LengthType
    Fls_ReadWordsSync: service-id=33, is-reentrant=false, is-synchronous=true, call-type=REGULAR
      return type Return: implementation-data-type=Std_ReturnType
      sw service arg SourceAddress: implementation-data-type=Fls_17_Dmu_AddressType
      sw service arg TargetAddressPtr: category=DATA_REFERENCE, sw-pointer-target-props={target-category=TYPE_REFERENCE, implementation-data-type=uint32}
      sw service arg Length: implementation-data-type=uint32
    Fls_CompareWordsSync: service-id=34, is-reentrant=false, is-synchronous=true, call-type=REGULAR
      return type Return: implementation-data-type=Std_ReturnType
      sw service arg SourceAddress: implementation-data-type=Fls_17_Dmu_AddressType
      sw service arg TargetAddressPtr: category=DATA_REFERENCE, sw-pointer-target-props={target-category=TYPE_REFERENCE, implementation-data-type=uint32}
      sw service arg Length: implementation-data-type=uint32
    Fls_VerifyErase: service-id=35, is-reentrant=false, is-synchronous=true, call-type=REGULAR
      return type Return: implementation-data-type=Std_ReturnType
      sw service arg BankNum: implementation-data-type=uint32
      sw service arg UnerasedWordlineAddressPtr: category=DATA_REFERENCE, sw-pointer-target-props={target-category=TYPE_REFERENCE, implementation-data-type=uint32}
      sw service arg UnerasedWordlineCountPtr: category=DATA_REFERENCE, sw-pointer-target-props={target-category=TYPE_REFERENCE, implementation-data-type=uint8}
    Fls_VerifySectorErase: service-id=36, is-reentrant=false, is-synchronous=true, call-type=REGULAR
      return type Return: implementation-data-type=Std_ReturnType
      4 x sw service arg:
        BankNum: implementation-data-type=uint32
        Sector: implementation-data-type=uint8
        UnerasedWordlineAddressPtr: category=DATA_REFERENCE, sw-pointer-target-props={target-category=TYPE_REFERENCE, implementation-data-type=uint32}
        UnerasedWordlineCountPtr: category=DATA_REFERENCE, sw-pointer-target-props={target-category=TYPE_REFERENCE, implementation-data-type=uint8}
    Fls_GetNotifCaller: service-id=41, is-reentrant=false, is-synchronous=true, call-type=REGULAR
      return type Return: implementation-data-type=Fls_17_Dmu_Job_Type
    Fls_CancelNonEraseJobs: service-id=40, is-reentrant=false, is-synchronous=true, call-type=REGULAR
    Fls_GetOperStatus: service-id=42, is-reentrant=false, is-synchronous=true, call-type=REGULAR
      return type Return: implementation-data-type=Std_ReturnType
    Fls_ControlTimeoutDet: service-id=39, is-reentrant=false, is-synchronous=true, call-type=REGULAR
      sw service arg Param: implementation-data-type=uint8
package /AUTOSAR_Fls_17_Dmu/Implementations
  bsw implementation Fls: programming-language=C, sw-version=10.40.1, vendor-id=17, ar-release-version=4.2.2, behavior=FlsBehavior, vendor-api-infix=Dmu, vendor-specific-module-def=Fls
    code-descriptors:
      code Files
        artifact-descriptors:
          short-label=src::Fls_17_Dmu.c, category=SWSRC
          short-label=inc::Fls_17_Dmu.h, category=SWHDR
          short-label=src::Fls_17_Dmu_ac.c, category=SWSRC
          short-label=inc::Fls_17_Dmu_ac.h, category=SWHDR
    generated-artifacts:
      5 x dependency on artifact:
        Fls_xdm: artifact-descriptor={short-label=config::Fls_17_Dmu.xdm, category=SWTOOL}, usages=CODEGENERATION
        Fls_bmd: artifact-descriptor={short-label=autosar::TC37x::TC377x::Fls_17_Dmu.bmd, category=SWTOOL}, usages=CODEGENERATION
        Fls_PBCfg_c: artifact-descriptor={short-label=generate::template::src::Fls_17_Dmu_PBcfg.c, category=SWTEMPLATE}, usages=EXECUTE
        Fls_Cfg_h: artifact-descriptor={short-label=generate::template::inc::Fls_17_Dmu_Cfg.h, category=SWTEMPLATE}, usages=COMPILE
        Fls_PBcfg_h: artifact-descriptor={short-label=generate::template::inc::Fls_17_Dmu_PBcfg.h, category=SWTEMPLATE}, usages=EXECUTE
    resource consumption ResourceConsumption
      4 x memory section:
        CODE_ASIL_B_LOCAL: alignment=UNSPECIFIED, sw-addrmethod=CODE
        VAR_CLEARED_ASIL_B_LOCAL_32: alignment=32, sw-addrmethod=VAR_CLEARED
        VAR_CLEARED_ASIL_B_LOCAL_UNSPECIFIED: alignment=UNSPECIFIED, sw-addrmethod=VAR_CLEARED
        CONFIG_DATA_ASIL_B_LOCAL_UNSPECIFIED: alignment=UNSPECIFIED, sw-addrmethod=CONFIG_DATA
      section name prefix FLS_17_DMU
package /AUTOSAR_Fls_17_Dmu/ImplementationDataTypes
  7 x impl type, all with type-emitter=BSW:
    Fls_17_Dmu_ConfigType: category=STRUCTURE
      10 x element:
        FlsStateVarPtr: category=DATA_REFERENCE, sw-pointer-target-props={target-category=TYPE_REFERENCE, implementation-data-type=Fls_17_Dmu_StateType}
        FlsFastRead: implementation-data-type=Fls_17_Dmu_LengthType
        FlsSlowRead: implementation-data-type=Fls_17_Dmu_LengthType
        FlsJobEndNotificationPtr: implementation-data-type=Fls_17_Dmu_NotifFunctionPtrType
        FlsJobErrorNotificationPtr: implementation-data-type=Fls_17_Dmu_NotifFunctionPtrType
        FlsIllegalStateNotificationPtr: implementation-data-type=Fls_17_Dmu_NotifFunctionPtrType
        FlsWaitStates: implementation-data-type=uint32
        FlsCallCycle: implementation-data-type=uint16
        FlsDefaultMode: implementation-data-type=MemIf_ModeType
        FlsEraseVerifyErrNotif: implementation-data-type=Fls_17_Dmu_NotifFunctionPtrType
    Fls_17_Dmu_StateType: category=STRUCTURE
      19 x element:
        FlsReadAddress: implementation-data-type=uint32
        FlsWriteAddress: implementation-data-type=uint32
        FlsEraseTimeoutCycleCount: implementation-data-type=uint32
        FlsWriteTimeoutCycleCount: implementation-data-type=uint32
        FlsReadLength: implementation-data-type=Fls_17_Dmu_LengthType
        FlsWriteLength: implementation-data-type=Fls_17_Dmu_LengthType
        FlsReadBufferPtr: category=DATA_REFERENCE, sw-pointer-target-props={target-category=TYPE_REFERENCE, implementation-data-type=uint8}
        FlsWriteBufferPtr: category=DATA_REFERENCE, sw-pointer-target-props={target-category=TYPE_REFERENCE, implementation-data-type=uint8}
        FlsJobResult: implementation-data-type=MemIf_JobResultType
        FlsMode: implementation-data-type=MemIf_ModeType
        NotifCaller: implementation-data-type=Fls_17_Dmu_Job_Type
        JobStarted: implementation-data-type=Fls_17_Dmu_JobStartType
        FlsJobType: implementation-data-type=uint8
        DriverInitialised: implementation-data-type=uint8
        FlsPver: implementation-data-type=uint8
        FlsOper: implementation-data-type=uint8
        FlsTimeoutErr: implementation-data-type=uint8
        FlsTimeoutControl: implementation-data-type=uint8
        FlsEver: implementation-data-type=uint8
    Fls_17_Dmu_LengthType: implementation-data-type=uint32
    Fls_17_Dmu_Job_Type: implementation-data-type=uint8
    Fls_17_Dmu_AddressType: implementation-data-type=uint32
    Fls_17_Dmu_NotifFunctionPtrType: category=FUNCTION_REFERENCE, sw-pointer-target-props=Fee_JobEndNotification
    Fls_17_Dmu_JobStartType: category=STRUCTURE
      6 x element, all with category=TYPE_REFERENCE, implementation-data-type=unsigned_int:
        Reserved1: sw-bit-representation=number-of-bits=1
        Write: sw-bit-representation=number-of-bits=1
        Erase: sw-bit-representation=number-of-bits=1
        Read: sw-bit-representation=number-of-bits=1
        Compare: sw-bit-representation=number-of-bits=1
        Reserved2: sw-bit-representation=number-of-bits=3
