AUTOSAR XML (schema 4-2-2)
# Copyright (C) Infineon Technologies (2020)
# All rights reserved.
package /AUTOSAR_Pwm_17_GtmCcu6/BswModuleDescriptions
  bsw module description Pwm: category=BSW_MODULE, module-id=121, provided-entrys=[Pwm_Init, Pwm_DeInit, Pwm_SetDutyCycle, Pwm_SetPeriodAndDuty, Pwm_SetOutputToIdle, Pwm_GetOutputState, Pwm_Isr]  # PWM Driver
    bsw module dependency DetDependency: target-module-id=15, required-entrys=Det_ReportError
    bsw module dependency McuDependency: target-module-id=101
      required-entrys:
        Mcu_17_Gtm_TomChannelInit
        Mcu_17_Gtm_TomChannelShadowTransfer
        Mcu_17_Gtm_ConnectTimerOutToPortPin
        Mcu_17_Gtm_AtomChannelInit
        Mcu_17_Gtm_AtomChannelShadowTransfer
        Mcu_17_Ccu6_TimerInit
        Mcu_17_Ccu6_TimerShadowTransfer
        Mcu_17_Ccu6_TimerIntEnDis
        Mcu_17_Ccu6_TimerStart
        Mcu_17_Ccu6_TimerStop
    bsw module dependency McalLibDependency: target-module-id=255, required-entrys=[Mcal_GetCpuIndex, Mcal_SetBitAtomic]
    bsw internal behavior PwmBehavior
      exclusive area HandleNotification
      exclusive area PeriodAndDutyUpdate
      6 x bsw called entity:
        Pwm_Init: reentrancy-level=NON-REENTRANT, implemented-entry=Pwm_Init
        Pwm_DeInit: reentrancy-level=NON-REENTRANT, implemented-entry=Pwm_DeInit
        Pwm_SetDutyCycle: can-enter-exclusive-area=[HandleNotification, PeriodAndDutyUpdate], reentrancy-level=MULTICORE-REENTRANT, implemented-entry=Pwm_SetDutyCycle
        Pwm_SetPeriodAndDuty: can-enter-exclusive-area=[HandleNotification, PeriodAndDutyUpdate], reentrancy-level=MULTICORE-REENTRANT, implemented-entry=Pwm_SetPeriodAndDuty
        Pwm_SetOutputToIdle: can-enter-exclusive-area=[HandleNotification, PeriodAndDutyUpdate], reentrancy-level=MULTICORE-REENTRANT, implemented-entry=Pwm_SetOutputToIdle
        Pwm_GetOutputState: reentrancy-level=MULTICORE-REENTRANT, implemented-entry=Pwm_GetOutputState
      bsw interrupt entity Pwm_Isr: reentrancy-level=NON-REENTRANT, implemented-entry=Pwm_Isr, interrupt-category=CAT-1, interrupt-source=SRC_GTMTOMxy, SRC_GTMATOMxy
package /AUTOSAR_Pwm_17_GtmCcu6/BswModuleEntrys
  7 x bsw module entry, all with is-synchronous=true, sw-service-impl-policy=STANDARD:
    Pwm_Init: service-id=0, is-reentrant=false, call-type=REGULAR, execution-context=TASK
      sw service arg ConfigPtr: category=DATA_REFERENCE, sw-pointer-target-props={target-category=TYPE_REFERENCE, implementation-data-type=Pwm_17_GtmCcu6_ConfigType}
    Pwm_DeInit: service-id=1, is-reentrant=false, call-type=REGULAR, execution-context=TASK
    Pwm_SetDutyCycle: service-id=2, is-reentrant=true, call-type=REGULAR, execution-context=TASK
      sw service arg ChannelNumber: implementation-data-type=Pwm_17_GtmCcu6_ChannelType
      sw service arg DutyCycle: implementation-data-type=uint16
    Pwm_SetPeriodAndDuty: service-id=3, is-reentrant=true, call-type=REGULAR, execution-context=TASK
      sw service arg ChannelNumber: implementation-data-type=Pwm_17_GtmCcu6_ChannelType
      sw service arg Period: implementation-data-type=Pwm_17_GtmCcu6_PeriodType
      sw service arg DutyCycle: implementation-data-type=uint16
    Pwm_SetOutputToIdle: service-id=4, is-reentrant=true, call-type=REGULAR, execution-context=TASK
      sw service arg ChannelNumber: implementation-data-type=Pwm_17_GtmCcu6_ChannelType
    Pwm_GetOutputState: service-id=5, is-reentrant=true, call-type=REGULAR, execution-context=TASK
      return type Return: implementation-data-type=Pwm_17_GtmCcu6_OutputStateType
      sw service arg ChannelNumber: implementation-data-type=Pwm_17_GtmCcu6_ChannelType
    Pwm_Isr: service-id=9, is-reentrant=false, call-type=INTERRUPT, execution-context=INTERRUPT-CAT-1
      sw service arg ChannelNumber: implementation-data-type=Pwm_17_GtmCcu6_ChannelType
package /AUTOSAR_Pwm_17_GtmCcu6/Implementations
  bsw implementation Pwm: programming-language=C, sw-version=10.40.2, vendor-id=17, ar-release-version=4.2.2, behavior=PwmBehavior, vendor-api-infix=GtmCcu6, vendor-specific-module-def=Pwm
    code-descriptors:
      code Files
        artifact-descriptors:
          short-label=src::Pwm_17_GtmCcu6.c, category=SWSRC
          short-label=inc::Pwm_17_GtmCcu6.h, category=SWHDR
          short-label=inc::Pwm_17_GtmCcu6_Cbk.h, category=SWHDR
    generated-artifacts:
      5 x dependency on artifact:
        Pwm_PBcfg_c: artifact-descriptor={short-label=plugins::Pwm_17_GtmCcu6_Aurix::generate::src::Pwm_17_GtmCcu6_PBcfg.c, category=SWTEMPLATE}, usages=EXECUTE
        Pwm_Cfg_h: artifact-descriptor={short-label=plugins::Pwm_17_GtmCcu6_Aurix::generate::inc::Pwm_17_GtmCcu6_Cfg.h, category=SWTEMPLATE}, usages=COMPILE
        Pwm_PBcfg_h: artifact-descriptor={short-label=plugins::Pwm_17_GtmCcu6_Aurix::generate::inc::Pwm_17_GtmCcu6_PBcfg.h, category=SWTEMPLATE}, usages=EXECUTE
        Pwm_xdm: artifact-descriptor={short-label=config::Pwm_17_GtmCcu6.xdm, category=SWTOOL}, usages=CODEGENERATION
        Pwm_bmd: artifact-descriptor={short-label=autosar::TC37x::TC377x::Pwm_17_GtmCcu6.bmd, category=SWTOOL}, usages=CODEGENERATION
    resource consumption ResourceConsumption
      7 x memory section:
        VAR_CLEARED_ASIL_B_GLOBAL_32: alignment=32, sw-addrmethod=VAR_CLEARED
        CODE_ASIL_B_GLOBAL: alignment=UNSPECIFIED, sw-addrmethod=CODE
        VAR_CLEARED_ASIL_B_CORE0_UNSPECIFIED: alignment=UNSPECIFIED, sw-addrmethod=VAR_CLEARED
        CONST_ASIL_B_GLOBAL_UNSPECIFIED: alignment=UNSPECIFIED, sw-addrmethod=CONST
        CONFIG_DATA_ASIL_B_GLOBAL_UNSPECIFIED: alignment=UNSPECIFIED, sw-addrmethod=CONFIG_DATA
        CONFIG_DATA_ASIL_B_CORE0_UNSPECIFIED: alignment=UNSPECIFIED, sw-addrmethod=CONFIG_DATA
        CODE_FAST_ASIL_B_GLOBAL: alignment=UNSPECIFIED, sw-addrmethod=CODE_FAST
      section name prefix PWM_17_GTMCCU6
package /AUTOSAR_Pwm_17_GtmCcu6/ImplementationDataTypes
  7 x impl type, all with type-emitter=BSW:
    Pwm_17_GtmCcu6_ChannelType: implementation-data-type=uint8
    Pwm_17_GtmCcu6_NotifiPtrType: category=FUNCTION_REFERENCE, sw-pointer-target-props=IoHwAb_Pwm_17_GtmCcu6Notification
    Pwm_17_GtmCcu6_PeriodType: implementation-data-type=uint32
    Pwm_17_GtmCcu6_OutputStateType: implementation-data-type=uint8
    Pwm_17_GtmCcu6_ConfigType: category=STRUCTURE
      element PwmChannelIdxmapPtr: category=DATA_REFERENCE, sw-pointer-target-props={target-category=TYPE_REFERENCE, implementation-data-type=uint8}
      element PwmCoreAdd: category=DATA_REFERENCE, array-size=3, array-size-semantics=FIXED-SIZE, sw-pointer-target-props={target-category=TYPE_REFERENCE, implementation-data-type=Pwm_17_GtmCcu6_CoreConfigType}
      element PwmCcu6ChIdx: category=DATA_REFERENCE, sw-pointer-target-props={target-category=TYPE_REFERENCE, implementation-data-type=uint32}
    Pwm_17_GtmCcu6_CoreConfigType: category=STRUCTURE
      element MaxChannels: implementation-data-type=Pwm_17_GtmCcu6_ChannelType
      element Pwm_ChannelConfigPtr: category=DATA_REFERENCE, sw-pointer-target-props={target-category=TYPE_REFERENCE, implementation-data-type=Pwm_17_GtmCcu6_ChannelType}
    Pwm_17_GtmCcu6_ChannelConfigType: category=STRUCTURE
      8 x element:
        PwmNotification: implementation-data-type=Pwm_17_GtmCcu6_NotifiPtrType
        PwmChannelInfo: implementation-data-type=uint16
        PwmPeriodDefault: implementation-data-type=Pwm_17_GtmCcu6_PeriodType
        PwmDutycycleDefault: implementation-data-type=uint32
        PwmShiftValue: implementation-data-type=uint32
        PwmChanneId: implementation-data-type=Pwm_17_GtmCcu6_ChannelType
        PwmTimerPtr: category=DATA_REFERENCE, sw-pointer-target-props={target-category=TYPE_REFERENCE, implementation-data-type=uint32}
        PwmTimerUsed: implementation-data-type=uint8
