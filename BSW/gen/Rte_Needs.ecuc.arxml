AUTOSAR XML (schema 4-0-3)
package /DaVinci_Project
  module config Com
    ComConfig
      34 x ComSignal:
        ECC_PMP2_SpdSet_oPMP_Cmd_oLIN00_8cabc4b7_Tx: ComSignalType=UINT8
        ECC_PMP3_SpdSet_oPMP_Cmd_oLIN00_0d8ea190_Tx: ComSignalType=UINT8
        EXT10_Valid_oVcuTxIoMsg5_oTC37X_VCU_CAN00_ba532916_Tx: ComSignalType=UINT16
        EXT11_Valid_oVcuTxIoMsg6_oTC37X_VCU_CAN00_d025e36b_Tx: ComSignalType=UINT16
        EXT12_Valid_oVcuTxIoMsg6_oTC37X_VCU_CAN00_8a44dc0b_Tx: ComSignalType=UINT16
        EXT13_Valid_oVcuTxIoMsg7_oTC37X_VCU_CAN00_e5e67df5_Tx: ComSignalType=UINT16
        EXT14_Valid_oVcuTxIoMsg7_oTC37X_VCU_CAN00_d1d4142a_Tx: ComSignalType=UINT16
        EXT15_Valid_oVcuTxIoMsg8_oTC37X_VCU_CAN00_a75ba75d_Tx: ComSignalType=UINT16
        EXT16_Valid_oVcuTxIoMsg8_oTC37X_VCU_CAN00_fd3a983d_Tx: ComSignalType=UINT16
        EXT1_Valid_oVcuTxIoMsg1_oTC37X_VCU_CAN00_caf787ea_Tx: ComSignalType=UINT16
        EXT2_Valid_oVcuTxIoMsg1_oTC37X_VCU_CAN00_9096b88a_Tx: ComSignalType=UINT16
        EXT3_Valid_oVcuTxIoMsg2_oTC37X_VCU_CAN00_fae072f7_Tx: ComSignalType=UINT16
        EXT4_Valid_oVcuTxIoMsg2_oTC37X_VCU_CAN00_ced21b28_Tx: ComSignalType=UINT16
        EXT5_Valid_oVcuTxIoMsg3_oTC37X_VCU_CAN00_a170bad6_Tx: ComSignalType=UINT16
        EXT6_Valid_oVcuTxIoMsg3_oTC37X_VCU_CAN00_fb1185b6_Tx: ComSignalType=UINT16
        EXT7_Valid_oVcuTxIoMsg4_oTC37X_VCU_CAN00_9acf98cd_Tx: ComSignalType=UINT16
        EXT8_Valid_oVcuTxIoMsg4_oTC37X_VCU_CAN00_725b5c6c_Tx: ComSignalType=UINT16
        EXT9_Valid_oVcuTxIoMsg5_oTC37X_VCU_CAN00_1df9fd92_Tx: ComSignalType=UINT16
        EXT_A_IN10_oVcuTxIoMsg5_oTC37X_VCU_CAN00_83e5b725_Tx: ComSignalType=SINT16
        EXT_A_IN11_oVcuTxIoMsg6_oTC37X_VCU_CAN00_67848296_Tx: ComSignalType=SINT16
        EXT_A_IN12_oVcuTxIoMsg6_oTC37X_VCU_CAN00_74acbbe5_Tx: ComSignalType=SINT16
        EXT_A_IN13_oVcuTxIoMsg7_oTC37X_VCU_CAN00_9519e5d5_Tx: ComSignalType=SINT16
        EXT_A_IN14_oVcuTxIoMsg7_oTC37X_VCU_CAN00_bdae7fe2_Tx: ComSignalType=SINT16
        EXT_A_IN15_oVcuTxIoMsg8_oTC37X_VCU_CAN00_4536335b_Tx: ComSignalType=SINT16
        EXT_A_IN16_oVcuTxIoMsg8_oTC37X_VCU_CAN00_561e0a28_Tx: ComSignalType=SINT16
        EXT_A_IN1_oVcuTxIoMsg1_oTC37X_VCU_CAN00_37348eff_Tx: ComSignalType=SINT16
        EXT_A_IN2_oVcuTxIoMsg1_oTC37X_VCU_CAN00_241cb78c_Tx: ComSignalType=SINT16
        EXT_A_IN3_oVcuTxIoMsg2_oTC37X_VCU_CAN00_c07d823f_Tx: ComSignalType=SINT16
        EXT_A_IN4_oVcuTxIoMsg2_oTC37X_VCU_CAN00_e8ca1808_Tx: ComSignalType=SINT16
        EXT_A_IN5_oVcuTxIoMsg3_oTC37X_VCU_CAN00_097f4638_Tx: ComSignalType=SINT16
        EXT_A_IN6_oVcuTxIoMsg3_oTC37X_VCU_CAN00_1a577f4b_Tx: ComSignalType=SINT16
        EXT_A_IN7_oVcuTxIoMsg4_oTC37X_VCU_CAN00_f59e9dfe_Tx: ComSignalType=SINT16
        EXT_A_IN8_oVcuTxIoMsg4_oTC37X_VCU_CAN00_aa164141_Tx: ComSignalType=SINT16
        EXT_A_IN9_oVcuTxIoMsg5_oTC37X_VCU_CAN00_4ba31f71_Tx: ComSignalType=SINT16
      SG_IBS_Status_06_Signal_Group_oIBS_Status_06_oTC37X_VCU_CAN01_481059d9_Rx (ComSignalGroup): ComNotification=Rte_COMCbk_SG_IBS_Status_06_Signal_Group_oIBS_Status_06_oTC37X_VCU_CAN01_481059d9_Rx
        20 x ComGroupSignal:
          Checksum_0BC_oIBS_Status_06_oTC37X_VCU_CAN01_586aa482_Rx: ComSignalType=UINT8
          IBS_AVHSts_oIBS_Status_06_oTC37X_VCU_CAN01_3d334918_Rx: ComSignalType=UINT8
          IBS_BrakeFluidWarning_oIBS_Status_06_oTC37X_VCU_CAN01_4cdf2121_Rx: ComSignalType=UINT8
          IBS_EPBFailureStatus_oIBS_Status_06_oTC37X_VCU_CAN01_ba4d18ec_Rx: ComSignalType=UINT8
          IBS_ESCOffSts_oIBS_Status_06_oTC37X_VCU_CAN01_8a954749_Rx: ComSignalType=BOOLEAN
          IBS_ESClampdisplay_oIBS_Status_06_oTC37X_VCU_CAN01_d7918b4f_Rx: ComSignalType=UINT8
          IBS_FactoryMode_oIBS_Status_06_oTC37X_VCU_CAN01_a9ca1443_Rx: ComSignalType=BOOLEAN
          IBS_HBAActive_oIBS_Status_06_oTC37X_VCU_CAN01_35d2723b_Rx: ComSignalType=BOOLEAN
          IBS_HDCSts_oIBS_Status_06_oTC37X_VCU_CAN01_ab37f07e_Rx: ComSignalType=UINT8
          IBS_MaintenaceMode_oIBS_Status_06_oTC37X_VCU_CAN01_896255a7_Rx: ComSignalType=BOOLEAN
          IBS_RWUActive_oIBS_Status_06_oTC37X_VCU_CAN01_10c4a4b9_Rx: ComSignalType=BOOLEAN
          IBS_RWUAvailable_oIBS_Status_06_oTC37X_VCU_CAN01_7502d327_Rx: ComSignalType=BOOLEAN
          IBS_RollerbenchMode_oIBS_Status_06_oTC37X_VCU_CAN01_c388d2a8_Rx: ComSignalType=BOOLEAN
          IBS_TPMS_ResetSts_oIBS_Status_06_oTC37X_VCU_CAN01_63f516d0_Rx: ComSignalType=BOOLEAN
          IBS_TireMonSysSts_oIBS_Status_06_oTC37X_VCU_CAN01_16b044b2_Rx: ComSignalType=BOOLEAN
          IBS_TireWarnFrntLe_oIBS_Status_06_oTC37X_VCU_CAN01_1e67f6ea_Rx: ComSignalType=BOOLEAN
          IBS_TireWarnFrntRi_oIBS_Status_06_oTC37X_VCU_CAN01_a8904419_Rx: ComSignalType=BOOLEAN
          IBS_TireWarnReLe_oIBS_Status_06_oTC37X_VCU_CAN01_38e70e6d_Rx: ComSignalType=BOOLEAN
          IBS_TireWarnReRi_oIBS_Status_06_oTC37X_VCU_CAN01_8e10bc9e_Rx: ComSignalType=BOOLEAN
          MessageCounter_0BC_oIBS_Status_06_oTC37X_VCU_CAN01_99ce1b8a_Rx: ComSignalType=UINT8
      SG_VCU_BMS_Signal_Group_oVCU_BMS_oTC37X_VCU_CAN01_c4ef97e6_Tx (ComSignalGroup)
        15 x ComGroupSignal:
          Checksum_0D1_oVCU_BMS_oTC37X_VCU_CAN01_71598f6f_Tx: ComSignalType=UINT8
          MessageCounter_0D1_oVCU_BMS_oTC37X_VCU_CAN01_4500c00c_Tx: ComSignalType=UINT8
          VCU_ActDriveMode_oVCU_BMS_oTC37X_VCU_CAN01_1e026d66_Tx: ComSignalType=UINT8
          VCU_ActiveEnergyProfile_oVCU_BMS_oTC37X_VCU_CAN01_22cbfa40_Tx: ComSignalType=UINT8
          VCU_ActiveRgnBrkProfile_oVCU_BMS_oTC37X_VCU_CAN01_0363ef69_Tx: ComSignalType=UINT8
          VCU_BMSTargetThermLevel_oVCU_BMS_oTC37X_VCU_CAN01_a0eafa9e_Tx: ComSignalType=UINT8
          VCU_BMS_Control_of_NegRelay_oVCU_BMS_oTC37X_VCU_CAN01_bc6cb144_Tx: ComSignalType=UINT8
          VCU_Chargestatus_oVCU_BMS_oTC37X_VCU_CAN01_1130fda5_Tx: ComSignalType=UINT8
          VCU_DrvModSwitchWarn_oVCU_BMS_oTC37X_VCU_CAN01_e4aabe75_Tx: ComSignalType=UINT8
          VCU_HVStatus_oVCU_BMS_oTC37X_VCU_CAN01_2f506c79_Tx: ComSignalType=UINT8
          VCU_IsomeasurmentSwitch_oVCU_BMS_oTC37X_VCU_CAN01_911803f5_Tx: ComSignalType=BOOLEAN
          VCU_LimitLevel_oVCU_BMS_oTC37X_VCU_CAN01_2fc74514_Tx: ComSignalType=UINT8
          VCU_RegenBrakeLightReqVld_oVCU_BMS_oTC37X_VCU_CAN01_d4db7fa5_Tx: ComSignalType=BOOLEAN
          VCU_RegenBrakeLightRequest_oVCU_BMS_oTC37X_VCU_CAN01_3252df12_Tx: ComSignalType=BOOLEAN
          VCU_RequestedModeBMS_oVCU_BMS_oTC37X_VCU_CAN01_1d4d6e47_Tx: ComSignalType=UINT8
      16 x ComSignal, all with ComSignalType=SINT16:
        VcuRxMsg1_Sig0_oVcuRxMsg1_oTC37X_VCU_CAN00_13cef464_Rx: ComNotification=Rte_COMCbk_VcuRxMsg1_Sig0_oVcuRxMsg1_oTC37X_VCU_CAN00_13cef464_Rx, ComTimeoutNotification=Rte_COMCbkRxTOut_VcuRxMsg1_Sig0_oVcuRxMsg1_oTC37X_VCU_CAN00_13cef464_Rx, ComTimeout=2
        VcuRxMsg1_Sig1_oVcuRxMsg1_oTC37X_VCU_CAN00_70c92d40_Rx: ComNotification=Rte_COMCbk_VcuRxMsg1_Sig1_oVcuRxMsg1_oTC37X_VCU_CAN00_70c92d40_Rx, ComTimeoutNotification=Rte_COMCbkRxTOut_VcuRxMsg1_Sig1_oVcuRxMsg1_oTC37X_VCU_CAN00_70c92d40_Rx, ComTimeout=2
        VcuRxMsg1_Sig2_oVcuRxMsg1_oTC37X_VCU_CAN00_d5c1462c_Rx: ComNotification=Rte_COMCbk_VcuRxMsg1_Sig2_oVcuRxMsg1_oTC37X_VCU_CAN00_d5c1462c_Rx, ComTimeoutNotification=Rte_COMCbkRxTOut_VcuRxMsg1_Sig2_oVcuRxMsg1_oTC37X_VCU_CAN00_d5c1462c_Rx, ComTimeout=2
        VcuRxMsg1_Sig3_oVcuRxMsg1_oTC37X_VCU_CAN00_b6c69f08_Rx: ComNotification=Rte_COMCbk_VcuRxMsg1_Sig3_oVcuRxMsg1_oTC37X_VCU_CAN00_b6c69f08_Rx, ComTimeoutNotification=Rte_COMCbkRxTOut_VcuRxMsg1_Sig3_oVcuRxMsg1_oTC37X_VCU_CAN00_b6c69f08_Rx, ComTimeout=2
        VcuRxMsg2_Sig0_oVcuRxMsg2_oTC37X_VCU_CAN00_94ceda5c_Rx: ComNotification=Rte_COMCbk_VcuRxMsg2_Sig0_oVcuRxMsg2_oTC37X_VCU_CAN00_94ceda5c_Rx, ComTimeoutNotification=Rte_COMCbkRxTOut_VcuRxMsg2_Sig0_oVcuRxMsg2_oTC37X_VCU_CAN00_94ceda5c_Rx, ComTimeout=2
        VcuRxMsg2_Sig1_oVcuRxMsg2_oTC37X_VCU_CAN00_f7c90378_Rx: ComNotification=Rte_COMCbk_VcuRxMsg2_Sig1_oVcuRxMsg2_oTC37X_VCU_CAN00_f7c90378_Rx, ComTimeoutNotification=Rte_COMCbkRxTOut_VcuRxMsg2_Sig1_oVcuRxMsg2_oTC37X_VCU_CAN00_f7c90378_Rx, ComTimeout=2
        VcuRxMsg2_Sig2_oVcuRxMsg2_oTC37X_VCU_CAN00_52c16814_Rx: ComNotification=Rte_COMCbk_VcuRxMsg2_Sig2_oVcuRxMsg2_oTC37X_VCU_CAN00_52c16814_Rx, ComTimeoutNotification=Rte_COMCbkRxTOut_VcuRxMsg2_Sig2_oVcuRxMsg2_oTC37X_VCU_CAN00_52c16814_Rx, ComTimeout=2
        VcuRxMsg2_Sig3_oVcuRxMsg2_oTC37X_VCU_CAN00_31c6b130_Rx: ComNotification=Rte_COMCbk_VcuRxMsg2_Sig3_oVcuRxMsg2_oTC37X_VCU_CAN00_31c6b130_Rx, ComTimeoutNotification=Rte_COMCbkRxTOut_VcuRxMsg2_Sig3_oVcuRxMsg2_oTC37X_VCU_CAN00_31c6b130_Rx, ComTimeout=2
        VcuTxMsg1_Sig0_oVcuTxMsg1_oTC37X_VCU_CAN00_8243b9a9_Tx
        VcuTxMsg1_Sig1_oVcuTxMsg1_oTC37X_VCU_CAN00_e144608d_Tx
        VcuTxMsg1_Sig2_oVcuTxMsg1_oTC37X_VCU_CAN00_444c0be1_Tx
        VcuTxMsg1_Sig3_oVcuTxMsg1_oTC37X_VCU_CAN00_274bd2c5_Tx
        VcuTxMsg2_Sig0_oVcuTxMsg2_oTC37X_VCU_CAN00_05439791_Tx
        VcuTxMsg2_Sig1_oVcuTxMsg2_oTC37X_VCU_CAN00_66444eb5_Tx
        VcuTxMsg2_Sig2_oVcuTxMsg2_oTC37X_VCU_CAN00_c34c25d9_Tx
        VcuTxMsg2_Sig3_oVcuTxMsg2_oTC37X_VCU_CAN00_a04bfcfd_Tx
  module config Rte
    34 x RteBswModuleInstance:
      Adc
      BswM
        BswM_MainFunctionTimingEvent0 (RteBswEventToTaskMapping): RteBswUsedOsEventRef=Rte_Ev_Cyclic2_Core0_BswTask_0_10ms, RteBswUsedOsAlarmRef=Os/Rte_Al_TE2_Core0_BswTask_0_10ms
      Can
        3 x RteBswEventToTaskMapping, all with RteBswUsedOsEventRef=Rte_Ev_Cyclic2_Core0_BswTask_0_10ms, RteBswUsedOsAlarmRef=Os/Rte_Al_TE2_Core0_BswTask_0_10ms:
          Can_MainFunction_BusOffTimingEvent0
          Can_MainFunction_ModeTimingEvent0
          Can_MainFunction_WakeupTimingEvent0
      CanIf
      CanNm
        CanNm_MainFunctionTimingEvent0 (RteBswEventToTaskMapping): RteBswUsedOsEventRef=Rte_Ev_Cyclic2_Core0_BswTask_0_10ms, RteBswUsedOsAlarmRef=Os/Rte_Al_TE2_Core0_BswTask_0_10ms
      CanSM
        CanSM_MainFunctionTimingEvent0 (RteBswEventToTaskMapping): RteBswUsedOsEventRef=Rte_Ev_Cyclic2_Core0_BswTask_0_10ms, RteBswUsedOsAlarmRef=Os/Rte_Al_TE2_Core0_BswTask_0_10ms
      CanTp
        CanTp_MainFunctionTimingEvent0 (RteBswEventToTaskMapping): RteBswUsedOsEventRef=Rte_Ev_Cyclic2_Core0_BswTask_0_5ms, RteBswUsedOsAlarmRef=Os/Rte_Al_TE2_Core0_BswTask_0_5ms
      Com
        Com_MainFunctionRx_ComMainFunctionRxTimingEvent0 (RteBswEventToTaskMapping): RteBswUsedOsEventRef=Rte_Ev_Cyclic2_Core0_BswTask_0_10ms, RteBswUsedOsAlarmRef=Os/Rte_Al_TE2_Core0_BswTask_0_10ms
        Com_MainFunctionTx_ComMainFunctionTxTimingEvent0 (RteBswEventToTaskMapping): RteBswUsedOsEventRef=Rte_Ev_Cyclic2_Core0_BswTask_0_10ms, RteBswUsedOsAlarmRef=Os/Rte_Al_TE2_Core0_BswTask_0_10ms
      ComM
        6 x RteBswEventToTaskMapping, all with RteBswUsedOsEventRef=Rte_Ev_Cyclic2_Core0_BswTask_0_20ms, RteBswUsedOsAlarmRef=Os/Rte_Al_TE2_Core0_BswTask_0_20ms:
          ComM_MainFunction_{0..5}TimingEvent0
      Dcm
        Dcm_MainFunctionTimingEvent0 (RteBswEventToTaskMapping): RteBswUsedOsEventRef=Rte_Ev_Cyclic2_Core0_BswTask_0_10ms, RteBswUsedOsAlarmRef=Os/Rte_Al_TE2_Core0_BswTask_0_10ms
      Dem
        Dem_MasterMainFunctionTimingEvent0 (RteBswEventToTaskMapping): RteBswUsedOsEventRef=Rte_Ev_Cyclic2_Core0_BswTask_0_10ms, RteBswUsedOsAlarmRef=Os/Rte_Al_TE2_Core0_BswTask_0_10ms
        Dem_SatelliteMainFunctionTimingEvent0 (RteBswEventToTaskMapping): RteBswUsedOsEventRef=Rte_Ev_Cyclic2_Core0_BswTask_0_10ms, RteBswUsedOsAlarmRef=Os/Rte_Al_TE2_Core0_BswTask_0_10ms
      Det
      Dio
      Dma
      EcuM
        3 x RteBswEventToTaskMapping:
          EcuM_MainFunctionTimingEvent0: RteBswUsedOsEventRef=Rte_Ev_Cyclic2_Core0_BswTask_0_10ms, RteBswUsedOsAlarmRef=Os/Rte_Al_TE2_Core0_BswTask_0_10ms
          EcuM_MainFunctionTimingEvent1: RteBswUsedOsAlarmRef=Os/Rte_Al_TE2_EcuM_EcuM_MainFunction
          EcuM_MainFunctionTimingEvent2: RteBswUsedOsAlarmRef=Os/Rte_Al_TE3_EcuM_EcuM_MainFunction
      EthIf
        3 x RteBswEventToTaskMapping:
          EthIf_MainFunctionRxTimingEvent0: RteBswUsedOsEventRef=Rte_Ev_Cyclic2_Core0_BswTask_0_5ms, RteBswUsedOsAlarmRef=Os/Rte_Al_TE2_Core0_BswTask_0_5ms
          EthIf_MainFunctionStateTimingEvent0: RteBswUsedOsEventRef=Rte_Ev_Run_EthIf_EthIf_MainFunctionState, RteBswUsedOsAlarmRef=Os/Rte_Al_TE_EthIf_EthIf_MainFunctionState
          EthIf_MainFunctionTxTimingEvent0: RteBswUsedOsEventRef=Rte_Ev_Cyclic2_Core0_BswTask_0_5ms, RteBswUsedOsAlarmRef=Os/Rte_Al_TE2_Core0_BswTask_0_5ms
      EthSM
        EthSM_MainFunctionTimingEvent0 (RteBswEventToTaskMapping): RteBswUsedOsEventRef=Rte_Ev_Cyclic2_Core0_BswTask_0_20ms, RteBswUsedOsAlarmRef=Os/Rte_Al_TE2_Core0_BswTask_0_20ms
      EthTrcv
      Eth
        Eth_30_Tc3xx_MainFunctionTimingEvent0 (RteBswEventToTaskMapping): RteBswUsedOsEventRef=Rte_Ev_Cyclic2_Core0_BswTask_0_20ms, RteBswUsedOsAlarmRef=Os/Rte_Al_TE2_Core0_BswTask_0_20ms
      Fee
        Fee_MainFunctionTimingEvent0 (RteBswEventToTaskMapping): RteBswUsedOsEventRef=Rte_Ev_Cyclic2_Core0_BswTask_0_10ms, RteBswUsedOsAlarmRef=Os/Rte_Al_TE2_Core0_BswTask_0_10ms
      Fls
        Fls_17_Dmu_MainFunctionTimingEvent0 (RteBswEventToTaskMapping): RteBswUsedOsEventRef=Rte_Ev_Cyclic2_Core0_BswTask_0_10ms, RteBswUsedOsAlarmRef=Os/Rte_Al_TE2_Core0_BswTask_0_10ms
      Irq
      LinIf
        LinIf_MainFunctionTimingEvent0 (RteBswEventToTaskMapping): RteBswUsedOsEventRef=Rte_Ev_Cyclic2_Core0_BswTask_0_5ms, RteBswUsedOsAlarmRef=Os/Rte_Al_TE2_Core0_BswTask_0_5ms
      LinSM
        LinSM_MainFunctionTimingEvent0 (RteBswEventToTaskMapping): RteBswUsedOsEventRef=Rte_Ev_Cyclic2_Core0_BswTask_0_10ms, RteBswUsedOsAlarmRef=Os/Rte_Al_TE2_Core0_BswTask_0_10ms
      LinTrcv
      McalLib
      Mcu
      Nm
      NvM
        NvM_MainFunctionTimingEvent0 (RteBswEventToTaskMapping): RteBswUsedOsEventRef=Rte_Ev_Cyclic2_Core0_BswTask_0_10ms, RteBswUsedOsAlarmRef=Os/Rte_Al_TE2_Core0_BswTask_0_10ms
      PduR
      Port
      Pwm
      Spi
        Spi_MainFunction_HandlingTimingEvent0 (RteBswEventToTaskMapping): RteBswUsedOsEventRef=Rte_Ev_Cyclic2_Core0_BswTask_0_5ms, RteBswUsedOsAlarmRef=Os/Rte_Al_TE2_Core0_BswTask_0_5ms
      Xcp
        CanXcp_MainFunctionTimingEvent0 (RteBswEventToTaskMapping): RteBswUsedOsEventRef=Rte_Ev_Cyclic2_Core0_BswTask_0_5ms, RteBswUsedOsAlarmRef=Os/Rte_Al_TE2_Core0_BswTask_0_5ms
        Xcp_MainFunctionTimingEvent0 (RteBswEventToTaskMapping): RteBswUsedOsEventRef=Rte_Ev_Cyclic2_Core0_BswTask_0_5ms, RteBswUsedOsAlarmRef=Os/Rte_Al_TE2_Core0_BswTask_0_5ms
    19 x RteSwComponentInstance:
      BswM_EcuSwComposition
        Timer_BswM_MainFunction (RteEventToTaskMapping): RteUsedOsEventRef=Rte_Ev_Cyclic2_Core0_BswTask_0_10ms, RteUsedOsAlarmRef=Os/Rte_Al_TE2_Core0_BswTask_0_10ms
      ComM_EcuSwComposition
        6 x RteEventToTaskMapping, all with RteUsedOsEventRef=Rte_Ev_Cyclic2_Core0_BswTask_0_20ms, RteUsedOsAlarmRef=Os/Rte_Al_TE2_Core0_BswTask_0_20ms:
          Timer_ComM_MainFunction_{0..5}
      Com_SWC_EcuSwComposition
        4 x RteEventToTaskMapping:
          TMT_Com_Runnable_20ms: RteUsedOsEventRef=Rte_Ev_Run_Com_SWC_Com_Runnable_20ms, RteUsedOsAlarmRef=Os/Rte_Al_TE_Com_SWC_Com_Runnable_20ms
          TMT_Com_Runnable_2ms: RteUsedOsEventRef=Rte_Ev_Run_Com_SWC_Com_Runnable_2ms, RteUsedOsAlarmRef=Os/Rte_Al_TE_Com_SWC_Com_Runnable_2ms
          DRT_Rte_Msg200h_Rx_Notification_VcuRxMsg1_Sig0_VcuRxMsg1_Sig0: RteUsedOsEventRef=Rte_Ev_Run_Com_SWC_Rte_Msg200h_Rx_Notification
          DRT_Rte_Msg201h_Rx_Notification_VcuRxMsg2_Sig0_VcuRxMsg2_Sig0: RteUsedOsEventRef=Rte_Ev_Run_Com_SWC_Rte_Msg201h_Rx_Notification
      Core1App_SWC_EcuSwComposition
        TMT_Core1App_Runnable100ms (RteEventToTaskMapping): RteUsedOsAlarmRef=Os/Rte_Al_TE_Core1App_SWC_Core1App_Runnable100ms
      Core2App_SWC_EcuSwComposition
        TMT_Core2App_Runnable100ms (RteEventToTaskMapping): RteUsedOsAlarmRef=Os/Rte_Al_TE_Core2App_SWC_Core2App_Runnable100ms
      DIAG_SWC_EcuSwComposition
        3 x RteEventToTaskMapping:
          TMT_DTCMonitorRunnable_10ms: RteUsedOsEventRef=Rte_Ev_Cyclic_Core0_AswTask_0_10ms, RteUsedOsAlarmRef=Os/Rte_Al_TE_Core0_AswTask_0_10ms
          MST_EcuReset_JumpFBL_0: RteUsedOsEventRef=Rte_Ev_Run_DIAG_SWC_EcuReset_JumpFBL
          MST_EcuReset_JumpFBL_1: RteUsedOsEventRef=Rte_Ev_Run_DIAG_SWC_EcuReset_JumpFBL
        3 x RteNvRamAllocation:
          NvmBlock_DIAG_SWC_NvBlockNeed_AttemptCounter: RteNvmRamBlockLocationSymbol=Rte_DIAG_SWC_NvBlockNeed_AttemptCounter_MirrorBlock, RteNvmRomBlockLocationSymbol=Rte_DIAG_SWC_NvBlockNeed_AttemptCounter_DefaultValue, RteNvmBlockRef=DIAG_SWC_NvBlockNeed_AttemptCounter
          NvmBlock_DIAG_SWC_NvBlockNeed: RteNvmRamBlockLocationSymbol=Rte_DIAG_SWC_NvBlockNeed_DID_F193_MirrorBlock, RteNvmRomBlockLocationSymbol=Rte_DIAG_SWC_NvBlockNeed_DID_F193_DefaultValue, RteNvmBlockRef=DIAG_SWC_NvBlockNeed_DID_F193
          NvmBlock_DIAG_SWC_NvBlockNeed_DiagDID_00: RteNvmRamBlockLocationSymbol=Rte_DIAG_SWC_NvBlockNeed_DiagDID_00_MirrorBlock, RteNvmRomBlockLocationSymbol=Rte_DIAG_SWC_NvBlockNeed_DiagDID_00_DefaultValue, RteNvmBlockRef=DIAG_SWC_NvBlockNeed_DiagDID_00
      Dcm_EcuSwComposition
        Timer_Dcm_MainFunction (RteEventToTaskMapping): RteUsedOsEventRef=Rte_Ev_Cyclic2_Core0_BswTask_0_10ms, RteUsedOsAlarmRef=Os/Rte_Al_TE2_Core0_BswTask_0_10ms
      DemMaster_0_EcuSwComposition
        Timer_Dem_MasterMainFunction (RteEventToTaskMapping): RteUsedOsEventRef=Rte_Ev_Cyclic2_Core0_BswTask_0_10ms, RteUsedOsAlarmRef=Os/Rte_Al_TE2_Core0_BswTask_0_10ms
      DemSatellite_0_EcuSwComposition
        Timer_Dem_SatelliteMainFunction (RteEventToTaskMapping): RteUsedOsEventRef=Rte_Ev_Cyclic2_Core0_BswTask_0_10ms, RteUsedOsAlarmRef=Os/Rte_Al_TE2_Core0_BswTask_0_10ms
      Det_EcuSwComposition
      EcuM_EcuSwComposition
        Timer_EcuM_MainFunction (RteEventToTaskMapping): RteUsedOsEventRef=Rte_Ev_Cyclic2_Core0_BswTask_0_10ms, RteUsedOsAlarmRef=Os/Rte_Al_TE2_Core0_BswTask_0_10ms
      IoHwAb_SWC_EcuSwComposition
        TMT_IoHwAb_SWC_Runnable (RteEventToTaskMapping): RteUsedOsEventRef=Rte_Ev_Cyclic_Core0_AswTask_0_10ms, RteUsedOsAlarmRef=Os/Rte_Al_TE_Core0_AswTask_0_10ms
      NvM_EcuSwComposition
        Timer_NvM_MainFunction (RteEventToTaskMapping): RteUsedOsEventRef=Rte_Ev_Cyclic2_Core0_BswTask_0_10ms, RteUsedOsAlarmRef=Os/Rte_Al_TE2_Core0_BswTask_0_10ms
      Os_OsCore{0..2}_swc_EcuSwComposition
      PowerMng_SWC_EcuSwComposition
        TMT_Led_Runnable1000ms (RteEventToTaskMapping): RteUsedOsEventRef=Rte_Ev_Run_PowerMng_SWC_Led_Runnable1000ms, RteUsedOsAlarmRef=Os/Rte_Al_TE_PowerMng_SWC_Led_Runnable1000ms
      SWC1_EcuSwComposition
        TMT_SWC1_Runnable10ms (RteEventToTaskMapping): RteUsedOsEventRef=Rte_Ev_Cyclic_Core0_AswTask_0_10ms, RteUsedOsAlarmRef=Os/Rte_Al_TE_Core0_AswTask_0_10ms
        NvmBlock_SWC1_NvBlockNeed_UserData3 (RteNvRamAllocation):
          RteNvmRamBlockLocationSymbol = Rte_SWC1_NvBlockNeed_UserData3_MirrorBlock
          RteNvmRomBlockLocationSymbol = Rte_SWC1_NvBlockNeed_UserData3_DefaultValue
          RteNvmBlockRef = SWC1NvBlockNeed_UserData3
      NvM_SWC_EcuSwComposition
        NvmBlock_NvM_SWC_NVNeed_NVBlockDescriptor_UserData1 (RteNvRamAllocation):
          RteNvmRomBlockLocationSymbol = Rte_NvM_SWC_NVBlockDescriptor_UserData1_ROM_NVBlockDescriptor_UserData1
          RteNvmBlockRef = NvM_SWC_NVBlockDescriptor_UserData1
        NvmBlock_NvM_SWC_NVNeed_NVBlockDescriptor_UserData2 (RteNvRamAllocation):
          RteNvmRomBlockLocationSymbol = Rte_NvM_SWC_NVBlockDescriptor_UserData2_ROM_NVBlockDescriptor_UserData2
          RteNvmBlockRef = NvM_SWC_NVBlockDescriptor_UserData2
    RteOsInteraction
      12 x RteUsedOsActivation, all with RteExpectedActivationOffset=0:
        Rte_Al_TE_Com_SWC_Com_Runnable_20ms: RteActivationOsAlarmRef=Os/Rte_Al_TE_Com_SWC_Com_Runnable_20ms, RteActivationOsTaskRef=Core0_AswTask
        Rte_Al_TE_Com_SWC_Com_Runnable_2ms: RteActivationOsAlarmRef=Os/Rte_Al_TE_Com_SWC_Com_Runnable_2ms, RteActivationOsTaskRef=Core0_AswTask
        Rte_Al_TE_Core0_AswTask_0_10ms: RteActivationOsAlarmRef=Os/Rte_Al_TE_Core0_AswTask_0_10ms, RteActivationOsTaskRef=Core0_AswTask
        Rte_Al_TE_PowerMng_SWC_Led_Runnable1000ms: RteActivationOsAlarmRef=Os/Rte_Al_TE_PowerMng_SWC_Led_Runnable1000ms, RteActivationOsTaskRef=Core0_AswTask
        Rte_Al_TE2_Core0_BswTask_0_10ms: RteActivationOsAlarmRef=Os/Rte_Al_TE2_Core0_BswTask_0_10ms, RteActivationOsTaskRef=Core0_BswTask
        Rte_Al_TE2_Core0_BswTask_0_20ms: RteActivationOsAlarmRef=Os/Rte_Al_TE2_Core0_BswTask_0_20ms, RteActivationOsTaskRef=Core0_BswTask
        Rte_Al_TE2_Core0_BswTask_0_5ms: RteActivationOsAlarmRef=Os/Rte_Al_TE2_Core0_BswTask_0_5ms, RteActivationOsTaskRef=Core0_BswTask
        Rte_Al_TE_EthIf_EthIf_MainFunctionState: RteActivationOsAlarmRef=Os/Rte_Al_TE_EthIf_EthIf_MainFunctionState, RteActivationOsTaskRef=Core0_BswTask
        Rte_Al_TE_Core1App_SWC_Core1App_Runnable100ms: RteActivationOsAlarmRef=Os/Rte_Al_TE_Core1App_SWC_Core1App_Runnable100ms, RteActivationOsTaskRef=Core1_AswTask
        Rte_Al_TE2_EcuM_EcuM_MainFunction: RteActivationOsAlarmRef=Os/Rte_Al_TE2_EcuM_EcuM_MainFunction, RteActivationOsTaskRef=Core1_BswTask
        Rte_Al_TE_Core2App_SWC_Core2App_Runnable100ms: RteActivationOsAlarmRef=Os/Rte_Al_TE_Core2App_SWC_Core2App_Runnable100ms, RteActivationOsTaskRef=Core2_AswTask
        Rte_Al_TE3_EcuM_EcuM_MainFunction: RteActivationOsAlarmRef=Os/Rte_Al_TE3_EcuM_EcuM_MainFunction, RteActivationOsTaskRef=Core2_BswTask
  module config NvM
    NvMCommonVendorParams: NvMCfgCbkIncludeList=Rte_Cbk.h
    6 x NvMBlockDescriptor:
      NvM_SWC_NVBlockDescriptor_UserData1: NvMNvBlockLength=10, NvMRomBlockDataAddress=Rte_NvM_SWC_NVBlockDescriptor_UserData1_ROM_NVBlockDescriptor_UserData1, NvMBlockUseSyncMechanism=true, NvMWriteRamBlockToNvCallback=Rte_GetMirror_NvM_SWC_NVBlockDescriptor_UserData1, NvMReadRamBlockFromNvCallback=Rte_SetMirror_NvM_SWC_NVBlockDescriptor_UserData1, NvMUseJobendCallback=true, NvMSingleBlockCallback=Rte_NvMNotifyJobFinished_NvM_SWC_NVBlockDescriptor_UserData1, NvMInitBlockCallback=NULL_PTR, NvMUseServicePorts=false
      NvM_SWC_NVBlockDescriptor_UserData2: NvMNvBlockLength=32, NvMRomBlockDataAddress=Rte_NvM_SWC_NVBlockDescriptor_UserData2_ROM_NVBlockDescriptor_UserData2, NvMBlockUseSyncMechanism=true, NvMWriteRamBlockToNvCallback=Rte_GetMirror_NvM_SWC_NVBlockDescriptor_UserData2, NvMReadRamBlockFromNvCallback=Rte_SetMirror_NvM_SWC_NVBlockDescriptor_UserData2, NvMUseJobendCallback=true, NvMSingleBlockCallback=Rte_NvMNotifyJobFinished_NvM_SWC_NVBlockDescriptor_UserData2, NvMInitBlockCallback=NULL_PTR, NvMUseServicePorts=false
      DIAG_SWC_NvBlockNeed_AttemptCounter: NvMNvBlockLength=1, NvMRamBlockDataAddress=Rte_DIAG_SWC_NvBlockNeed_AttemptCounter_MirrorBlock, NvMRomBlockDataAddress=Rte_DIAG_SWC_NvBlockNeed_AttemptCounter_DefaultValue
      DIAG_SWC_NvBlockNeed_DID_F193: NvMNvBlockLength=4, NvMRamBlockDataAddress=Rte_DIAG_SWC_NvBlockNeed_DID_F193_MirrorBlock, NvMRomBlockDataAddress=Rte_DIAG_SWC_NvBlockNeed_DID_F193_DefaultValue
      DIAG_SWC_NvBlockNeed_DiagDID_00: NvMNvBlockLength=4, NvMRamBlockDataAddress=Rte_DIAG_SWC_NvBlockNeed_DiagDID_00_MirrorBlock, NvMRomBlockDataAddress=Rte_DIAG_SWC_NvBlockNeed_DiagDID_00_DefaultValue
      SWC1NvBlockNeed_UserData3: NvMNvBlockLength=10, NvMRamBlockDataAddress=Rte_SWC1_NvBlockNeed_UserData3_MirrorBlock, NvMRomBlockDataAddress=Rte_SWC1_NvBlockNeed_UserData3_DefaultValue
  module config Os
    Core0_AswInit (OsTask): OsTaskActivation=1, OsTaskPriority=0, OsTaskSchedule=FULL
    Core0_AswTask (OsTask):
      OsTaskActivation = 1
      OsTaskPriority = 0
      OsTaskSchedule = FULL
      OsTaskEventRef = Rte_Ev_Cyclic_Core0_AswTask_0_10ms
      OsTaskEventRef = Rte_Ev_Run_Com_SWC_Com_Runnable_20ms
      OsTaskEventRef = Rte_Ev_Run_Com_SWC_Com_Runnable_2ms
      OsTaskEventRef = Rte_Ev_Run_Com_SWC_Rte_Msg200h_Rx_Notification
      OsTaskEventRef = Rte_Ev_Run_Com_SWC_Rte_Msg201h_Rx_Notification
      OsTaskEventRef = Rte_Ev_Run_DIAG_SWC_EcuReset_JumpFBL
      OsTaskEventRef = Rte_Ev_Run_NvM_SWC_NvM_SWC_UserData1_Runnable
      OsTaskEventRef = Rte_Ev_Run_NvM_SWC_NvM_SWC_UserData2_Runnable
      OsTaskEventRef = Rte_Ev_Run_PowerMng_SWC_Led_Runnable1000ms
    4 x OsAlarm, all with OsAlarmCounterRef=SystemTimer_Core0:
      Rte_Al_TE_Com_SWC_Com_Runnable_20ms
        OsAlarmAction
          OsAlarmSetEvent: OsAlarmSetEventRef=Rte_Ev_Run_Com_SWC_Com_Runnable_20ms, OsAlarmSetEventTaskRef=Core0_AswTask
      Rte_Al_TE_Com_SWC_Com_Runnable_2ms
        OsAlarmAction
          OsAlarmSetEvent: OsAlarmSetEventRef=Rte_Ev_Run_Com_SWC_Com_Runnable_2ms, OsAlarmSetEventTaskRef=Core0_AswTask
      Rte_Al_TE_Core0_AswTask_0_10ms
        OsAlarmAction
          OsAlarmSetEvent: OsAlarmSetEventRef=Rte_Ev_Cyclic_Core0_AswTask_0_10ms, OsAlarmSetEventTaskRef=Core0_AswTask
      Rte_Al_TE_PowerMng_SWC_Led_Runnable1000ms
        OsAlarmAction
          OsAlarmSetEvent: OsAlarmSetEventRef=Rte_Ev_Run_PowerMng_SWC_Led_Runnable1000ms, OsAlarmSetEventTaskRef=Core0_AswTask
    Core0_BswTask (OsTask):
      OsTaskActivation = 1
      OsTaskPriority = 66
      OsTaskSchedule = FULL
      OsTaskEventRef = Rte_Ev_Cyclic2_Core0_BswTask_0_10ms
      OsTaskEventRef = Rte_Ev_Cyclic2_Core0_BswTask_0_20ms
      OsTaskEventRef = Rte_Ev_Cyclic2_Core0_BswTask_0_5ms
      OsTaskEventRef = Rte_Ev_Run_EthIf_EthIf_MainFunctionState
    4 x OsAlarm, all with OsAlarmCounterRef=SystemTimer_Core0:
      Rte_Al_TE2_Core0_BswTask_0_10ms
        OsAlarmAction
          OsAlarmSetEvent: OsAlarmSetEventRef=Rte_Ev_Cyclic2_Core0_BswTask_0_10ms, OsAlarmSetEventTaskRef=Core0_BswTask
      Rte_Al_TE2_Core0_BswTask_0_20ms
        OsAlarmAction
          OsAlarmSetEvent: OsAlarmSetEventRef=Rte_Ev_Cyclic2_Core0_BswTask_0_20ms, OsAlarmSetEventTaskRef=Core0_BswTask
      Rte_Al_TE2_Core0_BswTask_0_5ms
        OsAlarmAction
          OsAlarmSetEvent: OsAlarmSetEventRef=Rte_Ev_Cyclic2_Core0_BswTask_0_5ms, OsAlarmSetEventTaskRef=Core0_BswTask
      Rte_Al_TE_EthIf_EthIf_MainFunctionState
        OsAlarmAction
          OsAlarmSetEvent: OsAlarmSetEventRef=Rte_Ev_Run_EthIf_EthIf_MainFunctionState, OsAlarmSetEventTaskRef=Core0_BswTask
    Core1_AswInit (OsTask): OsTaskActivation=1, OsTaskPriority=53, OsTaskSchedule=FULL
    Core1_AswTask (OsTask): OsTaskActivation=1, OsTaskPriority=52, OsTaskSchedule=FULL
    Rte_Al_TE_Core1App_SWC_Core1App_Runnable100ms (OsAlarm): OsAlarmCounterRef=SystemTimer_Core1, OsAlarmAccessingApplication=SystemApplication_OsCore0
      OsAlarmAction
        OsAlarmActivateTask: OsAlarmActivateTaskRef=Core1_AswTask
    Core1_BswTask (OsTask): OsTaskActivation=1, OsTaskPriority=51, OsTaskSchedule=FULL
    Rte_Al_TE2_EcuM_EcuM_MainFunction (OsAlarm): OsAlarmCounterRef=SystemTimer_Core1
      OsAlarmAction
        OsAlarmActivateTask: OsAlarmActivateTaskRef=Core1_BswTask
    Core2_AswInit (OsTask): OsTaskActivation=1, OsTaskPriority=53, OsTaskSchedule=FULL
    Core2_AswTask (OsTask): OsTaskActivation=1, OsTaskPriority=52, OsTaskSchedule=FULL
    Rte_Al_TE_Core2App_SWC_Core2App_Runnable100ms (OsAlarm): OsAlarmCounterRef=SystemTimer_Core2, OsAlarmAccessingApplication=SystemApplication_OsCore0
      OsAlarmAction
        OsAlarmActivateTask: OsAlarmActivateTaskRef=Core2_AswTask
    Core2_BswTask (OsTask): OsTaskActivation=1, OsTaskPriority=51, OsTaskSchedule=FULL
    Rte_Al_TE3_EcuM_EcuM_MainFunction (OsAlarm): OsAlarmCounterRef=SystemTimer_Core2
      OsAlarmAction
        OsAlarmActivateTask: OsAlarmActivateTaskRef=Core2_BswTask
    13 x OsEvent:
      Rte_Ev_Cyclic2_Core0_BswTask_0_10ms
      Rte_Ev_Cyclic2_Core0_BswTask_0_20ms
      Rte_Ev_Cyclic2_Core0_BswTask_0_5ms
      Rte_Ev_Cyclic_Core0_AswTask_0_10ms
      Rte_Ev_Run_Com_SWC_Com_Runnable_20ms
      Rte_Ev_Run_Com_SWC_Com_Runnable_2ms
      Rte_Ev_Run_Com_SWC_Rte_Msg200h_Rx_Notification
      Rte_Ev_Run_Com_SWC_Rte_Msg201h_Rx_Notification
      Rte_Ev_Run_DIAG_SWC_EcuReset_JumpFBL
      Rte_Ev_Run_EthIf_EthIf_MainFunctionState
      Rte_Ev_Run_NvM_SWC_NvM_SWC_UserData1_Runnable
      Rte_Ev_Run_NvM_SWC_NvM_SWC_UserData2_Runnable
      Rte_Ev_Run_PowerMng_SWC_Led_Runnable1000ms
    3 x OsApplication, all with OsTrusted=true:
      SystemApplication_OsCore0: OsAppTaskRef=Core0_AswInit, OsAppTaskRef=Core0_AswTask, OsAppAlarmRef=Os/Rte_Al_TE_Com_SWC_Com_Runnable_20ms, OsAppAlarmRef=Os/Rte_Al_TE_Com_SWC_Com_Runnable_2ms, OsAppAlarmRef=Os/Rte_Al_TE_Core0_AswTask_0_10ms, OsAppAlarmRef=Os/Rte_Al_TE_PowerMng_SWC_Led_Runnable1000ms, OsAppTaskRef=Core0_BswTask, OsAppAlarmRef=Os/Rte_Al_TE2_Core0_BswTask_0_10ms, OsAppAlarmRef=Os/Rte_Al_TE2_Core0_BswTask_0_20ms, OsAppAlarmRef=Os/Rte_Al_TE2_Core0_BswTask_0_5ms, OsAppAlarmRef=Os/Rte_Al_TE_EthIf_EthIf_MainFunctionState
      SystemApplication_OsCore1: OsAppTaskRef=Core1_AswInit, OsAppTaskRef=Core1_AswTask, OsAppAlarmRef=Os/Rte_Al_TE_Core1App_SWC_Core1App_Runnable100ms, OsAppTaskRef=Core1_BswTask, OsAppAlarmRef=Os/Rte_Al_TE2_EcuM_EcuM_MainFunction
      SystemApplication_OsCore2: OsAppTaskRef=Core2_AswInit, OsAppTaskRef=Core2_AswTask, OsAppAlarmRef=Os/Rte_Al_TE_Core2App_SWC_Core2App_Runnable100ms, OsAppTaskRef=Core2_BswTask, OsAppAlarmRef=Os/Rte_Al_TE3_EcuM_EcuM_MainFunction
    OsIoc: OsIocIncludeHeader=usrostyp.h
      Rte_Core1App_SWC_P_Arry8Bytes_DEP_Arry8Bytes (OsIocCommunication)
        OsIocDataProperties0 (OsIocDataProperties):
          OsIocDataType = IDT_Arry8Bytes
          OsIocInitValue = Rte_IocInitValue_Core1App_SWC_P_Arry8Bytes_DEP_Arry8Bytes
          OsIocDataPropertyIndex = 0
          OsIocDataTypeIsAtomic = false
        OsIocReceiverProperties: OsIocReceivingOsApplicationRef=SystemApplication_OsCore1
        OsIocSenderProperties0 (OsIocSenderProperties): OsIocSendingOsApplicationRef=SystemApplication_OsCore0
  module config EcuC
  ecuc value collection DaVinci_Project: ecuc-values=[Com, Rte, Os, EcuC, NvM]
