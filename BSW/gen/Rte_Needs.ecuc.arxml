AUTOSAR XML (schema 4-0-3)
package /DaVinci_Project
  module config Com
    ComConfig
      73 x ComSignal:
        AN0_oVcuAdcTxG0Msg0_oTC37X_VCU_CAN01_66f10a00_Tx: ComSignalType=SINT16
        AN10_oVcuAdcTxG1Msg0_oTC37X_VCU_CAN01_f71f00b1_Tx: ComSignalType=SINT16
        AN11_oVcuAdcTxG1Msg0_oTC37X_VCU_CAN01_d39d5187_Tx: ComSignalType=SINT16
        AN12_oVcuAdcTxG1Msg1_oTC37X_VCU_CAN01_5149143c_Tx: ComSignalType=SINT16
        AN13_oVcuAdcTxG1Msg1_oTC37X_VCU_CAN01_75cb450a_Tx: ComSignalType=SINT16
        AN14_oVcuAdcTxG1Msg1_oTC37X_VCU_CAN01_8a44f288_Tx: ComSignalType=SINT16
        AN15_oVcuAdcTxG1Msg1_oTC37X_VCU_CAN01_aec6a3be_Tx: ComSignalType=SINT16
        AN16_oVcuAdcTxG2Msg0_oTC37X_VCU_CAN01_156a4b45_Tx: ComSignalType=SINT16
        AN17_oVcuAdcTxG2Msg0_oTC37X_VCU_CAN01_31e81a73_Tx: ComSignalType=SINT16
        AN18_oVcuAdcTxG2Msg0_oTC37X_VCU_CAN01_31042200_Tx: ComSignalType=SINT16
        AN19_oVcuAdcTxG2Msg0_oTC37X_VCU_CAN01_15867336_Tx: ComSignalType=SINT16
        AN1_oVcuAdcTxG0Msg0_oTC37X_VCU_CAN01_42735b36_Tx: ComSignalType=SINT16
        AN20_oVcuAdcTxG2Msg1_oTC37X_VCU_CAN01_aae62509_Tx: ComSignalType=SINT16
        AN21_oVcuAdcTxG2Msg1_oTC37X_VCU_CAN01_8e64743f_Tx: ComSignalType=SINT16
        AN22_oVcuAdcTxG2Msg1_oTC37X_VCU_CAN01_e3e28765_Tx: ComSignalType=SINT16
        AN23_oVcuAdcTxG2Msg1_oTC37X_VCU_CAN01_c760d653_Tx: ComSignalType=SINT16
        AN24_oVcuAdcTxG3Msg0_oTC37X_VCU_CAN01_c095b3f0_Tx: ComSignalType=SINT16
        AN25_oVcuAdcTxG3Msg0_oTC37X_VCU_CAN01_e417e2c6_Tx: ComSignalType=SINT16
        AN26_oVcuAdcTxG3Msg0_oTC37X_VCU_CAN01_8991119c_Tx: ComSignalType=SINT16
        AN27_oVcuAdcTxG3Msg0_oTC37X_VCU_CAN01_ad1340aa_Tx: ComSignalType=SINT16
        AN28_oVcuAdcTxG3Msg1_oTC37X_VCU_CAN01_42adce38_Tx: ComSignalType=SINT16
        AN29_oVcuAdcTxG3Msg1_oTC37X_VCU_CAN01_662f9f0e_Tx: ComSignalType=SINT16
        AN2_oVcuAdcTxG0Msg0_oTC37X_VCU_CAN01_2ff5a86c_Tx: ComSignalType=SINT16
        AN30_oVcuAdcTxG3Msg1_oTC37X_VCU_CAN01_72505601_Tx: ComSignalType=SINT16
        AN31_oVcuAdcTxG3Msg1_oTC37X_VCU_CAN01_56d20737_Tx: ComSignalType=SINT16
        AN32_oVcuAdcTxG8Msg0_oTC37X_VCU_CAN01_543dc9cc_Tx: ComSignalType=SINT16
        AN33_oVcuAdcTxG8Msg0_oTC37X_VCU_CAN01_70bf98fa_Tx: ComSignalType=SINT16
        AN34_oVcuAdcTxG8Msg0_oTC37X_VCU_CAN01_8f302f78_Tx: ComSignalType=SINT16
        AN35_oVcuAdcTxG8Msg0_oTC37X_VCU_CAN01_abb27e4e_Tx: ComSignalType=SINT16
        AN36_oVcuAdcTxG8Msg1_oTC37X_VCU_CAN01_29663bf5_Tx: ComSignalType=SINT16
        AN37_oVcuAdcTxG8Msg1_oTC37X_VCU_CAN01_0de46ac3_Tx: ComSignalType=SINT16
        AN38_oVcuAdcTxG8Msg1_oTC37X_VCU_CAN01_0d0852b0_Tx: ComSignalType=SINT16
        AN39_oVcuAdcTxG8Msg1_oTC37X_VCU_CAN01_298a0386_Tx: ComSignalType=SINT16
        AN3_oVcuAdcTxG0Msg0_oTC37X_VCU_CAN01_0b77f95a_Tx: ComSignalType=SINT16
        AN40_oVcuAdcTxG8Msg2_oTC37X_VCU_CAN01_1ba46d98_Tx: ComSignalType=SINT16
        AN41_oVcuAdcTxG8Msg2_oTC37X_VCU_CAN01_3f263cae_Tx: ComSignalType=SINT16
        AN42_oVcuAdcTxG8Msg2_oTC37X_VCU_CAN01_52a0cff4_Tx: ComSignalType=SINT16
        AN43_oVcuAdcTxG8Msg2_oTC37X_VCU_CAN01_76229ec2_Tx: ComSignalType=SINT16
        AN44_oVcuAdcTxG8Msg3_oTC37X_VCU_CAN01_66ff9fa1_Tx: ComSignalType=SINT16
        AN45_oVcuAdcTxG8Msg3_oTC37X_VCU_CAN01_427dce97_Tx: ComSignalType=SINT16
        AN46_oVcuAdcTxG8Msg3_oTC37X_VCU_CAN01_2ffb3dcd_Tx: ComSignalType=SINT16
        AN47_oVcuAdcTxG8Msg3_oTC37X_VCU_CAN01_0b796cfb_Tx: ComSignalType=SINT16
        AN4_oVcuAdcTxG0Msg1_oTC37X_VCU_CAN01_1baaf839_Tx: ComSignalType=SINT16
        AN5_oVcuAdcTxG0Msg1_oTC37X_VCU_CAN01_3f28a90f_Tx: ComSignalType=SINT16
        AN6_oVcuAdcTxG0Msg1_oTC37X_VCU_CAN01_52ae5a55_Tx: ComSignalType=SINT16
        AN7_oVcuAdcTxG0Msg1_oTC37X_VCU_CAN01_762c0b63_Tx: ComSignalType=SINT16
        AN8_oVcuAdcTxG1Msg0_oTC37X_VCU_CAN01_8ebae131_Tx: ComSignalType=SINT16
        AN9_oVcuAdcTxG1Msg0_oTC37X_VCU_CAN01_aa38b007_Tx: ComSignalType=SINT16
        Bts7xx_HS1_En_oVcuRxCtrlMsg1_oTC37X_VCU_CAN01_d0692a3c_Rx: ComNotification=Rte_COMCbk_Bts7xx_HS1_En_oVcuRxCtrlMsg1_oTC37X_VCU_CAN01_d0692a3c_Rx, ComSignalType=SINT8
        Bts7xx_HS2_En_oVcuRxCtrlMsg1_oTC37X_VCU_CAN01_b48951c2_Rx: ComSignalType=SINT8
        Bts7xx_HS3_En_oVcuRxCtrlMsg1_oTC37X_VCU_CAN01_21f98557_Rx: ComSignalType=SINT8
        Bts7xx_HS4_En_oVcuRxCtrlMsg1_oTC37X_VCU_CAN01_7d49a63e_Rx: ComSignalType=SINT8
        EXT_PWM_IN1_Duty_oVcuMeasurementMsg0_oTC37X_VCU_CAN01_92760a96_Tx: ComSignalType=SINT8
        EXT_PWM_IN1_Period_oVcuMeasurementMsg0_oTC37X_VCU_CAN01_c46a50e4_Tx: ComSignalType=SINT16
        EXT_PWM_IN2_Duty_oVcuMeasurementMsg0_oTC37X_VCU_CAN01_5b42119b_Tx: ComSignalType=SINT8
        EXT_PWM_IN2_Period_oVcuMeasurementMsg0_oTC37X_VCU_CAN01_fba12e71_Tx: ComSignalType=SINT16
        Ext_IN2_oVcuMeasurementMsg0_oTC37X_VCU_CAN01_a925e19e_Tx: ComSignalType=SINT8
        Tle4252d_en_oVcuRxCtrlMsg1_oTC37X_VCU_CAN01_24c739a8_Rx: ComSignalType=SINT8
        Tle888qk_Lout14_En_oVcuRxCtrlMsg2_oTC37X_VCU_CAN01_a11e1e88_Rx: ComSignalType=SINT8
        Tle888qk_Lout16_En_oVcuRxCtrlMsg2_oTC37X_VCU_CAN01_508eb1e3_Rx: ComSignalType=SINT8
        Tle888qk_Lout1_En_oVcuRxCtrlMsg2_oTC37X_VCU_CAN01_0e3571fa_Rx: ComNotification=Rte_COMCbk_Tle888qk_Lout1_En_oVcuRxCtrlMsg2_oTC37X_VCU_CAN01_0e3571fa_Rx, ComSignalType=SINT8
        Tle888qk_Lout8_En_oVcuRxCtrlMsg2_oTC37X_VCU_CAN01_ebe51441_Rx: ComSignalType=SINT8
        Tle888qk_Out21BriCfg_oVcuRxCtrlMsg0_oTC37X_VCU_CAN01_f4735e02_Rx: ComSignalType=SINT8
        Tle888qk_Out21_En_oVcuRxCtrlMsg0_oTC37X_VCU_CAN01_fce8b2a9_Rx: ComNotification=Rte_COMCbk_Tle888qk_Out21_En_oVcuRxCtrlMsg0_oTC37X_VCU_CAN01_fce8b2a9_Rx, ComSignalType=SINT8
        Tle888qk_Out22BriCfg_oVcuRxCtrlMsg0_oTC37X_VCU_CAN01_27e842f9_Rx: ComSignalType=SINT8
        Tle888qk_Out22_En_oVcuRxCtrlMsg0_oTC37X_VCU_CAN01_9808c957_Rx: ComSignalType=SINT8
        Tle888qk_Out23BriCfg_oVcuRxCtrlMsg0_oTC37X_VCU_CAN01_69614950_Rx: ComSignalType=SINT8
        Tle888qk_Out23_En_oVcuRxCtrlMsg0_oTC37X_VCU_CAN01_0d781dc2_Rx: ComSignalType=SINT8
        Tle888qk_Out24BriCfg_oVcuRxCtrlMsg0_oTC37X_VCU_CAN01_5baf7d4e_Rx: ComSignalType=SINT8
        Tle888qk_Out24_En_oVcuRxCtrlMsg0_oTC37X_VCU_CAN01_51c83eab_Rx: ComSignalType=SINT8
        Tle9201_Dir_oVcuRxCtrlMsg1_oTC37X_VCU_CAN01_4c38edaa_Rx: ComSignalType=SINT8
        Tle9201_Dis_oVcuRxCtrlMsg1_oTC37X_VCU_CAN01_7aca7d59_Rx: ComSignalType=SINT8
        Tle9201_Pwm_oVcuRxCtrlMsg1_oTC37X_VCU_CAN01_bf73fa17_Rx: ComSignalType=SINT8
  module config Rte
    33 x RteBswModuleInstance:
      Adc
      BswM
        BswM_MainFunctionTimingEvent0 (RteBswEventToTaskMapping): RteBswUsedOsEventRef=Rte_Ev_Cyclic2_Core0_Bsw_Task_0_10ms, RteBswUsedOsAlarmRef=Os/Rte_Al_TE2_Core0_Bsw_Task_0_10ms
      Can
        3 x RteBswEventToTaskMapping, all with RteBswUsedOsEventRef=Rte_Ev_Cyclic2_Core0_Bsw_Task_0_10ms, RteBswUsedOsAlarmRef=Os/Rte_Al_TE2_Core0_Bsw_Task_0_10ms:
          Can_MainFunction_BusOffTimingEvent0
          Can_MainFunction_ModeTimingEvent0
          Can_MainFunction_WakeupTimingEvent0
      CanIf
      CanNm
        CanNm_MainFunctionTimingEvent0 (RteBswEventToTaskMapping): RteBswUsedOsEventRef=Rte_Ev_Cyclic2_Core0_Bsw_Task_0_10ms, RteBswUsedOsAlarmRef=Os/Rte_Al_TE2_Core0_Bsw_Task_0_10ms
      CanSM
        CanSM_MainFunctionTimingEvent0 (RteBswEventToTaskMapping): RteBswUsedOsEventRef=Rte_Ev_Cyclic2_Core0_Bsw_Task_0_10ms, RteBswUsedOsAlarmRef=Os/Rte_Al_TE2_Core0_Bsw_Task_0_10ms
      CanTp
        CanTp_MainFunctionTimingEvent0 (RteBswEventToTaskMapping): RteBswUsedOsEventRef=Rte_Ev_Cyclic2_Core0_Bsw_Task_0_5ms, RteBswUsedOsAlarmRef=Os/Rte_Al_TE2_Core0_Bsw_Task_0_5ms
      Com
        Com_MainFunctionRx_ComMainFunctionRxTimingEvent0 (RteBswEventToTaskMapping): RteBswUsedOsEventRef=Rte_Ev_Cyclic2_Core0_Bsw_Task_0_10ms, RteBswUsedOsAlarmRef=Os/Rte_Al_TE2_Core0_Bsw_Task_0_10ms
        Com_MainFunctionTx_ComMainFunctionTxTimingEvent0 (RteBswEventToTaskMapping): RteBswUsedOsEventRef=Rte_Ev_Cyclic2_Core0_Bsw_Task_0_10ms, RteBswUsedOsAlarmRef=Os/Rte_Al_TE2_Core0_Bsw_Task_0_10ms
      ComM
        8 x RteBswEventToTaskMapping, all with RteBswUsedOsEventRef=Rte_Ev_Cyclic2_Core0_Bsw_Task_0_20ms, RteBswUsedOsAlarmRef=Os/Rte_Al_TE2_Core0_Bsw_Task_0_20ms:
          ComM_MainFunction_{0..7}TimingEvent0
      Dcm
        Dcm_MainFunctionTimingEvent0 (RteBswEventToTaskMapping): RteBswUsedOsEventRef=Rte_Ev_Cyclic2_Core0_Bsw_Task_0_10ms, RteBswUsedOsAlarmRef=Os/Rte_Al_TE2_Core0_Bsw_Task_0_10ms
      Dem
        Dem_MasterMainFunctionTimingEvent0 (RteBswEventToTaskMapping): RteBswUsedOsEventRef=Rte_Ev_Cyclic2_Core0_Bsw_Task_0_10ms, RteBswUsedOsAlarmRef=Os/Rte_Al_TE2_Core0_Bsw_Task_0_10ms
        Dem_SatelliteMainFunctionTimingEvent0 (RteBswEventToTaskMapping): RteBswUsedOsEventRef=Rte_Ev_Cyclic2_Core0_Bsw_Task_0_10ms, RteBswUsedOsAlarmRef=Os/Rte_Al_TE2_Core0_Bsw_Task_0_10ms
      Det
      Dio
      Dma
      EcuM
        3 x RteBswEventToTaskMapping:
          EcuM_MainFunctionTimingEvent0: RteBswUsedOsEventRef=Rte_Ev_Cyclic2_Core0_Bsw_Task_0_10ms, RteBswUsedOsAlarmRef=Os/Rte_Al_TE2_Core0_Bsw_Task_0_10ms
          EcuM_MainFunctionTimingEvent1: RteBswUsedOsAlarmRef=Os/Rte_Al_TE2_EcuM_EcuM_MainFunction
          EcuM_MainFunctionTimingEvent2: RteBswUsedOsAlarmRef=Os/Rte_Al_TE3_EcuM_EcuM_MainFunction
      Fee
        Fee_MainFunctionTimingEvent0 (RteBswEventToTaskMapping): RteBswUsedOsEventRef=Rte_Ev_Cyclic2_Core0_Bsw_Task_0_10ms, RteBswUsedOsAlarmRef=Os/Rte_Al_TE2_Core0_Bsw_Task_0_10ms
      Fls
        Fls_17_Dmu_MainFunctionTimingEvent0 (RteBswEventToTaskMapping): RteBswUsedOsEventRef=Rte_Ev_Cyclic2_Core0_Bsw_Task_0_10ms, RteBswUsedOsAlarmRef=Os/Rte_Al_TE2_Core0_Bsw_Task_0_10ms
      Icu
      IoHwAb
      Irq
      J1939Tp
        J1939Tp_MainFunctionTimingEvent0 (RteBswEventToTaskMapping): RteBswUsedOsEventRef=Rte_Ev_Cyclic2_Core0_Bsw_Task_0_10ms, RteBswUsedOsAlarmRef=Os/Rte_Al_TE2_Core0_Bsw_Task_0_10ms
      LinIf
        LinIf_MainFunctionTimingEvent0 (RteBswEventToTaskMapping): RteBswUsedOsEventRef=Rte_Ev_Cyclic2_Core0_Bsw_Task_0_5ms, RteBswUsedOsAlarmRef=Os/Rte_Al_TE2_Core0_Bsw_Task_0_5ms
      LinSM
        LinSM_MainFunctionTimingEvent0 (RteBswEventToTaskMapping): RteBswUsedOsEventRef=Rte_Ev_Cyclic2_Core0_Bsw_Task_0_10ms, RteBswUsedOsAlarmRef=Os/Rte_Al_TE2_Core0_Bsw_Task_0_10ms
      LinTrcv
      McalLib
      Mcu
      Nm
      NvM
        NvM_MainFunctionTimingEvent0 (RteBswEventToTaskMapping): RteBswUsedOsEventRef=Rte_Ev_Cyclic2_Core0_Bsw_Task_0_10ms, RteBswUsedOsAlarmRef=Os/Rte_Al_TE2_Core0_Bsw_Task_0_10ms
      PduR
      Port
      Pwm
      Spi
        Spi_MainFunction_HandlingTimingEvent0 (RteBswEventToTaskMapping): RteBswUsedOsEventRef=Rte_Ev_Cyclic2_Core0_Bsw_Task_0_5ms, RteBswUsedOsAlarmRef=Os/Rte_Al_TE2_Core0_Bsw_Task_0_5ms
      Xcp
        CanXcp_MainFunctionTimingEvent0 (RteBswEventToTaskMapping): RteBswUsedOsEventRef=Rte_Ev_Cyclic2_Core0_Bsw_Task_0_5ms, RteBswUsedOsAlarmRef=Os/Rte_Al_TE2_Core0_Bsw_Task_0_5ms
        Xcp_MainFunctionTimingEvent0 (RteBswEventToTaskMapping): RteBswUsedOsEventRef=Rte_Ev_Cyclic2_Core0_Bsw_Task_0_5ms, RteBswUsedOsAlarmRef=Os/Rte_Al_TE2_Core0_Bsw_Task_0_5ms
    18 x RteSwComponentInstance:
      BswM_EcuSwComposition
        Timer_BswM_MainFunction (RteEventToTaskMapping): RteUsedOsEventRef=Rte_Ev_Cyclic2_Core0_Bsw_Task_0_10ms, RteUsedOsAlarmRef=Os/Rte_Al_TE2_Core0_Bsw_Task_0_10ms
      ComM_EcuSwComposition
        8 x RteEventToTaskMapping, all with RteUsedOsEventRef=Rte_Ev_Cyclic2_Core0_Bsw_Task_0_20ms, RteUsedOsAlarmRef=Os/Rte_Al_TE2_Core0_Bsw_Task_0_20ms:
          Timer_ComM_MainFunction_{0..7}
      Com_SWC_EcuSwComposition
        5 x RteEventToTaskMapping:
          TMT_Com_Runnable_2ms: RteUsedOsEventRef=Rte_Ev_Run_Com_SWC_Com_Runnable_2ms, RteUsedOsAlarmRef=Os/Rte_Al_TE_Com_SWC_Com_Runnable_2ms
          TMT_Com_Runnable_20ms: RteUsedOsEventRef=Rte_Ev_Run_Com_SWC_Com_Runnable_500ms, RteUsedOsAlarmRef=Os/Rte_Al_TE_Com_SWC_Com_Runnable_500ms
          DRT_Rte_Msg10Eh_Rx_Notification_Tle888qk_Out21_En_Tle888qk_Out21_En: RteUsedOsEventRef=Rte_Ev_Run_Com_SWC_Rte_Msg10Eh_Rx_Notification
          DRT_Rte_Msg10Fh_Rx_Notification_Bts7xx_HS1_En_Bts7xx_HS1_En: RteUsedOsEventRef=Rte_Ev_Run_Com_SWC_Rte_Msg10Fh_Rx_Notification
          DRT_Rte_Msg110h_Rx_Notification_Tle888qk_Lout1_En_Tle888qk_Lout1_En: RteUsedOsEventRef=Rte_Ev_Run_Com_SWC_Rte_Msg110h_Rx_Notification
      Core1App_SWC_EcuSwComposition
        TMT_Core1App_SWC_Runnable_10ms (RteEventToTaskMapping): RteUsedOsAlarmRef=Os/Rte_Al_TE_Core1App_SWC_Core1App_SWC_Runnable_10ms
      Core2App_SWC_EcuSwComposition
        TMT_Core2App_SWC_Runnable_10ms (RteEventToTaskMapping): RteUsedOsAlarmRef=Os/Rte_Al_TE_Core2App_SWC_Core2App_SWC_Runnable_10ms
      Dcm_EcuSwComposition
        Timer_Dcm_MainFunction (RteEventToTaskMapping): RteUsedOsEventRef=Rte_Ev_Cyclic2_Core0_Bsw_Task_0_10ms, RteUsedOsAlarmRef=Os/Rte_Al_TE2_Core0_Bsw_Task_0_10ms
      DemMaster_0_EcuSwComposition
        Timer_Dem_MasterMainFunction (RteEventToTaskMapping): RteUsedOsEventRef=Rte_Ev_Cyclic2_Core0_Bsw_Task_0_10ms, RteUsedOsAlarmRef=Os/Rte_Al_TE2_Core0_Bsw_Task_0_10ms
      DemSatellite_0_EcuSwComposition
        Timer_Dem_SatelliteMainFunction (RteEventToTaskMapping): RteUsedOsEventRef=Rte_Ev_Cyclic2_Core0_Bsw_Task_0_10ms, RteUsedOsAlarmRef=Os/Rte_Al_TE2_Core0_Bsw_Task_0_10ms
      Det_EcuSwComposition
      EcuM_EcuSwComposition
        Timer_EcuM_MainFunction (RteEventToTaskMapping): RteUsedOsEventRef=Rte_Ev_Cyclic2_Core0_Bsw_Task_0_10ms, RteUsedOsAlarmRef=Os/Rte_Al_TE2_Core0_Bsw_Task_0_10ms
      IoHwAb_EcuSwComposition
        Timer_IoHwAb_IoHwAbRunnable_10ms (RteEventToTaskMapping): RteUsedOsEventRef=Rte_Ev_Run_IoHwAb_IoHwAb_IoHwAbRunnable_10ms, RteUsedOsAlarmRef=Os/Rte_Al_TE_IoHwAb_IoHwAb_IoHwAbRunnable_10ms
      NvM_EcuSwComposition
        Timer_NvM_MainFunction (RteEventToTaskMapping): RteUsedOsEventRef=Rte_Ev_Cyclic2_Core0_Bsw_Task_0_10ms, RteUsedOsAlarmRef=Os/Rte_Al_TE2_Core0_Bsw_Task_0_10ms
      Os_OsCore{0..2}_swc_EcuSwComposition
      PowerMng_SWC_EcuSwComposition
        TMT_Led_Runnable1000ms (RteEventToTaskMapping): RteUsedOsEventRef=Rte_Ev_Run_PowerMng_SWC_Led_Runnable1000ms, RteUsedOsAlarmRef=Os/Rte_Al_TE_PowerMng_SWC_Led_Runnable1000ms
      SWC1_EcuSwComposition
        TMT_SWC1_Runnable10ms (RteEventToTaskMapping): RteUsedOsEventRef=Rte_Ev_Run_SWC1_SWC1_Runnable10ms, RteUsedOsAlarmRef=Os/Rte_Al_TE_SWC1_SWC1_Runnable10ms
        NvmBlock_SWC1_NvBlockNeed_UserData3 (RteNvRamAllocation):
          RteNvmRamBlockLocationSymbol = Rte_SWC1_NvBlockNeed_UserData3_MirrorBlock
          RteNvmRomBlockLocationSymbol = Rte_SWC1_NvBlockNeed_UserData3_DefaultValue
          RteNvmBlockRef = SWC1NvBlockNeed_UserData3
      NvM_SWC_EcuSwComposition
        NvmBlock_NvM_SWC_NVNeed_NVBlockDescriptor_UserData1 (RteNvRamAllocation):
          RteNvmRomBlockLocationSymbol = Rte_NvM_SWC_NVBlockDescriptor_UserData1_ROM_NVBlockDescriptor_UserData1
          RteNvmBlockRef = NvM_SWC_NVBlockDescriptor_UserData1
        NvmBlock_NvM_SWC_NVNeed_NVBlockDescriptor_UserData2 (RteNvRamAllocation):
          RteNvmRomBlockLocationSymbol = Rte_NvM_SWC_NVBlockDescriptor_UserData2_ROM_NVBlockDescriptor_UserData2
          RteNvmBlockRef = NvM_SWC_NVBlockDescriptor_UserData2
    RteOsInteraction
      12 x RteUsedOsActivation, all with RteExpectedActivationOffset=0:
        Rte_Al_TE_Com_SWC_Com_Runnable_2ms: RteActivationOsAlarmRef=Os/Rte_Al_TE_Com_SWC_Com_Runnable_2ms, RteActivationOsTaskRef=Core0_AswTask
        Rte_Al_TE_Com_SWC_Com_Runnable_500ms: RteActivationOsAlarmRef=Os/Rte_Al_TE_Com_SWC_Com_Runnable_500ms, RteActivationOsTaskRef=Core0_AswTask
        Rte_Al_TE_PowerMng_SWC_Led_Runnable1000ms: RteActivationOsAlarmRef=Os/Rte_Al_TE_PowerMng_SWC_Led_Runnable1000ms, RteActivationOsTaskRef=Core0_AswTask
        Rte_Al_TE_SWC1_SWC1_Runnable10ms: RteActivationOsAlarmRef=Os/Rte_Al_TE_SWC1_SWC1_Runnable10ms, RteActivationOsTaskRef=Core0_AswTask
        Rte_Al_TE2_Core0_Bsw_Task_0_10ms: RteActivationOsAlarmRef=Os/Rte_Al_TE2_Core0_Bsw_Task_0_10ms, RteActivationOsTaskRef=Core0_Bsw_Task
        Rte_Al_TE2_Core0_Bsw_Task_0_20ms: RteActivationOsAlarmRef=Os/Rte_Al_TE2_Core0_Bsw_Task_0_20ms, RteActivationOsTaskRef=Core0_Bsw_Task
        Rte_Al_TE2_Core0_Bsw_Task_0_5ms: RteActivationOsAlarmRef=Os/Rte_Al_TE2_Core0_Bsw_Task_0_5ms, RteActivationOsTaskRef=Core0_Bsw_Task
        Rte_Al_TE_IoHwAb_IoHwAb_IoHwAbRunnable_10ms: RteActivationOsAlarmRef=Os/Rte_Al_TE_IoHwAb_IoHwAb_IoHwAbRunnable_10ms, RteActivationOsTaskRef=Core0_Bsw_Task
        Rte_Al_TE_Core1App_SWC_Core1App_SWC_Runnable_10ms: RteActivationOsAlarmRef=Os/Rte_Al_TE_Core1App_SWC_Core1App_SWC_Runnable_10ms, RteActivationOsTaskRef=Core1_Asw_Task
        Rte_Al_TE2_EcuM_EcuM_MainFunction: RteActivationOsAlarmRef=Os/Rte_Al_TE2_EcuM_EcuM_MainFunction, RteActivationOsTaskRef=Core1_Bsw_Task
        Rte_Al_TE_Core2App_SWC_Core2App_SWC_Runnable_10ms: RteActivationOsAlarmRef=Os/Rte_Al_TE_Core2App_SWC_Core2App_SWC_Runnable_10ms, RteActivationOsTaskRef=Core2_Asw_Task
        Rte_Al_TE3_EcuM_EcuM_MainFunction: RteActivationOsAlarmRef=Os/Rte_Al_TE3_EcuM_EcuM_MainFunction, RteActivationOsTaskRef=Core2_Bsw_Task
  module config NvM
    NvMCommonVendorParams: NvMCfgCbkIncludeList=Rte_Cbk.h
    3 x NvMBlockDescriptor:
      NvM_SWC_NVBlockDescriptor_UserData1: NvMNvBlockLength=10, NvMRomBlockDataAddress=Rte_NvM_SWC_NVBlockDescriptor_UserData1_ROM_NVBlockDescriptor_UserData1, NvMBlockUseSyncMechanism=true, NvMWriteRamBlockToNvCallback=Rte_GetMirror_NvM_SWC_NVBlockDescriptor_UserData1, NvMReadRamBlockFromNvCallback=Rte_SetMirror_NvM_SWC_NVBlockDescriptor_UserData1, NvMUseJobendCallback=true, NvMSingleBlockCallback=Rte_NvMNotifyJobFinished_NvM_SWC_NVBlockDescriptor_UserData1, NvMInitBlockCallback=NULL_PTR, NvMUseServicePorts=false
      NvM_SWC_NVBlockDescriptor_UserData2: NvMNvBlockLength=32, NvMRomBlockDataAddress=Rte_NvM_SWC_NVBlockDescriptor_UserData2_ROM_NVBlockDescriptor_UserData2, NvMBlockUseSyncMechanism=true, NvMWriteRamBlockToNvCallback=Rte_GetMirror_NvM_SWC_NVBlockDescriptor_UserData2, NvMReadRamBlockFromNvCallback=Rte_SetMirror_NvM_SWC_NVBlockDescriptor_UserData2, NvMUseJobendCallback=true, NvMSingleBlockCallback=Rte_NvMNotifyJobFinished_NvM_SWC_NVBlockDescriptor_UserData2, NvMInitBlockCallback=NULL_PTR, NvMUseServicePorts=false
      SWC1NvBlockNeed_UserData3: NvMNvBlockLength=10, NvMRamBlockDataAddress=Rte_SWC1_NvBlockNeed_UserData3_MirrorBlock, NvMRomBlockDataAddress=Rte_SWC1_NvBlockNeed_UserData3_DefaultValue
  module config Os
    Core0_AswTask (OsTask):
      OsTaskActivation = 1
      OsTaskPriority = 64
      OsTaskSchedule = FULL
      OsTaskEventRef = Rte_Ev_Run_Com_SWC_Com_Runnable_2ms
      OsTaskEventRef = Rte_Ev_Run_Com_SWC_Com_Runnable_500ms
      OsTaskEventRef = Rte_Ev_Run_Com_SWC_Rte_Msg10Eh_Rx_Notification
      OsTaskEventRef = Rte_Ev_Run_Com_SWC_Rte_Msg10Fh_Rx_Notification
      OsTaskEventRef = Rte_Ev_Run_Com_SWC_Rte_Msg110h_Rx_Notification
      OsTaskEventRef = Rte_Ev_Run_NvM_SWC_NvM_SWC_UserData1_Runnable
      OsTaskEventRef = Rte_Ev_Run_NvM_SWC_NvM_SWC_UserData2_Runnable
      OsTaskEventRef = Rte_Ev_Run_PowerMng_SWC_Led_Runnable1000ms
      OsTaskEventRef = Rte_Ev_Run_SWC1_SWC1_Runnable10ms
    4 x OsAlarm, all with OsAlarmCounterRef=SystemTimer_Core0:
      Rte_Al_TE_Com_SWC_Com_Runnable_2ms
        OsAlarmAction
          OsAlarmSetEvent: OsAlarmSetEventRef=Rte_Ev_Run_Com_SWC_Com_Runnable_2ms, OsAlarmSetEventTaskRef=Core0_AswTask
      Rte_Al_TE_Com_SWC_Com_Runnable_500ms
        OsAlarmAction
          OsAlarmSetEvent: OsAlarmSetEventRef=Rte_Ev_Run_Com_SWC_Com_Runnable_500ms, OsAlarmSetEventTaskRef=Core0_AswTask
      Rte_Al_TE_PowerMng_SWC_Led_Runnable1000ms
        OsAlarmAction
          OsAlarmSetEvent: OsAlarmSetEventRef=Rte_Ev_Run_PowerMng_SWC_Led_Runnable1000ms, OsAlarmSetEventTaskRef=Core0_AswTask
      Rte_Al_TE_SWC1_SWC1_Runnable10ms
        OsAlarmAction
          OsAlarmSetEvent: OsAlarmSetEventRef=Rte_Ev_Run_SWC1_SWC1_Runnable10ms, OsAlarmSetEventTaskRef=Core0_AswTask
    Core0_Asw_Init (OsTask): OsTaskActivation=1, OsTaskPriority=63, OsTaskSchedule=FULL
    Core0_Bsw_Task (OsTask):
      OsTaskActivation = 1
      OsTaskPriority = 65
      OsTaskSchedule = FULL
      OsTaskEventRef = Rte_Ev_Cyclic2_Core0_Bsw_Task_0_10ms
      OsTaskEventRef = Rte_Ev_Cyclic2_Core0_Bsw_Task_0_20ms
      OsTaskEventRef = Rte_Ev_Cyclic2_Core0_Bsw_Task_0_5ms
      OsTaskEventRef = Rte_Ev_Run_IoHwAb_IoHwAb_IoHwAbRunnable_10ms
    4 x OsAlarm, all with OsAlarmCounterRef=SystemTimer_Core0:
      Rte_Al_TE2_Core0_Bsw_Task_0_10ms
        OsAlarmAction
          OsAlarmSetEvent: OsAlarmSetEventRef=Rte_Ev_Cyclic2_Core0_Bsw_Task_0_10ms, OsAlarmSetEventTaskRef=Core0_Bsw_Task
      Rte_Al_TE2_Core0_Bsw_Task_0_20ms
        OsAlarmAction
          OsAlarmSetEvent: OsAlarmSetEventRef=Rte_Ev_Cyclic2_Core0_Bsw_Task_0_20ms, OsAlarmSetEventTaskRef=Core0_Bsw_Task
      Rte_Al_TE2_Core0_Bsw_Task_0_5ms
        OsAlarmAction
          OsAlarmSetEvent: OsAlarmSetEventRef=Rte_Ev_Cyclic2_Core0_Bsw_Task_0_5ms, OsAlarmSetEventTaskRef=Core0_Bsw_Task
      Rte_Al_TE_IoHwAb_IoHwAb_IoHwAbRunnable_10ms
        OsAlarmAction
          OsAlarmSetEvent: OsAlarmSetEventRef=Rte_Ev_Run_IoHwAb_IoHwAb_IoHwAbRunnable_10ms, OsAlarmSetEventTaskRef=Core0_Bsw_Task
    Core1_Asw_Init (OsTask): OsTaskActivation=1, OsTaskPriority=0, OsTaskSchedule=FULL
    Core1_Asw_Task (OsTask): OsTaskActivation=1, OsTaskPriority=0, OsTaskSchedule=FULL
    Rte_Al_TE_Core1App_SWC_Core1App_SWC_Runnable_10ms (OsAlarm): OsAlarmCounterRef=SystemTimer_Core1, OsAlarmAccessingApplication=SystemApplication_OsCore0
      OsAlarmAction
        OsAlarmActivateTask: OsAlarmActivateTaskRef=Core1_Asw_Task
    Core1_Bsw_Task (OsTask): OsTaskActivation=1, OsTaskPriority=0, OsTaskSchedule=FULL
    Rte_Al_TE2_EcuM_EcuM_MainFunction (OsAlarm): OsAlarmCounterRef=SystemTimer_Core1
      OsAlarmAction
        OsAlarmActivateTask: OsAlarmActivateTaskRef=Core1_Bsw_Task
    Core2_Asw_Init (OsTask): OsTaskActivation=1, OsTaskPriority=0, OsTaskSchedule=FULL
    Core2_Asw_Task (OsTask): OsTaskActivation=1, OsTaskPriority=0, OsTaskSchedule=FULL
    Rte_Al_TE_Core2App_SWC_Core2App_SWC_Runnable_10ms (OsAlarm): OsAlarmCounterRef=SystemTimer_Core2, OsAlarmAccessingApplication=SystemApplication_OsCore0
      OsAlarmAction
        OsAlarmActivateTask: OsAlarmActivateTaskRef=Core2_Asw_Task
    Core2_Bsw_Task (OsTask): OsTaskActivation=1, OsTaskPriority=0, OsTaskSchedule=FULL
    Rte_Al_TE3_EcuM_EcuM_MainFunction (OsAlarm): OsAlarmCounterRef=SystemTimer_Core2
      OsAlarmAction
        OsAlarmActivateTask: OsAlarmActivateTaskRef=Core2_Bsw_Task
    13 x OsEvent:
      Rte_Ev_Cyclic2_Core0_Bsw_Task_0_10ms
      Rte_Ev_Cyclic2_Core0_Bsw_Task_0_20ms
      Rte_Ev_Cyclic2_Core0_Bsw_Task_0_5ms
      Rte_Ev_Run_Com_SWC_Com_Runnable_2ms
      Rte_Ev_Run_Com_SWC_Com_Runnable_500ms
      Rte_Ev_Run_Com_SWC_Rte_Msg10Eh_Rx_Notification
      Rte_Ev_Run_Com_SWC_Rte_Msg10Fh_Rx_Notification
      Rte_Ev_Run_Com_SWC_Rte_Msg110h_Rx_Notification
      Rte_Ev_Run_IoHwAb_IoHwAb_IoHwAbRunnable_10ms
      Rte_Ev_Run_NvM_SWC_NvM_SWC_UserData1_Runnable
      Rte_Ev_Run_NvM_SWC_NvM_SWC_UserData2_Runnable
      Rte_Ev_Run_PowerMng_SWC_Led_Runnable1000ms
      Rte_Ev_Run_SWC1_SWC1_Runnable10ms
    3 x OsApplication, all with OsTrusted=true:
      SystemApplication_OsCore0: OsAppTaskRef=Core0_AswTask, OsAppAlarmRef=Os/Rte_Al_TE_Com_SWC_Com_Runnable_2ms, OsAppAlarmRef=Os/Rte_Al_TE_Com_SWC_Com_Runnable_500ms, OsAppAlarmRef=Os/Rte_Al_TE_PowerMng_SWC_Led_Runnable1000ms, OsAppAlarmRef=Os/Rte_Al_TE_SWC1_SWC1_Runnable10ms, OsAppTaskRef=Core0_Asw_Init, OsAppTaskRef=Core0_Bsw_Task, OsAppAlarmRef=Os/Rte_Al_TE2_Core0_Bsw_Task_0_10ms, OsAppAlarmRef=Os/Rte_Al_TE2_Core0_Bsw_Task_0_20ms, OsAppAlarmRef=Os/Rte_Al_TE2_Core0_Bsw_Task_0_5ms, OsAppAlarmRef=Os/Rte_Al_TE_IoHwAb_IoHwAb_IoHwAbRunnable_10ms
      SystemApplication_OsCore1: OsAppTaskRef=Core1_Asw_Init, OsAppTaskRef=Core1_Asw_Task, OsAppAlarmRef=Os/Rte_Al_TE_Core1App_SWC_Core1App_SWC_Runnable_10ms, OsAppTaskRef=Core1_Bsw_Task, OsAppAlarmRef=Os/Rte_Al_TE2_EcuM_EcuM_MainFunction
      SystemApplication_OsCore2: OsAppTaskRef=Core2_Asw_Init, OsAppTaskRef=Core2_Asw_Task, OsAppAlarmRef=Os/Rte_Al_TE_Core2App_SWC_Core2App_SWC_Runnable_10ms, OsAppTaskRef=Core2_Bsw_Task, OsAppAlarmRef=Os/Rte_Al_TE3_EcuM_EcuM_MainFunction
  module config EcuC
  ecuc value collection DaVinci_Project: ecuc-values=[Com, Rte, Os, EcuC, NvM]
