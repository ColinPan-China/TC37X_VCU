AUTOSAR XML (schema 4-0-3)
package /DaVinci_Project
  module config Rte
    15 x RteBswModuleInstance:
      BswM
        BswM_MainFunctionTimingEvent0 (RteBswEventToTaskMapping): RteBswUsedOsEventRef=Rte_Ev_Cyclic2_Bsw_Task_0_10ms, RteBswUsedOsAlarmRef=Os/Rte_Al_TE2_Bsw_Task_0_10ms
      Can
        3 x RteBswEventToTaskMapping, all with RteBswUsedOsEventRef=Rte_Ev_Cyclic2_Bsw_Task_0_10ms, RteBswUsedOsAlarmRef=Os/Rte_Al_TE2_Bsw_Task_0_10ms:
          Can_MainFunction_BusOffTimingEvent0
          Can_MainFunction_ModeTimingEvent0
          Can_MainFunction_WakeupTimingEvent0
      CanIf
      CanNm
        CanNm_MainFunctionTimingEvent0 (RteBswEventToTaskMapping): RteBswUsedOsEventRef=Rte_Ev_Cyclic2_Bsw_Task_0_10ms, RteBswUsedOsAlarmRef=Os/Rte_Al_TE2_Bsw_Task_0_10ms
      CanSM
        CanSM_MainFunctionTimingEvent0 (RteBswEventToTaskMapping): RteBswUsedOsEventRef=Rte_Ev_Cyclic2_Bsw_Task_0_10ms, RteBswUsedOsAlarmRef=Os/Rte_Al_TE2_Bsw_Task_0_10ms
      Com
        Com_MainFunctionRx_ComMainFunctionRxTimingEvent0 (RteBswEventToTaskMapping): RteBswUsedOsEventRef=Rte_Ev_Cyclic2_Bsw_Task_0_10ms, RteBswUsedOsAlarmRef=Os/Rte_Al_TE2_Bsw_Task_0_10ms
        Com_MainFunctionTx_ComMainFunctionTxTimingEvent0 (RteBswEventToTaskMapping): RteBswUsedOsEventRef=Rte_Ev_Cyclic2_Bsw_Task_0_10ms, RteBswUsedOsAlarmRef=Os/Rte_Al_TE2_Bsw_Task_0_10ms
      ComM
        ComM_MainFunction_0TimingEvent0 (RteBswEventToTaskMapping): RteBswUsedOsEventRef=Rte_Ev_Cyclic2_Bsw_Task_0_20ms, RteBswUsedOsAlarmRef=Os/Rte_Al_TE2_Bsw_Task_0_20ms
      Det
      Dio
      EcuM
        EcuM_MainFunctionTimingEvent0 (RteBswEventToTaskMapping): RteBswUsedOsEventRef=Rte_Ev_Cyclic2_Bsw_Task_0_10ms, RteBswUsedOsAlarmRef=Os/Rte_Al_TE2_Bsw_Task_0_10ms
      McalLib
      Mcu
      Nm
      PduR
      Port
    7 x RteSwComponentInstance:
      BswM_EcuSwComposition
        Timer_BswM_MainFunction (RteEventToTaskMapping): RteUsedOsEventRef=Rte_Ev_Cyclic2_Bsw_Task_0_10ms, RteUsedOsAlarmRef=Os/Rte_Al_TE2_Bsw_Task_0_10ms
      ComM_EcuSwComposition
        Timer_ComM_MainFunction_0 (RteEventToTaskMapping): RteUsedOsEventRef=Rte_Ev_Cyclic2_Bsw_Task_0_20ms, RteUsedOsAlarmRef=Os/Rte_Al_TE2_Bsw_Task_0_20ms
      Det_EcuSwComposition
      EcuM_EcuSwComposition
        Timer_EcuM_MainFunction (RteEventToTaskMapping): RteUsedOsEventRef=Rte_Ev_Cyclic2_Bsw_Task_0_10ms, RteUsedOsAlarmRef=Os/Rte_Al_TE2_Bsw_Task_0_10ms
      Os_OsCore0_swc_EcuSwComposition
      PowerMng_SWC_EcuSwComposition
        TMT_Led_Runnable1000ms (RteEventToTaskMapping): RteUsedOsEventRef=Rte_Ev_Run_PowerMng_SWC_Led_Runnable1000ms, RteUsedOsAlarmRef=Os/Rte_Al_TE_PowerMng_SWC_Led_Runnable1000ms
      SWC1_EcuSwComposition
        TMT_SWC1_Runnable10ms (RteEventToTaskMapping): RteUsedOsEventRef=Rte_Ev_Run_SWC1_SWC1_Runnable10ms, RteUsedOsAlarmRef=Os/Rte_Al_TE_SWC1_SWC1_Runnable10ms
    RteOsInteraction
      4 x RteUsedOsActivation, all with RteExpectedActivationOffset=0:
        Rte_Al_TE_PowerMng_SWC_Led_Runnable1000ms: RteActivationOsAlarmRef=Os/Rte_Al_TE_PowerMng_SWC_Led_Runnable1000ms, RteActivationOsTaskRef=AswTask
        Rte_Al_TE_SWC1_SWC1_Runnable10ms: RteActivationOsAlarmRef=Os/Rte_Al_TE_SWC1_SWC1_Runnable10ms, RteActivationOsTaskRef=AswTask
        Rte_Al_TE2_Bsw_Task_0_10ms: RteActivationOsAlarmRef=Os/Rte_Al_TE2_Bsw_Task_0_10ms, RteActivationOsTaskRef=Bsw_Task
        Rte_Al_TE2_Bsw_Task_0_20ms: RteActivationOsAlarmRef=Os/Rte_Al_TE2_Bsw_Task_0_20ms, RteActivationOsTaskRef=Bsw_Task
  module config NvM
  module config Os
    AswTask (OsTask):
      OsTaskActivation = 1
      OsTaskPriority = 64
      OsTaskSchedule = FULL
      OsTaskEventRef = Rte_Ev_Run_PowerMng_SWC_Led_Runnable1000ms
      OsTaskEventRef = Rte_Ev_Run_SWC1_SWC1_Runnable10ms
    Rte_Al_TE_PowerMng_SWC_Led_Runnable1000ms (OsAlarm): OsAlarmCounterRef=SystemTimer
      OsAlarmAction
        OsAlarmSetEvent: OsAlarmSetEventRef=Rte_Ev_Run_PowerMng_SWC_Led_Runnable1000ms, OsAlarmSetEventTaskRef=AswTask
    Rte_Al_TE_SWC1_SWC1_Runnable10ms (OsAlarm): OsAlarmCounterRef=SystemTimer
      OsAlarmAction
        OsAlarmSetEvent: OsAlarmSetEventRef=Rte_Ev_Run_SWC1_SWC1_Runnable10ms, OsAlarmSetEventTaskRef=AswTask
    Asw_Init (OsTask): OsTaskActivation=1, OsTaskPriority=63, OsTaskSchedule=FULL
    Bsw_Task (OsTask):
      OsTaskActivation = 1
      OsTaskPriority = 65
      OsTaskSchedule = FULL
      OsTaskEventRef = Rte_Ev_Cyclic2_Bsw_Task_0_10ms
      OsTaskEventRef = Rte_Ev_Cyclic2_Bsw_Task_0_20ms
    Rte_Al_TE2_Bsw_Task_0_10ms (OsAlarm): OsAlarmCounterRef=SystemTimer
      OsAlarmAction
        OsAlarmSetEvent: OsAlarmSetEventRef=Rte_Ev_Cyclic2_Bsw_Task_0_10ms, OsAlarmSetEventTaskRef=Bsw_Task
    Rte_Al_TE2_Bsw_Task_0_20ms (OsAlarm): OsAlarmCounterRef=SystemTimer
      OsAlarmAction
        OsAlarmSetEvent: OsAlarmSetEventRef=Rte_Ev_Cyclic2_Bsw_Task_0_20ms, OsAlarmSetEventTaskRef=Bsw_Task
    4 x OsEvent:
      Rte_Ev_Cyclic2_Bsw_Task_0_10ms
      Rte_Ev_Cyclic2_Bsw_Task_0_20ms
      Rte_Ev_Run_PowerMng_SWC_Led_Runnable1000ms
      Rte_Ev_Run_SWC1_SWC1_Runnable10ms
  module config EcuC
  ecuc value collection DaVinci_Project: ecuc-values=[Com, Rte, Os, EcuC, NvM]
