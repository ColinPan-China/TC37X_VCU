AUTOSAR XML (schema 4-0-3)
package /DaVinci_Project
  module config Com
    ComConfig
      95 x ComSignal:
        BCL_ChargeMode_oBCL_oJ1939_bms_2f4f0f62_Tx: ComSignalType=UINT8
        BCL_CurrentRequire_oBCL_oJ1939_bms_d7664f08_Tx: ComSignalType=UINT16
        BCL_VolltageRequire_oBCL_oJ1939_bms_425ed7b1_Tx: ComSignalType=UINT16
        BCP_AllowChargeVoltageMax_oBCP_oJ1939_bms_fc3dfe75_Tx: ComSignalType=UINT16
        BCP_AllowTempMax_oBCP_oJ1939_bms_3d5b24f4_Tx: ComSignalType=UINT8
        BCP_BatteryChargeVoltageMax_oBCP_oJ1939_bms_5d02e2aa_Tx: ComSignalType=UINT16
        BCP_BatteryNominalEnergy_oBCP_oJ1939_bms_7dc98c8b_Tx: ComSignalType=UINT16
        BCP_BatteryTotalVoltage_oBCP_oJ1939_bms_19a0567e_Tx: ComSignalType=UINT16
        BCP_ChargeCurrentMax_oBCP_oJ1939_bms_7cdaf0d4_Tx: ComSignalType=UINT16
        BCP_SOC_oBCP_oJ1939_bms_78e6b083_Tx: ComSignalType=UINT16
        BCS_BatteryVoltMaxGroup_oBCS_oJ1939_bms_196f50c9_Tx: ComSignalType=UINT8
        BCS_BatteryVoltMax_oBCS_oJ1939_bms_11a53a15_Tx: ComSignalType=UINT16
        BCS_ChargeCurrentMeasure_oBCS_oJ1939_bms_0ae65560_Tx: ComSignalType=UINT16
        BCS_ChargeVoltageMeasure_oBCS_oJ1939_bms_abbd1969_Tx: ComSignalType=UINT16
        BCS_EstimatedTimeRemaining_oBCS_oJ1939_bms_c6383d22_Tx: ComSignalType=UINT16
        BCS_SOC_oBCS_oJ1939_bms_7466e090_Tx: ComSignalType=UINT8
        BEM_ChargeAbortTimeout_oBEM_oJ1939_bms_4849b46c_Tx: ComSignalType=UINT8
        BEM_ChargeFinishTimeout_oBEM_oJ1939_bms_2d8e7a9e_Tx: ComSignalType=UINT8
        BEM_ChargeStateTimeout_oBEM_oJ1939_bms_4d32efa5_Tx: ComSignalType=UINT8
        BEM_ChargeStatisticsTimeout_oBEM_oJ1939_bms_d07a3692_Tx: ComSignalType=UINT8
        BEM_ChargerIdTimeout0_oBEM_oJ1939_bms_eb813ae3_Tx: ComSignalType=UINT8
        BEM_ChargerIdTimeout1_oBEM_oJ1939_bms_6c27f1a0_Tx: ComSignalType=UINT8
        BEM_TimesyncOrPowerTimeout_oBEM_oJ1939_bms_f132cc4f_Tx: ComSignalType=UINT8
        BHM_AllowChargeVoltageMax_oBHM_oJ1939_bms_5c3d4762_Tx: ComSignalType=UINT16
        BRM_BatteryChargeTimes_oBRM_oJ1939_bms_b699eff3_Tx: ComSignalType=UINT32
        BRM_BatteryProductDay_oBRM_oJ1939_bms_da11520f_Tx: ComSignalType=UINT8
        BRM_BatteryProductMonth_oBRM_oJ1939_bms_9ee6c732_Tx: ComSignalType=UINT8
        BRM_BatteryProductYear_oBRM_oJ1939_bms_4f8656a1_Tx: ComSignalType=UINT8
        BRM_BatteryProperty_oBRM_oJ1939_bms_1c53b5e5_Tx: ComSignalType=UINT8
        BRM_BatterySN_oBRM_oJ1939_bms_10b903de_Tx: ComSignalType=UINT32
        BRM_BatterySystemRatedCapacity_oBRM_oJ1939_bms_8c5f9fd1_Tx: ComSignalType=UINT16
        BRM_BatterySystemRatedVoltage_oBRM_oJ1939_bms_902f9149_Tx: ComSignalType=UINT16
        BRM_BatteryType_oBRM_oJ1939_bms_67affdba_Tx: ComSignalType=UINT8
        BRM_Manufacturer_oBRM_oJ1939_bms_1506e637_Tx: ComSignalType=UINT32
        BRM_ProtocolVersion_oBRM_oJ1939_bms_4595b96f_Tx: ComSignalType=UINT32
        BRM_VehicleIdByte17_oBRM_oJ1939_bms_3bcab298_Tx: ComSignalType=UINT8
        BRM_VehicleIdByte1_8_oBRM_oJ1939_bms_38f10529_Tx: ComSignalType=UINT8_N
        BRM_VehicleIdByte9_16_oBRM_oJ1939_bms_50f2ed11_Tx: ComSignalType=UINT8_N
        BRO_BMSChargeReady_oBRO_oJ1939_bms_639997bd_Tx: ComSignalType=UINT8
        BSD_AbortSOC_oBSD_oJ1939_bms_1bf4999e_Tx: ComSignalType=UINT8
        BSD_BatteryTempMax_oBSD_oJ1939_bms_0a97b3dc_Tx: ComSignalType=UINT8
        BSD_BatteryTempMin_oBSD_oJ1939_bms_ada333a5_Tx: ComSignalType=UINT8
        BSD_BatteryVoltageMax_oBSD_oJ1939_bms_7df654bd_Tx: ComSignalType=UINT16
        BSD_BatteryVoltageMin_oBSD_oJ1939_bms_dac2d4c4_Tx: ComSignalType=UINT16
        BSM_BatteryCurrentState_oBSM_oJ1939_bms_fbd112e0_Tx: ComSignalType=UINT8
        BSM_BatteryOutpuConnectorState_oBSM_oJ1939_bms_505480e6_Tx: ComSignalType=UINT8
        BSM_BatteryTempMaxNo_oBSM_oJ1939_bms_497a5c4e_Tx: ComSignalType=UINT8
        BSM_BatteryTempMax_oBSM_oJ1939_bms_85f0b8b3_Tx: ComSignalType=UINT8
        BSM_BatteryTempMinNo_oBSM_oJ1939_bms_5a3fbae5_Tx: ComSignalType=UINT8
        BSM_BatteryTempMin_oBSM_oJ1939_bms_22c438ca_Tx: ComSignalType=UINT8
        BSM_BatteryTempState_oBSM_oJ1939_bms_84506101_Tx: ComSignalType=UINT8
        BSM_BatteryVoltageMaxNo_oBSM_oJ1939_bms_8c4562b4_Tx: ComSignalType=UINT8
        BSM_BatteryVoltageState_oBSM_oJ1939_bms_416f5ffb_Tx: ComSignalType=UINT8
        BSM_ChargeEnable_oBSM_oJ1939_bms_a2bcc681_Tx: ComSignalType=UINT8
        BSM_InsulationState_oBSM_oJ1939_bms_7d927ad9_Tx: ComSignalType=UINT8
        BSM_SOC_oBSM_oJ1939_bms_14942cb5_Tx: ComSignalType=UINT8
        BST_AbortAchiveSOC_oBST_oJ1939_bms_c136b77d_Tx: ComSignalType=UINT8
        BST_AbortAchiveSingleVolt_oBST_oJ1939_bms_eba61cdf_Tx: ComSignalType=UINT8
        BST_AbortAchiveTotalVolt_oBST_oJ1939_bms_e1a7b5c9_Tx: ComSignalType=UINT8
        BST_AbortChargparameter_oBST_oJ1939_bms_76c05b72_Tx: ComSignalType=UINT8
        BST_AbortErrorCurrent_oBST_oJ1939_bms_a1621160_Tx: ComSignalType=UINT8
        BST_AbortErrorVoltage_oBST_oJ1939_bms_984fbd12_Tx: ComSignalType=UINT8
        BST_AbortFaultBMSTemp_oBST_oJ1939_bms_1f548a97_Tx: ComSignalType=UINT8
        BST_AbortFaultBatteryTemp_oBST_oJ1939_bms_24bc84f9_Tx: ComSignalType=UINT8
        BST_AbortFaultConnectorTemp_oBST_oJ1939_bms_5ac8c1a2_Tx: ComSignalType=UINT8
        BST_AbortFaultConnector_oBST_oJ1939_bms_c267077a_Tx: ComSignalType=UINT8
        BST_AbortFaultInsulation_oBST_oJ1939_bms_54f72c95_Tx: ComSignalType=UINT8
        BST_AbortFaultOther_oBST_oJ1939_bms_bf783560_Tx: ComSignalType=UINT8
        BST_AbortHVrelayfault_oBST_oJ1939_bms_dd44a377_Tx: ComSignalType=UINT8
        BST_Abortdet2Voltexception_oBST_oJ1939_bms_e015929e_Tx: ComSignalType=UINT8
        BST_Abortmanoperate_oBST_oJ1939_bms_b2432717_Tx: ComSignalType=UINT8
        CCS_OutputCurrent_oCCS_oJ1939_bms_d187cc6a_Rx: ComNotification=Rte_COMCbk_CCS_OutputCurrent_oCCS_oJ1939_bms_d187cc6a_Rx, ComSignalType=UINT16
        CCS_OutputVoltage_oCCS_oJ1939_bms_e8aa6018_Rx: ComNotification=Rte_COMCbk_CCS_OutputVoltage_oCCS_oJ1939_bms_e8aa6018_Rx, ComSignalType=UINT16
        CEM_BatteryChargeRequireTimeout_oCEM_oJ1939_bms_5fb156f4_Rx: ComNotification=Rte_COMCbk_CEM_BatteryChargeRequireTimeout_oCEM_oJ1939_bms_5fb156f4_Rx, ComSignalType=UINT8
        CHM_ProtocolVersion_oCHM_oJ1939_bms_0a8dbb13_Rx: ComNotification=Rte_COMCbk_CHM_ProtocolVersion_oCHM_oJ1939_bms_0a8dbb13_Rx, ComSignalType=UINT32
        CML_OutpuVoltageMax_oCML_oJ1939_bms_5dd5d6c5_Rx: ComNotification=Rte_COMCbk_CML_OutpuVoltageMax_oCML_oJ1939_bms_5dd5d6c5_Rx, ComSignalType=UINT16
        CML_OutputCurrentMax_oCML_oJ1939_bms_a474b4e9_Rx: ComNotification=Rte_COMCbk_CML_OutputCurrentMax_oCML_oJ1939_bms_a474b4e9_Rx, ComSignalType=UINT16
        CML_OutputCurrentMin_oCML_oJ1939_bms_03403490_Rx: ComNotification=Rte_COMCbk_CML_OutputCurrentMin_oCML_oJ1939_bms_03403490_Rx, ComSignalType=UINT16
        CML_OutputVoltageMin_oCML_oJ1939_bms_13582707_Rx: ComNotification=Rte_COMCbk_CML_OutputVoltageMin_oCML_oJ1939_bms_13582707_Rx, ComSignalType=UINT16
        CRM_RecognitionResult_oCRM_oJ1939_bms_dd9063d0_Rx: ComNotification=Rte_COMCbk_CRM_RecognitionResult_oCRM_oJ1939_bms_dd9063d0_Rx, ComSignalType=UINT8
        CRO_ChargerReady_oCRO_oJ1939_bms_5ed7a56d_Rx: ComNotification=Rte_COMCbk_CRO_ChargerReady_oCRO_oJ1939_bms_5ed7a56d_Rx, ComSignalType=UINT8
        CSD_ChargerNo_oCSD_oJ1939_bms_26864bff_Rx: ComNotification=Rte_COMCbk_CSD_ChargerNo_oCSD_oJ1939_bms_26864bff_Rx, ComSignalType=UINT32
        CST_AbortAchiveCondition_oCST_oJ1939_bms_ed49cd8a_Rx: ComNotification=Rte_COMCbk_CST_AbortAchiveCondition_oCST_oJ1939_bms_ed49cd8a_Rx, ComSignalType=UINT8
        CTS_Year_oCTS_oJ1939_bms_66f2efa9_Rx: ComNotification=Rte_COMCbk_CTS_Year_oCTS_oJ1939_bms_66f2efa9_Rx, ComSignalType=UINT16
        ChargeCurrWU_Ena_oVCU_BS_01_oATOM_HWLIN1_d9c09dc2_Tx: ComSignalType=BOOLEAN
        ChargeCurrWU_Treshold_oVCU_BS_01_oATOM_HWLIN1_5e5d12a4_Tx: ComSignalType=UINT8
        DisChargeCurrWU_Ena_oVCU_BS_01_oATOM_HWLIN1_b8f53272_Tx: ComSignalType=BOOLEAN
        DisChargeCurrWU_Treshold_oVCU_BS_01_oATOM_HWLIN1_05d46e7e_Tx: ComSignalType=UINT8
        FRC_ComFtonNet_oFRC_01_oATOM_HWLIN1_9657f14b_Rx: ComNotification=Rte_COMCbk_FRC_ComFtonNet_oFRC_01_oATOM_HWLIN1_9657f14b_Rx, ComSignalType=BOOLEAN
        FRC_Vl_OV_oFRC_01_oATOM_HWLIN1_0d56a8b4_Rx: ComNotification=Rte_COMCbk_FRC_Vl_OV_oFRC_01_oATOM_HWLIN1_0d56a8b4_Rx, ComSignalType=BOOLEAN
        FRC_Vl_UV_oFRC_01_oATOM_HWLIN1_e10bbe37_Rx: ComNotification=Rte_COMCbk_FRC_Vl_UV_oFRC_01_oATOM_HWLIN1_e10bbe37_Rx, ComSignalType=BOOLEAN
        IBATT_QUIESCENT_oBS_01_oATOM_HWLIN1_4bd68518_Rx: ComNotification=Rte_COMCbk_IBATT_QUIESCENT_oBS_01_oATOM_HWLIN1_4bd68518_Rx, ComSignalType=UINT8
        I_BATT_oBS_01_oATOM_HWLIN1_194c0d33_Rx: ComNotification=Rte_COMCbk_I_BATT_oBS_01_oATOM_HWLIN1_194c0d33_Rx, ComSignalType=UINT16
        I_RANGE_oBS_01_oATOM_HWLIN1_5f69a46a_Rx: ComNotification=Rte_COMCbk_I_RANGE_oBS_01_oATOM_HWLIN1_5f69a46a_Rx, ComSignalType=UINT8
        Resp_Error_oBS_01_oATOM_HWLIN1_f35fadbf_Rx: ComNotification=Rte_COMCbk_Resp_Error_oBS_01_oATOM_HWLIN1_f35fadbf_Rx, ComSignalType=BOOLEAN
      106 x ComSignalGroup:
        SG_ACU_01_SigGroup_oACU_01_oATOM_CANFD_Matrix_CH_V600_202502_0a16dd9e_Rx: ComNotification=Rte_COMCbk_SG_ACU_01_SigGroup_oACU_01_oATOM_CANFD_Matrix_CH_V600_202502_0a16dd9e_Rx
          4 x ComGroupSignal:
            ACU_YawRateStatus_oACU_01_oATOM_CANFD_Matrix_CH_V600_202502_a5dd4854_Rx: ComSignalType=UINT8
            ACU_YawRate_oACU_01_oATOM_CANFD_Matrix_CH_V600_202502_35ce62e9_Rx: ComSignalType=UINT16
            Checksum_0F5_oACU_01_oATOM_CANFD_Matrix_CH_V600_202502_21944b83_Rx: ComSignalType=UINT8
            MessageCounter_0F5_oACU_01_oATOM_CANFD_Matrix_CH_V600_202502_e1f37972_Rx: ComSignalType=UINT8
        SG_ACU_02_SigGroup_oACU_02_oATOM_CANFD_Matrix_CH_V600_202502_3b90e790_Rx: ComNotification=Rte_COMCbk_SG_ACU_02_SigGroup_oACU_02_oATOM_CANFD_Matrix_CH_V600_202502_3b90e790_Rx
          6 x ComGroupSignal:
            ACU_LatAStatus_oACU_02_oATOM_CANFD_Matrix_CH_V600_202502_5faf7139_Rx: ComSignalType=UINT8
            ACU_LatA_oACU_02_oATOM_CANFD_Matrix_CH_V600_202502_0373507d_Rx: ComSignalType=UINT16
            ACU_LgtAStatus_oACU_02_oATOM_CANFD_Matrix_CH_V600_202502_8eba5290_Rx: ComSignalType=UINT8
            ACU_LgtA_oACU_02_oATOM_CANFD_Matrix_CH_V600_202502_7ce5ad57_Rx: ComSignalType=UINT16
            Checksum_0F6_oACU_02_oATOM_CANFD_Matrix_CH_V600_202502_63736e97_Rx: ComSignalType=UINT8
            MessageCounter_0F6_oACU_02_oATOM_CANFD_Matrix_CH_V600_202502_a3145c66_Rx: ComSignalType=UINT8
        SG_ACU_info_SigGroup_oACU_info_oATOM_CANFD_Matrix_CH_V600_202502_5b63ef23_Rx: ComNotification=Rte_COMCbk_SG_ACU_info_SigGroup_oACU_info_oATOM_CANFD_Matrix_CH_V600_202502_5b63ef23_Rx
          19 x ComGroupSignal:
            ACU_CrashOutputStsValid_oACU_info_oATOM_CANFD_Matrix_CH_V600_202502_01645954_Rx: ComSignalType=BOOLEAN
            ACU_CrashOutputSts_oACU_info_oATOM_CANFD_Matrix_CH_V600_202502_8aba12b9_Rx: ComSignalType=UINT8
            ACU_DriverSeatBeltStsValid_oACU_info_oATOM_CANFD_Matrix_CH_V600_202502_2fcd0f16_Rx: ComSignalType=BOOLEAN
            ACU_DriverSeatBeltSts_oACU_info_oATOM_CANFD_Matrix_CH_V600_202502_4a79a099_Rx: ComSignalType=BOOLEAN
            ACU_DriverWarningLampSts_oACU_info_oATOM_CANFD_Matrix_CH_V600_202502_53dfaac4_Rx: ComSignalType=UINT8
            ACU_PassengerAirbagSts_oACU_info_oATOM_CANFD_Matrix_CH_V600_202502_4a4cb1e6_Rx: ComSignalType=UINT8
            ACU_PassengerSeatBeltStsValid_oACU_info_oATOM_CANFD_Matrix_CH_V600_202502_96ea6676_Rx: ComSignalType=BOOLEAN
            ACU_PassengerSeatBeltSts_oACU_info_oATOM_CANFD_Matrix_CH_V600_202502_2c4c3734_Rx: ComSignalType=BOOLEAN
            ACU_PassengerSts_oACU_info_oATOM_CANFD_Matrix_CH_V600_202502_eb52bcb8_Rx: ComSignalType=BOOLEAN
            ACU_PassengerWarningLampSts_oACU_info_oATOM_CANFD_Matrix_CH_V600_202502_eaccbc6f_Rx: ComSignalType=UINT8
            ACU_RLSeatBeltStatusValid_oACU_info_oATOM_CANFD_Matrix_CH_V600_202502_231d8b98_Rx: ComSignalType=BOOLEAN
            ACU_RRSeatBeltStatusValid_oACU_info_oATOM_CANFD_Matrix_CH_V600_202502_8ba1e757_Rx: ComSignalType=BOOLEAN
            ACU_SecondLeftSeatBeltSts_oACU_info_oATOM_CANFD_Matrix_CH_V600_202502_0c298557_Rx: ComSignalType=BOOLEAN
            ACU_SecondLeftSts_oACU_info_oATOM_CANFD_Matrix_CH_V600_202502_4d0b3459_Rx: ComSignalType=BOOLEAN
            ACU_SecondRightSeatBeltSts_oACU_info_oATOM_CANFD_Matrix_CH_V600_202502_3170c946_Rx: ComSignalType=BOOLEAN
            ACU_SecondRightSts_oACU_info_oATOM_CANFD_Matrix_CH_V600_202502_19211d8e_Rx: ComSignalType=BOOLEAN
            ACU_WarningLampSts_oACU_info_oATOM_CANFD_Matrix_CH_V600_202502_9c596fcb_Rx: ComSignalType=UINT8
            Checksum_097_oACU_info_oATOM_CANFD_Matrix_CH_V600_202502_591da21b_Rx: ComSignalType=UINT8
            MessageCounter_097_oACU_info_oATOM_CANFD_Matrix_CH_V600_202502_9c6de300_Rx: ComSignalType=UINT8
        SG_ADCU_ACC_02_SigGroup_oADCU_ACC_02_oATOM_CANFD_Matrix_CH_V600_202502_1e479296_Rx: ComNotification=Rte_COMCbk_SG_ADCU_ACC_02_SigGroup_oADCU_ACC_02_oATOM_CANFD_Matrix_CH_V600_202502_1e479296_Rx
          5 x ComGroupSignal, all with ComSignalType=UINT8:
            ADCU_ACCDA_HandsOFF_Warning_oADCU_ACC_02_oATOM_CANFD_Matrix_CH_V600_202502_cdbbce90_Rx
            ADCU_ACCDA_SYS_Failure_oADCU_ACC_02_oATOM_CANFD_Matrix_CH_V600_202502_0c0a67d0_Rx
            ADCU_ACC_Mode_oADCU_ACC_02_oATOM_CANFD_Matrix_CH_V600_202502_4b80afee_Rx
            Checksum_0E0_oADCU_ACC_02_oATOM_CANFD_Matrix_CH_V600_202502_31389c92_Rx
            MessageCounter_0E0_oADCU_ACC_02_oATOM_CANFD_Matrix_CH_V600_202502_982cdfbe_Rx
        SG_ADCU_AEB_01_SigGroup_oADCU_AEB_01_oATOM_CANFD_Matrix_CH_V600_202502_50a93e3a_Rx: ComNotification=Rte_COMCbk_SG_ADCU_AEB_01_SigGroup_oADCU_AEB_01_oATOM_CANFD_Matrix_CH_V600_202502_50a93e3a_Rx
          11 x ComGroupSignal:
            ADCU_AEBReq_oADCU_AEB_01_oATOM_CANFD_Matrix_CH_V600_202502_cfcc0419_Rx: ComSignalType=BOOLEAN
            ADCU_AEBWarningSts_oADCU_AEB_01_oATOM_CANFD_Matrix_CH_V600_202502_ce5fed0e_Rx: ComSignalType=UINT8
            ADCU_AEB_AWB_Level_oADCU_AEB_01_oATOM_CANFD_Matrix_CH_V600_202502_16b7390a_Rx: ComSignalType=UINT8
            ADCU_AEB_AWB_Req_oADCU_AEB_01_oATOM_CANFD_Matrix_CH_V600_202502_52a850e5_Rx: ComSignalType=BOOLEAN
            ADCU_AEB_Decel_Cmd_oADCU_AEB_01_oATOM_CANFD_Matrix_CH_V600_202502_e2026fd4_Rx: ComSignalType=SINT16
            ADCU_AEB_Prefill_CMD_oADCU_AEB_01_oATOM_CANFD_Matrix_CH_V600_202502_935b0159_Rx: ComSignalType=BOOLEAN
            ADCU_AEB_State_oADCU_AEB_01_oATOM_CANFD_Matrix_CH_V600_202502_040d6d85_Rx: ComSignalType=UINT8
            ADCU_AEB_Stop_Req_oADCU_AEB_01_oATOM_CANFD_Matrix_CH_V600_202502_edd96c77_Rx: ComSignalType=BOOLEAN
            ADCU_FCW_State_oADCU_AEB_01_oATOM_CANFD_Matrix_CH_V600_202502_858628ce_Rx: ComSignalType=UINT8
            Checksum_0E2_oADCU_AEB_01_oATOM_CANFD_Matrix_CH_V600_202502_3047b966_Rx: ComSignalType=UINT8
            MessageCounter_0E2_oADCU_AEB_01_oATOM_CANFD_Matrix_CH_V600_202502_9953fa4a_Rx: ComSignalType=UINT8
        SG_ADCU_APS_01_SigGroup_oADCU_APS_01_oATOM_CANFD_Matrix_CH_V600_202502_c590572d_Rx: ComNotification=Rte_COMCbk_SG_ADCU_APS_01_SigGroup_oADCU_APS_01_oATOM_CANFD_Matrix_CH_V600_202502_c590572d_Rx
          12 x ComGroupSignal:
            ADCU_APSComfBrkReq_oADCU_APS_01_oATOM_CANFD_Matrix_CH_V600_202502_b25663d8_Rx: ComSignalType=UINT8
            ADCU_APSCrlModeReq_oADCU_APS_01_oATOM_CANFD_Matrix_CH_V600_202502_589f1c09_Rx: ComSignalType=UINT8
            ADCU_APSCrlReq_oADCU_APS_01_oATOM_CANFD_Matrix_CH_V600_202502_da787726_Rx: ComSignalType=UINT8
            ADCU_APSCrlTypReq_oADCU_APS_01_oATOM_CANFD_Matrix_CH_V600_202502_25dd00be_Rx: ComSignalType=UINT8
            ADCU_APSDistanceStop_oADCU_APS_01_oATOM_CANFD_Matrix_CH_V600_202502_5af9bfc0_Rx: ComSignalType=UINT16
            ADCU_APSMaxSpeedReq_oADCU_APS_01_oATOM_CANFD_Matrix_CH_V600_202502_afdb21bd_Rx: ComSignalType=UINT8
            ADCU_APS_Stop_Req_oADCU_APS_01_oATOM_CANFD_Matrix_CH_V600_202502_cd03c7ef_Rx: ComSignalType=UINT8
            ADCU_Parking_CtrlSts_oADCU_APS_01_oATOM_CANFD_Matrix_CH_V600_202502_c95774a6_Rx: ComSignalType=UINT8
            ADCU_Parking_Mode_oADCU_APS_01_oATOM_CANFD_Matrix_CH_V600_202502_c6e9f3f9_Rx: ComSignalType=UINT8
            ADCU_TargetGear_oADCU_APS_01_oATOM_CANFD_Matrix_CH_V600_202502_dbe43087_Rx: ComSignalType=UINT8
            Checksum_0E4_oADCU_APS_01_oATOM_CANFD_Matrix_CH_V600_202502_19b3517b_Rx: ComSignalType=UINT8
            MessageCounter_0E4_oADCU_APS_01_oATOM_CANFD_Matrix_CH_V600_202502_b0a71257_Rx: ComSignalType=UINT8
        SG_ADCU_APS_02_SigGroup_oADCU_APS_02_oATOM_CANFD_Matrix_CH_V600_202502_67bc1f98_Rx: ComNotification=Rte_COMCbk_SG_ADCU_APS_02_SigGroup_oADCU_APS_02_oATOM_CANFD_Matrix_CH_V600_202502_67bc1f98_Rx
          ADCU_RemoteParkingMode_oADCU_APS_02_oATOM_CANFD_Matrix_CH_V600_202502_262c752a_Rx (ComGroupSignal): ComSignalType=UINT8
        SG_ADCU_DA_SigGroup_oADCU_DA_oATOM_CANFD_Matrix_CH_V600_202502_4133b6dd_Rx: ComNotification=Rte_COMCbk_SG_ADCU_DA_SigGroup_oADCU_DA_oATOM_CANFD_Matrix_CH_V600_202502_4133b6dd_Rx
          3 x ComGroupSignal, all with ComSignalType=UINT8:
            ADCU_DA_Mode_oADCU_DA_oATOM_CANFD_Matrix_CH_V600_202502_98abcb34_Rx
            Checksum_0E6_oADCU_DA_oATOM_CANFD_Matrix_CH_V600_202502_6e918845_Rx
            MessageCounter_0E6_oADCU_DA_oATOM_CANFD_Matrix_CH_V600_202502_a4eb2dfd_Rx
        SG_APTC_TCU_SigGroup_oAPTC_TCU_oATOM_CAN_Matrix_PT_V600_20250211_467c0275_Rx: ComNotification=Rte_COMCbk_SG_APTC_TCU_SigGroup_oAPTC_TCU_oATOM_CAN_Matrix_PT_V600_20250211_467c0275_Rx
          APTC_PowerConsumption_oAPTC_TCU_oATOM_CAN_Matrix_PT_V600_20250211_1649be11_Rx (ComGroupSignal): ComSignalType=UINT8
        SG_BCM_05_SigGroup_oBCM_05_oATOM_CAN_Matrix_PT_V600_20250211_46c76b05_Rx: ComNotification=Rte_COMCbk_SG_BCM_05_SigGroup_oBCM_05_oATOM_CAN_Matrix_PT_V600_20250211_46c76b05_Rx
          17 x ComGroupSignal:
            BCM_AutoCloseWinFunSts_oBCM_05_oATOM_CAN_Matrix_PT_V600_20250211_721cde79_Rx: ComSignalType=BOOLEAN
            BCM_ChrgFlapLockSts_oBCM_05_oATOM_CAN_Matrix_PT_V600_20250211_178f84af_Rx: ComSignalType=BOOLEAN
            BCM_DomeLampAutoSts_oBCM_05_oATOM_CAN_Matrix_PT_V600_20250211_d0321d9a_Rx: ComSignalType=UINT8
            BCM_DomeLampBrightSts_oBCM_05_oATOM_CAN_Matrix_PT_V600_20250211_a496c206_Rx: ComSignalType=BOOLEAN
            BCM_FLSeatBeltRemindReq_oBCM_05_oATOM_CAN_Matrix_PT_V600_20250211_65ab8c1e_Rx: ComSignalType=UINT8
            BCM_FRSeatBeltRemindReq_oBCM_05_oATOM_CAN_Matrix_PT_V600_20250211_4ddb1af9_Rx: ComSignalType=UINT8
            BCM_FrontWiperModeSts_oBCM_05_oATOM_CAN_Matrix_PT_V600_20250211_bc45dbca_Rx: ComSignalType=UINT8
            BCM_GearTimesSts_oBCM_05_oATOM_CAN_Matrix_PT_V600_20250211_f9cf4f13_Rx: ComSignalType=UINT8
            BCM_KeyNotInCarRemind_oBCM_05_oATOM_CAN_Matrix_PT_V600_20250211_26929e5b_Rx: ComSignalType=BOOLEAN
            BCM_PuddleLiReq_oBCM_05_oATOM_CAN_Matrix_PT_V600_20250211_e2d97524_Rx: ComSignalType=UINT8
            BCM_RLSeatBeltRemindReq_oBCM_05_oATOM_CAN_Matrix_PT_V600_20250211_f8ff7457_Rx: ComSignalType=UINT8
            BCM_RRSeatBeltRemindReq_oBCM_05_oATOM_CAN_Matrix_PT_V600_20250211_d08fe2b0_Rx: ComSignalType=UINT8
            BCM_WelLightshowOnOffSts_oBCM_05_oATOM_CAN_Matrix_PT_V600_20250211_5761d474_Rx: ComSignalType=UINT8
            BCM_WiperServiceSts_oBCM_05_oATOM_CAN_Matrix_PT_V600_20250211_00dc1681_Rx: ComSignalType=UINT8
            BCM_WiperWorkingSts_oBCM_05_oATOM_CAN_Matrix_PT_V600_20250211_2776ea8d_Rx: ComSignalType=UINT8
            Checksum_33A_oBCM_05_oATOM_CAN_Matrix_PT_V600_20250211_240d647b_Rx: ComSignalType=UINT8
            MessageCounter_33A_oBCM_05_oATOM_CAN_Matrix_PT_V600_20250211_e46a568a_Rx: ComSignalType=UINT8
        SG_BCM_06_SigGroup_oBCM_06_oATOM_CAN_Matrix_PT_V600_20250211_7741510b_Rx: ComNotification=Rte_COMCbk_SG_BCM_06_SigGroup_oBCM_06_oATOM_CAN_Matrix_PT_V600_20250211_7741510b_Rx
          4 x ComGroupSignal:
            BCM_PepsPowerMode_oBCM_06_oATOM_CAN_Matrix_PT_V600_20250211_db922ead_Rx: ComSignalType=UINT8
            BCM_PowerOffDisplayReq_oBCM_06_oATOM_CAN_Matrix_PT_V600_20250211_9133ccdf_Rx: ComSignalType=BOOLEAN
            MessageCounter_271_oBCM_06_oATOM_CAN_Matrix_PT_V600_20250211_8423cb57_Rx: ComSignalType=UINT8
            checksum_271_oBCM_06_oATOM_CAN_Matrix_PT_V600_20250211_70f1cf66_Rx: ComSignalType=UINT8
        SG_BMS_BatInfor_01_SigGroup_oBMS_BatInfor_01_oATOM_CAN_Matrix_PT_V600_20250211_4fef2501_Rx: ComNotification=Rte_COMCbk_SG_BMS_BatInfor_01_SigGroup_oBMS_BatInfor_01_oATOM_CAN_Matrix_PT_V600_20250211_4fef2501_Rx
          5 x ComGroupSignal:
            BMS_BatType_oBMS_BatInfor_01_oATOM_CAN_Matrix_PT_V600_20250211_379fb564_Rx: ComSignalType=UINT8
            BMS_CellNumbers_oBMS_BatInfor_01_oATOM_CAN_Matrix_PT_V600_20250211_c37ce81e_Rx: ComSignalType=UINT8
            BMS_RatBatVoltage_oBMS_BatInfor_01_oATOM_CAN_Matrix_PT_V600_20250211_f1943e5d_Rx: ComSignalType=UINT16
            BMS_RatCapacity_oBMS_BatInfor_01_oATOM_CAN_Matrix_PT_V600_20250211_a06c3dfc_Rx: ComSignalType=UINT16
            BMS_RatEnergy_oBMS_BatInfor_01_oATOM_CAN_Matrix_PT_V600_20250211_92d3972c_Rx: ComSignalType=UINT16
        SG_BMS_BatInfor_02_SigGroup_oBMS_BatInfor_02_oATOM_CAN_Matrix_PT_V600_20250211_426bcc59_Rx: ComNotification=Rte_COMCbk_SG_BMS_BatInfor_02_SigGroup_oBMS_BatInfor_02_oATOM_CAN_Matrix_PT_V600_20250211_426bcc59_Rx
          BMS_BatSupName_oBMS_BatInfor_02_oATOM_CAN_Matrix_PT_V600_20250211_eaf2f758_Rx (ComGroupSignal): ComSignalType=UINT64
        SG_BMS_BatInfor_03_SigGroup_oBMS_BatInfor_03_oATOM_CAN_Matrix_PT_V600_20250211_f03896ae_Rx: ComNotification=Rte_COMCbk_SG_BMS_BatInfor_03_SigGroup_oBMS_BatInfor_03_oATOM_CAN_Matrix_PT_V600_20250211_f03896ae_Rx
          BMS_RemainCapacity_oBMS_BatInfor_03_oATOM_CAN_Matrix_PT_V600_20250211_0c2dc68f_Rx (ComGroupSignal): ComSignalType=UINT16
        SG_BMS_CellTemp_SigGroup_oBMS_CellTemp_oATOM_CAN_Matrix_PT_V600_20250211_591a267a_Rx: ComNotification=Rte_COMCbk_SG_BMS_CellTemp_SigGroup_oBMS_CellTemp_oATOM_CAN_Matrix_PT_V600_20250211_591a267a_Rx
          6 x ComGroupSignal, all with ComSignalType=UINT8:
            BMS_AverageCellTemp_oBMS_CellTemp_oATOM_CAN_Matrix_PT_V600_20250211_8a0ff926_Rx
            BMS_MaxCellTempNO_oBMS_CellTemp_oATOM_CAN_Matrix_PT_V600_20250211_34228f51_Rx
            BMS_MaxCellTemp_oBMS_CellTemp_oATOM_CAN_Matrix_PT_V600_20250211_f2af76ab_Rx
            BMS_MinCellTempModuleNO_oBMS_CellTemp_oATOM_CAN_Matrix_PT_V600_20250211_5ad1b821_Rx
            BMS_MinCellTempNO_oBMS_CellTemp_oATOM_CAN_Matrix_PT_V600_20250211_5aa7be5e_Rx
            BMS_MinCellTemp_oBMS_CellTemp_oATOM_CAN_Matrix_PT_V600_20250211_cb26cda9_Rx
        SG_BMS_CellVoltage_SigGroup_oBMS_CellVoltage_oATOM_CAN_Matrix_PT_V600_20250211_e26ec140_Rx: ComNotification=Rte_COMCbk_SG_BMS_CellVoltage_SigGroup_oBMS_CellVoltage_oATOM_CAN_Matrix_PT_V600_20250211_e26ec140_Rx
          4 x ComGroupSignal:
            BMS_MaxCellVoltageModuleNO_oBMS_CellVoltage_oATOM_CAN_Matrix_PT_V600_20250211_41af4f62_Rx: ComSignalType=UINT8
            BMS_MaxCellVoltageNO_oBMS_CellVoltage_oATOM_CAN_Matrix_PT_V600_20250211_f7be414b_Rx: ComSignalType=UINT8
            BMS_MaxCellVoltage_oBMS_CellVoltage_oATOM_CAN_Matrix_PT_V600_20250211_44643af9_Rx: ComSignalType=UINT16
            BMS_MinCellVoltage_oBMS_CellVoltage_oATOM_CAN_Matrix_PT_V600_20250211_d5508559_Rx: ComSignalType=UINT16
        SG_BMS_Charge_01_SigGroup_oBMS_Charge_01_oATOM_CAN_Matrix_PT_V600_20250211_216177cb_Rx: ComNotification=Rte_COMCbk_SG_BMS_Charge_01_SigGroup_oBMS_Charge_01_oATOM_CAN_Matrix_PT_V600_20250211_216177cb_Rx
          3 x ComGroupSignal, all with ComSignalType=UINT16:
            BMS_AllowChagCurrent_oBMS_Charge_01_oATOM_CAN_Matrix_PT_V600_20250211_5bdeed04_Rx
            BMS_MaxChagVoltage_oBMS_Charge_01_oATOM_CAN_Matrix_PT_V600_20250211_6cebdb8e_Rx
            BMS_RemChagTime_oBMS_Charge_01_oATOM_CAN_Matrix_PT_V600_20250211_27af82cf_Rx
        SG_BMS_Charge_02_SigGroup_oBMS_Charge_02_oATOM_CAN_Matrix_PT_V600_20250211_116647c1_Rx: ComNotification=Rte_COMCbk_SG_BMS_Charge_02_SigGroup_oBMS_Charge_02_oATOM_CAN_Matrix_PT_V600_20250211_116647c1_Rx
          10 x ComGroupSignal, all with ComSignalType=UINT8:
            BMS_AbortAchiveSingleVolt_oBMS_Charge_02_oATOM_CAN_Matrix_PT_V600_20250211_b1bd7374_Rx
            BMS_AbortAchiveTotalVolt_oBMS_Charge_02_oATOM_CAN_Matrix_PT_V600_20250211_f53da614_Rx
            BMS_AbortAchivesetValue_oBMS_Charge_02_oATOM_CAN_Matrix_PT_V600_20250211_efa8b96b_Rx
            BMS_AbortErrorCurrent_oBMS_Charge_02_oATOM_CAN_Matrix_PT_V600_20250211_db5d5e67_Rx
            BMS_AbortErrorVoltage_oBMS_Charge_02_oATOM_CAN_Matrix_PT_V600_20250211_445453cb_Rx
            BMS_AbortFaultBMSTemp_oBMS_Charge_02_oATOM_CAN_Matrix_PT_V600_20250211_403794ce_Rx
            BMS_AbortFaultBatteryTemp_oBMS_Charge_02_oATOM_CAN_Matrix_PT_V600_20250211_5b6b8a56_Rx
            BMS_ChagComplete_oBMS_Charge_02_oATOM_CAN_Matrix_PT_V600_20250211_ea7a6697_Rx
            BMS_ChargeRequest_oBMS_Charge_02_oATOM_CAN_Matrix_PT_V600_20250211_1918c4e0_Rx
            BMS_DCChgMode_oBMS_Charge_02_oATOM_CAN_Matrix_PT_V600_20250211_6d869dd0_Rx
        SG_BMS_Charge_03_SigGroup_oBMS_Charge_03_oATOM_CAN_Matrix_PT_V600_20250211_b7b455f8_Rx: ComNotification=Rte_COMCbk_SG_BMS_Charge_03_SigGroup_oBMS_Charge_03_oATOM_CAN_Matrix_PT_V600_20250211_b7b455f8_Rx
          3 x ComGroupSignal:
            BMS_BatChagSum_oBMS_Charge_03_oATOM_CAN_Matrix_PT_V600_20250211_acd539d3_Rx: ComSignalType=UINT16
            BMS_SingChgkwh_oBMS_Charge_03_oATOM_CAN_Matrix_PT_V600_20250211_015ce54e_Rx: ComSignalType=UINT8
            BMS_SumChgkwh_oBMS_Charge_03_oATOM_CAN_Matrix_PT_V600_20250211_483ef743_Rx: ComSignalType=UINT32
        SG_BMS_DIRelayState_SigGroup_oBMS_DIRelayState_oATOM_CAN_Matrix_PT_V600_20250211_ca554d8c_Rx: ComNotification=Rte_COMCbk_SG_BMS_DIRelayState_SigGroup_oBMS_DIRelayState_oATOM_CAN_Matrix_PT_V600_20250211_ca554d8c_Rx
          5 x ComGroupSignal:
            BMS_NegRelayStatus_oBMS_DIRelayState_oATOM_CAN_Matrix_PT_V600_20250211_cb3f998e_Rx: ComSignalType=UINT8
            BMS_PTCRelayStatus_oBMS_DIRelayState_oATOM_CAN_Matrix_PT_V600_20250211_51f2d2bd_Rx: ComSignalType=UINT8
            BMS_PTC_VoltageValue_oBMS_DIRelayState_oATOM_CAN_Matrix_PT_V600_20250211_01e2b502_Rx: ComSignalType=UINT16
            BMS_PosRelayStatus_oBMS_DIRelayState_oATOM_CAN_Matrix_PT_V600_20250211_0aa0be71_Rx: ComSignalType=UINT8
            BMS_PreRelayStatus_oBMS_DIRelayState_oATOM_CAN_Matrix_PT_V600_20250211_51af39b6_Rx: ComSignalType=UINT8
        SG_BMS_ErrorInfo_SigGroup_oBMS_ErrorInfo_oATOM_CAN_Matrix_PT_V600_20250211_0728f72e_Rx: ComNotification=Rte_COMCbk_SG_BMS_ErrorInfo_SigGroup_oBMS_ErrorInfo_oATOM_CAN_Matrix_PT_V600_20250211_0728f72e_Rx
          10 x ComGroupSignal:
            BMS_ErrorCellHighTemp_oBMS_ErrorInfo_oATOM_CAN_Matrix_PT_V600_20250211_99700c48_Rx: ComSignalType=UINT8
            BMS_ErrorCellLowTemp_oBMS_ErrorInfo_oATOM_CAN_Matrix_PT_V600_20250211_c40cc4fe_Rx: ComSignalType=UINT8
            BMS_ErrorCellOverVolt_oBMS_ErrorInfo_oATOM_CAN_Matrix_PT_V600_20250211_5db8e4a2_Rx: ComSignalType=UINT8
            BMS_ErrorCellUnderVolt_oBMS_ErrorInfo_oATOM_CAN_Matrix_PT_V600_20250211_56775465_Rx: ComSignalType=UINT8
            BMS_ErrorChaCurrentOver_oBMS_ErrorInfo_oATOM_CAN_Matrix_PT_V600_20250211_a2ef7503_Rx: ComSignalType=UINT8
            BMS_ErrorHighSoc_oBMS_ErrorInfo_oATOM_CAN_Matrix_PT_V600_20250211_73bd0212_Rx: ComSignalType=BOOLEAN
            BMS_ErrorLowSoc_oBMS_ErrorInfo_oATOM_CAN_Matrix_PT_V600_20250211_b96841e2_Rx: ComSignalType=UINT8
            BMS_ErrorPreChaFailed_oBMS_ErrorInfo_oATOM_CAN_Matrix_PT_V600_20250211_59a6a965_Rx: ComSignalType=BOOLEAN
            BMS_ErrorRelay_oBMS_ErrorInfo_oATOM_CAN_Matrix_PT_V600_20250211_117a9031_Rx: ComSignalType=BOOLEAN
            BMS_ThermalRunawayFault_oBMS_ErrorInfo_oATOM_CAN_Matrix_PT_V600_20250211_bc9ae26c_Rx: ComSignalType=BOOLEAN
        SG_BMS_PRO_SigGroup_oBMS_PRO_oATOM_CAN_Matrix_PT_V600_20250211_21a267c0_Rx: ComNotification=Rte_COMCbk_SG_BMS_PRO_SigGroup_oBMS_PRO_oATOM_CAN_Matrix_PT_V600_20250211_21a267c0_Rx
          3 x ComGroupSignal, all with ComSignalType=UINT8:
            BMS_BatProDatDay_oBMS_PRO_oATOM_CAN_Matrix_PT_V600_20250211_7f9a6bc2_Rx
            BMS_BatProDatMonth_oBMS_PRO_oATOM_CAN_Matrix_PT_V600_20250211_a585932e_Rx
            BMS_BatProDatYear_oBMS_PRO_oATOM_CAN_Matrix_PT_V600_20250211_329b6492_Rx
        SG_BMS_TCU_SigGroup_oBMS_TCU_oATOM_CAN_Matrix_PT_V600_20250211_541a46a3_Rx: ComNotification=Rte_COMCbk_SG_BMS_TCU_SigGroup_oBMS_TCU_oATOM_CAN_Matrix_PT_V600_20250211_541a46a3_Rx
          4 x ComGroupSignal:
            BMS_AllowCellTemperature_oBMS_TCU_oATOM_CAN_Matrix_PT_V600_20250211_696be742_Rx: ComSignalType=UINT8
            BMS_KeepWarmRequest_oBMS_TCU_oATOM_CAN_Matrix_PT_V600_20250211_1b8e0c34_Rx: ComSignalType=BOOLEAN
            BMS_KeepWarmStatus_oBMS_TCU_oATOM_CAN_Matrix_PT_V600_20250211_96e48497_Rx: ComSignalType=UINT8
            BMS_RTC_Request_oBMS_TCU_oATOM_CAN_Matrix_PT_V600_20250211_dbff15fc_Rx: ComSignalType=BOOLEAN
        SG_BMS_VersionInfor_SigGroup_oBMS_VersionInfor_oATOM_CAN_Matrix_PT_V600_20250211_3c7841d8_Rx: ComNotification=Rte_COMCbk_SG_BMS_VersionInfor_SigGroup_oBMS_VersionInfor_oATOM_CAN_Matrix_PT_V600_20250211_3c7841d8_Rx
          BMS_BatProRights_oBMS_VersionInfor_oATOM_CAN_Matrix_PT_V600_20250211_65b7c251_Rx (ComGroupSignal): ComSignalType=BOOLEAN
          BMS_ComVersion_oBMS_VersionInfor_oATOM_CAN_Matrix_PT_V600_20250211_a6b9c4fe_Rx (ComGroupSignal): ComSignalType=UINT16
        SG_BMS_status_01_SigGroup_oBMS_status_01_oATOM_CAN_Matrix_PT_V600_20250211_2f7ddbcd_Rx: ComNotification=Rte_COMCbk_SG_BMS_status_01_SigGroup_oBMS_status_01_oATOM_CAN_Matrix_PT_V600_20250211_2f7ddbcd_Rx
          14 x ComGroupSignal:
            BMS_BalancingStatus_oBMS_status_01_oATOM_CAN_Matrix_PT_V600_20250211_282baecd_Rx: ComSignalType=BOOLEAN
            BMS_ChargeStatus_oBMS_status_01_oATOM_CAN_Matrix_PT_V600_20250211_79fec82c_Rx: ComSignalType=UINT8
            BMS_ErrorIsolationSingleLow_oBMS_status_01_oATOM_CAN_Matrix_PT_V600_20250211_b188e9c7_Rx: ComSignalType=UINT8
            BMS_ErrorLevel_oBMS_status_01_oATOM_CAN_Matrix_PT_V600_20250211_9a0a25e1_Rx: ComSignalType=UINT8
            BMS_HVinterlockState_oBMS_status_01_oATOM_CAN_Matrix_PT_V600_20250211_83b45d03_Rx: ComSignalType=BOOLEAN
            BMS_InsulationDetectionStatus_oBMS_status_01_oATOM_CAN_Matrix_PT_V600_20250211_27ab5dff_Rx: ComSignalType=BOOLEAN
            BMS_PreCharge_oBMS_status_01_oATOM_CAN_Matrix_PT_V600_20250211_07564e5b_Rx: ComSignalType=UINT8
            BMS_RunHeatStatus_oBMS_status_01_oATOM_CAN_Matrix_PT_V600_20250211_2fcb1018_Rx: ComSignalType=UINT8
            BMS_SOH_oBMS_status_01_oATOM_CAN_Matrix_PT_V600_20250211_1aab6bd4_Rx: ComSignalType=UINT8
            BMS_SysRegInsulationValue_oBMS_status_01_oATOM_CAN_Matrix_PT_V600_20250211_8d0ccb80_Rx: ComSignalType=UINT16
            BMS_ThrmlRunawayFault_oBMS_status_01_oATOM_CAN_Matrix_PT_V600_20250211_72ef69bf_Rx: ComSignalType=BOOLEAN
            BMS_WorkMode_oBMS_status_01_oATOM_CAN_Matrix_PT_V600_20250211_93c719c8_Rx: ComSignalType=UINT8
            Checksum_0C1_oBMS_status_01_oATOM_CAN_Matrix_PT_V600_20250211_2a2c563b_Rx: ComSignalType=UINT8
            MessageCounter_0C1_oBMS_status_01_oATOM_CAN_Matrix_PT_V600_20250211_fcc884ab_Rx: ComSignalType=UINT8
        SG_BMS_status_02_SigGroup_oBMS_status_02_oATOM_CAN_Matrix_PT_V600_20250211_1f7aebc7_Rx: ComNotification=Rte_COMCbk_SG_BMS_status_02_SigGroup_oBMS_status_02_oATOM_CAN_Matrix_PT_V600_20250211_1f7aebc7_Rx
          3 x ComGroupSignal, all with ComSignalType=UINT16:
            BMS_BattCurr_oBMS_status_02_oATOM_CAN_Matrix_PT_V600_20250211_114279ae_Rx
            BMS_BattVolt_oBMS_status_02_oATOM_CAN_Matrix_PT_V600_20250211_434721f0_Rx
            BMS_Heatcurrent_oBMS_status_02_oATOM_CAN_Matrix_PT_V600_20250211_d7161a8d_Rx
        SG_BMS_status_03_SigGroup_oBMS_status_03_oATOM_CAN_Matrix_PT_V600_20250211_b9a8f9fe_Rx: ComNotification=Rte_COMCbk_SG_BMS_status_03_SigGroup_oBMS_status_03_oATOM_CAN_Matrix_PT_V600_20250211_b9a8f9fe_Rx
          3 x ComGroupSignal, all with ComSignalType=UINT16:
            BMS_DisplaySOC_oBMS_status_03_oATOM_CAN_Matrix_PT_V600_20250211_58348b09_Rx
            BMS_LinkVoltage_oBMS_status_03_oATOM_CAN_Matrix_PT_V600_20250211_57ffa044_Rx
            BMS_PackVoltage_oBMS_status_03_oATOM_CAN_Matrix_PT_V600_20250211_4cda4f33_Rx
        SG_BMS_status_04_SigGroup_oBMS_status_04_oATOM_CAN_Matrix_PT_V600_20250211_7f748bd3_Rx: ComNotification=Rte_COMCbk_SG_BMS_status_04_SigGroup_oBMS_status_04_oATOM_CAN_Matrix_PT_V600_20250211_7f748bd3_Rx
          BMS_DisChgCurr_oBMS_status_04_oATOM_CAN_Matrix_PT_V600_20250211_9054a7c7_Rx (ComGroupSignal): ComSignalType=SINT16
          BMS_FeedbackCurr_oBMS_status_04_oATOM_CAN_Matrix_PT_V600_20250211_adfb81c2_Rx (ComGroupSignal): ComSignalType=SINT16
        SG_CGW_01_SigGroup_oCGW_01_oATOM_CAN_Matrix_PT_V600_20250211_9280de14_Rx: ComNotification=Rte_COMCbk_SG_CGW_01_SigGroup_oCGW_01_oATOM_CAN_Matrix_PT_V600_20250211_9280de14_Rx
          3 x ComGroupSignal, all with ComSignalType=UINT8:
            CGW_VehicleState_oCGW_01_oATOM_CAN_Matrix_PT_V600_20250211_1252b1db_Rx
            Checksum_278_oCGW_01_oATOM_CAN_Matrix_PT_V600_20250211_d9b09121_Rx
            MessageCounter_278_oCGW_01_oATOM_CAN_Matrix_PT_V600_20250211_19d7a3d0_Rx
        SG_CGW_02_SigGroup_oCGW_02_oATOM_CAN_Matrix_PT_V600_20250211_a306e41a_Rx: ComNotification=Rte_COMCbk_SG_CGW_02_SigGroup_oCGW_02_oATOM_CAN_Matrix_PT_V600_20250211_a306e41a_Rx
          22 x ComGroupSignal, all with ComSignalType=BOOLEAN:
            CGW_ADCUSts_oCGW_02_oATOM_CAN_Matrix_PT_V600_20250211_4e5b2421_Rx
            CGW_BCMSts_oCGW_02_oATOM_CAN_Matrix_PT_V600_20250211_973cb2b1_Rx
            CGW_BMSSts_oCGW_02_oATOM_CAN_Matrix_PT_V600_20250211_c446f701_Rx
            CGW_CBMSts_oCGW_02_oATOM_CAN_Matrix_PT_V600_20250211_c3f45508_Rx
            CGW_CGWSts_oCGW_02_oATOM_CAN_Matrix_PT_V600_20250211_f27832b0_Rx
            CGW_DCM_FLSts_oCGW_02_oATOM_CAN_Matrix_PT_V600_20250211_b0fddc0a_Rx
            CGW_DCM_FRSts_oCGW_02_oATOM_CAN_Matrix_PT_V600_20250211_b2caf30f_Rx
            CGW_DCM_RLSts_oCGW_02_oATOM_CAN_Matrix_PT_V600_20250211_ef4d5eca_Rx
            CGW_DCM_RRSts_oCGW_02_oATOM_CAN_Matrix_PT_V600_20250211_ed7a71cf_Rx
            CGW_HLLSts_oCGW_02_oATOM_CAN_Matrix_PT_V600_20250211_9d5cf1eb_Rx
            CGW_HLRSts_oCGW_02_oATOM_CAN_Matrix_PT_V600_20250211_9f6bdeee_Rx
            CGW_HOD_HeatingSts_oCGW_02_oATOM_CAN_Matrix_PT_V600_20250211_d2f6c570_Rx
            CGW_IVISts_oCGW_02_oATOM_CAN_Matrix_PT_V600_20250211_f58e06dc_Rx
            CGW_MFP_FCSts_oCGW_02_oATOM_CAN_Matrix_PT_V600_20250211_6eb7e4ef_Rx
            CGW_MFP_RCSts_oCGW_02_oATOM_CAN_Matrix_PT_V600_20250211_3107662f_Rx
            CGW_PRNDSts_oCGW_02_oATOM_CAN_Matrix_PT_V600_20250211_bdb63078_Rx
            CGW_SCU_LSts_oCGW_02_oATOM_CAN_Matrix_PT_V600_20250211_9ba30c74_Rx
            CGW_SCU_RSts_oCGW_02_oATOM_CAN_Matrix_PT_V600_20250211_99942371_Rx
            CGW_SGWSts_oCGW_02_oATOM_CAN_Matrix_PT_V600_20250211_9f84f3f2_Rx
            CGW_SWPSts_oCGW_02_oATOM_CAN_Matrix_PT_V600_20250211_1aac9e5f_Rx
            CGW_SwichesSts_oCGW_02_oATOM_CAN_Matrix_PT_V600_20250211_c378d64a_Rx
            CGW_VCUSts_oCGW_02_oATOM_CAN_Matrix_PT_V600_20250211_d5f4b0ad_Rx
        SG_CGW_VIN1_SigGroup_oCGW_VIN1_oATOM_CAN_Matrix_PT_V600_20250211_49910b51_Rx: ComNotification=Rte_COMCbk_SG_CGW_VIN1_SigGroup_oCGW_VIN1_oATOM_CAN_Matrix_PT_V600_20250211_49910b51_Rx
          8 x ComGroupSignal, all with ComSignalType=UINT8:
            CGW_VIN0_oCGW_VIN1_oATOM_CAN_Matrix_PT_V600_20250211_460f82b6_Rx
            CGW_VIN1_oCGW_VIN1_oATOM_CAN_Matrix_PT_V600_20250211_e599aafa_Rx
            CGW_VIN2_oCGW_VIN1_oATOM_CAN_Matrix_PT_V600_20250211_da52d46f_Rx
            CGW_VIN3_oCGW_VIN1_oATOM_CAN_Matrix_PT_V600_20250211_79c4fc23_Rx
            CGW_VIN4_oCGW_VIN1_oATOM_CAN_Matrix_PT_V600_20250211_a5c42945_Rx
            CGW_VIN5_oCGW_VIN1_oATOM_CAN_Matrix_PT_V600_20250211_06520109_Rx
            CGW_VIN6_oCGW_VIN1_oATOM_CAN_Matrix_PT_V600_20250211_39997f9c_Rx
            CGW_VIN7_oCGW_VIN1_oATOM_CAN_Matrix_PT_V600_20250211_9a0f57d0_Rx
        SG_CGW_VIN2_SigGroup_oCGW_VIN2_oATOM_CAN_Matrix_PT_V600_20250211_c0accf92_Rx: ComNotification=Rte_COMCbk_SG_CGW_VIN2_SigGroup_oCGW_VIN2_oATOM_CAN_Matrix_PT_V600_20250211_c0accf92_Rx
          8 x ComGroupSignal, all with ComSignalType=UINT8:
            CGW_VIN10_oCGW_VIN2_oATOM_CAN_Matrix_PT_V600_20250211_40e1447e_Rx
            CGW_VIN11_oCGW_VIN2_oATOM_CAN_Matrix_PT_V600_20250211_e3776c32_Rx
            CGW_VIN12_oCGW_VIN2_oATOM_CAN_Matrix_PT_V600_20250211_dcbc12a7_Rx
            CGW_VIN13_oCGW_VIN2_oATOM_CAN_Matrix_PT_V600_20250211_7f2a3aeb_Rx
            CGW_VIN14_oCGW_VIN2_oATOM_CAN_Matrix_PT_V600_20250211_a32aef8d_Rx
            CGW_VIN15_oCGW_VIN2_oATOM_CAN_Matrix_PT_V600_20250211_00bcc7c1_Rx
            CGW_VIN8_oCGW_VIN2_oATOM_CAN_Matrix_PT_V600_20250211_d13aed08_Rx
            CGW_VIN9_oCGW_VIN2_oATOM_CAN_Matrix_PT_V600_20250211_72acc544_Rx
        SG_CGW_VIN3VER_SigGroup_oCGW_VIN3VER_oATOM_CAN_Matrix_PT_V600_20250211_7600cd71_Rx: ComNotification=Rte_COMCbk_SG_CGW_VIN3VER_SigGroup_oCGW_VIN3VER_oATOM_CAN_Matrix_PT_V600_20250211_7600cd71_Rx
          3 x ComGroupSignal, all with ComSignalType=UINT8:
            CGW_VERSION1_oCGW_VIN3VER_oATOM_CAN_Matrix_PT_V600_20250211_870615dc_Rx
            CGW_VERSION2_oCGW_VIN3VER_oATOM_CAN_Matrix_PT_V600_20250211_c1d420b8_Rx
            CGW_VIN16_oCGW_VIN3VER_oATOM_CAN_Matrix_PT_V600_20250211_e72a7464_Rx
        SG_DCM_FL_02_SigGroup_oDCM_FL_02_oATOM_CAN_Matrix_PT_V600_20250211_46147686_Rx: ComNotification=Rte_COMCbk_SG_DCM_FL_02_SigGroup_oDCM_FL_02_oATOM_CAN_Matrix_PT_V600_20250211_46147686_Rx
          12 x ComGroupSignal:
            Checksum_28A_oDCM_FL_02_oATOM_CAN_Matrix_PT_V600_20250211_cce2105d_Rx: ComSignalType=UINT8
            DCM_FL_DoorFLSts_oDCM_FL_02_oATOM_CAN_Matrix_PT_V600_20250211_2e6576e2_Rx: ComSignalType=BOOLEAN
            DCM_FL_FRWndSwA_oDCM_FL_02_oATOM_CAN_Matrix_PT_V600_20250211_a982c250_Rx: ComSignalType=UINT8
            DCM_FL_LeftMirrorHorizontalPos_oDCM_FL_02_oATOM_CAN_Matrix_PT_V600_20250211_010d4778_Rx: ComSignalType=UINT8
            DCM_FL_LeftMirrorVerticalPos_oDCM_FL_02_oATOM_CAN_Matrix_PT_V600_20250211_5ff4b001_Rx: ComSignalType=UINT8
            DCM_FL_MirrorAutoFoldUnfoldSts_oDCM_FL_02_oATOM_CAN_Matrix_PT_V600_20250211_6b867db1_Rx: ComSignalType=BOOLEAN
            DCM_FL_MirrorAutoTurnDownSts_oDCM_FL_02_oATOM_CAN_Matrix_PT_V600_20250211_da51d0f7_Rx: ComSignalType=BOOLEAN
            DCM_FL_MirrorFold_UnfoldSts_oDCM_FL_02_oATOM_CAN_Matrix_PT_V600_20250211_fb31c620_Rx: ComSignalType=BOOLEAN
            DCM_FL_RLWndSwA_oDCM_FL_02_oATOM_CAN_Matrix_PT_V600_20250211_74fa2511_Rx: ComSignalType=UINT8
            DCM_FL_RRWndSwA_oDCM_FL_02_oATOM_CAN_Matrix_PT_V600_20250211_09de1801_Rx: ComSignalType=UINT8
            DCM_FL_RearmirrorHeatingSts_oDCM_FL_02_oATOM_CAN_Matrix_PT_V600_20250211_aa058e71_Rx: ComSignalType=BOOLEAN
            MessageCounter_28A_oDCM_FL_02_oATOM_CAN_Matrix_PT_V600_20250211_4642a9f0_Rx: ComSignalType=UINT8
        SG_DCM_FR_02_SigGroup_oDCM_FR_02_oATOM_CAN_Matrix_PT_V600_20250211_f609c275_Rx: ComNotification=Rte_COMCbk_SG_DCM_FR_02_SigGroup_oDCM_FR_02_oATOM_CAN_Matrix_PT_V600_20250211_f609c275_Rx
          DCM_FR_AmbientTemperatureValid_oDCM_FR_02_oATOM_CAN_Matrix_PT_V600_20250211_e90c62bb_Rx (ComGroupSignal): ComSignalType=BOOLEAN
          DCM_FR_AmbientTemperature_oDCM_FR_02_oATOM_CAN_Matrix_PT_V600_20250211_cadd082e_Rx (ComGroupSignal): ComSignalType=UINT8
        SG_DCM_FR_SigGroup_oDCM_FR_oATOM_CAN_Matrix_PT_V600_20250211_eb540c93_Rx: ComNotification=Rte_COMCbk_SG_DCM_FR_SigGroup_oDCM_FR_oATOM_CAN_Matrix_PT_V600_20250211_eb540c93_Rx
          DCM_FR_DoorFRSts_oDCM_FR_oATOM_CAN_Matrix_PT_V600_20250211_525d6e8b_Rx (ComGroupSignal): ComSignalType=BOOLEAN
        SG_DCM_RL_SigGroup_oDCM_RL_oATOM_CAN_Matrix_PT_V600_20250211_a6554e24_Rx: ComNotification=Rte_COMCbk_SG_DCM_RL_SigGroup_oDCM_RL_oATOM_CAN_Matrix_PT_V600_20250211_a6554e24_Rx
          DCM_RL_DoorRLSts_oDCM_RL_oATOM_CAN_Matrix_PT_V600_20250211_9ea56f59_Rx (ComGroupSignal): ComSignalType=BOOLEAN
        SG_DCM_RR_SigGroup_oDCM_RR_oATOM_CAN_Matrix_PT_V600_20250211_9219ec09_Rx: ComNotification=Rte_COMCbk_SG_DCM_RR_SigGroup_oDCM_RR_oATOM_CAN_Matrix_PT_V600_20250211_9219ec09_Rx
          DCM_RR_DoorRRSts_oDCM_RR_oATOM_CAN_Matrix_PT_V600_20250211_c830eb38_Rx (ComGroupSignal): ComSignalType=BOOLEAN
        SG_EPS_CONV_SigGroup_oEPS_CONV_oATOM_CANFD_Matrix_CH_V600_202502_42428757_Rx: ComNotification=Rte_COMCbk_SG_EPS_CONV_SigGroup_oEPS_CONV_oATOM_CANFD_Matrix_CH_V600_202502_42428757_Rx
          11 x ComGroupSignal:
            Checksum_0F0_oEPS_CONV_oATOM_CANFD_Matrix_CH_V600_202502_1363b82a_Rx: ComSignalType=UINT8
            EPS_ModeChangeEnable_oEPS_CONV_oATOM_CANFD_Matrix_CH_V600_202502_151dc1e3_Rx: ComSignalType=BOOLEAN
            EPS_ModeFb_oEPS_CONV_oATOM_CANFD_Matrix_CH_V600_202502_e801e79c_Rx: ComSignalType=UINT8
            EPS_SteeringGearAngleSpdValid_oEPS_CONV_oATOM_CANFD_Matrix_CH_V600_202502_d84ac20b_Rx: ComSignalType=BOOLEAN
            EPS_SteeringGearAngleSpd_oEPS_CONV_oATOM_CANFD_Matrix_CH_V600_202502_1b144f24_Rx: ComSignalType=UINT16
            EPS_SteeringGearAngleValid_oEPS_CONV_oATOM_CANFD_Matrix_CH_V600_202502_70279b88_Rx: ComSignalType=BOOLEAN
            EPS_SteeringGearAngle_oEPS_CONV_oATOM_CANFD_Matrix_CH_V600_202502_afb680bd_Rx: ComSignalType=UINT16
            EPS_TorsionBarTorqueValid_oEPS_CONV_oATOM_CANFD_Matrix_CH_V600_202502_70e0d0fb_Rx: ComSignalType=BOOLEAN
            EPS_TorsionBarTorque_oEPS_CONV_oATOM_CANFD_Matrix_CH_V600_202502_28eeb08e_Rx: ComSignalType=UINT8
            EPS_WarningLamp_oEPS_CONV_oATOM_CANFD_Matrix_CH_V600_202502_1f264a37_Rx: ComSignalType=UINT8
            MessageCounter_0F0_oEPS_CONV_oATOM_CANFD_Matrix_CH_V600_202502_d613f931_Rx: ComSignalType=UINT8
        SG_EVCOM_State_01_SigGroup_oEVCOM_State_01_oATOM_CAN_Matrix_PT_V600_20250211_16f3767b_Rx: ComNotification=Rte_COMCbk_SG_EVCOM_State_01_SigGroup_oEVCOM_State_01_oATOM_CAN_Matrix_PT_V600_20250211_16f3767b_Rx
          EVCOM_CompActlCnsmpCur_oEVCOM_State_01_oATOM_CAN_Matrix_PT_V600_20250211_a627e94c_Rx (ComGroupSignal): ComSignalType=UINT8
          EVCOM_CompActlPwrCnsmp_oEVCOM_State_01_oATOM_CAN_Matrix_PT_V600_20250211_d741f4fb_Rx (ComGroupSignal): ComSignalType=UINT8
        SG_IBS_ACC_SigGroup_oIBS_ACC_oATOM_CANFD_Matrix_CH_V600_202502_c31bc8ab_Rx: ComNotification=Rte_COMCbk_SG_IBS_ACC_SigGroup_oIBS_ACC_oATOM_CANFD_Matrix_CH_V600_202502_c31bc8ab_Rx
          12 x ComGroupSignal:
            Checksum_0B8_oIBS_ACC_oATOM_CANFD_Matrix_CH_V600_202502_ea42d99c_Rx: ComSignalType=UINT8
            IBS_CddActive_oIBS_ACC_oATOM_CANFD_Matrix_CH_V600_202502_cd634808_Rx: ComSignalType=BOOLEAN
            IBS_CddAvailable_oIBS_ACC_oATOM_CANFD_Matrix_CH_V600_202502_694f6a44_Rx: ComSignalType=BOOLEAN
            IBS_CddError_oIBS_ACC_oATOM_CANFD_Matrix_CH_V600_202502_15ba1189_Rx: ComSignalType=BOOLEAN
            IBS_VehicleStandstill_Valid_oIBS_ACC_oATOM_CANFD_Matrix_CH_V600_202502_8e482947_Rx: ComSignalType=BOOLEAN
            IBS_VehicleStandstill_oIBS_ACC_oATOM_CANFD_Matrix_CH_V600_202502_e5c3fb2c_Rx: ComSignalType=UINT8
            IBS_VlcActive_oIBS_ACC_oATOM_CANFD_Matrix_CH_V600_202502_3fa05f6d_Rx: ComSignalType=BOOLEAN
            IBS_VlcAvalible_oIBS_ACC_oATOM_CANFD_Matrix_CH_V600_202502_5ec40897_Rx: ComSignalType=BOOLEAN
            IBS_VlcError_oIBS_ACC_oATOM_CANFD_Matrix_CH_V600_202502_b4ad3ada_Rx: ComSignalType=BOOLEAN
            IBS_WLTorqueVLCReqValid_oIBS_ACC_oATOM_CANFD_Matrix_CH_V600_202502_d640a38d_Rx: ComSignalType=UINT8
            IBS_WLTorqueVLCReq_oIBS_ACC_oATOM_CANFD_Matrix_CH_V600_202502_e5232329_Rx: ComSignalType=SINT16
            MessageCounter_0B8_oIBS_ACC_oATOM_CANFD_Matrix_CH_V600_202502_20387c24_Rx: ComSignalType=UINT8
        SG_IBS_APS_SigGroup_oIBS_APS_oATOM_CANFD_Matrix_CH_V600_202502_91bbe9ec_Rx: ComNotification=Rte_COMCbk_SG_IBS_APS_SigGroup_oIBS_APS_oATOM_CANFD_Matrix_CH_V600_202502_91bbe9ec_Rx
          9 x ComGroupSignal, all with ComSignalType=UINT8:
            Checksum_0B7_oIBS_APS_oATOM_CANFD_Matrix_CH_V600_202502_7cf1e80a_Rx
            IBS_APSComfortAvl_oIBS_APS_oATOM_CANFD_Matrix_CH_V600_202502_761e7ded_Rx
            IBS_APSCrlReqEcho_oIBS_APS_oATOM_CANFD_Matrix_CH_V600_202502_7e0dcab4_Rx
            IBS_APSEmergenyAvl_oIBS_APS_oATOM_CANFD_Matrix_CH_V600_202502_98e19592_Rx
            IBS_APSModeEcho_oIBS_APS_oATOM_CANFD_Matrix_CH_V600_202502_b13c14e1_Rx
            IBS_APSTrqReqActive_oIBS_APS_oATOM_CANFD_Matrix_CH_V600_202502_95892cb5_Rx
            IBS_APS_Avl_oIBS_APS_oATOM_CANFD_Matrix_CH_V600_202502_912b9c67_Rx
            IBS_BrakeTypEcho_oIBS_APS_oATOM_CANFD_Matrix_CH_V600_202502_efa1b54d_Rx
            MessageCounter_0B7_oIBS_APS_oATOM_CANFD_Matrix_CH_V600_202502_b68b4db2_Rx
        SG_IBS_Status_01_SigGroup_oIBS_Status_01_oATOM_CANFD_Matrix_CH_V600_202502_bdf732ba_Rx: ComNotification=Rte_COMCbk_SG_IBS_Status_01_SigGroup_oIBS_Status_01_oATOM_CANFD_Matrix_CH_V600_202502_bdf732ba_Rx
          7 x ComGroupSignal:
            Checksum_0B2_oIBS_Status_01_oATOM_CANFD_Matrix_CH_V600_202502_ad2c5ce1_Rx: ComSignalType=UINT8
            IBS_BrakePedalStatusValid_oIBS_Status_01_oATOM_CANFD_Matrix_CH_V600_202502_ba3a564c_Rx: ComSignalType=BOOLEAN
            IBS_BrakePedalStatus_oIBS_Status_01_oATOM_CANFD_Matrix_CH_V600_202502_c14952d9_Rx: ComSignalType=UINT8
            IBS_BrakePushrodStroke_oIBS_Status_01_oATOM_CANFD_Matrix_CH_V600_202502_b9911368_Rx: ComSignalType=SINT16
            IBS_MasterCylinderPressure_oIBS_Status_01_oATOM_CANFD_Matrix_CH_V600_202502_b339468a_Rx: ComSignalType=UINT16
            IBS_PlungerPressure_oIBS_Status_01_oATOM_CANFD_Matrix_CH_V600_202502_1a29f19b_Rx: ComSignalType=SINT16
            MessageCounter_0B2_oIBS_Status_01_oATOM_CANFD_Matrix_CH_V600_202502_7bc88e71_Rx: ComSignalType=UINT8
        SG_IBS_Status_02_SigGroup_oIBS_Status_02_oATOM_CANFD_Matrix_CH_V600_202502_8df002b0_Rx: ComNotification=Rte_COMCbk_SG_IBS_Status_02_SigGroup_oIBS_Status_02_oATOM_CANFD_Matrix_CH_V600_202502_8df002b0_Rx
          18 x ComGroupSignal:
            Checksum_0B3_oIBS_Status_02_oATOM_CANFD_Matrix_CH_V600_202502_a2ce7b09_Rx: ComSignalType=UINT8
            IBS_AEBActive_oIBS_Status_02_oATOM_CANFD_Matrix_CH_V600_202502_27fddc4e_Rx: ComSignalType=BOOLEAN
            IBS_AEBAvailable_oIBS_Status_02_oATOM_CANFD_Matrix_CH_V600_202502_586c329d_Rx: ComSignalType=BOOLEAN
            IBS_AVHAvailable_oIBS_Status_02_oATOM_CANFD_Matrix_CH_V600_202502_e9505f9e_Rx: ComSignalType=BOOLEAN
            IBS_AWBActive_oIBS_Status_02_oATOM_CANFD_Matrix_CH_V600_202502_47745887_Rx: ComSignalType=BOOLEAN
            IBS_AWBAvailable_oIBS_Status_02_oATOM_CANFD_Matrix_CH_V600_202502_0d99f9f9_Rx: ComSignalType=BOOLEAN
            IBS_BrakeLightRequest_oIBS_Status_02_oATOM_CANFD_Matrix_CH_V600_202502_a14297cf_Rx: ComSignalType=UINT8
            IBS_EPBControllerSts_oIBS_Status_02_oATOM_CANFD_Matrix_CH_V600_202502_65ed44e8_Rx: ComSignalType=UINT8
            IBS_EPBFailureLamp_oIBS_Status_02_oATOM_CANFD_Matrix_CH_V600_202502_94ade1a4_Rx: ComSignalType=UINT8
            IBS_EPBFunctionLamp_oIBS_Status_02_oATOM_CANFD_Matrix_CH_V600_202502_947116d4_Rx: ComSignalType=UINT8
            IBS_EPBworkingSts_oIBS_Status_02_oATOM_CANFD_Matrix_CH_V600_202502_fc06f35e_Rx: ComSignalType=UINT8
            IBS_HDCAvailable_oIBS_Status_02_oATOM_CANFD_Matrix_CH_V600_202502_deb691a6_Rx: ComSignalType=BOOLEAN
            IBS_HHCActive_oIBS_Status_02_oATOM_CANFD_Matrix_CH_V600_202502_f453be85_Rx: ComSignalType=BOOLEAN
            IBS_HHCAvailable_oIBS_Status_02_oATOM_CANFD_Matrix_CH_V600_202502_a333cc25_Rx: ComSignalType=BOOLEAN
            IBS_HazWarnReq_oIBS_Status_02_oATOM_CANFD_Matrix_CH_V600_202502_b191eb63_Rx: ComSignalType=UINT8
            IBS_TCSActive_oIBS_Status_02_oATOM_CANFD_Matrix_CH_V600_202502_a64ac2d8_Rx: ComSignalType=BOOLEAN
            IBS_VDCActive_oIBS_Status_02_oATOM_CANFD_Matrix_CH_V600_202502_7ab0d9f3_Rx: ComSignalType=BOOLEAN
            MessageCounter_0B3_oIBS_Status_02_oATOM_CANFD_Matrix_CH_V600_202502_742aa999_Rx: ComSignalType=UINT8
        SG_IBS_Status_03_SigGroup_oIBS_Status_03_oATOM_CANFD_Matrix_CH_V600_202502_2b221089_Rx: ComNotification=Rte_COMCbk_SG_IBS_Status_03_SigGroup_oIBS_Status_03_oATOM_CANFD_Matrix_CH_V600_202502_2b221089_Rx
          16 x ComGroupSignal:
            Checksum_0B4_oIBS_Status_03_oATOM_CANFD_Matrix_CH_V600_202502_47252d94_Rx: ComSignalType=UINT8
            IBS_ABPActive_oIBS_Status_03_oATOM_CANFD_Matrix_CH_V600_202502_9a3de825_Rx: ComSignalType=BOOLEAN
            IBS_ABPAvailable_oIBS_Status_03_oATOM_CANFD_Matrix_CH_V600_202502_7eb6cd8c_Rx: ComSignalType=BOOLEAN
            IBS_ABSActive_oIBS_Status_03_oATOM_CANFD_Matrix_CH_V600_202502_bc82dc5c_Rx: ComSignalType=BOOLEAN
            IBS_ABSFault_oIBS_Status_03_oATOM_CANFD_Matrix_CH_V600_202502_1bd8c058_Rx: ComSignalType=BOOLEAN
            IBS_DTCFault_oIBS_Status_03_oATOM_CANFD_Matrix_CH_V600_202502_632f33ac_Rx: ComSignalType=BOOLEAN
            IBS_EBDActive_oIBS_Status_03_oATOM_CANFD_Matrix_CH_V600_202502_1e24a445_Rx: ComSignalType=BOOLEAN
            IBS_EBDFault_oIBS_Status_03_oATOM_CANFD_Matrix_CH_V600_202502_dad1ab7b_Rx: ComSignalType=BOOLEAN
            IBS_EPBTextdisplay_oIBS_Status_03_oATOM_CANFD_Matrix_CH_V600_202502_e8354645_Rx: ComSignalType=UINT8
            IBS_SystemStatus_oIBS_Status_03_oATOM_CANFD_Matrix_CH_V600_202502_306130d0_Rx: ComSignalType=UINT8
            IBS_TCSFault_oIBS_Status_03_oATOM_CANFD_Matrix_CH_V600_202502_2d90687a_Rx: ComSignalType=BOOLEAN
            IBS_VCU_DecelerationRequest_Available_oIBS_Status_03_oATOM_CANFD_Matrix_CH_V600_202502_227d55b1_Rx: ComSignalType=UINT8
            IBS_VDCFault_oIBS_Status_03_oATOM_CANFD_Matrix_CH_V600_202502_01868c54_Rx: ComSignalType=BOOLEAN
            IBS_VehicleSpeedValid_oIBS_Status_03_oATOM_CANFD_Matrix_CH_V600_202502_317a0a26_Rx: ComSignalType=BOOLEAN
            IBS_VehicleSpeed_oIBS_Status_03_oATOM_CANFD_Matrix_CH_V600_202502_5ce10c83_Rx: ComSignalType=UINT16
            MessageCounter_0B4_oIBS_Status_03_oATOM_CANFD_Matrix_CH_V600_202502_91c1ff04_Rx: ComSignalType=UINT8
        SG_IBS_Status_04_SigGroup_oIBS_Status_04_oATOM_CANFD_Matrix_CH_V600_202502_edfe62a4_Rx: ComNotification=Rte_COMCbk_SG_IBS_Status_04_SigGroup_oIBS_Status_04_oATOM_CANFD_Matrix_CH_V600_202502_edfe62a4_Rx
          5 x ComGroupSignal:
            Checksum_0BA_oIBS_Status_04_oATOM_CANFD_Matrix_CH_V600_202502_77cd2b4a_Rx: ComSignalType=UINT8
            IBS_CDPActive_oIBS_Status_04_oATOM_CANFD_Matrix_CH_V600_202502_5f0477e0_Rx: ComSignalType=BOOLEAN
            IBS_CDPAvailable_oIBS_Status_04_oATOM_CANFD_Matrix_CH_V600_202502_551f17a8_Rx: ComSignalType=BOOLEAN
            IBS_DTCActive_oIBS_Status_04_oATOM_CANFD_Matrix_CH_V600_202502_05637011_Rx: ComSignalType=BOOLEAN
            MessageCounter_0BA_oIBS_Status_04_oATOM_CANFD_Matrix_CH_V600_202502_a129f9da_Rx: ComSignalType=UINT8
        SG_IBS_Status_05_SigGroup_oIBS_Status_05_oATOM_CAN_Matrix_PT_V600_20250211_7471090c_Rx: ComNotification=Rte_COMCbk_SG_IBS_Status_05_SigGroup_oIBS_Status_05_oATOM_CAN_Matrix_PT_V600_20250211_7471090c_Rx
          5 x ComGroupSignal, all with ComSignalType=UINT8:
            Checksum_0BB_oIBS_Status_05_oATOM_CAN_Matrix_PT_V600_20250211_d02c6941_Rx
            IBS_SUBEPBControllerSts_oIBS_Status_05_oATOM_CAN_Matrix_PT_V600_20250211_4db2fa5a_Rx
            IBS_SUBEPBFailureStatus_oIBS_Status_05_oATOM_CAN_Matrix_PT_V600_20250211_85549b8d_Rx
            IBS_SUBEPBworkingSts_oIBS_Status_05_oATOM_CAN_Matrix_PT_V600_20250211_6b861b0d_Rx
            MessageCounter_0BB_oIBS_Status_05_oATOM_CAN_Matrix_PT_V600_20250211_06c8bbd1_Rx
        SG_IBS_Status_06_SigGroup_oIBS_Status_06_oATOM_CANFD_Matrix_CH_V600_202502_7b2b4097_Rx: ComNotification=Rte_COMCbk_SG_IBS_Status_06_SigGroup_oIBS_Status_06_oATOM_CANFD_Matrix_CH_V600_202502_7b2b4097_Rx
          20 x ComGroupSignal:
            Checksum_0BC_oIBS_Status_06_oATOM_CANFD_Matrix_CH_V600_202502_e0933738_Rx: ComSignalType=UINT8
            IBS_AVHSts_oIBS_Status_06_oATOM_CANFD_Matrix_CH_V600_202502_e3018ac7_Rx: ComSignalType=UINT8
            IBS_BrakeFluidWarning_oIBS_Status_06_oATOM_CANFD_Matrix_CH_V600_202502_cf3bf9da_Rx: ComSignalType=UINT8
            IBS_EPBFailureStatus_oIBS_Status_06_oATOM_CANFD_Matrix_CH_V600_202502_2591769d_Rx: ComSignalType=UINT8
            IBS_ESCOffSts_oIBS_Status_06_oATOM_CANFD_Matrix_CH_V600_202502_a7e250e7_Rx: ComSignalType=BOOLEAN
            IBS_ESClampdisplay_oIBS_Status_06_oATOM_CANFD_Matrix_CH_V600_202502_cffaf18c_Rx: ComSignalType=UINT8
            IBS_FactoryMode_oIBS_Status_06_oATOM_CANFD_Matrix_CH_V600_202502_1f4b8984_Rx: ComSignalType=BOOLEAN
            IBS_HBAActive_oIBS_Status_06_oATOM_CANFD_Matrix_CH_V600_202502_b3e0fd61_Rx: ComSignalType=BOOLEAN
            IBS_HDCSts_oIBS_Status_06_oATOM_CANFD_Matrix_CH_V600_202502_d0313153_Rx: ComSignalType=UINT8
            IBS_MaintenaceMode_oIBS_Status_06_oATOM_CANFD_Matrix_CH_V600_202502_e1932fbc_Rx: ComSignalType=BOOLEAN
            IBS_RWUActive_oIBS_Status_06_oATOM_CANFD_Matrix_CH_V600_202502_353ab732_Rx: ComSignalType=BOOLEAN
            IBS_RWUAvailable_oIBS_Status_06_oATOM_CANFD_Matrix_CH_V600_202502_55a4e82d_Rx: ComSignalType=BOOLEAN
            IBS_RollerbenchMode_oIBS_Status_06_oATOM_CANFD_Matrix_CH_V600_202502_7e2deccc_Rx: ComSignalType=BOOLEAN
            IBS_TPMS_ResetSts_oIBS_Status_06_oATOM_CANFD_Matrix_CH_V600_202502_ee7e0532_Rx: ComSignalType=BOOLEAN
            IBS_TireMonSysSts_oIBS_Status_06_oATOM_CANFD_Matrix_CH_V600_202502_91ee3722_Rx: ComSignalType=BOOLEAN
            IBS_TireWarnFrntLe_oIBS_Status_06_oATOM_CANFD_Matrix_CH_V600_202502_7fea0ce4_Rx: ComSignalType=BOOLEAN
            IBS_TireWarnFrntRi_oIBS_Status_06_oATOM_CANFD_Matrix_CH_V600_202502_dbb01a62_Rx: ComSignalType=BOOLEAN
            IBS_TireWarnReLe_oIBS_Status_06_oATOM_CANFD_Matrix_CH_V600_202502_6e5db930_Rx: ComSignalType=BOOLEAN
            IBS_TireWarnReRi_oIBS_Status_06_oATOM_CANFD_Matrix_CH_V600_202502_ca07afb6_Rx: ComSignalType=BOOLEAN
            MessageCounter_0BC_oIBS_Status_06_oATOM_CANFD_Matrix_CH_V600_202502_3677e5a8_Rx: ComSignalType=UINT8
        SG_IBS_Torque_SigGroup_oIBS_Torque_oATOM_CANFD_Matrix_CH_V600_202502_5a2dd5ad_Rx: ComNotification=Rte_COMCbk_SG_IBS_Torque_SigGroup_oIBS_Torque_oATOM_CANFD_Matrix_CH_V600_202502_5a2dd5ad_Rx
          9 x ComGroupSignal:
            Checksum_0B9_oIBS_Torque_oATOM_CANFD_Matrix_CH_V600_202502_c0d26283_Rx: ComSignalType=UINT8
            IBS_RBSStatus_oIBS_Torque_oATOM_CANFD_Matrix_CH_V600_202502_dc8e16c0_Rx: ComSignalType=BOOLEAN
            IBS_TargetGearReq_oIBS_Torque_oATOM_CANFD_Matrix_CH_V600_202502_35085f4b_Rx: ComSignalType=UINT8
            IBS_VCU_DecelerationReqActive_oIBS_Torque_oATOM_CANFD_Matrix_CH_V600_202502_5138c66a_Rx: ComSignalType=BOOLEAN
            IBS_WLTorqueAPSReqValid_oIBS_Torque_oATOM_CANFD_Matrix_CH_V600_202502_406d9ee6_Rx: ComSignalType=UINT8
            IBS_WLTorqueAPSReq_oIBS_Torque_oATOM_CANFD_Matrix_CH_V600_202502_1036d2a9_Rx: ComSignalType=UINT16
            IBS_WLTorqueRBSReqValid_oIBS_Torque_oATOM_CANFD_Matrix_CH_V600_202502_0144d4d4_Rx: ComSignalType=UINT8
            IBS_WLTorqueRBSReq_oIBS_Torque_oATOM_CANFD_Matrix_CH_V600_202502_dae1e9b7_Rx: ComSignalType=UINT16
            MessageCounter_0B9_oIBS_Torque_oATOM_CANFD_Matrix_CH_V600_202502_683f1d6f_Rx: ComSignalType=UINT8
        SG_IBS_VCU_MotorControl_SigGroup_oIBS_VCU_MotorControl_oATOM_CANFD_Matrix_CH_V600_202502_9a811a5b_Rx: ComNotification=Rte_COMCbk_SG_IBS_VCU_MotorControl_SigGroup_oIBS_VCU_MotorControl_oATOM_CANFD_Matrix_CH_V600_202502_9a811a5b_Rx
          6 x ComGroupSignal:
            Checksum_090_oIBS_VCU_MotorControl_oATOM_CANFD_Matrix_CH_V600_202502_b5095e35_Rx: ComSignalType=UINT8
            IBS_WLTorqueIncrReqSts_oIBS_VCU_MotorControl_oATOM_CANFD_Matrix_CH_V600_202502_f80f3ab5_Rx: ComSignalType=BOOLEAN
            IBS_WLTorqueIncrReq_oIBS_VCU_MotorControl_oATOM_CANFD_Matrix_CH_V600_202502_6e9d7a41_Rx: ComSignalType=UINT16
            IBS_WLTorqueRedReqSts_oIBS_VCU_MotorControl_oATOM_CANFD_Matrix_CH_V600_202502_2655e1fb_Rx: ComSignalType=BOOLEAN
            IBS_WLTorqueRedReq_oIBS_VCU_MotorControl_oATOM_CANFD_Matrix_CH_V600_202502_79bc7664_Rx: ComSignalType=UINT16
            MessageCounter_090_oIBS_VCU_MotorControl_oATOM_CANFD_Matrix_CH_V600_202502_db5c1277_Rx: ComSignalType=UINT8
        SG_IBS_WheelSpeed_01_SigGroup_oIBS_WheelSpeed_01_oATOM_CANFD_Matrix_CH_V600_202502_5773aa13_Rx: ComNotification=Rte_COMCbk_SG_IBS_WheelSpeed_01_SigGroup_oIBS_WheelSpeed_01_oATOM_CANFD_Matrix_CH_V600_202502_5773aa13_Rx
          10 x ComGroupSignal:
            Checksum_0B0_oIBS_WheelSpeed_01_oATOM_CANFD_Matrix_CH_V600_202502_efb220b2_Rx: ComSignalType=UINT8
            IBS_FLMovingDirection_oIBS_WheelSpeed_01_oATOM_CANFD_Matrix_CH_V600_202502_0e538d73_Rx: ComSignalType=UINT8
            IBS_FLWheelPulseCounter_oIBS_WheelSpeed_01_oATOM_CANFD_Matrix_CH_V600_202502_9718fa24_Rx: ComSignalType=UINT8
            IBS_FLWheelSpeed_Fault_oIBS_WheelSpeed_01_oATOM_CANFD_Matrix_CH_V600_202502_19d76bef_Rx: ComSignalType=BOOLEAN
            IBS_FLWheelSpeed_oIBS_WheelSpeed_01_oATOM_CANFD_Matrix_CH_V600_202502_d228a055_Rx: ComSignalType=UINT16
            IBS_FRMovingDirection_oIBS_WheelSpeed_01_oATOM_CANFD_Matrix_CH_V600_202502_be7c8b57_Rx: ComSignalType=UINT8
            IBS_FRWheelPulseCounter_oIBS_WheelSpeed_01_oATOM_CANFD_Matrix_CH_V600_202502_8f930e98_Rx: ComSignalType=UINT8
            IBS_FRWheelSpeed_Fault_oIBS_WheelSpeed_01_oATOM_CANFD_Matrix_CH_V600_202502_2564a038_Rx: ComSignalType=BOOLEAN
            IBS_FRWheelSpeed_oIBS_WheelSpeed_01_oATOM_CANFD_Matrix_CH_V600_202502_7a94cc9a_Rx: ComSignalType=UINT16
            MessageCounter_0B0_oIBS_WheelSpeed_01_oATOM_CANFD_Matrix_CH_V600_202502_895d6141_Rx: ComSignalType=UINT8
        SG_IBS_WheelSpeed_02_SigGroup_oIBS_WheelSpeed_02_oATOM_CANFD_Matrix_CH_V600_202502_2d752b6e_Rx: ComNotification=Rte_COMCbk_SG_IBS_WheelSpeed_02_SigGroup_oIBS_WheelSpeed_02_oATOM_CANFD_Matrix_CH_V600_202502_2d752b6e_Rx
          10 x ComGroupSignal:
            Checksum_0B1_oIBS_WheelSpeed_02_oATOM_CANFD_Matrix_CH_V600_202502_65c4b71d_Rx: ComSignalType=UINT8
            IBS_RLMovingDirection_oIBS_WheelSpeed_02_oATOM_CANFD_Matrix_CH_V600_202502_ad5dc1f0_Rx: ComSignalType=UINT8
            IBS_RLWheelPulseCounter_oIBS_WheelSpeed_02_oATOM_CANFD_Matrix_CH_V600_202502_296e9e60_Rx: ComSignalType=UINT8
            IBS_RLWheelSpeed_Fault_oIBS_WheelSpeed_02_oATOM_CANFD_Matrix_CH_V600_202502_82f6f2de_Rx: ComSignalType=BOOLEAN
            IBS_RLWheelSpeed_oIBS_WheelSpeed_02_oATOM_CANFD_Matrix_CH_V600_202502_5459dc3a_Rx: ComSignalType=UINT16
            IBS_RRMovingDirection_oIBS_WheelSpeed_02_oATOM_CANFD_Matrix_CH_V600_202502_1d72c7d4_Rx: ComSignalType=UINT8
            IBS_RRWheelPulseCounter_oIBS_WheelSpeed_02_oATOM_CANFD_Matrix_CH_V600_202502_31e56adc_Rx: ComSignalType=UINT8
            IBS_RRWheelSpeed_Fault_oIBS_WheelSpeed_02_oATOM_CANFD_Matrix_CH_V600_202502_be453909_Rx: ComSignalType=BOOLEAN
            IBS_RRWheelSpeed_oIBS_WheelSpeed_02_oATOM_CANFD_Matrix_CH_V600_202502_fce5b0f5_Rx: ComSignalType=UINT16
            MessageCounter_0B1_oIBS_WheelSpeed_02_oATOM_CANFD_Matrix_CH_V600_202502_032bf6ee_Rx: ComSignalType=UINT8
        SG_IVI_01_SigGroup_oIVI_01_oATOM_CAN_Matrix_PT_V600_20250211_284cc0c2_Rx: ComNotification=Rte_COMCbk_SG_IVI_01_SigGroup_oIVI_01_oATOM_CAN_Matrix_PT_V600_20250211_284cc0c2_Rx
          IVI_GearRequest_oIVI_01_oATOM_CAN_Matrix_PT_V600_20250211_3ae0554e_Rx (ComGroupSignal): ComSignalType=UINT8
        SG_IVI_03_SigGroup_oIVI_03_oATOM_CAN_Matrix_PT_V600_20250211_bf981109_Rx: ComNotification=Rte_COMCbk_SG_IVI_03_SigGroup_oIVI_03_oATOM_CAN_Matrix_PT_V600_20250211_bf981109_Rx
          5 x ComGroupSignal:
            Checksum_0F9_oIVI_03_oATOM_CAN_Matrix_PT_V600_20250211_77cc8260_Rx: ComSignalType=UINT8
            IVI_BulbCheckSts_oIVI_03_oATOM_CAN_Matrix_PT_V600_20250211_ac8ee3d9_Rx: ComSignalType=BOOLEAN
            IVI_SFIDippedBeamSet_oIVI_03_oATOM_CAN_Matrix_PT_V600_20250211_23dcee29_Rx: ComSignalType=UINT8
            IVI_SFIabnormalSts_oIVI_03_oATOM_CAN_Matrix_PT_V600_20250211_fd225a73_Rx: ComSignalType=BOOLEAN
            MessageCounter_0F9_oIVI_03_oATOM_CAN_Matrix_PT_V600_20250211_b7abb091_Rx: ComSignalType=UINT8
        SG_IVI_OdometerInfor_SigGroup_oIVI_OdometerInfor_oATOM_CAN_Matrix_PT_V600_20250211_3516238b_Rx: ComNotification=Rte_COMCbk_SG_IVI_OdometerInfor_SigGroup_oIVI_OdometerInfor_oATOM_CAN_Matrix_PT_V600_20250211_3516238b_Rx
          IVI_OdometerInfor_oIVI_OdometerInfor_oATOM_CAN_Matrix_PT_V600_20250211_e6e371ee_Rx (ComGroupSignal): ComSignalType=UINT32
        SG_MCU_01_SigGroup_oMCU_01_oATOM_CAN_Matrix_PT_V600_20250211_3844bc9f_Rx: ComNotification=Rte_COMCbk_SG_MCU_01_SigGroup_oMCU_01_oATOM_CAN_Matrix_PT_V600_20250211_3844bc9f_Rx
          8 x ComGroupSignal:
            Checksum_098_oMCU_01_oATOM_CAN_Matrix_PT_V600_20250211_3d12a66a_Rx: ComSignalType=UINT8
            MCU_ActTrqValid_oMCU_01_oATOM_CAN_Matrix_PT_V600_20250211_ac2cd648_Rx: ComSignalType=BOOLEAN
            MCU_ActualSpeedValid_oMCU_01_oATOM_CAN_Matrix_PT_V600_20250211_cc3b4560_Rx: ComSignalType=BOOLEAN
            MCU_ActualSpeed_oMCU_01_oATOM_CAN_Matrix_PT_V600_20250211_528eb860_Rx: ComSignalType=UINT16
            MCU_ActualTorque_oMCU_01_oATOM_CAN_Matrix_PT_V600_20250211_6a6087a3_Rx: ComSignalType=UINT16
            MCU_IsCurr_oMCU_01_oATOM_CAN_Matrix_PT_V600_20250211_3f405105_Rx: ComSignalType=UINT16
            MCU_UdcCurr_oMCU_01_oATOM_CAN_Matrix_PT_V600_20250211_c9f788aa_Rx: ComSignalType=UINT16
            MessageCounter_098_oMCU_01_oATOM_CAN_Matrix_PT_V600_20250211_fd75949b_Rx: ComSignalType=UINT8
        SG_MCU_02_SigGroup_oMCU_02_oATOM_CAN_Matrix_PT_V600_20250211_09c28691_Rx: ComNotification=Rte_COMCbk_SG_MCU_02_SigGroup_oMCU_02_oATOM_CAN_Matrix_PT_V600_20250211_09c28691_Rx
          MCU_BDmpCActv_oMCU_02_oATOM_CAN_Matrix_PT_V600_20250211_c0586eb8_Rx (ComGroupSignal): ComSignalType=BOOLEAN
          MCU_VCUWorkMode_oMCU_02_oATOM_CAN_Matrix_PT_V600_20250211_2a117a8b_Rx (ComGroupSignal): ComSignalType=UINT8
        SG_MCU_DeratingStatus_SigGroup_oMCU_DeratingStatus_oATOM_CAN_Matrix_PT_V600_20250211_c60bf9ce_Rx: ComNotification=Rte_COMCbk_SG_MCU_DeratingStatus_SigGroup_oMCU_DeratingStatus_oATOM_CAN_Matrix_PT_V600_20250211_c60bf9ce_Rx
          MCU_TrqAbsMax_oMCU_DeratingStatus_oATOM_CAN_Matrix_PT_V600_20250211_e9a1ec48_Rx (ComGroupSignal): ComSignalType=UINT16
          MCU_TrqAbsMin_oMCU_DeratingStatus_oATOM_CAN_Matrix_PT_V600_20250211_84a8e353_Rx (ComGroupSignal): ComSignalType=UINT16
        SG_MCU_FailureCode_SigGroup_oMCU_FailureCode_oATOM_CAN_Matrix_PT_V600_20250211_bf11f7cf_Rx: ComNotification=Rte_COMCbk_SG_MCU_FailureCode_SigGroup_oMCU_FailureCode_oATOM_CAN_Matrix_PT_V600_20250211_bf11f7cf_Rx
          3 x ComGroupSignal, all with ComSignalType=UINT8:
            Checksum_253_oMCU_FailureCode_oATOM_CAN_Matrix_PT_V600_20250211_81801456_Rx
            MCU_FaultLevel_oMCU_FailureCode_oATOM_CAN_Matrix_PT_V600_20250211_bf7f5830_Rx
            MessageCounter_253_oMCU_FailureCode_oATOM_CAN_Matrix_PT_V600_20250211_981cfb50_Rx
        SG_MCU_Temperature_01_SigGroup_oMCU_Temperature_01_oATOM_CAN_Matrix_PT_V600_20250211_9ee5905c_Rx: ComNotification=Rte_COMCbk_SG_MCU_Temperature_01_SigGroup_oMCU_Temperature_01_oATOM_CAN_Matrix_PT_V600_20250211_9ee5905c_Rx
          MCU_IGBTTempMax_oMCU_Temperature_01_oATOM_CAN_Matrix_PT_V600_20250211_2c994d0d_Rx (ComGroupSignal): ComSignalType=UINT8
        SG_MCU_Temperature_02_SigGroup_oMCU_Temperature_02_oATOM_CAN_Matrix_PT_V600_20250211_5f18debb_Rx: ComNotification=Rte_COMCbk_SG_MCU_Temperature_02_SigGroup_oMCU_Temperature_02_oATOM_CAN_Matrix_PT_V600_20250211_5f18debb_Rx
          MCU_TempStatus_oMCU_Temperature_02_oATOM_CAN_Matrix_PT_V600_20250211_ccf76e7e_Rx (ComGroupSignal): ComSignalType=UINT8
        SG_POD_DCDC_01_SigGroup_oPOD_DCDC_01_oATOM_CAN_Matrix_PT_V600_20250211_c0cfae4d_Rx: ComNotification=Rte_COMCbk_SG_POD_DCDC_01_SigGroup_oPOD_DCDC_01_oATOM_CAN_Matrix_PT_V600_20250211_c0cfae4d_Rx
          3 x ComGroupSignal:
            POD_DCDC_HVInputCurrent_oPOD_DCDC_01_oATOM_CAN_Matrix_PT_V600_20250211_135e2f35_Rx: ComSignalType=UINT8
            POD_DCDC_HVInputVoltage_oPOD_DCDC_01_oATOM_CAN_Matrix_PT_V600_20250211_9c7a540a_Rx: ComSignalType=UINT16
            POD_DCDC_WorkMode_oPOD_DCDC_01_oATOM_CAN_Matrix_PT_V600_20250211_444a4f6b_Rx: ComSignalType=UINT8
        SG_POD_DCDC_02_SigGroup_oPOD_DCDC_02_oATOM_CAN_Matrix_PT_V600_20250211_62e3e6f8_Rx: ComNotification=Rte_COMCbk_SG_POD_DCDC_02_SigGroup_oPOD_DCDC_02_oATOM_CAN_Matrix_PT_V600_20250211_62e3e6f8_Rx
          POD_DCDC_FaultLevel_oPOD_DCDC_02_oATOM_CAN_Matrix_PT_V600_20250211_eefe3afb_Rx (ComGroupSignal): ComSignalType=UINT8
          POD_DCDC_Side2Overtempfault_oPOD_DCDC_02_oATOM_CAN_Matrix_PT_V600_20250211_52f42506_Rx (ComGroupSignal): ComSignalType=BOOLEAN
        SG_POD_OBC_CHRGSTATION_SigGroup_oPOD_OBC_CHRGSTATION_oATOM_CAN_Matrix_PT_V600_20250211_4d87b474_Rx: ComNotification=Rte_COMCbk_SG_POD_OBC_CHRGSTATION_SigGroup_oPOD_OBC_CHRGSTATION_oATOM_CAN_Matrix_PT_V600_20250211_4d87b474_Rx
          10 x ComGroupSignal:
            POD_OBC_CCCurrentLimit_oPOD_OBC_CHRGSTATION_oATOM_CAN_Matrix_PT_V600_20250211_19f9b4da_Rx: ComSignalType=UINT8
            POD_OBC_CCStatus_oPOD_OBC_CHRGSTATION_oATOM_CAN_Matrix_PT_V600_20250211_6df4ee5e_Rx: ComSignalType=UINT8
            POD_OBC_CPCurrentLimit_oPOD_OBC_CHRGSTATION_oATOM_CAN_Matrix_PT_V600_20250211_53d381d9_Rx: ComSignalType=UINT8
            POD_OBC_CPDuty_oPOD_OBC_CHRGSTATION_oATOM_CAN_Matrix_PT_V600_20250211_602b732e_Rx: ComSignalType=UINT8
            POD_OBC_CPStatus_oPOD_OBC_CHRGSTATION_oATOM_CAN_Matrix_PT_V600_20250211_d6c8ee40_Rx: ComSignalType=UINT8
            POD_OBC_ChargCapacibility_oPOD_OBC_CHRGSTATION_oATOM_CAN_Matrix_PT_V600_20250211_1bd7c0f0_Rx: ComSignalType=UINT8
            POD_OBC_EMLockState_oPOD_OBC_CHRGSTATION_oATOM_CAN_Matrix_PT_V600_20250211_4eb1f977_Rx: ComSignalType=UINT8
            POD_OBC_OBCMaxPermOutpCrrt_oPOD_OBC_CHRGSTATION_oATOM_CAN_Matrix_PT_V600_20250211_27da1158_Rx: ComSignalType=UINT16
            POD_OBC_S2State_oPOD_OBC_CHRGSTATION_oATOM_CAN_Matrix_PT_V600_20250211_d46756d3_Rx: ComSignalType=UINT8
            POD_OBC_WorkMode_oPOD_OBC_CHRGSTATION_oATOM_CAN_Matrix_PT_V600_20250211_206572d6_Rx: ComSignalType=UINT8
        SG_POD_OBC_STATUS_02_SigGroup_oPOD_OBC_STATUS_02_oATOM_CAN_Matrix_PT_V600_20250211_49c67a09_Rx: ComNotification=Rte_COMCbk_SG_POD_OBC_STATUS_02_SigGroup_oPOD_OBC_STATUS_02_oATOM_CAN_Matrix_PT_V600_20250211_49c67a09_Rx
          3 x ComGroupSignal:
            POD_OBC_ChrgOutpPwrAvl_oPOD_OBC_STATUS_02_oATOM_CAN_Matrix_PT_V600_20250211_a1981126_Rx: ComSignalType=UINT8
            POD_OBC_OutputDCChargeCurrent_oPOD_OBC_STATUS_02_oATOM_CAN_Matrix_PT_V600_20250211_9a885370_Rx: ComSignalType=UINT16
            POD_OBC_OutputDCChargeVoltage_oPOD_OBC_STATUS_02_oATOM_CAN_Matrix_PT_V600_20250211_249f5302_Rx: ComSignalType=UINT16
        SG_POD_OBC_STATUS_03_SigGroup_oPOD_OBC_STATUS_03_oATOM_CAN_Matrix_PT_V600_20250211_d6eb071d_Rx: ComNotification=Rte_COMCbk_SG_POD_OBC_STATUS_03_SigGroup_oPOD_OBC_STATUS_03_oATOM_CAN_Matrix_PT_V600_20250211_d6eb071d_Rx
          5 x ComGroupSignal:
            POD_OBC_FaultLevel_oPOD_OBC_STATUS_03_oATOM_CAN_Matrix_PT_V600_20250211_dfddb20c_Rx: ComSignalType=UINT8
            POD_OBC_PrimarySideTemp_oPOD_OBC_STATUS_03_oATOM_CAN_Matrix_PT_V600_20250211_315b5171_Rx: ComSignalType=UINT8
            POD_OBC_SecondarySideTemp_oPOD_OBC_STATUS_03_oATOM_CAN_Matrix_PT_V600_20250211_6ad0dc35_Rx: ComSignalType=UINT8
            POD_OBC_Side1Overtempfault_oPOD_OBC_STATUS_03_oATOM_CAN_Matrix_PT_V600_20250211_180c8c7c_Rx: ComSignalType=BOOLEAN
            POD_OBC_Side2Overtempfault_oPOD_OBC_STATUS_03_oATOM_CAN_Matrix_PT_V600_20250211_54bfa6d5_Rx: ComSignalType=BOOLEAN
        SG_POD_OBC_STATUS_04_SigGroup_oPOD_OBC_STATUS_04_oATOM_CAN_Matrix_PT_V600_20250211_bdcb78f3_Rx: ComNotification=Rte_COMCbk_SG_POD_OBC_STATUS_04_SigGroup_oPOD_OBC_STATUS_04_oATOM_CAN_Matrix_PT_V600_20250211_bdcb78f3_Rx
          6 x ComGroupSignal, all with ComSignalType=UINT16:
            POD_OBC_InputACCurrent_R_oPOD_OBC_STATUS_04_oATOM_CAN_Matrix_PT_V600_20250211_6a93fe10_Rx
            POD_OBC_InputACCurrent_S_oPOD_OBC_STATUS_04_oATOM_CAN_Matrix_PT_V600_20250211_6b3657a6_Rx
            POD_OBC_InputACCurrent_T_oPOD_OBC_STATUS_04_oATOM_CAN_Matrix_PT_V600_20250211_6f4e0ba4_Rx
            POD_OBC_InputACVoltage_R_oPOD_OBC_STATUS_04_oATOM_CAN_Matrix_PT_V600_20250211_779a5b73_Rx
            POD_OBC_InputACVoltage_S_oPOD_OBC_STATUS_04_oATOM_CAN_Matrix_PT_V600_20250211_763ff2c5_Rx
            POD_OBC_InputACVoltage_T_oPOD_OBC_STATUS_04_oATOM_CAN_Matrix_PT_V600_20250211_7247aec7_Rx
        SG_POD_Status_01_SigGroup_oPOD_Status_01_oATOM_CAN_Matrix_PT_V600_20250211_880c9d5a_Rx: ComNotification=Rte_COMCbk_SG_POD_Status_01_SigGroup_oPOD_Status_01_oATOM_CAN_Matrix_PT_V600_20250211_880c9d5a_Rx
          3 x ComGroupSignal:
            POD_DCFCVoltage_oPOD_Status_01_oATOM_CAN_Matrix_PT_V600_20250211_b89acdd0_Rx: ComSignalType=UINT16
            POD_DCInletTempA_oPOD_Status_01_oATOM_CAN_Matrix_PT_V600_20250211_3fbc48fa_Rx: ComSignalType=UINT8
            POD_DCInletTempB_oPOD_Status_01_oATOM_CAN_Matrix_PT_V600_20250211_689e64a8_Rx: ComSignalType=UINT8
        SG_POD_Status_02_SigGroup_oPOD_Status_02_oATOM_CAN_Matrix_PT_V600_20250211_b80bad50_Rx: ComNotification=Rte_COMCbk_SG_POD_Status_02_SigGroup_oPOD_Status_02_oATOM_CAN_Matrix_PT_V600_20250211_b80bad50_Rx
          3 x ComGroupSignal, all with ComSignalType=UINT8:
            POD_DCPortInletTempAValid_oPOD_Status_02_oATOM_CAN_Matrix_PT_V600_20250211_bbc9cc4c_Rx
            POD_DCPortInletTempBValid_oPOD_Status_02_oATOM_CAN_Matrix_PT_V600_20250211_ddcd197c_Rx
            POD_DCPosRelayState_oPOD_Status_02_oATOM_CAN_Matrix_PT_V600_20250211_6f150a52_Rx
        SG_PRND_SigGroup_oPRND_oATOM_CAN_Matrix_PT_V600_20250211_ddf34a23_Rx: ComNotification=Rte_COMCbk_SG_PRND_SigGroup_oPRND_oATOM_CAN_Matrix_PT_V600_20250211_ddf34a23_Rx
          6 x ComGroupSignal:
            Checksum_248_oPRND_oATOM_CAN_Matrix_PT_V600_20250211_2169404d_Rx: ComSignalType=UINT8
            MessageCounter_248_oPRND_oATOM_CAN_Matrix_PT_V600_20250211_7249f622_Rx: ComSignalType=UINT8
            PRND_Pbutton_FaultSts_oPRND_oATOM_CAN_Matrix_PT_V600_20250211_748786ed_Rx: ComSignalType=BOOLEAN
            PRND_Pbutton_oPRND_oATOM_CAN_Matrix_PT_V600_20250211_2bc3bb96_Rx: ComSignalType=UINT8
            PRND_RNDbutton_FaultSts_oPRND_oATOM_CAN_Matrix_PT_V600_20250211_fe92ca7a_Rx: ComSignalType=BOOLEAN
            PRND_RNDbutton_oPRND_oATOM_CAN_Matrix_PT_V600_20250211_400cef5e_Rx: ComSignalType=UINT8
        SG_SGW_01_SigGroup_oSGW_01_oATOM_CAN_Matrix_PT_V600_20250211_37bbfdeb_Rx: ComNotification=Rte_COMCbk_SG_SGW_01_SigGroup_oSGW_01_oATOM_CAN_Matrix_PT_V600_20250211_37bbfdeb_Rx
          5 x ComGroupSignal, all with ComSignalType=UINT8:
            SGW_AppointChargeCmd_oSGW_01_oATOM_CAN_Matrix_PT_V600_20250211_cf3a83f6_Rx
            SGW_ChargeFormSet_oSGW_01_oATOM_CAN_Matrix_PT_V600_20250211_3f92bd57_Rx
            SGW_DschrgOnOffSet_oSGW_01_oATOM_CAN_Matrix_PT_V600_20250211_a0a977dd_Rx
            SGW_LockACPlug_oSGW_01_oATOM_CAN_Matrix_PT_V600_20250211_5ade64ae_Rx
            SGW_TimingChargeSwitchStatus_oSGW_01_oATOM_CAN_Matrix_PT_V600_20250211_83e61a6c_Rx
        SG_SGW_04_SigGroup_oSGW_04_oATOM_CAN_Matrix_PT_V600_20250211_6531b3f9_Rx: ComNotification=Rte_COMCbk_SG_SGW_04_SigGroup_oSGW_04_oATOM_CAN_Matrix_PT_V600_20250211_6531b3f9_Rx
          SGW_RemoteHVCtrlReq_oSGW_04_oATOM_CAN_Matrix_PT_V600_20250211_17e2f736_Rx (ComGroupSignal): ComSignalType=UINT8
        SG_SGW_16_SigGroup_oSGW_16_oATOM_CAN_Matrix_PT_V600_20250211_194d06e6_Rx: ComNotification=Rte_COMCbk_SG_SGW_16_SigGroup_oSGW_16_oATOM_CAN_Matrix_PT_V600_20250211_194d06e6_Rx
          IVI_VrState_oSGW_16_oATOM_CAN_Matrix_PT_V600_20250211_518f75b6_Rx (ComGroupSignal): ComSignalType=BOOLEAN
        SG_SGW_17_SigGroup_oSGW_17_oATOM_CANFD_Matrix_CH_V600_202502_804294b2_Rx: ComNotification=Rte_COMCbk_SG_SGW_17_SigGroup_oSGW_17_oATOM_CANFD_Matrix_CH_V600_202502_804294b2_Rx
          SGW_BLESystemReadyReq_oSGW_17_oATOM_CANFD_Matrix_CH_V600_202502_359ce2fd_Rx (ComGroupSignal): ComSignalType=UINT8
        SG_SGW_FVSynchronization_01_SigGrou_oSGW_FVSynchronization_01_oATOM_CAN_Matrix_PT_V600_20250211_0d3cf875_Rx: ComNotification=Rte_COMCbk_SG_SGW_FVSynchronization_01_SigGrou_oSGW_FVSynchronization_01_oATOM_CAN_Matrix_PT_V600_20250211_0d3cf875_Rx
          SGW_TripCounter_oSGW_FVSynchronization_01_oATOM_CAN_Matrix_PT_V600_20250211_1cad6227_Rx (ComGroupSignal): ComSignalType=UINT32
        SG_SGW_IBS_01_SigGroup_oSGW_IBS_01_oATOM_CAN_Matrix_PT_V600_20250211_0dec95d0_Rx: ComNotification=Rte_COMCbk_SG_SGW_IBS_01_SigGroup_oSGW_IBS_01_oATOM_CAN_Matrix_PT_V600_20250211_0dec95d0_Rx
          IVI_BrakeCompensateCmd_oSGW_IBS_01_oATOM_CAN_Matrix_PT_V600_20250211_49b5a1e8_Rx (ComGroupSignal): ComSignalType=UINT8
          IVI_CRLevelSet_oSGW_IBS_01_oATOM_CAN_Matrix_PT_V600_20250211_8543222f_Rx (ComGroupSignal): ComSignalType=UINT8
        SG_SGW_PT_01_SigGroup_oSGW_PT_01_oATOM_CAN_Matrix_PT_V600_20250211_d1f7f071_Rx: ComNotification=Rte_COMCbk_SG_SGW_PT_01_SigGroup_oSGW_PT_01_oATOM_CAN_Matrix_PT_V600_20250211_d1f7f071_Rx
          4 x ComGroupSignal, all with ComSignalType=UINT8:
            IVI_AppointChargeCmd_oSGW_PT_01_oATOM_CAN_Matrix_PT_V600_20250211_8c65f5f8_Rx
            IVI_ForwardVmaxlimitSw_oSGW_PT_01_oATOM_CAN_Matrix_PT_V600_20250211_8d0f6899_Rx
            IVI_LV_LimitPop_oSGW_PT_01_oATOM_CAN_Matrix_PT_V600_20250211_1112ab7d_Rx
            IVI_LockACPlug_oSGW_PT_01_oATOM_CAN_Matrix_PT_V600_20250211_01b87dfd_Rx
        SG_SGW_Time_SigGroup_oSGW_Time_oATOM_CAN_Matrix_PT_V600_20250211_0ca37593_Rx: ComNotification=Rte_COMCbk_SG_SGW_Time_SigGroup_oSGW_Time_oATOM_CAN_Matrix_PT_V600_20250211_0ca37593_Rx
          7 x ComGroupSignal:
            SGW_TimeInfoDay_oSGW_Time_oATOM_CAN_Matrix_PT_V600_20250211_880a47df_Rx: ComSignalType=UINT8
            SGW_TimeInfoHour_oSGW_Time_oATOM_CAN_Matrix_PT_V600_20250211_bc8cc791_Rx: ComSignalType=UINT8
            SGW_TimeInfoMinute_oSGW_Time_oATOM_CAN_Matrix_PT_V600_20250211_107045bf_Rx: ComSignalType=UINT8
            SGW_TimeInfoMonth_oSGW_Time_oATOM_CAN_Matrix_PT_V600_20250211_0acdad62_Rx: ComSignalType=UINT8
            SGW_TimeInfoSecond_oSGW_Time_oATOM_CAN_Matrix_PT_V600_20250211_ed2116e5_Rx: ComSignalType=UINT8
            SGW_TimeInfoYear_oSGW_Time_oATOM_CAN_Matrix_PT_V600_20250211_76136356_Rx: ComSignalType=UINT8
            SGW_TimeValid_oSGW_Time_oATOM_CAN_Matrix_PT_V600_20250211_4cd83a01_Rx: ComSignalType=BOOLEAN
        SG_SGW_VCU_01_SigGroup_oSGW_VCU_01_oATOM_CAN_Matrix_PT_V600_20250211_899d317b_Rx: ComNotification=Rte_COMCbk_SG_SGW_VCU_01_SigGroup_oSGW_VCU_01_oATOM_CAN_Matrix_PT_V600_20250211_899d317b_Rx
          5 x ComGroupSignal, all with ComSignalType=UINT8:
            IVI_DriveModeSet_oSGW_VCU_01_oATOM_CAN_Matrix_PT_V600_20250211_e3273eed_Rx
            IVI_DschrgOnOffSet_oSGW_VCU_01_oATOM_CAN_Matrix_PT_V600_20250211_21f6b725_Rx
            IVI_ForwardVmaxAllowed_oSGW_VCU_01_oATOM_CAN_Matrix_PT_V600_20250211_13b9eae3_Rx
            IVI_MaxChrgSocSet_oSGW_VCU_01_oATOM_CAN_Matrix_PT_V600_20250211_99c3e2a8_Rx
            IVI_V2LidisSet_oSGW_VCU_01_oATOM_CAN_Matrix_PT_V600_20250211_25a8a73a_Rx
        SG_TCU_01_SigGroup_oTCU_01_oATOM_CAN_Matrix_PT_V600_20250211_95b4cd9c_Rx: ComNotification=Rte_COMCbk_SG_TCU_01_SigGroup_oTCU_01_oATOM_CAN_Matrix_PT_V600_20250211_95b4cd9c_Rx
          4 x ComGroupSignal, all with ComSignalType=UINT8:
            TCU_HVPwrState_oTCU_01_oATOM_CAN_Matrix_PT_V600_20250211_8d7d29e0_Rx
            TCU_TMSFaultLevel_oTCU_01_oATOM_CAN_Matrix_PT_V600_20250211_0e521934_Rx
            TCU_TMSTotalPwrCnsmp_oTCU_01_oATOM_CAN_Matrix_PT_V600_20250211_9dde2d90_Rx
            TCU_TMSTotoalPwrReq_oTCU_01_oATOM_CAN_Matrix_PT_V600_20250211_247c22c3_Rx
        SG_TCU_02_SigGroup_oTCU_02_oATOM_CAN_Matrix_PT_V600_20250211_a432f792_Rx: ComNotification=Rte_COMCbk_SG_TCU_02_SigGroup_oTCU_02_oATOM_CAN_Matrix_PT_V600_20250211_a432f792_Rx
          TCU_HVCHHVDCCurrent_oTCU_02_oATOM_CAN_Matrix_PT_V600_20250211_400bea9a_Rx (ComGroupSignal): ComSignalType=UINT8
          TCU_HVCHHighVoltage_oTCU_02_oATOM_CAN_Matrix_PT_V600_20250211_3d196c75_Rx (ComGroupSignal): ComSignalType=UINT16
        SG_VCU_02_SigGroup_oVCU_02_oATOM_CANFD_Matrix_CH_V600_202502_2fc20804_Tx
          5 x ComGroupSignal:
            VCU_BS_Current_oVCU_02_oATOM_CANFD_Matrix_CH_V600_202502_55d19f8e_Tx: ComSignalType=UINT16
            VCU_BS_IBSBatSOC_oVCU_02_oATOM_CANFD_Matrix_CH_V600_202502_34765b89_Tx: ComSignalType=UINT8
            VCU_BS_IndicatorSts_oVCU_02_oATOM_CANFD_Matrix_CH_V600_202502_0d3265cb_Tx: ComSignalType=BOOLEAN
            VCU_BS_LV_Batt_oVCU_02_oATOM_CANFD_Matrix_CH_V600_202502_41d6d523_Tx: ComSignalType=UINT16
            VCU_WakeUpStatus_oVCU_02_oATOM_CANFD_Matrix_CH_V600_202502_091aaa11_Tx: ComSignalType=UINT8
        SG_VCU_02_SigGroup_oVCU_02_oATOM_CAN_Matrix_PT_V600_20250211_109f7195_Tx
          5 x ComGroupSignal:
            VCU_BS_Current_oVCU_02_oATOM_CAN_Matrix_PT_V600_20250211_6a8ce61f_Tx: ComSignalType=UINT16
            VCU_BS_IBSBatSOC_oVCU_02_oATOM_CAN_Matrix_PT_V600_20250211_0b2b2218_Tx: ComSignalType=UINT8
            VCU_BS_IndicatorSts_oVCU_02_oATOM_CAN_Matrix_PT_V600_20250211_326f1c5a_Tx: ComSignalType=BOOLEAN
            VCU_BS_LV_Batt_oVCU_02_oATOM_CAN_Matrix_PT_V600_20250211_7e8bacb2_Tx: ComSignalType=UINT16
            VCU_WakeUpStatus_oVCU_02_oATOM_CAN_Matrix_PT_V600_20250211_3647d380_Tx: ComSignalType=UINT8
        SG_VCU_03_SigGroup_oVCU_03_oATOM_CANFD_Matrix_CH_V600_202502_8990e3c1_Tx
          5 x ComGroupSignal:
            VCU_BrakeCompensateStatus_oVCU_03_oATOM_CANFD_Matrix_CH_V600_202502_aada4313_Tx: ComSignalType=UINT8
            VCU_ChargeProcessComment_oVCU_03_oATOM_CANFD_Matrix_CH_V600_202502_b076f405_Tx: ComSignalType=UINT8
            VCU_DCFCCurrent_oVCU_03_oATOM_CANFD_Matrix_CH_V600_202502_54508868_Tx: ComSignalType=UINT16
            VCU_EnergyV2L_oVCU_03_oATOM_CANFD_Matrix_CH_V600_202502_5ef6f2f0_Tx: ComSignalType=UINT16
            VCU_MemoryChargeFault_oVCU_03_oATOM_CANFD_Matrix_CH_V600_202502_cb765ea4_Tx: ComSignalType=BOOLEAN
        SG_VCU_04_SigGroup_oVCU_04_oATOM_CANFD_Matrix_CH_V600_202502_4cce7c18_Tx
          VCU_ForwardVmaxlimitStatus_oVCU_04_oATOM_CANFD_Matrix_CH_V600_202502_beba9b73_Tx (ComGroupSignal): ComSignalType=BOOLEAN
          VCU_ManuallyUnlockComment_oVCU_04_oATOM_CANFD_Matrix_CH_V600_202502_3223f100_Tx (ComGroupSignal): ComSignalType=BOOLEAN
        SG_VCU_05_SigGroup_oVCU_05_oATOM_CAN_Matrix_PT_V600_20250211_d5c1ee4c_Tx
          4 x ComGroupSignal, all with ComSignalType=UINT16:
            VCU_MaximumOutputCurrent_oVCU_05_oATOM_CAN_Matrix_PT_V600_20250211_fe0b8d7d_Tx
            VCU_MaximumOutputVoltage_oVCU_05_oATOM_CAN_Matrix_PT_V600_20250211_9c0bf641_Tx
            VCU_MinimumOutputCurrent_oVCU_05_oATOM_CAN_Matrix_PT_V600_20250211_6eda15dd_Tx
            VCU_MinimumOutputVoltage_oVCU_05_oATOM_CAN_Matrix_PT_V600_20250211_0cda6ee1_Tx
        SG_VCU_06_SigGroup_oVCU_06_oATOM_CAN_Matrix_PT_V600_20250211_e447d442_Tx
          6 x ComGroupSignal:
            VCU_ChargeEnergy_oVCU_06_oATOM_CAN_Matrix_PT_V600_20250211_aa509ad7_Tx: ComSignalType=UINT16
            VCU_ChargeTime_oVCU_06_oATOM_CAN_Matrix_PT_V600_20250211_b03563a4_Tx: ComSignalType=UINT16
            VCU_DisChgPowerLimit_oVCU_06_oATOM_CAN_Matrix_PT_V600_20250211_aae83d58_Tx: ComSignalType=UINT8
            VCU_DisplayMileage_oVCU_06_oATOM_CAN_Matrix_PT_V600_20250211_1f4b707e_Tx: ComSignalType=UINT16
            VCU_MCUPower_oVCU_06_oATOM_CAN_Matrix_PT_V600_20250211_5ed6e72f_Tx: ComSignalType=UINT16
            VCU_PermitPackPTC_oVCU_06_oATOM_CAN_Matrix_PT_V600_20250211_8f94a915_Tx: ComSignalType=BOOLEAN
        SG_VCU_AccPedal_SigGroup_oVCU_AccPedal_oATOM_CANFD_Matrix_CH_V600_202502_aa50ac8d_Tx
          13 x ComGroupSignal:
            Checksum_0D2_oVCU_AccPedal_oATOM_CANFD_Matrix_CH_V600_202502_51727e14_Tx: ComSignalType=UINT8
            MessageCounter_0D2_oVCU_AccPedal_oATOM_CANFD_Matrix_CH_V600_202502_630306b4_Tx: ComSignalType=UINT8
            VCU_AccelerationPedalValid_oVCU_AccPedal_oATOM_CANFD_Matrix_CH_V600_202502_365d9f08_Tx: ComSignalType=BOOLEAN
            VCU_AccelerationPedal_oVCU_AccPedal_oATOM_CANFD_Matrix_CH_V600_202502_f84e7cef_Tx: ComSignalType=UINT16
            VCU_EPBReq_oVCU_AccPedal_oATOM_CANFD_Matrix_CH_V600_202502_4a2bfea4_Tx: ComSignalType=UINT8
            VCU_Kickdown_oVCU_AccPedal_oATOM_CANFD_Matrix_CH_V600_202502_17d4134b_Tx: ComSignalType=BOOLEAN
            VCU_TargetGear_oVCU_AccPedal_oATOM_CANFD_Matrix_CH_V600_202502_d928d8b4_Tx: ComSignalType=UINT8
            VCU_VLCTorqueRequestActive_oVCU_AccPedal_oATOM_CANFD_Matrix_CH_V600_202502_a1329f5d_Tx: ComSignalType=BOOLEAN
            VCU_VLCTorqueRequestAvailable_oVCU_AccPedal_oATOM_CANFD_Matrix_CH_V600_202502_d00cfa4f_Tx: ComSignalType=BOOLEAN
            VCU_VehicleSpeedValid_oVCU_AccPedal_oATOM_CANFD_Matrix_CH_V600_202502_70135d30_Tx: ComSignalType=BOOLEAN
            VCU_VehicleSpeed_oVCU_AccPedal_oATOM_CANFD_Matrix_CH_V600_202502_da00c229_Tx: ComSignalType=UINT16
            VCU_VirtualACPedalValid_oVCU_AccPedal_oATOM_CANFD_Matrix_CH_V600_202502_4b161096_Tx: ComSignalType=BOOLEAN
            VCU_VirtualACPedal_oVCU_AccPedal_oATOM_CANFD_Matrix_CH_V600_202502_03ae7390_Tx: ComSignalType=UINT16
        SG_VCU_AccPedal_SigGroup_oVCU_AccPedal_oATOM_CAN_Matrix_PT_V600_20250211_950dd51c_Tx
          13 x ComGroupSignal:
            Checksum_0D2_oVCU_AccPedal_oATOM_CAN_Matrix_PT_V600_20250211_6e2f0785_Tx: ComSignalType=UINT8
            MessageCounter_0D2_oVCU_AccPedal_oATOM_CAN_Matrix_PT_V600_20250211_5c5e7f25_Tx: ComSignalType=UINT8
            VCU_AccelerationPedalValid_oVCU_AccPedal_oATOM_CAN_Matrix_PT_V600_20250211_0900e699_Tx: ComSignalType=BOOLEAN
            VCU_AccelerationPedal_oVCU_AccPedal_oATOM_CAN_Matrix_PT_V600_20250211_c713057e_Tx: ComSignalType=UINT16
            VCU_EPBReq_oVCU_AccPedal_oATOM_CAN_Matrix_PT_V600_20250211_75768735_Tx: ComSignalType=UINT8
            VCU_Kickdown_oVCU_AccPedal_oATOM_CAN_Matrix_PT_V600_20250211_28896ada_Tx: ComSignalType=BOOLEAN
            VCU_TargetGear_oVCU_AccPedal_oATOM_CAN_Matrix_PT_V600_20250211_e675a125_Tx: ComSignalType=UINT8
            VCU_VLCTorqueRequestActive_oVCU_AccPedal_oATOM_CAN_Matrix_PT_V600_20250211_9e6fe6cc_Tx: ComSignalType=BOOLEAN
            VCU_VLCTorqueRequestAvailable_oVCU_AccPedal_oATOM_CAN_Matrix_PT_V600_20250211_ef5183de_Tx: ComSignalType=BOOLEAN
            VCU_VehicleSpeedValid_oVCU_AccPedal_oATOM_CAN_Matrix_PT_V600_20250211_4f4e24a1_Tx: ComSignalType=BOOLEAN
            VCU_VehicleSpeed_oVCU_AccPedal_oATOM_CAN_Matrix_PT_V600_20250211_e55dbbb8_Tx: ComSignalType=UINT16
            VCU_VirtualACPedalValid_oVCU_AccPedal_oATOM_CAN_Matrix_PT_V600_20250211_744b6907_Tx: ComSignalType=BOOLEAN
            VCU_VirtualACPedal_oVCU_AccPedal_oATOM_CAN_Matrix_PT_V600_20250211_3cf30a01_Tx: ComSignalType=UINT16
        SG_VCU_BMS_SigGroup_oVCU_BMS_oATOM_CANFD_Matrix_CH_V600_202502_d27feb30_Tx
          13 x ComGroupSignal:
            Checksum_0D1_oVCU_BMS_oATOM_CANFD_Matrix_CH_V600_202502_c848143c_Tx: ComSignalType=UINT8
            MessageCounter_0D1_oVCU_BMS_oATOM_CANFD_Matrix_CH_V600_202502_0232b184_Tx: ComSignalType=UINT8
            VCU_ActDriveMode_oVCU_BMS_oATOM_CANFD_Matrix_CH_V600_202502_c1c6ace2_Tx: ComSignalType=UINT8
            VCU_BMSTargetThermLevel_oVCU_BMS_oATOM_CANFD_Matrix_CH_V600_202502_9ec34af1_Tx: ComSignalType=UINT8
            VCU_BMS_Control_of_PosRelay_oVCU_BMS_oATOM_CANFD_Matrix_CH_V600_202502_cab9d256_Tx: ComSignalType=UINT8
            VCU_ChargeStatus_oVCU_BMS_oATOM_CANFD_Matrix_CH_V600_202502_17f7901d_Tx: ComSignalType=UINT8
            VCU_DrvModSwitchWarn_oVCU_BMS_oATOM_CANFD_Matrix_CH_V600_202502_8a817be7_Tx: ComSignalType=UINT8
            VCU_HVStatus_oVCU_BMS_oATOM_CANFD_Matrix_CH_V600_202502_aebb67ba_Tx: ComSignalType=UINT8
            VCU_IsoMeasurementSwitch_oVCU_BMS_oATOM_CANFD_Matrix_CH_V600_202502_d7a76412_Tx: ComSignalType=BOOLEAN
            VCU_LimitLevel_oVCU_BMS_oATOM_CANFD_Matrix_CH_V600_202502_944086eb_Tx: ComSignalType=UINT8
            VCU_RegenBrakeLightReqVld_oVCU_BMS_oATOM_CANFD_Matrix_CH_V600_202502_b28083e9_Tx: ComSignalType=BOOLEAN
            VCU_RegenBrakeLightRequest_oVCU_BMS_oATOM_CANFD_Matrix_CH_V600_202502_9537c5ed_Tx: ComSignalType=BOOLEAN
            VCU_RequestedModeBMS_oVCU_BMS_oATOM_CANFD_Matrix_CH_V600_202502_a3197c92_Tx: ComSignalType=UINT8
        SG_VCU_BMS_SigGroup_oVCU_BMS_oATOM_CAN_Matrix_PT_V600_20250211_ed2292a1_Tx
          13 x ComGroupSignal:
            Checksum_0D1_oVCU_BMS_oATOM_CAN_Matrix_PT_V600_20250211_f7156dad_Tx: ComSignalType=UINT8
            MessageCounter_0D1_oVCU_BMS_oATOM_CAN_Matrix_PT_V600_20250211_3d6fc815_Tx: ComSignalType=UINT8
            VCU_ActDriveMode_oVCU_BMS_oATOM_CAN_Matrix_PT_V600_20250211_fe9bd573_Tx: ComSignalType=UINT8
            VCU_BMSTargetThermLevel_oVCU_BMS_oATOM_CAN_Matrix_PT_V600_20250211_a19e3360_Tx: ComSignalType=UINT8
            VCU_BMS_Control_of_PosRelay_oVCU_BMS_oATOM_CAN_Matrix_PT_V600_20250211_f5e4abc7_Tx: ComSignalType=UINT8
            VCU_ChargeStatus_oVCU_BMS_oATOM_CAN_Matrix_PT_V600_20250211_28aae98c_Tx: ComSignalType=UINT8
            VCU_DrvModSwitchWarn_oVCU_BMS_oATOM_CAN_Matrix_PT_V600_20250211_b5dc0276_Tx: ComSignalType=UINT8
            VCU_HVStatus_oVCU_BMS_oATOM_CAN_Matrix_PT_V600_20250211_91e61e2b_Tx: ComSignalType=UINT8
            VCU_IsoMeasurementSwitch_oVCU_BMS_oATOM_CAN_Matrix_PT_V600_20250211_e8fa1d83_Tx: ComSignalType=BOOLEAN
            VCU_LimitLevel_oVCU_BMS_oATOM_CAN_Matrix_PT_V600_20250211_ab1dff7a_Tx: ComSignalType=UINT8
            VCU_RegenBrakeLightReqVld_oVCU_BMS_oATOM_CAN_Matrix_PT_V600_20250211_8dddfa78_Tx: ComSignalType=BOOLEAN
            VCU_RegenBrakeLightRequest_oVCU_BMS_oATOM_CAN_Matrix_PT_V600_20250211_aa6abc7c_Tx: ComSignalType=BOOLEAN
            VCU_RequestedModeBMS_oVCU_BMS_oATOM_CAN_Matrix_PT_V600_20250211_9c440503_Tx: ComSignalType=UINT8
        SG_VCU_Chassis_01_SigGroup_oVCU_Chassis_01_oATOM_CANFD_Matrix_CH_V600_202502_52963860_Tx
          15 x ComGroupSignal:
            Checksum_0D3_oVCU_Chassis_01_oATOM_CANFD_Matrix_CH_V600_202502_090e4c9b_Tx: ComSignalType=UINT8
            MessageCounter_0D3_oVCU_Chassis_01_oATOM_CANFD_Matrix_CH_V600_202502_f9d73b0d_Tx: ComSignalType=UINT8
            VCU_ADASOverride_oVCU_Chassis_01_oATOM_CANFD_Matrix_CH_V600_202502_0c002a43_Tx: ComSignalType=BOOLEAN
            VCU_APSTorqueRequestActive_oVCU_Chassis_01_oATOM_CANFD_Matrix_CH_V600_202502_c8f21b10_Tx: ComSignalType=BOOLEAN
            VCU_APSTorqueRequestAvailable_oVCU_Chassis_01_oATOM_CANFD_Matrix_CH_V600_202502_8298a57a_Tx: ComSignalType=BOOLEAN
            VCU_BrakeCompensateWarn_oVCU_Chassis_01_oATOM_CANFD_Matrix_CH_V600_202502_8427f667_Tx: ComSignalType=UINT8
            VCU_DecelerationReq_oVCU_Chassis_01_oATOM_CANFD_Matrix_CH_V600_202502_22f1bc0a_Tx: ComSignalType=UINT8
            VCU_DecelerationReqactive_oVCU_Chassis_01_oATOM_CANFD_Matrix_CH_V600_202502_29147867_Tx: ComSignalType=BOOLEAN
            VCU_DriverTorqueRequest_oVCU_Chassis_01_oATOM_CANFD_Matrix_CH_V600_202502_f98385dc_Tx: ComSignalType=UINT16
            VCU_EnergyManagementWarn_oVCU_Chassis_01_oATOM_CANFD_Matrix_CH_V600_202502_4b7de956_Tx: ComSignalType=UINT8
            VCU_RegStatus_oVCU_Chassis_01_oATOM_CANFD_Matrix_CH_V600_202502_6d4e3983_Tx: ComSignalType=UINT8
            VCU_RegenTorqueCapValid_oVCU_Chassis_01_oATOM_CANFD_Matrix_CH_V600_202502_5eaff4d8_Tx: ComSignalType=BOOLEAN
            VCU_RegenTorqueCap_oVCU_Chassis_01_oATOM_CANFD_Matrix_CH_V600_202502_a5a4bebf_Tx: ComSignalType=UINT16
            VCU_TorqueRequestActive_oVCU_Chassis_01_oATOM_CANFD_Matrix_CH_V600_202502_24abcc5b_Tx: ComSignalType=BOOLEAN
            VCU_TorqueRequestAvailable_oVCU_Chassis_01_oATOM_CANFD_Matrix_CH_V600_202502_22997d3f_Tx: ComSignalType=BOOLEAN
        SG_VCU_DCDC_SigGroup_oVCU_DCDC_oATOM_CAN_Matrix_PT_V600_20250211_d0a22af6_Tx
          3 x ComGroupSignal:
            VCU_DCDCPowerLimit_oVCU_DCDC_oATOM_CAN_Matrix_PT_V600_20250211_90ed45f3_Tx: ComSignalType=UINT8
            VCU_RequestedModeDCDC_oVCU_DCDC_oATOM_CAN_Matrix_PT_V600_20250211_c910d2b3_Tx: ComSignalType=UINT8
            VCU_VoltageDemandLV_oVCU_DCDC_oATOM_CAN_Matrix_PT_V600_20250211_9951a04f_Tx: ComSignalType=UINT16
        SG_VCU_HMIsignals_01_SigGroup_oVCU_HMIsignals_01_oATOM_CANFD_Matrix_CH_V600_202502_c30c8d8f_Tx
          14 x ComGroupSignal:
            Checksum_317_oVCU_HMIsignals_01_oATOM_CANFD_Matrix_CH_V600_202502_7e8714d3_Tx: ComSignalType=UINT8
            MessageCounter_317_oVCU_HMIsignals_01_oATOM_CANFD_Matrix_CH_V600_202502_18685520_Tx: ComSignalType=UINT8
            VCU_CriSysFailure_oVCU_HMIsignals_01_oATOM_CANFD_Matrix_CH_V600_202502_13fa69e3_Tx: ComSignalType=UINT8
            VCU_DCDCFail_oVCU_HMIsignals_01_oATOM_CANFD_Matrix_CH_V600_202502_8211651e_Tx: ComSignalType=BOOLEAN
            VCU_DriveMotOvrTemp_oVCU_HMIsignals_01_oATOM_CANFD_Matrix_CH_V600_202502_2b850699_Tx: ComSignalType=BOOLEAN
            VCU_HVBatCriFail_oVCU_HMIsignals_01_oATOM_CANFD_Matrix_CH_V600_202502_05faf04f_Tx: ComSignalType=UINT8
            VCU_HVBatOvrTemp_oVCU_HMIsignals_01_oATOM_CANFD_Matrix_CH_V600_202502_1ab841cc_Tx: ComSignalType=BOOLEAN
            VCU_HVILError_oVCU_HMIsignals_01_oATOM_CANFD_Matrix_CH_V600_202502_f1e2e871_Tx: ComSignalType=BOOLEAN
            VCU_HVInsulResFault_oVCU_HMIsignals_01_oATOM_CANFD_Matrix_CH_V600_202502_e6836204_Tx: ComSignalType=BOOLEAN
            VCU_InvldGearSel_oVCU_HMIsignals_01_oATOM_CANFD_Matrix_CH_V600_202502_773f11d0_Tx: ComSignalType=UINT8
            VCU_LimpHome_oVCU_HMIsignals_01_oATOM_CANFD_Matrix_CH_V600_202502_664ff33a_Tx: ComSignalType=BOOLEAN
            VCU_MileagelowRemind_oVCU_HMIsignals_01_oATOM_CANFD_Matrix_CH_V600_202502_1b14b376_Tx: ComSignalType=BOOLEAN
            VCU_PlugStatus_oVCU_HMIsignals_01_oATOM_CANFD_Matrix_CH_V600_202502_250fa71e_Tx: ComSignalType=UINT8
            VCU_ReachLimitStd_oVCU_HMIsignals_01_oATOM_CANFD_Matrix_CH_V600_202502_5cd2e319_Tx: ComSignalType=BOOLEAN
        SG_VCU_HMIsignals_02_SigGroup_oVCU_HMIsignals_02_oATOM_CANFD_Matrix_CH_V600_202502_b90a0cf2_Tx
          9 x ComGroupSignal:
            Checksum_318_oVCU_HMIsignals_02_oATOM_CANFD_Matrix_CH_V600_202502_fc013b78_Tx: ComSignalType=UINT8
            MessageCounter_318_oVCU_HMIsignals_02_oATOM_CANFD_Matrix_CH_V600_202502_9aee7a8b_Tx: ComSignalType=UINT8
            VCU_DischargeEndSoc_oVCU_HMIsignals_02_oATOM_CANFD_Matrix_CH_V600_202502_a47f7a1f_Tx: ComSignalType=UINT8
            VCU_Display_Cur_oVCU_HMIsignals_02_oATOM_CANFD_Matrix_CH_V600_202502_629aba80_Tx: ComSignalType=UINT16
            VCU_Display_Power_oVCU_HMIsignals_02_oATOM_CANFD_Matrix_CH_V600_202502_1364d55f_Tx: ComSignalType=UINT16
            VCU_ForwardVmaxAllowed_oVCU_HMIsignals_02_oATOM_CANFD_Matrix_CH_V600_202502_631e19bb_Tx: ComSignalType=UINT8
            VCU_MCU_FaultLampReq_oVCU_HMIsignals_02_oATOM_CANFD_Matrix_CH_V600_202502_b94ce354_Tx: ComSignalType=UINT8
            VCU_SystemReady_oVCU_HMIsignals_02_oATOM_CANFD_Matrix_CH_V600_202502_3baa5f6f_Tx: ComSignalType=BOOLEAN
            VCU_maxChargeSOC_oVCU_HMIsignals_02_oATOM_CANFD_Matrix_CH_V600_202502_b7e91aff_Tx: ComSignalType=UINT8
        SG_VCU_HMIsignals_02_SigGroup_oVCU_HMIsignals_02_oATOM_CAN_Matrix_PT_V600_20250211_86577563_Tx
          9 x ComGroupSignal:
            Checksum_318_oVCU_HMIsignals_02_oATOM_CAN_Matrix_PT_V600_20250211_c35c42e9_Tx: ComSignalType=UINT8
            MessageCounter_318_oVCU_HMIsignals_02_oATOM_CAN_Matrix_PT_V600_20250211_a5b3031a_Tx: ComSignalType=UINT8
            VCU_DischargeEndSoc_oVCU_HMIsignals_02_oATOM_CAN_Matrix_PT_V600_20250211_9b22038e_Tx: ComSignalType=UINT8
            VCU_Display_Cur_oVCU_HMIsignals_02_oATOM_CAN_Matrix_PT_V600_20250211_5dc7c311_Tx: ComSignalType=UINT16
            VCU_Display_Power_oVCU_HMIsignals_02_oATOM_CAN_Matrix_PT_V600_20250211_2c39acce_Tx: ComSignalType=UINT16
            VCU_ForwardVmaxAllowed_oVCU_HMIsignals_02_oATOM_CAN_Matrix_PT_V600_20250211_5c43602a_Tx: ComSignalType=UINT8
            VCU_MCU_FaultLampReq_oVCU_HMIsignals_02_oATOM_CAN_Matrix_PT_V600_20250211_86119ac5_Tx: ComSignalType=UINT8
            VCU_SystemReady_oVCU_HMIsignals_02_oATOM_CAN_Matrix_PT_V600_20250211_04f726fe_Tx: ComSignalType=BOOLEAN
            VCU_maxChargeSOC_oVCU_HMIsignals_02_oATOM_CAN_Matrix_PT_V600_20250211_88b4636e_Tx: ComSignalType=UINT8
        SG_VCU_HMIsignals_03_SigGroup_oVCU_HMIsignals_03_oATOM_CAN_Matrix_PT_V600_20250211_197a0877_Tx
          3 x ComGroupSignal:
            VCU_BS_HCurrent_oVCU_HMIsignals_03_oATOM_CAN_Matrix_PT_V600_20250211_6f1b1ed0_Tx: ComSignalType=SINT16
            VCU_BS_QuiescentCurrent_oVCU_HMIsignals_03_oATOM_CAN_Matrix_PT_V600_20250211_2f6b45d6_Tx: ComSignalType=UINT8
            VCU_Display_voltage_oVCU_HMIsignals_03_oATOM_CAN_Matrix_PT_V600_20250211_1f4e8320_Tx: ComSignalType=UINT16
        SG_VCU_IBS_01_SigGroup_oVCU_IBS_01_oATOM_CANFD_Matrix_CH_V600_202502_f0f49d09_Tx
          7 x ComGroupSignal:
            Checksum_094_oVCU_IBS_01_oATOM_CANFD_Matrix_CH_V600_202502_28a707e9_Tx: ComSignalType=UINT8
            MessageCounter_094_oVCU_IBS_01_oATOM_CANFD_Matrix_CH_V600_202502_804a7805_Tx: ComSignalType=UINT8
            VCU_MotorActualTorqueValid_oVCU_IBS_01_oATOM_CANFD_Matrix_CH_V600_202502_2709c7ef_Tx: ComSignalType=BOOLEAN
            VCU_MotorActualTorque_oVCU_IBS_01_oATOM_CANFD_Matrix_CH_V600_202502_90c1c989_Tx: ComSignalType=UINT16
            VCU_OPStandstillReq_oVCU_IBS_01_oATOM_CANFD_Matrix_CH_V600_202502_af773c24_Tx: ComSignalType=UINT8
            VCU_WheelTrqACTValid_oVCU_IBS_01_oATOM_CANFD_Matrix_CH_V600_202502_0e2031fb_Tx: ComSignalType=BOOLEAN
            VCU_WheelTrqACT_oVCU_IBS_01_oATOM_CANFD_Matrix_CH_V600_202502_722027bb_Tx: ComSignalType=UINT16
        SG_VCU_MCU_02_SigGroup_oVCU_MCU_02_oATOM_CAN_Matrix_PT_V600_20250211_2d530015_Tx
          3 x ComGroupSignal:
            VCU_MCUActHeatPwr_oVCU_MCU_02_oATOM_CAN_Matrix_PT_V600_20250211_420c1833_Tx: ComSignalType=UINT8
            VCU_MaxSpdLimit_oVCU_MCU_02_oATOM_CAN_Matrix_PT_V600_20250211_1d67c298_Tx: ComSignalType=UINT16
            VCU_MotorSpdReq_oVCU_MCU_02_oATOM_CAN_Matrix_PT_V600_20250211_c5c80260_Tx: ComSignalType=UINT16
        SG_VCU_MCU_03_SigGroup_oVCU_MCU_03_oATOM_CANFD_Matrix_CH_V600_202502_c0057d9b_Tx
          11 x ComGroupSignal:
            Checksum_095_oVCU_MCU_03_oATOM_CANFD_Matrix_CH_V600_202502_004b6de5_Tx: ComSignalType=UINT8
            MessageCounter_095_oVCU_MCU_03_oATOM_CANFD_Matrix_CH_V600_202502_a8a61209_Tx: ComSignalType=UINT8
            VCU_ActualGear_oVCU_MCU_03_oATOM_CANFD_Matrix_CH_V600_202502_adcf3745_Tx: ComSignalType=UINT8
            VCU_BrakepedalStatus_oVCU_MCU_03_oATOM_CANFD_Matrix_CH_V600_202502_f285ec19_Tx: ComSignalType=UINT8
            VCU_KL15eOn_oVCU_MCU_03_oATOM_CANFD_Matrix_CH_V600_202502_2306d930_Tx: ComSignalType=BOOLEAN
            VCU_MCUDesiredTorque_oVCU_MCU_03_oATOM_CANFD_Matrix_CH_V600_202502_a07350bb_Tx: ComSignalType=UINT16
            VCU_MCUSurgeDamperState_oVCU_MCU_03_oATOM_CANFD_Matrix_CH_V600_202502_4b3e55ae_Tx: ComSignalType=UINT8
            VCU_PWTErrorLevel_oVCU_MCU_03_oATOM_CANFD_Matrix_CH_V600_202502_4725a26e_Tx: ComSignalType=UINT8
            VCU_RequestedModeMCU_oVCU_MCU_03_oATOM_CANFD_Matrix_CH_V600_202502_97cf52ed_Tx: ComSignalType=UINT8
            VCU_TCSActive_oVCU_MCU_03_oATOM_CANFD_Matrix_CH_V600_202502_f7e15433_Tx: ComSignalType=BOOLEAN
            VCU_TrqThresholdDampgCtl_oVCU_MCU_03_oATOM_CANFD_Matrix_CH_V600_202502_86f61526_Tx: ComSignalType=UINT8
        SG_VCU_MCU_03_SigGroup_oVCU_MCU_03_oATOM_CAN_Matrix_PT_V600_20250211_ff58040a_Tx
          11 x ComGroupSignal:
            Checksum_095_oVCU_MCU_03_oATOM_CAN_Matrix_PT_V600_20250211_3f161474_Tx: ComSignalType=UINT8
            MessageCounter_095_oVCU_MCU_03_oATOM_CAN_Matrix_PT_V600_20250211_97fb6b98_Tx: ComSignalType=UINT8
            VCU_ActualGear_oVCU_MCU_03_oATOM_CAN_Matrix_PT_V600_20250211_92924ed4_Tx: ComSignalType=UINT8
            VCU_BrakepedalStatus_oVCU_MCU_03_oATOM_CAN_Matrix_PT_V600_20250211_cdd89588_Tx: ComSignalType=UINT8
            VCU_KL15eOn_oVCU_MCU_03_oATOM_CAN_Matrix_PT_V600_20250211_1c5ba0a1_Tx: ComSignalType=BOOLEAN
            VCU_MCUDesiredTorque_oVCU_MCU_03_oATOM_CAN_Matrix_PT_V600_20250211_9f2e292a_Tx: ComSignalType=UINT16
            VCU_MCUSurgeDamperState_oVCU_MCU_03_oATOM_CAN_Matrix_PT_V600_20250211_74632c3f_Tx: ComSignalType=UINT8
            VCU_PWTErrorLevel_oVCU_MCU_03_oATOM_CAN_Matrix_PT_V600_20250211_7878dbff_Tx: ComSignalType=UINT8
            VCU_RequestedModeMCU_oVCU_MCU_03_oATOM_CAN_Matrix_PT_V600_20250211_a8922b7c_Tx: ComSignalType=UINT8
            VCU_TCSActive_oVCU_MCU_03_oATOM_CAN_Matrix_PT_V600_20250211_c8bc2da2_Tx: ComSignalType=BOOLEAN
            VCU_TrqThresholdDampgCtl_oVCU_MCU_03_oATOM_CAN_Matrix_PT_V600_20250211_b9ab6cb7_Tx: ComSignalType=UINT8
        SG_VCU_MCU_05_SigGroup_oVCU_MCU_05_oATOM_CAN_Matrix_PT_V600_20250211_7ef1168b_Tx
          5 x ComGroupSignal, all with ComSignalType=UINT16:
            VCU_CreepTorque_oVCU_MCU_05_oATOM_CAN_Matrix_PT_V600_20250211_7425dee6_Tx
            VCU_MaxTorqueGradient_oVCU_MCU_05_oATOM_CAN_Matrix_PT_V600_20250211_2927c5de_Tx
            VCU_MaxTorqueLimit_oVCU_MCU_05_oATOM_CAN_Matrix_PT_V600_20250211_3a034e45_Tx
            VCU_MinTorqueLimit_oVCU_MCU_05_oATOM_CAN_Matrix_PT_V600_20250211_d434a6d2_Tx
            VCU_SpdLimitActTorque_oVCU_MCU_05_oATOM_CAN_Matrix_PT_V600_20250211_6de9d8ce_Tx
        SG_VCU_POD_SigGroup_oVCU_POD_oATOM_CAN_Matrix_PT_V600_20250211_c17d64e5_Tx
          5 x ComGroupSignal:
            VCU_EnableOBC_oVCU_POD_oATOM_CAN_Matrix_PT_V600_20250211_316adab0_Tx: ComSignalType=UINT8
            VCU_Enable_DC_Relay_oVCU_POD_oATOM_CAN_Matrix_PT_V600_20250211_187d15ec_Tx: ComSignalType=BOOLEAN
            VCU_OBC_ChargeCurrentCommand_oVCU_POD_oATOM_CAN_Matrix_PT_V600_20250211_afae32a2_Tx: ComSignalType=UINT16
            VCU_OBC_Control_of_S2_SW_oVCU_POD_oATOM_CAN_Matrix_PT_V600_20250211_2bbcc657_Tx: ComSignalType=BOOLEAN
            VCU_OBC_Control_of_em_lock_oVCU_POD_oATOM_CAN_Matrix_PT_V600_20250211_476ced65_Tx: ComSignalType=BOOLEAN
        SG_VCU_PlugInChrgInfo_SigGroup_oVCU_PlugInChrgInfo_oATOM_CANFD_Matrix_CH_V600_202502_c285d340_Tx
          4 x ComGroupSignal:
            VCU_ChargeEndReason_oVCU_PlugInChrgInfo_oATOM_CANFD_Matrix_CH_V600_202502_86604033_Tx: ComSignalType=UINT8
            VCU_DischargeEndReason_oVCU_PlugInChrgInfo_oATOM_CANFD_Matrix_CH_V600_202502_a9c41ef6_Tx: ComSignalType=UINT8
            VCU_HVConnectFault_oVCU_PlugInChrgInfo_oATOM_CANFD_Matrix_CH_V600_202502_ad3614da_Tx: ComSignalType=BOOLEAN
            VCU_RemainChrgTime_oVCU_PlugInChrgInfo_oATOM_CANFD_Matrix_CH_V600_202502_deed3006_Tx: ComSignalType=UINT16
        SG_VCU_SynReq_01_SigGroup_oVCU_SynReq_01_oATOM_CAN_Matrix_PT_V600_20250211_2ec232a9_Tx
          VCU_SynRequest_oVCU_SynReq_01_oATOM_CAN_Matrix_PT_V600_20250211_c64837e4_Tx (ComGroupSignal): ComSignalType=UINT32
        SG_VCU_TCU_SigGroup_oVCU_TCU_oATOM_CAN_Matrix_PT_V600_20250211_1a98021d_Tx
          VCU_RequestedModeTCU_oVCU_TCU_oATOM_CAN_Matrix_PT_V600_20250211_ea14d901_Tx (ComGroupSignal): ComSignalType=UINT8
          VCU_TCUPowerAllowed_oVCU_TCU_oATOM_CAN_Matrix_PT_V600_20250211_0cf367b9_Tx (ComGroupSignal): ComSignalType=UINT16
      31 x ComSignal:
        SOCWU_Ena_oVCU_BS_01_oATOM_HWLIN1_c1ae10c8_Tx: ComSignalType=BOOLEAN
        SOCWU_Treshold_oVCU_BS_01_oATOM_HWLIN1_cb8c1a90_Tx: ComSignalType=UINT8
        SOC_oBS_02_oATOM_HWLIN1_5cc1cc8b_Rx: ComNotification=Rte_COMCbk_SOC_oBS_02_oATOM_HWLIN1_5cc1cc8b_Rx, ComSignalType=UINT8
        SOF_V1_oBS_02_oATOM_HWLIN1_92563dee_Rx: ComNotification=Rte_COMCbk_SOF_V1_oBS_02_oATOM_HWLIN1_92563dee_Rx, ComSignalType=UINT8
        SOF_V2_oBS_02_oATOM_HWLIN1_e948bf0d_Rx: ComNotification=Rte_COMCbk_SOF_V2_oBS_02_oATOM_HWLIN1_e948bf0d_Rx, ComSignalType=UINT8
        SOH_oBS_02_oATOM_HWLIN1_022d471e_Rx: ComNotification=Rte_COMCbk_SOH_oBS_02_oATOM_HWLIN1_022d471e_Rx, ComSignalType=UINT8
        T_BATT_oBS_01_oATOM_HWLIN1_2bbe4bbe_Rx: ComNotification=Rte_COMCbk_T_BATT_oBS_01_oATOM_HWLIN1_2bbe4bbe_Rx, ComSignalType=UINT8
        U_BATT_oBS_01_oATOM_HWLIN1_cca3ed29_Rx: ComNotification=Rte_COMCbk_U_BATT_oBS_01_oATOM_HWLIN1_cca3ed29_Rx, ComSignalType=UINT16
        VCU_ACU_DriverWarningLampSts_oVCU_01_oATOM_HWLIN1_42c2b0b9_Tx: ComSignalType=UINT8
        VCU_ACU_PassengerAirbagSts_oVCU_01_oATOM_HWLIN1_a0d9a7b9_Tx: ComSignalType=UINT8
        VCU_ACU_PassengerWarningLampSts_oVCU_01_oATOM_HWLIN1_76395bc4_Tx: ComSignalType=UINT8
        VCU_ACU_WarningLampSts_oVCU_01_oATOM_HWLIN1_7751b62b_Tx: ComSignalType=UINT8
        VCU_BCM_FLSeatBeltRemindReq_oVCU_01_oATOM_HWLIN1_980b8460_Tx: ComSignalType=UINT8
        VCU_BCM_FRSeatBeltRemindReq_oVCU_01_oATOM_HWLIN1_ce21434a_Tx: ComSignalType=UINT8
        VCU_BCM_RLSeatBeltRemindReq_oVCU_01_oATOM_HWLIN1_bc6dc441_Tx: ComSignalType=UINT8
        VCU_BCM_RRSeatBeltRemindReq_oVCU_01_oATOM_HWLIN1_ea47036b_Tx: ComSignalType=UINT8
        VCU_CGW_VehicleState_oVCU_01_oATOM_HWLIN1_77400d2e_Tx: ComSignalType=UINT8
        VCU_DCDCFail_LIN_oVCU_01_oATOM_HWLIN1_0c50ae50_Tx: ComSignalType=BOOLEAN
        VCU_DCM_FL_DoorFLSts_oVCU_01_oATOM_HWLIN1_c9cb9c36_Tx: ComSignalType=BOOLEAN
        VCU_DCM_FR_DoorFRSts_oVCU_01_oATOM_HWLIN1_610e09cb_Tx: ComSignalType=BOOLEAN
        VCU_DCM_RL_DoorRLSts_oVCU_01_oATOM_HWLIN1_4b0c11ee_Tx: ComSignalType=BOOLEAN
        VCU_DCM_RR_DoorRRSts_oVCU_01_oATOM_HWLIN1_e3c98413_Tx: ComSignalType=BOOLEAN
        VCU_DriveMotOvrTemp_LIN_oVCU_01_oATOM_HWLIN1_65d20ded_Tx: ComSignalType=BOOLEAN
        VCU_HVBatCriFail_LIN_oVCU_01_oATOM_HWLIN1_2bf2157d_Tx: ComSignalType=UINT8
        VCU_HVBatOvrTemp_LIN_oVCU_01_oATOM_HWLIN1_7c76df3a_Tx: ComSignalType=BOOLEAN
        VCU_IBS_BrakeFluidWarning_oVCU_01_oATOM_HWLIN1_5bfbc2fa_Tx: ComSignalType=UINT8
        VCU_IBS_EBDFault_oVCU_01_oATOM_HWLIN1_7e339715_Tx: ComSignalType=BOOLEAN
        VCU_IBS_RollerbenchMode_oVCU_01_oATOM_HWLIN1_91a58216_Tx: ComSignalType=BOOLEAN
        VCU_IBS_SystemStatus_oVCU_01_oATOM_HWLIN1_7138be07_Tx: ComSignalType=UINT8
        VCU_IVI_BulbCheckSts_oVCU_01_oATOM_HWLIN1_d842011f_Tx: ComSignalType=BOOLEAN
        VCU_IVI_VrState_oVCU_01_oATOM_HWLIN1_eab73730_Tx: ComSignalType=BOOLEAN
  module config Rte
    34 x RteBswModuleInstance:
      Adc
      BswM
        BswM_MainFunctionTimingEvent0 (RteBswEventToTaskMapping): RteBswUsedOsEventRef=Rte_Ev_Cyclic2_Core0_Bsw_Task_0_10ms, RteBswUsedOsAlarmRef=Os/Rte_Al_TE2_Core0_Bsw_Task_0_10ms
      Can
        3 x RteBswEventToTaskMapping, all with RteBswUsedOsEventRef=Rte_Ev_Cyclic2_Core0_Bsw_Task_0_10ms, RteBswUsedOsAlarmRef=Os/Rte_Al_TE2_Core0_Bsw_Task_0_10ms:
          Can_MainFunction_BusOffTimingEvent0
          Can_MainFunction_ModeTimingEvent0
          Can_MainFunction_WakeupTimingEvent0
      CanIf
      CanNm
        CanNm_MainFunctionTimingEvent0 (RteBswEventToTaskMapping): RteBswUsedOsEventRef=Rte_Ev_Cyclic2_Core0_Bsw_Task_0_10ms, RteBswUsedOsAlarmRef=Os/Rte_Al_TE2_Core0_Bsw_Task_0_10ms
      CanSM
        CanSM_MainFunctionTimingEvent0 (RteBswEventToTaskMapping): RteBswUsedOsEventRef=Rte_Ev_Cyclic2_Core0_Bsw_Task_0_10ms, RteBswUsedOsAlarmRef=Os/Rte_Al_TE2_Core0_Bsw_Task_0_10ms
      CanTp
        CanTp_MainFunctionTimingEvent0 (RteBswEventToTaskMapping): RteBswUsedOsEventRef=Rte_Ev_Cyclic2_Core0_Bsw_Task_0_5ms, RteBswUsedOsAlarmRef=Os/Rte_Al_TE2_Core0_Bsw_Task_0_5ms
      CanTrcv
        CanTrcv_30_Tja1040_MainFunctionTimingEvent0 (RteBswEventToTaskMapping): RteBswUsedOsEventRef=Rte_Ev_Cyclic2_Core0_Bsw_Task_0_10ms, RteBswUsedOsAlarmRef=Os/Rte_Al_TE2_Core0_Bsw_Task_0_10ms
      Com
        Com_MainFunctionRx_ComMainFunctionRxTimingEvent0 (RteBswEventToTaskMapping): RteBswUsedOsEventRef=Rte_Ev_Cyclic2_Core0_Bsw_Task_0_10ms, RteBswUsedOsAlarmRef=Os/Rte_Al_TE2_Core0_Bsw_Task_0_10ms
        Com_MainFunctionTx_ComMainFunctionTxTimingEvent0 (RteBswEventToTaskMapping): RteBswUsedOsEventRef=Rte_Ev_Cyclic2_Core0_Bsw_Task_0_10ms, RteBswUsedOsAlarmRef=Os/Rte_Al_TE2_Core0_Bsw_Task_0_10ms
      ComM
        8 x RteBswEventToTaskMapping, all with RteBswUsedOsEventRef=Rte_Ev_Cyclic2_Core0_Bsw_Task_0_20ms, RteBswUsedOsAlarmRef=Os/Rte_Al_TE2_Core0_Bsw_Task_0_20ms:
          ComM_MainFunction_{0..7}TimingEvent0
      Dcm
        Dcm_MainFunctionTimingEvent0 (RteBswEventToTaskMapping): RteBswUsedOsEventRef=Rte_Ev_Cyclic2_Core0_Bsw_Task_0_10ms, RteBswUsedOsAlarmRef=Os/Rte_Al_TE2_Core0_Bsw_Task_0_10ms
      Dem
        Dem_MasterMainFunctionTimingEvent0 (RteBswEventToTaskMapping): RteBswUsedOsEventRef=Rte_Ev_Cyclic2_Core0_Bsw_Task_0_10ms, RteBswUsedOsAlarmRef=Os/Rte_Al_TE2_Core0_Bsw_Task_0_10ms
        Dem_SatelliteMainFunctionTimingEvent0 (RteBswEventToTaskMapping): RteBswUsedOsEventRef=Rte_Ev_Cyclic2_Core0_Bsw_Task_0_10ms, RteBswUsedOsAlarmRef=Os/Rte_Al_TE2_Core0_Bsw_Task_0_10ms
      Det
      Dio
      Dma
      EcuM
        3 x RteBswEventToTaskMapping:
          EcuM_MainFunctionTimingEvent0: RteBswUsedOsEventRef=Rte_Ev_Cyclic2_Core0_Bsw_Task_0_10ms, RteBswUsedOsAlarmRef=Os/Rte_Al_TE2_Core0_Bsw_Task_0_10ms
          EcuM_MainFunctionTimingEvent1: RteBswUsedOsEventRef=Rte_Ev_RunS2_EcuM_EcuM_MainFunction, RteBswUsedOsAlarmRef=Os/Rte_Al_TE2_EcuM_EcuM_MainFunction
          EcuM_MainFunctionTimingEvent2: RteBswUsedOsAlarmRef=Os/Rte_Al_TE3_EcuM_EcuM_MainFunction
      Fee
        Fee_MainFunctionTimingEvent0 (RteBswEventToTaskMapping): RteBswUsedOsEventRef=Rte_Ev_Cyclic2_Core0_Bsw_Task_0_10ms, RteBswUsedOsAlarmRef=Os/Rte_Al_TE2_Core0_Bsw_Task_0_10ms
      Fls
        Fls_17_Dmu_MainFunctionTimingEvent0 (RteBswEventToTaskMapping): RteBswUsedOsEventRef=Rte_Ev_Cyclic2_Core0_Bsw_Task_0_10ms, RteBswUsedOsAlarmRef=Os/Rte_Al_TE2_Core0_Bsw_Task_0_10ms
      Icu
      IoHwAb
      Irq
      J1939Tp
        J1939Tp_MainFunctionTimingEvent0 (RteBswEventToTaskMapping): RteBswUsedOsEventRef=Rte_Ev_Cyclic2_Core0_Bsw_Task_0_10ms, RteBswUsedOsAlarmRef=Os/Rte_Al_TE2_Core0_Bsw_Task_0_10ms
      LinIf
        LinIf_MainFunctionTimingEvent0 (RteBswEventToTaskMapping): RteBswUsedOsEventRef=Rte_Ev_Cyclic2_Core0_Bsw_Task_0_5ms, RteBswUsedOsAlarmRef=Os/Rte_Al_TE2_Core0_Bsw_Task_0_5ms
      LinSM
        LinSM_MainFunctionTimingEvent0 (RteBswEventToTaskMapping): RteBswUsedOsEventRef=Rte_Ev_Cyclic2_Core0_Bsw_Task_0_10ms, RteBswUsedOsAlarmRef=Os/Rte_Al_TE2_Core0_Bsw_Task_0_10ms
      LinTrcv
      McalLib
      Mcu
      Nm
      NvM
        NvM_MainFunctionTimingEvent0 (RteBswEventToTaskMapping): RteBswUsedOsEventRef=Rte_Ev_Cyclic2_Core0_Bsw_Task_0_10ms, RteBswUsedOsAlarmRef=Os/Rte_Al_TE2_Core0_Bsw_Task_0_10ms
      PduR
      Port
      Pwm
      Spi
        Spi_MainFunction_HandlingTimingEvent0 (RteBswEventToTaskMapping): RteBswUsedOsEventRef=Rte_Ev_Cyclic2_Core0_Bsw_Task_0_5ms, RteBswUsedOsAlarmRef=Os/Rte_Al_TE2_Core0_Bsw_Task_0_5ms
      Xcp
        CanXcp_MainFunctionTimingEvent0 (RteBswEventToTaskMapping): RteBswUsedOsEventRef=Rte_Ev_Cyclic2_Core0_Bsw_Task_0_5ms, RteBswUsedOsAlarmRef=Os/Rte_Al_TE2_Core0_Bsw_Task_0_5ms
        Xcp_MainFunctionTimingEvent0 (RteBswEventToTaskMapping): RteBswUsedOsEventRef=Rte_Ev_Cyclic2_Core0_Bsw_Task_0_5ms, RteBswUsedOsAlarmRef=Os/Rte_Al_TE2_Core0_Bsw_Task_0_5ms
    71 x RteSwComponentInstance:
      BswM_EcuSwComposition
        Timer_BswM_MainFunction (RteEventToTaskMapping): RteUsedOsEventRef=Rte_Ev_Cyclic2_Core0_Bsw_Task_0_10ms, RteUsedOsAlarmRef=Os/Rte_Al_TE2_Core0_Bsw_Task_0_10ms
      ComM_EcuSwComposition
        8 x RteEventToTaskMapping, all with RteUsedOsEventRef=Rte_Ev_Cyclic2_Core0_Bsw_Task_0_20ms, RteUsedOsAlarmRef=Os/Rte_Al_TE2_Core0_Bsw_Task_0_20ms:
          Timer_ComM_MainFunction_{0..7}
      Core1App_SWC_EcuSwComposition
        TMT_Core1App_SWC_Runnable_10ms (RteEventToTaskMapping): RteUsedOsEventRef=Rte_Ev_Cyclic_Core1_Asw_Task_Qm_0_10ms, RteUsedOsAlarmRef=Os/Rte_Al_TE_Core1_Asw_Task_Qm_0_10ms
      Core2App_SWC_EcuSwComposition
        TMT_Core2App_SWC_Runnable_10ms (RteEventToTaskMapping): RteUsedOsAlarmRef=Os/Rte_Al_TE_Core2App_SWC_Core2App_SWC_Runnable_10ms
      CtAp_ACParMgmt_EcuSwComposition
        TMT_R_ACParMgmt_Cyclic_50ms (RteEventToTaskMapping): RteUsedOsEventRef=Rte_Ev_Cyclic_Core1_Asw_Task_Qm_0_50ms, RteUsedOsAlarmRef=Os/Rte_Al_TE_Core1_Asw_Task_Qm_0_50ms
      CtAp_AccCal_EcuSwComposition
        TMT_R_AccCal_Cyclic_10ms (RteEventToTaskMapping): RteUsedOsEventRef=Rte_Ev_Cyclic_Core1_Asw_Task_Qm_0_10ms, RteUsedOsAlarmRef=Os/Rte_Al_TE_Core1_Asw_Task_Qm_0_10ms
      CtAp_AccrPedlDrv_EcuSwComposition
        TMT_R_AccrPedlDrv_Cyclic_10ms (RteEventToTaskMapping): RteUsedOsEventRef=Rte_Ev_Cyclic_Core1_Asw_Task_Qm_0_10ms, RteUsedOsAlarmRef=Os/Rte_Al_TE_Core1_Asw_Task_Qm_0_10ms
      CtAp_BMSMgmt_EcuSwComposition
        TMT_R_BMSMgmt_Cyclic_20ms (RteEventToTaskMapping): RteUsedOsEventRef=Rte_Ev_Cyclic_Core1_Asw_Task_Qm_0_20ms, RteUsedOsAlarmRef=Os/Rte_Al_TE_Core1_Asw_Task_Qm_0_20ms
      CtAp_BrkMgmt_EcuSwComposition
        TMT_R_BrkMgmt_Cyclic_10ms (RteEventToTaskMapping): RteUsedOsEventRef=Rte_Ev_Cyclic_Core1_Asw_Task_Qm_0_10ms, RteUsedOsAlarmRef=Os/Rte_Al_TE_Core1_Asw_Task_Qm_0_10ms
      CtAp_CANHandler_EcuSwComposition
        12 x RteEventToTaskMapping:
          TMT_R_CANHandler_Cyclic_1000ms: RteUsedOsEventRef=Rte_Ev_Run_CtAp_CANHandler_R_CANHandlerInput_Cyclic_1000ms, RteUsedOsAlarmRef=Os/Rte_Al_TE_CtAp_CANHandler_R_CANHandlerInput_Cyclic_1000ms
          TMT_R_CANHandler_Cyclic_100ms: RteUsedOsEventRef=Rte_Ev_Cyclic_Core1_Asw_Task_Qm_0_100ms, RteUsedOsAlarmRef=Os/Rte_Al_TE_Core1_Asw_Task_Qm_0_100ms
          TMT_R_CANHandler_Cyclic_10ms: RteUsedOsEventRef=Rte_Ev_Cyclic_Core1_Asw_Task_Qm_0_10ms, RteUsedOsAlarmRef=Os/Rte_Al_TE_Core1_Asw_Task_Qm_0_10ms
          TMT_R_CANHandler_Cyclic_200ms: RteUsedOsEventRef=Rte_Ev_Cyclic_Core1_Asw_Task_Qm_0_200ms, RteUsedOsAlarmRef=Os/Rte_Al_TE_Core1_Asw_Task_Qm_0_200ms
          TMT_R_CANHandler_Cyclic_20ms: RteUsedOsEventRef=Rte_Ev_Cyclic_Core1_Asw_Task_Qm_0_20ms, RteUsedOsAlarmRef=Os/Rte_Al_TE_Core1_Asw_Task_Qm_0_20ms
          TMT_R_CANHandler_Cyclic_500ms: RteUsedOsEventRef=Rte_Ev_Run_CtAp_CANHandler_R_CANHandlerInput_Cyclic_500ms, RteUsedOsAlarmRef=Os/Rte_Al_TE_CtAp_CANHandler_R_CANHandlerInput_Cyclic_500ms
          TMT_R_CANHandler_Cyclic_50ms: RteUsedOsEventRef=Rte_Ev_Cyclic_Core1_Asw_Task_Qm_0_50ms, RteUsedOsAlarmRef=Os/Rte_Al_TE_Core1_Asw_Task_Qm_0_50ms
          TMT_R_CANHandlerOutput_Cyclic_100ms: RteUsedOsEventRef=Rte_Ev_Cyclic_Core1_Asw_Task_Qm_0_100ms, RteUsedOsAlarmRef=Os/Rte_Al_TE_Core1_Asw_Task_Qm_0_100ms
          TMT_R_CANHandlerOutput_Cyclic_10ms: RteUsedOsEventRef=Rte_Ev_Cyclic_Core1_Asw_Task_Qm_0_10ms, RteUsedOsAlarmRef=Os/Rte_Al_TE_Core1_Asw_Task_Qm_0_10ms
          TMT_R_CANHandlerOutput_Cyclic_200ms: RteUsedOsEventRef=Rte_Ev_Cyclic_Core1_Asw_Task_Qm_0_200ms, RteUsedOsAlarmRef=Os/Rte_Al_TE_Core1_Asw_Task_Qm_0_200ms
          TMT_R_CANHandlerOutput_Cyclic_20ms: RteUsedOsEventRef=Rte_Ev_Cyclic_Core1_Asw_Task_Qm_0_20ms, RteUsedOsAlarmRef=Os/Rte_Al_TE_Core1_Asw_Task_Qm_0_20ms
          TMT_R_CANHandlerOutput_Cyclic_50ms: RteUsedOsEventRef=Rte_Ev_Cyclic_Core1_Asw_Task_Qm_0_50ms, RteUsedOsAlarmRef=Os/Rte_Al_TE_Core1_Asw_Task_Qm_0_50ms
      CtAp_ChrgComM_EcuSwComposition
        TMT_R_ChrgComM_Cyclic_50ms (RteEventToTaskMapping): RteUsedOsEventRef=Rte_Ev_Cyclic_Core1_Asw_Task_Qm_0_50ms, RteUsedOsAlarmRef=Os/Rte_Al_TE_Core1_Asw_Task_Qm_0_50ms
      CtAp_ChrgEgyCal_EcuSwComposition
        TMT_R_ChrgEgyCal_Cyclic_50ms (RteEventToTaskMapping): RteUsedOsEventRef=Rte_Ev_Cyclic_Core1_Asw_Task_Qm_0_50ms, RteUsedOsAlarmRef=Os/Rte_Al_TE_Core1_Asw_Task_Qm_0_50ms
      CtAp_ChrgMod_EcuSwComposition
        TMT_R_ChrgMod_Cyclic_50ms (RteEventToTaskMapping): RteUsedOsEventRef=Rte_Ev_Cyclic_Core1_Asw_Task_Qm_0_50ms, RteUsedOsAlarmRef=Os/Rte_Al_TE_Core1_Asw_Task_Qm_0_50ms
      CtAp_ChrgPreHeat_EcuSwComposition
        TMT_R_ChrgPreHeat_Cyclic_50ms (RteEventToTaskMapping): RteUsedOsEventRef=Rte_Ev_Cyclic_Core1_Asw_Task_Qm_0_50ms, RteUsedOsAlarmRef=Os/Rte_Al_TE_Core1_Asw_Task_Qm_0_50ms
      CtAp_ChrgSdl_EcuSwComposition
        TMT_R_ChrgSdl_Cyclic_50ms (RteEventToTaskMapping): RteUsedOsEventRef=Rte_Ev_Cyclic_Core1_Asw_Task_Qm_0_50ms, RteUsedOsAlarmRef=Os/Rte_Al_TE_Core1_Asw_Task_Qm_0_50ms
      CtAp_ChrgSeqCtrl_EcuSwComposition
        TMT_R_ChrgSeqCtrl_Cyclic_50ms (RteEventToTaskMapping): RteUsedOsEventRef=Rte_Ev_Cyclic_Core1_Asw_Task_Qm_0_50ms, RteUsedOsAlarmRef=Os/Rte_Al_TE_Core1_Asw_Task_Qm_0_50ms
      CtAp_ChrgStat_EcuSwComposition
        TMT_R_ChrgStat_Cyclic_50ms (RteEventToTaskMapping): RteUsedOsEventRef=Rte_Ev_Cyclic_Core1_Asw_Task_Qm_0_50ms, RteUsedOsAlarmRef=Os/Rte_Al_TE_Core1_Asw_Task_Qm_0_50ms
      CtAp_CnsCalcn_EcuSwComposition
        TMT_R_CnsCalcn_Cyclic_100ms (RteEventToTaskMapping): RteUsedOsEventRef=Rte_Ev_Cyclic_Core1_Asw_Task_Qm_0_100ms, RteUsedOsAlarmRef=Os/Rte_Al_TE_Core1_Asw_Task_Qm_0_100ms
      CtAp_CoastCtrl_EcuSwComposition
        TMT_R_CoastCtrl_Cyclic_10ms (RteEventToTaskMapping): RteUsedOsEventRef=Rte_Ev_Cyclic_Core1_Asw_Task_Qm_0_10ms, RteUsedOsAlarmRef=Os/Rte_Al_TE_Core1_Asw_Task_Qm_0_10ms
      CtAp_ComMErr_EcuSwComposition
        TMT_R_ComMErr_Cyclic_10ms (RteEventToTaskMapping): RteUsedOsEventRef=Rte_Ev_Cyclic_Core1_Asw_Task_Qm_0_10ms, RteUsedOsAlarmRef=Os/Rte_Al_TE_Core1_Asw_Task_Qm_0_10ms
      CtAp_CrpCtrl_EcuSwComposition
        TMT_R_CrpCtrl_Cyclic_10ms (RteEventToTaskMapping): RteUsedOsEventRef=Rte_Ev_Cyclic_Core1_Asw_Task_Qm_0_10ms, RteUsedOsAlarmRef=Os/Rte_Al_TE_Core1_Asw_Task_Qm_0_10ms
      CtAp_DCComM_EcuSwComposition
        TMT_R_DCComM_Cyclic_10ms (RteEventToTaskMapping): RteUsedOsEventRef=Rte_Ev_Cyclic_Core1_Asw_Task_Qm_0_10ms, RteUsedOsAlarmRef=Os/Rte_Al_TE_Core1_Asw_Task_Qm_0_10ms
      CtAp_DCDCMgmt_EcuSwComposition
        TMT_R_DCDCMgmt_Cyclic_20ms (RteEventToTaskMapping): RteUsedOsEventRef=Rte_Ev_Cyclic_Core1_Asw_Task_Qm_0_20ms, RteUsedOsAlarmRef=Os/Rte_Al_TE_Core1_Asw_Task_Qm_0_20ms
      CtAp_DCFCMgmt_EcuSwComposition
        TMT_R_DCFCMgmt_Cyclic_20ms (RteEventToTaskMapping): RteUsedOsEventRef=Rte_Ev_Cyclic_Core1_Asw_Task_Qm_0_20ms, RteUsedOsAlarmRef=Os/Rte_Al_TE_Core1_Asw_Task_Qm_0_20ms
      CtAp_DCParMgmt_EcuSwComposition
        TMT_R_DCParMgmt_Cyclic_50ms (RteEventToTaskMapping): RteUsedOsEventRef=Rte_Ev_Cyclic_Core1_Asw_Task_Qm_0_50ms, RteUsedOsAlarmRef=Os/Rte_Al_TE_Core1_Asw_Task_Qm_0_50ms
      CtAp_DrvAsscCtrl_EcuSwComposition
        TMT_R_DrvAsscCtrl_Cyclic_10ms (RteEventToTaskMapping): RteUsedOsEventRef=Rte_Ev_Cyclic_Core1_Asw_Task_Qm_0_10ms, RteUsedOsAlarmRef=Os/Rte_Al_TE_Core1_Asw_Task_Qm_0_10ms
      CtAp_DrvMod_EcuSwComposition
        TMT_R_DrvMod_Cyclic_20ms (RteEventToTaskMapping): RteUsedOsEventRef=Rte_Ev_Cyclic_Core1_Bsw_Task_0_20ms, RteUsedOsAlarmRef=Os/Rte_Al_TE_Core1_Bsw_Task_0_20ms
      CtAp_DrvTorqCoor_EcuSwComposition
        TMT_R_DrvTorqCoor_Cyclic_10ms (RteEventToTaskMapping): RteUsedOsEventRef=Rte_Ev_Cyclic_Core1_Bsw_Task_0_10ms, RteUsedOsAlarmRef=Os/Rte_Al_TE_Core1_Bsw_Task_0_10ms
      CtAp_ElSSDiag_EcuSwComposition
        TMT_R_ElSSDiag_Cyclic_20ms (RteEventToTaskMapping): RteUsedOsEventRef=Rte_Ev_Cyclic_Core1_Bsw_Task_0_20ms, RteUsedOsAlarmRef=Os/Rte_Al_TE_Core1_Bsw_Task_0_20ms
      CtAp_EmMgmt_EcuSwComposition
        TMT_R_EmMgmt_Cyclic_50ms (RteEventToTaskMapping): RteUsedOsEventRef=Rte_Ev_Cyclic_Core1_Bsw_Task_0_50ms, RteUsedOsAlarmRef=Os/Rte_Al_TE_Core1_Bsw_Task_0_50ms
      CtAp_FctSftyGear_EcuSwComposition
        TMT_R_FctSftyGear_Cyclic_20ms (RteEventToTaskMapping): RteUsedOsEventRef=Rte_Ev_Cyclic_Core1_Bsw_Task_0_20ms, RteUsedOsAlarmRef=Os/Rte_Al_TE_Core1_Bsw_Task_0_20ms
      CtAp_FctSftyTorq_EcuSwComposition
        TMT_R_FctSftyTorqMon_Cyclic_10ms (RteEventToTaskMapping): RteUsedOsEventRef=Rte_Ev_Cyclic_Core1_Bsw_Task_0_10ms, RteUsedOsAlarmRef=Os/Rte_Al_TE_Core1_Bsw_Task_0_10ms
      CtAp_FltReactn_EcuSwComposition
        TMT_R_FltReactn_Cyclic_10ms (RteEventToTaskMapping): RteUsedOsEventRef=Rte_Ev_Cyclic_Core1_Bsw_Task_0_10ms, RteUsedOsAlarmRef=Os/Rte_Al_TE_Core1_Bsw_Task_0_10ms
      CtAp_GearCal_EcuSwComposition
        TMT_R_GearCal_Cyclic_20ms (RteEventToTaskMapping): RteUsedOsEventRef=Rte_Ev_Cyclic_Core1_Bsw_Task_0_20ms, RteUsedOsAlarmRef=Os/Rte_Al_TE_Core1_Bsw_Task_0_20ms
      CtAp_HVSfty_EcuSwComposition
        TMT_R_HVSfty_Cyclic_10ms (RteEventToTaskMapping): RteUsedOsEventRef=Rte_Ev_Cyclic_Core1_Bsw_Task_0_10ms, RteUsedOsAlarmRef=Os/Rte_Al_TE_Core1_Bsw_Task_0_10ms
      CtAp_LINHandler_EcuSwComposition
        TMT_R_LINHandler_Cyclic_10ms (RteEventToTaskMapping): RteUsedOsEventRef=Rte_Ev_Cyclic_Core1_Bsw_Task_0_10ms, RteUsedOsAlarmRef=Os/Rte_Al_TE_Core1_Bsw_Task_0_10ms
      CtAp_LvBattMgmt_EcuSwComposition
        TMT_R_LvBattMgmt_Cyclic_20ms (RteEventToTaskMapping): RteUsedOsEventRef=Rte_Ev_Cyclic_Core1_Bsw_Task_0_20ms, RteUsedOsAlarmRef=Os/Rte_Al_TE_Core1_Bsw_Task_0_20ms
      CtAp_MCUMgmt_EcuSwComposition
        TMT_R_MCUMgmt_Cyclic_20ms (RteEventToTaskMapping): RteUsedOsEventRef=Rte_Ev_Cyclic_Core1_Bsw_Task_0_20ms, RteUsedOsAlarmRef=Os/Rte_Al_TE_Core1_Bsw_Task_0_20ms
      CtAp_OBCStsMgmt_EcuSwComposition
        TMT_R_OBCStsMgmt_Cyclic_50ms (RteEventToTaskMapping): RteUsedOsEventRef=Rte_Ev_Cyclic_Core1_Bsw_Task_0_50ms, RteUsedOsAlarmRef=Os/Rte_Al_TE_Core1_Bsw_Task_0_50ms
      CtAp_OnePedCtrl_EcuSwComposition
        TMT_R_OnePedlCtrl_Cyclic_10ms (RteEventToTaskMapping): RteUsedOsEventRef=Rte_Ev_Cyclic_Core1_Bsw_Task_0_10ms, RteUsedOsAlarmRef=Os/Rte_Al_TE_Core1_Bsw_Task_0_10ms
      CtAp_PdlAlys_EcuSwComposition
        TMT_R_PdlAlys_Cyclic_10ms (RteEventToTaskMapping): RteUsedOsEventRef=Rte_Ev_Cyclic_Core1_Bsw_Task_0_10ms, RteUsedOsAlarmRef=Os/Rte_Al_TE_Core1_Bsw_Task_0_10ms
      CtAp_PwrLim_EcuSwComposition
        TMT_R_PwrLim_Cyclic_100ms (RteEventToTaskMapping): RteUsedOsEventRef=Rte_Ev_Cyclic_Core1_Bsw_Task_0_100ms, RteUsedOsAlarmRef=Os/Rte_Al_TE_Core1_Bsw_Task_0_100ms
      CtAp_ResEst_EcuSwComposition
        TMT_R_ResEst_Cyclic_10ms (RteEventToTaskMapping): RteUsedOsEventRef=Rte_Ev_Cyclic_Core1_Bsw_Task_0_10ms, RteUsedOsAlarmRef=Os/Rte_Al_TE_Core1_Bsw_Task_0_10ms
      CtAp_RngEstimn_EcuSwComposition
        TMT_R_RngEstimn_Cyclic_100ms (RteEventToTaskMapping): RteUsedOsEventRef=Rte_Ev_Cyclic_Core1_Bsw_Task_0_100ms, RteUsedOsAlarmRef=Os/Rte_Al_TE_Core1_Bsw_Task_0_100ms
      CtAp_S2Mgmt_EcuSwComposition
        TMT_R_S2Mgmt_Cyclic_50ms (RteEventToTaskMapping): RteUsedOsEventRef=Rte_Ev_Cyclic_Core1_Bsw_Task_0_50ms, RteUsedOsAlarmRef=Os/Rte_Al_TE_Core1_Bsw_Task_0_50ms
      CtAp_SlopEst_EcuSwComposition
        TMT_R_SlopEst_Cyclic_10ms (RteEventToTaskMapping): RteUsedOsEventRef=Rte_Ev_Cyclic_Core1_Bsw_Task_0_10ms, RteUsedOsAlarmRef=Os/Rte_Al_TE_Core1_Bsw_Task_0_10ms
      CtAp_SpdLmt_EcuSwComposition
        TMT_R_SpdLmt_Cyclic_10ms (RteEventToTaskMapping): RteUsedOsEventRef=Rte_Ev_Cyclic_Core1_Bsw_Task_0_10ms, RteUsedOsAlarmRef=Os/Rte_Al_TE_Core1_Bsw_Task_0_10ms
      CtAp_TCUMgmt_EcuSwComposition
        TMT_R_TCUMgmt_Cyclic_20ms (RteEventToTaskMapping): RteUsedOsEventRef=Rte_Ev_Cyclic_Core1_Bsw_Task_0_20ms, RteUsedOsAlarmRef=Os/Rte_Al_TE_Core1_Bsw_Task_0_20ms
      CtAp_TorqCoor_EcuSwComposition
        TMT_R_TorqCoor_Cyclic_10ms (RteEventToTaskMapping): RteUsedOsEventRef=Rte_Ev_Cyclic_Core1_Bsw_Task_0_10ms, RteUsedOsAlarmRef=Os/Rte_Al_TE_Core1_Bsw_Task_0_10ms
      CtAp_TorqCrossZr_EcuSwComposition
        TMT_R_TorqCrossZr_Cyclic_10ms (RteEventToTaskMapping): RteUsedOsEventRef=Rte_Ev_Cyclic_Core1_Bsw_Task_0_10ms, RteUsedOsAlarmRef=Os/Rte_Al_TE_Core1_Bsw_Task_0_10ms
      CtAp_TorqDamp_EcuSwComposition
        TMT_R_TorqDamp_Cyclic_10ms (RteEventToTaskMapping): RteUsedOsEventRef=Rte_Ev_Cyclic_Core1_Bsw_Task_0_10ms, RteUsedOsAlarmRef=Os/Rte_Al_TE_Core1_Bsw_Task_0_10ms
      CtAp_TorqFil_EcuSwComposition
        TMT_R_TorqFil_Cyclic_10ms (RteEventToTaskMapping): RteUsedOsEventRef=Rte_Ev_Cyclic_Core1_Bsw_Task_0_10ms, RteUsedOsAlarmRef=Os/Rte_Al_TE_Core1_Bsw_Task_0_10ms
      CtAp_TorqLmt_EcuSwComposition
        TMT_R_TorqLmt_Cyclic_10ms (RteEventToTaskMapping): RteUsedOsEventRef=Rte_Ev_Cyclic_Core1_Bsw_Task_0_10ms, RteUsedOsAlarmRef=Os/Rte_Al_TE_Core1_Bsw_Task_0_10ms
      CtAp_TorqModMap_EcuSwComposition
        TMT_R_TorqModMap_Cyclic_10ms (RteEventToTaskMapping): RteUsedOsEventRef=Rte_Ev_Cyclic_Core1_Bsw_Task_0_10ms, RteUsedOsAlarmRef=Os/Rte_Al_TE_Core1_Bsw_Task_0_10ms
      CtAp_TrsmProtd_EcuSwComposition
        TMT_R_TrsmProtd_Cyclic_10ms (RteEventToTaskMapping): RteUsedOsEventRef=Rte_Ev_Cyclic_Core1_Bsw_Task_0_10ms, RteUsedOsAlarmRef=Os/Rte_Al_TE_Core1_Bsw_Task_0_10ms
      CtAp_VehSpd_EcuSwComposition
        TMT_R_VehSpd_Cyclic_10ms (RteEventToTaskMapping): RteUsedOsEventRef=Rte_Ev_Cyclic_Core1_Bsw_Task_0_10ms, RteUsedOsAlarmRef=Os/Rte_Al_TE_Core1_Bsw_Task_0_10ms
      CtAp_VehStabyCtrl_EcuSwComposition
        TMT_R_VehStabyCtrl_Cyclic_10ms (RteEventToTaskMapping): RteUsedOsEventRef=Rte_Ev_Cyclic_Core1_Bsw_Task_0_10ms, RteUsedOsAlarmRef=Os/Rte_Al_TE_Core1_Bsw_Task_0_10ms
      CtAp_VehStat_EcuSwComposition
        TMT_R_VehStat_Cyclic_20ms (RteEventToTaskMapping): RteUsedOsEventRef=Rte_Ev_Cyclic_Core1_Bsw_Task_0_20ms, RteUsedOsAlarmRef=Os/Rte_Al_TE_Core1_Bsw_Task_0_20ms
      CtAp_WakeUpRsn_EcuSwComposition
        TMT_R_WakeUpRsn_Cyclic_20ms (RteEventToTaskMapping): RteUsedOsEventRef=Rte_Ev_Cyclic_Core1_Bsw_Task_0_10ms, RteUsedOsAlarmRef=Os/Rte_Al_TE_Core1_Bsw_Task_0_10ms
      Dcm_EcuSwComposition
        Timer_Dcm_MainFunction (RteEventToTaskMapping): RteUsedOsEventRef=Rte_Ev_Cyclic2_Core0_Bsw_Task_0_10ms, RteUsedOsAlarmRef=Os/Rte_Al_TE2_Core0_Bsw_Task_0_10ms
      DemMaster_0_EcuSwComposition
        Timer_Dem_MasterMainFunction (RteEventToTaskMapping): RteUsedOsEventRef=Rte_Ev_Cyclic2_Core0_Bsw_Task_0_10ms, RteUsedOsAlarmRef=Os/Rte_Al_TE2_Core0_Bsw_Task_0_10ms
      DemSatellite_0_EcuSwComposition
        Timer_Dem_SatelliteMainFunction (RteEventToTaskMapping): RteUsedOsEventRef=Rte_Ev_Cyclic2_Core0_Bsw_Task_0_10ms, RteUsedOsAlarmRef=Os/Rte_Al_TE2_Core0_Bsw_Task_0_10ms
      Det_EcuSwComposition
      EcuM_EcuSwComposition
        Timer_EcuM_MainFunction (RteEventToTaskMapping): RteUsedOsEventRef=Rte_Ev_Cyclic2_Core0_Bsw_Task_0_10ms, RteUsedOsAlarmRef=Os/Rte_Al_TE2_Core0_Bsw_Task_0_10ms
      HookCallout_EcuSwComposition
      IoHwAb_EcuSwComposition
        Timer_IoHwAb_IoHwAbRunnable_10ms (RteEventToTaskMapping): RteUsedOsEventRef=Rte_Ev_Run_IoHwAb_IoHwAb_IoHwAbRunnable_10ms, RteUsedOsAlarmRef=Os/Rte_Al_TE_IoHwAb_IoHwAb_IoHwAbRunnable_10ms
        Timer_IoHwAb_IoHwAbRunnable_500ms (RteEventToTaskMapping): RteUsedOsAlarmRef=Os/Rte_Al_TE_IoHwAb_IoHwAb_IoHwAbRunnable_500ms
      IoHwAb_SWC_EcuSwComposition
        TMT_IoHwAb_SWC_Runnable_50ms (RteEventToTaskMapping): RteUsedOsEventRef=Rte_Ev_Run_IoHwAb_SWC_IoHwAb_SWC_Runnable_50ms, RteUsedOsAlarmRef=Os/Rte_Al_TE_IoHwAb_SWC_IoHwAb_SWC_Runnable_50ms
      NvM_EcuSwComposition
        Timer_NvM_MainFunction (RteEventToTaskMapping): RteUsedOsEventRef=Rte_Ev_Cyclic2_Core0_Bsw_Task_0_10ms, RteUsedOsAlarmRef=Os/Rte_Al_TE2_Core0_Bsw_Task_0_10ms
      Os_OsCore{0..2}_swc_EcuSwComposition
    RteOsInteraction
      20 x RteUsedOsActivation, all with RteExpectedActivationOffset=0:
        Rte_Al_TE_IoHwAb_IoHwAb_IoHwAbRunnable_500ms: RteActivationOsAlarmRef=Os/Rte_Al_TE_IoHwAb_IoHwAb_IoHwAbRunnable_500ms, RteActivationOsTaskRef=Core0_AswTask
        Rte_Al_TE2_Core0_Bsw_Task_0_10ms: RteActivationOsAlarmRef=Os/Rte_Al_TE2_Core0_Bsw_Task_0_10ms, RteActivationOsTaskRef=Core0_Bsw_Task
        Rte_Al_TE2_Core0_Bsw_Task_0_20ms: RteActivationOsAlarmRef=Os/Rte_Al_TE2_Core0_Bsw_Task_0_20ms, RteActivationOsTaskRef=Core0_Bsw_Task
        Rte_Al_TE2_Core0_Bsw_Task_0_5ms: RteActivationOsAlarmRef=Os/Rte_Al_TE2_Core0_Bsw_Task_0_5ms, RteActivationOsTaskRef=Core0_Bsw_Task
        Rte_Al_TE_IoHwAb_IoHwAb_IoHwAbRunnable_10ms: RteActivationOsAlarmRef=Os/Rte_Al_TE_IoHwAb_IoHwAb_IoHwAbRunnable_10ms, RteActivationOsTaskRef=Core0_CddTask
        Rte_Al_TE_IoHwAb_SWC_IoHwAb_SWC_Runnable_50ms: RteActivationOsAlarmRef=Os/Rte_Al_TE_IoHwAb_SWC_IoHwAb_SWC_Runnable_50ms, RteActivationOsTaskRef=Core0_CddTask
        Rte_Al_TE_Core1_Asw_Task_Qm_0_100ms: RteActivationOsAlarmRef=Os/Rte_Al_TE_Core1_Asw_Task_Qm_0_100ms, RteActivationOsTaskRef=Core1_Asw_Task_Qm
        Rte_Al_TE_Core1_Asw_Task_Qm_0_10ms: RteActivationOsAlarmRef=Os/Rte_Al_TE_Core1_Asw_Task_Qm_0_10ms, RteActivationOsTaskRef=Core1_Asw_Task_Qm
        Rte_Al_TE_Core1_Asw_Task_Qm_0_200ms: RteActivationOsAlarmRef=Os/Rte_Al_TE_Core1_Asw_Task_Qm_0_200ms, RteActivationOsTaskRef=Core1_Asw_Task_Qm
        Rte_Al_TE_Core1_Asw_Task_Qm_0_20ms: RteActivationOsAlarmRef=Os/Rte_Al_TE_Core1_Asw_Task_Qm_0_20ms, RteActivationOsTaskRef=Core1_Asw_Task_Qm
        Rte_Al_TE_Core1_Asw_Task_Qm_0_50ms: RteActivationOsAlarmRef=Os/Rte_Al_TE_Core1_Asw_Task_Qm_0_50ms, RteActivationOsTaskRef=Core1_Asw_Task_Qm
        Rte_Al_TE_CtAp_CANHandler_R_CANHandlerInput_Cyclic_1000ms: RteActivationOsAlarmRef=Os/Rte_Al_TE_CtAp_CANHandler_R_CANHandlerInput_Cyclic_1000ms, RteActivationOsTaskRef=Core1_Asw_Task_Qm
        Rte_Al_TE_CtAp_CANHandler_R_CANHandlerInput_Cyclic_500ms: RteActivationOsAlarmRef=Os/Rte_Al_TE_CtAp_CANHandler_R_CANHandlerInput_Cyclic_500ms, RteActivationOsTaskRef=Core1_Asw_Task_Qm
        Rte_Al_TE2_EcuM_EcuM_MainFunction: RteActivationOsAlarmRef=Os/Rte_Al_TE2_EcuM_EcuM_MainFunction, RteActivationOsTaskRef=Core1_Bsw_Task
        Rte_Al_TE_Core1_Bsw_Task_0_100ms: RteActivationOsAlarmRef=Os/Rte_Al_TE_Core1_Bsw_Task_0_100ms, RteActivationOsTaskRef=Core1_Bsw_Task
        Rte_Al_TE_Core1_Bsw_Task_0_10ms: RteActivationOsAlarmRef=Os/Rte_Al_TE_Core1_Bsw_Task_0_10ms, RteActivationOsTaskRef=Core1_Bsw_Task
        Rte_Al_TE_Core1_Bsw_Task_0_20ms: RteActivationOsAlarmRef=Os/Rte_Al_TE_Core1_Bsw_Task_0_20ms, RteActivationOsTaskRef=Core1_Bsw_Task
        Rte_Al_TE_Core1_Bsw_Task_0_50ms: RteActivationOsAlarmRef=Os/Rte_Al_TE_Core1_Bsw_Task_0_50ms, RteActivationOsTaskRef=Core1_Bsw_Task
        Rte_Al_TE_Core2App_SWC_Core2App_SWC_Runnable_10ms: RteActivationOsAlarmRef=Os/Rte_Al_TE_Core2App_SWC_Core2App_SWC_Runnable_10ms, RteActivationOsTaskRef=Core2_Asw_Task
        Rte_Al_TE3_EcuM_EcuM_MainFunction: RteActivationOsAlarmRef=Os/Rte_Al_TE3_EcuM_EcuM_MainFunction, RteActivationOsTaskRef=Core2_Bsw_Task
  module config NvM
  module config Os
    Core0_AswTask (OsTask): OsTaskActivation=1, OsTaskPriority=64, OsTaskSchedule=FULL
    Rte_Al_TE_IoHwAb_IoHwAb_IoHwAbRunnable_500ms (OsAlarm): OsAlarmCounterRef=SystemTimer_Core0
      OsAlarmAction
        OsAlarmActivateTask: OsAlarmActivateTaskRef=Core0_AswTask
    Core0_Bsw_Task (OsTask):
      OsTaskActivation = 1
      OsTaskPriority = 65
      OsTaskSchedule = FULL
      OsTaskEventRef = Rte_Ev_Cyclic2_Core0_Bsw_Task_0_10ms
      OsTaskEventRef = Rte_Ev_Cyclic2_Core0_Bsw_Task_0_20ms
      OsTaskEventRef = Rte_Ev_Cyclic2_Core0_Bsw_Task_0_5ms
    3 x OsAlarm, all with OsAlarmCounterRef=SystemTimer_Core0:
      Rte_Al_TE2_Core0_Bsw_Task_0_10ms
        OsAlarmAction
          OsAlarmSetEvent: OsAlarmSetEventRef=Rte_Ev_Cyclic2_Core0_Bsw_Task_0_10ms, OsAlarmSetEventTaskRef=Core0_Bsw_Task
      Rte_Al_TE2_Core0_Bsw_Task_0_20ms
        OsAlarmAction
          OsAlarmSetEvent: OsAlarmSetEventRef=Rte_Ev_Cyclic2_Core0_Bsw_Task_0_20ms, OsAlarmSetEventTaskRef=Core0_Bsw_Task
      Rte_Al_TE2_Core0_Bsw_Task_0_5ms
        OsAlarmAction
          OsAlarmSetEvent: OsAlarmSetEventRef=Rte_Ev_Cyclic2_Core0_Bsw_Task_0_5ms, OsAlarmSetEventTaskRef=Core0_Bsw_Task
    Core0_CddTask (OsTask):
      OsTaskActivation = 1
      OsTaskPriority = 60
      OsTaskSchedule = FULL
      OsTaskEventRef = Rte_Ev_Run_IoHwAb_IoHwAb_IoHwAbRunnable_10ms
      OsTaskEventRef = Rte_Ev_Run_IoHwAb_SWC_IoHwAb_SWC_Runnable_50ms
    Rte_Al_TE_IoHwAb_IoHwAb_IoHwAbRunnable_10ms (OsAlarm): OsAlarmCounterRef=SystemTimer_Core0
      OsAlarmAction
        OsAlarmSetEvent: OsAlarmSetEventRef=Rte_Ev_Run_IoHwAb_IoHwAb_IoHwAbRunnable_10ms, OsAlarmSetEventTaskRef=Core0_CddTask
    Rte_Al_TE_IoHwAb_SWC_IoHwAb_SWC_Runnable_50ms (OsAlarm): OsAlarmCounterRef=SystemTimer_Core0
      OsAlarmAction
        OsAlarmSetEvent: OsAlarmSetEventRef=Rte_Ev_Run_IoHwAb_SWC_IoHwAb_SWC_Runnable_50ms, OsAlarmSetEventTaskRef=Core0_CddTask
    Core1_Asw_Init (OsTask): OsTaskActivation=1, OsTaskPriority=40, OsTaskSchedule=FULL
    Core1_Asw_Task_Qm (OsTask):
      OsTaskActivation = 1
      OsTaskPriority = 41
      OsTaskSchedule = FULL
      OsTaskEventRef = Rte_Ev_Cyclic_Core1_Asw_Task_Qm_0_100ms
      OsTaskEventRef = Rte_Ev_Cyclic_Core1_Asw_Task_Qm_0_10ms
      OsTaskEventRef = Rte_Ev_Cyclic_Core1_Asw_Task_Qm_0_200ms
      OsTaskEventRef = Rte_Ev_Cyclic_Core1_Asw_Task_Qm_0_20ms
      OsTaskEventRef = Rte_Ev_Cyclic_Core1_Asw_Task_Qm_0_50ms
      OsTaskEventRef = Rte_Ev_Run_CtAp_CANHandler_R_CANHandlerInput_Cyclic_1000ms
      OsTaskEventRef = Rte_Ev_Run_CtAp_CANHandler_R_CANHandlerInput_Cyclic_500ms
    7 x OsAlarm, all with OsAlarmCounterRef=SystemTimer_Core1, OsAlarmAccessingApplication=SystemApplication_OsCore0:
      Rte_Al_TE_Core1_Asw_Task_Qm_0_100ms
        OsAlarmAction
          OsAlarmSetEvent: OsAlarmSetEventRef=Rte_Ev_Cyclic_Core1_Asw_Task_Qm_0_100ms, OsAlarmSetEventTaskRef=Core1_Asw_Task_Qm
      Rte_Al_TE_Core1_Asw_Task_Qm_0_10ms
        OsAlarmAction
          OsAlarmSetEvent: OsAlarmSetEventRef=Rte_Ev_Cyclic_Core1_Asw_Task_Qm_0_10ms, OsAlarmSetEventTaskRef=Core1_Asw_Task_Qm
      Rte_Al_TE_Core1_Asw_Task_Qm_0_200ms
        OsAlarmAction
          OsAlarmSetEvent: OsAlarmSetEventRef=Rte_Ev_Cyclic_Core1_Asw_Task_Qm_0_200ms, OsAlarmSetEventTaskRef=Core1_Asw_Task_Qm
      Rte_Al_TE_Core1_Asw_Task_Qm_0_20ms
        OsAlarmAction
          OsAlarmSetEvent: OsAlarmSetEventRef=Rte_Ev_Cyclic_Core1_Asw_Task_Qm_0_20ms, OsAlarmSetEventTaskRef=Core1_Asw_Task_Qm
      Rte_Al_TE_Core1_Asw_Task_Qm_0_50ms
        OsAlarmAction
          OsAlarmSetEvent: OsAlarmSetEventRef=Rte_Ev_Cyclic_Core1_Asw_Task_Qm_0_50ms, OsAlarmSetEventTaskRef=Core1_Asw_Task_Qm
      Rte_Al_TE_CtAp_CANHandler_R_CANHandlerInput_Cyclic_1000ms
        OsAlarmAction
          OsAlarmSetEvent: OsAlarmSetEventRef=Rte_Ev_Run_CtAp_CANHandler_R_CANHandlerInput_Cyclic_1000ms, OsAlarmSetEventTaskRef=Core1_Asw_Task_Qm
      Rte_Al_TE_CtAp_CANHandler_R_CANHandlerInput_Cyclic_500ms
        OsAlarmAction
          OsAlarmSetEvent: OsAlarmSetEventRef=Rte_Ev_Run_CtAp_CANHandler_R_CANHandlerInput_Cyclic_500ms, OsAlarmSetEventTaskRef=Core1_Asw_Task_Qm
    Core1_Bsw_Task (OsTask):
      OsTaskActivation = 1
      OsTaskPriority = 42
      OsTaskSchedule = FULL
      OsTaskEventRef = Rte_Ev_Cyclic_Core1_Bsw_Task_0_100ms
      OsTaskEventRef = Rte_Ev_Cyclic_Core1_Bsw_Task_0_10ms
      OsTaskEventRef = Rte_Ev_Cyclic_Core1_Bsw_Task_0_20ms
      OsTaskEventRef = Rte_Ev_Cyclic_Core1_Bsw_Task_0_50ms
      OsTaskEventRef = Rte_Ev_RunS2_EcuM_EcuM_MainFunction
    5 x OsAlarm, all with OsAlarmCounterRef=SystemTimer_Core1:
      Rte_Al_TE2_EcuM_EcuM_MainFunction
        OsAlarmAction
          OsAlarmSetEvent: OsAlarmSetEventRef=Rte_Ev_RunS2_EcuM_EcuM_MainFunction, OsAlarmSetEventTaskRef=Core1_Bsw_Task
      Rte_Al_TE_Core1_Bsw_Task_0_100ms: OsAlarmAccessingApplication=SystemApplication_OsCore0
        OsAlarmAction
          OsAlarmSetEvent: OsAlarmSetEventRef=Rte_Ev_Cyclic_Core1_Bsw_Task_0_100ms, OsAlarmSetEventTaskRef=Core1_Bsw_Task
      Rte_Al_TE_Core1_Bsw_Task_0_10ms: OsAlarmAccessingApplication=SystemApplication_OsCore0
        OsAlarmAction
          OsAlarmSetEvent: OsAlarmSetEventRef=Rte_Ev_Cyclic_Core1_Bsw_Task_0_10ms, OsAlarmSetEventTaskRef=Core1_Bsw_Task
      Rte_Al_TE_Core1_Bsw_Task_0_20ms: OsAlarmAccessingApplication=SystemApplication_OsCore0
        OsAlarmAction
          OsAlarmSetEvent: OsAlarmSetEventRef=Rte_Ev_Cyclic_Core1_Bsw_Task_0_20ms, OsAlarmSetEventTaskRef=Core1_Bsw_Task
      Rte_Al_TE_Core1_Bsw_Task_0_50ms: OsAlarmAccessingApplication=SystemApplication_OsCore0
        OsAlarmAction
          OsAlarmSetEvent: OsAlarmSetEventRef=Rte_Ev_Cyclic_Core1_Bsw_Task_0_50ms, OsAlarmSetEventTaskRef=Core1_Bsw_Task
    Core2_Asw_Init (OsTask): OsTaskActivation=1, OsTaskPriority=0, OsTaskSchedule=FULL
    Core2_Asw_Task (OsTask): OsTaskActivation=1, OsTaskPriority=0, OsTaskSchedule=FULL
    Rte_Al_TE_Core2App_SWC_Core2App_SWC_Runnable_10ms (OsAlarm): OsAlarmCounterRef=SystemTimer_Core2, OsAlarmAccessingApplication=SystemApplication_OsCore0
      OsAlarmAction
        OsAlarmActivateTask: OsAlarmActivateTaskRef=Core2_Asw_Task
    Core2_Bsw_Task (OsTask): OsTaskActivation=1, OsTaskPriority=0, OsTaskSchedule=FULL
    Rte_Al_TE3_EcuM_EcuM_MainFunction (OsAlarm): OsAlarmCounterRef=SystemTimer_Core2
      OsAlarmAction
        OsAlarmActivateTask: OsAlarmActivateTaskRef=Core2_Bsw_Task
    17 x OsEvent:
      Rte_Ev_Cyclic2_Core0_Bsw_Task_0_10ms
      Rte_Ev_Cyclic2_Core0_Bsw_Task_0_20ms
      Rte_Ev_Cyclic2_Core0_Bsw_Task_0_5ms
      Rte_Ev_Cyclic_Core1_Asw_Task_Qm_0_100ms
      Rte_Ev_Cyclic_Core1_Asw_Task_Qm_0_10ms
      Rte_Ev_Cyclic_Core1_Asw_Task_Qm_0_200ms
      Rte_Ev_Cyclic_Core1_Asw_Task_Qm_0_20ms
      Rte_Ev_Cyclic_Core1_Asw_Task_Qm_0_50ms
      Rte_Ev_Cyclic_Core1_Bsw_Task_0_100ms
      Rte_Ev_Cyclic_Core1_Bsw_Task_0_10ms
      Rte_Ev_Cyclic_Core1_Bsw_Task_0_20ms
      Rte_Ev_Cyclic_Core1_Bsw_Task_0_50ms
      Rte_Ev_RunS2_EcuM_EcuM_MainFunction
      Rte_Ev_Run_CtAp_CANHandler_R_CANHandlerInput_Cyclic_1000ms
      Rte_Ev_Run_CtAp_CANHandler_R_CANHandlerInput_Cyclic_500ms
      Rte_Ev_Run_IoHwAb_IoHwAb_IoHwAbRunnable_10ms
      Rte_Ev_Run_IoHwAb_SWC_IoHwAb_SWC_Runnable_50ms
    3 x OsApplication, all with OsTrusted=true:
      SystemApplication_OsCore0: OsAppTaskRef=Core0_AswTask, OsAppAlarmRef=Os/Rte_Al_TE_IoHwAb_IoHwAb_IoHwAbRunnable_500ms, OsAppTaskRef=Core0_Bsw_Task, OsAppAlarmRef=Os/Rte_Al_TE2_Core0_Bsw_Task_0_10ms, OsAppAlarmRef=Os/Rte_Al_TE2_Core0_Bsw_Task_0_20ms, OsAppAlarmRef=Os/Rte_Al_TE2_Core0_Bsw_Task_0_5ms, OsAppTaskRef=Core0_CddTask, OsAppAlarmRef=Os/Rte_Al_TE_IoHwAb_IoHwAb_IoHwAbRunnable_10ms, OsAppAlarmRef=Os/Rte_Al_TE_IoHwAb_SWC_IoHwAb_SWC_Runnable_50ms
      SystemApplication_OsCore1: OsAppTaskRef=Core1_Asw_Init, OsAppTaskRef=Core1_Asw_Task_Qm, OsAppAlarmRef=Os/Rte_Al_TE_Core1_Asw_Task_Qm_0_100ms, OsAppAlarmRef=Os/Rte_Al_TE_Core1_Asw_Task_Qm_0_10ms, OsAppAlarmRef=Os/Rte_Al_TE_Core1_Asw_Task_Qm_0_200ms, OsAppAlarmRef=Os/Rte_Al_TE_Core1_Asw_Task_Qm_0_20ms, OsAppAlarmRef=Os/Rte_Al_TE_Core1_Asw_Task_Qm_0_50ms, OsAppAlarmRef=Os/Rte_Al_TE_CtAp_CANHandler_R_CANHandlerInput_Cyclic_1000ms, OsAppAlarmRef=Os/Rte_Al_TE_CtAp_CANHandler_R_CANHandlerInput_Cyclic_500ms, OsAppTaskRef=Core1_Bsw_Task, OsAppAlarmRef=Os/Rte_Al_TE2_EcuM_EcuM_MainFunction, OsAppAlarmRef=Os/Rte_Al_TE_Core1_Bsw_Task_0_100ms, OsAppAlarmRef=Os/Rte_Al_TE_Core1_Bsw_Task_0_10ms, OsAppAlarmRef=Os/Rte_Al_TE_Core1_Bsw_Task_0_20ms, OsAppAlarmRef=Os/Rte_Al_TE_Core1_Bsw_Task_0_50ms
      SystemApplication_OsCore2: OsAppTaskRef=Core2_Asw_Init, OsAppTaskRef=Core2_Asw_Task, OsAppAlarmRef=Os/Rte_Al_TE_Core2App_SWC_Core2App_SWC_Runnable_10ms, OsAppTaskRef=Core2_Bsw_Task, OsAppAlarmRef=Os/Rte_Al_TE3_EcuM_EcuM_MainFunction
    212 x OsSpinlock, all with OsSpinlockLockMethod=LOCK_CAT2_INTERRUPTS, OsSpinlockAccessingApplication=SystemApplication_OsCore0, OsSpinlockAccessingApplication=SystemApplication_OsCore1:
      Rte_Spinlock_BCL_ChargeMode_oBCL_oJ1939_bms_2f4f0f62_Tx
      Rte_Spinlock_BCL_CurrentRequire_oBCL_oJ1939_bms_d7664f08_Tx
      Rte_Spinlock_BCL_VolltageRequire_oBCL_oJ1939_bms_425ed7b1_Tx
      Rte_Spinlock_BCP_AllowChargeVoltageMax_oBCP_oJ1939_bms_fc3dfe75_Tx
      Rte_Spinlock_BCP_AllowTempMax_oBCP_oJ1939_bms_3d5b24f4_Tx
      Rte_Spinlock_BCP_BatteryChargeVoltageMax_oBCP_oJ1939_bms_5d02e2aa_Tx
      Rte_Spinlock_BCP_BatteryNominalEnergy_oBCP_oJ1939_bms_7dc98c8b_Tx
      Rte_Spinlock_BCP_BatteryTotalVoltage_oBCP_oJ1939_bms_19a0567e_Tx
      Rte_Spinlock_BCP_ChargeCurrentMax_oBCP_oJ1939_bms_7cdaf0d4_Tx
      Rte_Spinlock_BCP_SOC_oBCP_oJ1939_bms_78e6b083_Tx
      Rte_Spinlock_BCS_BatteryVoltMaxGroup_oBCS_oJ1939_bms_196f50c9_Tx
      Rte_Spinlock_BCS_BatteryVoltMax_oBCS_oJ1939_bms_11a53a15_Tx
      Rte_Spinlock_BCS_ChargeCurrentMeasure_oBCS_oJ1939_bms_0ae65560_Tx
      Rte_Spinlock_BCS_ChargeVoltageMeasure_oBCS_oJ1939_bms_abbd1969_Tx
      Rte_Spinlock_BCS_EstimatedTimeRemaining_oBCS_oJ1939_bms_c6383d22_Tx
      Rte_Spinlock_BCS_SOC_oBCS_oJ1939_bms_7466e090_Tx
      Rte_Spinlock_BEM_ChargeAbortTimeout_oBEM_oJ1939_bms_4849b46c_Tx
      Rte_Spinlock_BEM_ChargeFinishTimeout_oBEM_oJ1939_bms_2d8e7a9e_Tx
      Rte_Spinlock_BEM_ChargeStateTimeout_oBEM_oJ1939_bms_4d32efa5_Tx
      Rte_Spinlock_BEM_ChargeStatisticsTimeout_oBEM_oJ1939_bms_d07a3692_Tx
      Rte_Spinlock_BEM_ChargerIdTimeout0_oBEM_oJ1939_bms_eb813ae3_Tx
      Rte_Spinlock_BEM_ChargerIdTimeout1_oBEM_oJ1939_bms_6c27f1a0_Tx
      Rte_Spinlock_BEM_TimesyncOrPowerTimeout_oBEM_oJ1939_bms_f132cc4f_Tx
      Rte_Spinlock_BHM_AllowChargeVoltageMax_oBHM_oJ1939_bms_5c3d4762_Tx
      Rte_Spinlock_BRM_BatteryChargeTimes_oBRM_oJ1939_bms_b699eff3_Tx
      Rte_Spinlock_BRM_BatteryProductDay_oBRM_oJ1939_bms_da11520f_Tx
      Rte_Spinlock_BRM_BatteryProductMonth_oBRM_oJ1939_bms_9ee6c732_Tx
      Rte_Spinlock_BRM_BatteryProductYear_oBRM_oJ1939_bms_4f8656a1_Tx
      Rte_Spinlock_BRM_BatteryProperty_oBRM_oJ1939_bms_1c53b5e5_Tx
      Rte_Spinlock_BRM_BatterySN_oBRM_oJ1939_bms_10b903de_Tx
      Rte_Spinlock_BRM_BatterySystemRatedCapacity_oBRM_oJ1939_bms_8c5f9fd1_Tx
      Rte_Spinlock_BRM_BatterySystemRatedVoltage_oBRM_oJ1939_bms_902f9149_Tx
      Rte_Spinlock_BRM_BatteryType_oBRM_oJ1939_bms_67affdba_Tx
      Rte_Spinlock_BRM_Manufacturer_oBRM_oJ1939_bms_1506e637_Tx
      Rte_Spinlock_BRM_ProtocolVersion_oBRM_oJ1939_bms_4595b96f_Tx
      Rte_Spinlock_BRM_VehicleIdByte17_oBRM_oJ1939_bms_3bcab298_Tx
      Rte_Spinlock_BRM_VehicleIdByte1_8_oBRM_oJ1939_bms_38f10529_Tx
      Rte_Spinlock_BRM_VehicleIdByte9_16_oBRM_oJ1939_bms_50f2ed11_Tx
      Rte_Spinlock_BRO_BMSChargeReady_oBRO_oJ1939_bms_639997bd_Tx
      Rte_Spinlock_BSD_AbortSOC_oBSD_oJ1939_bms_1bf4999e_Tx
      Rte_Spinlock_BSD_BatteryTempMax_oBSD_oJ1939_bms_0a97b3dc_Tx
      Rte_Spinlock_BSD_BatteryTempMin_oBSD_oJ1939_bms_ada333a5_Tx
      Rte_Spinlock_BSD_BatteryVoltageMax_oBSD_oJ1939_bms_7df654bd_Tx
      Rte_Spinlock_BSD_BatteryVoltageMin_oBSD_oJ1939_bms_dac2d4c4_Tx
      Rte_Spinlock_BSM_BatteryCurrentState_oBSM_oJ1939_bms_fbd112e0_Tx
      Rte_Spinlock_BSM_BatteryOutpuConnectorState_oBSM_oJ1939_bms_505480e6_Tx
      Rte_Spinlock_BSM_BatteryTempMaxNo_oBSM_oJ1939_bms_497a5c4e_Tx
      Rte_Spinlock_BSM_BatteryTempMax_oBSM_oJ1939_bms_85f0b8b3_Tx
      Rte_Spinlock_BSM_BatteryTempMinNo_oBSM_oJ1939_bms_5a3fbae5_Tx
      Rte_Spinlock_BSM_BatteryTempMin_oBSM_oJ1939_bms_22c438ca_Tx
      Rte_Spinlock_BSM_BatteryTempState_oBSM_oJ1939_bms_84506101_Tx
      Rte_Spinlock_BSM_BatteryVoltageMaxNo_oBSM_oJ1939_bms_8c4562b4_Tx
      Rte_Spinlock_BSM_BatteryVoltageState_oBSM_oJ1939_bms_416f5ffb_Tx
      Rte_Spinlock_BSM_ChargeEnable_oBSM_oJ1939_bms_a2bcc681_Tx
      Rte_Spinlock_BSM_InsulationState_oBSM_oJ1939_bms_7d927ad9_Tx
      Rte_Spinlock_BSM_SOC_oBSM_oJ1939_bms_14942cb5_Tx
      Rte_Spinlock_BST_AbortAchiveSOC_oBST_oJ1939_bms_c136b77d_Tx
      Rte_Spinlock_BST_AbortAchiveSingleVolt_oBST_oJ1939_bms_eba61cdf_Tx
      Rte_Spinlock_BST_AbortAchiveTotalVolt_oBST_oJ1939_bms_e1a7b5c9_Tx
      Rte_Spinlock_BST_AbortChargparameter_oBST_oJ1939_bms_76c05b72_Tx
      Rte_Spinlock_BST_AbortErrorCurrent_oBST_oJ1939_bms_a1621160_Tx
      Rte_Spinlock_BST_AbortErrorVoltage_oBST_oJ1939_bms_984fbd12_Tx
      Rte_Spinlock_BST_AbortFaultBMSTemp_oBST_oJ1939_bms_1f548a97_Tx
      Rte_Spinlock_BST_AbortFaultBatteryTemp_oBST_oJ1939_bms_24bc84f9_Tx
      Rte_Spinlock_BST_AbortFaultConnectorTemp_oBST_oJ1939_bms_5ac8c1a2_Tx
      Rte_Spinlock_BST_AbortFaultConnector_oBST_oJ1939_bms_c267077a_Tx
      Rte_Spinlock_BST_AbortFaultInsulation_oBST_oJ1939_bms_54f72c95_Tx
      Rte_Spinlock_BST_AbortFaultOther_oBST_oJ1939_bms_bf783560_Tx
      Rte_Spinlock_BST_AbortHVrelayfault_oBST_oJ1939_bms_dd44a377_Tx
      Rte_Spinlock_BST_Abortdet2Voltexception_oBST_oJ1939_bms_e015929e_Tx
      Rte_Spinlock_BST_Abortmanoperate_oBST_oJ1939_bms_b2432717_Tx
      Rte_Spinlock_CCS_OutputVoltage_oCCS_oJ1939_bms_e8aa6018_Rx
      Rte_Spinlock_CEM_BatteryChargeRequireTimeout_oCEM_oJ1939_bms_5fb156f4_Rx
      Rte_Spinlock_CHM_ProtocolVersion_oCHM_oJ1939_bms_0a8dbb13_Rx
      Rte_Spinlock_CML_OutpuVoltageMax_oCML_oJ1939_bms_5dd5d6c5_Rx
      Rte_Spinlock_CRM_RecognitionResult_oCRM_oJ1939_bms_dd9063d0_Rx
      Rte_Spinlock_CRO_ChargerReady_oCRO_oJ1939_bms_5ed7a56d_Rx
      Rte_Spinlock_CSD_ChargerNo_oCSD_oJ1939_bms_26864bff_Rx
      Rte_Spinlock_CST_AbortAchiveCondition_oCST_oJ1939_bms_ed49cd8a_Rx
      Rte_Spinlock_CTS_Year_oCTS_oJ1939_bms_66f2efa9_Rx
      Rte_Spinlock_ChargeCurrWU_Ena_oVCU_BS_01_oATOM_HWLIN1_d9c09dc2_Tx
      Rte_Spinlock_ChargeCurrWU_Treshold_oVCU_BS_01_oATOM_HWLIN1_5e5d12a4_Tx
      Rte_Spinlock_DisChargeCurrWU_Ena_oVCU_BS_01_oATOM_HWLIN1_b8f53272_Tx
      Rte_Spinlock_DisChargeCurrWU_Treshold_oVCU_BS_01_oATOM_HWLIN1_05d46e7e_Tx
      Rte_Spinlock_FRC_ComFtonNet_oFRC_01_oATOM_HWLIN1_9657f14b_Rx
      Rte_Spinlock_Resp_Error_oBS_01_oATOM_HWLIN1_f35fadbf_Rx
      Rte_Spinlock_SG_ACU_01_SigGroup_oACU_01_oATOM_CANFD_Matrix_CH_V600_202502_0a16dd9e_Rx
      Rte_Spinlock_SG_ACU_02_SigGroup_oACU_02_oATOM_CANFD_Matrix_CH_V600_202502_3b90e790_Rx
      Rte_Spinlock_SG_ACU_info_SigGroup_oACU_info_oATOM_CANFD_Matrix_CH_V600_202502_5b63ef23_Rx
      Rte_Spinlock_SG_ADCU_ACC_02_SigGroup_oADCU_ACC_02_oATOM_CANFD_Matrix_CH_V600_202502_1e479296_Rx
      Rte_Spinlock_SG_ADCU_AEB_01_SigGroup_oADCU_AEB_01_oATOM_CANFD_Matrix_CH_V600_202502_50a93e3a_Rx
      Rte_Spinlock_SG_ADCU_APS_01_SigGroup_oADCU_APS_01_oATOM_CANFD_Matrix_CH_V600_202502_c590572d_Rx
      Rte_Spinlock_SG_ADCU_APS_02_SigGroup_oADCU_APS_02_oATOM_CANFD_Matrix_CH_V600_202502_67bc1f98_Rx
      Rte_Spinlock_SG_ADCU_DA_SigGroup_oADCU_DA_oATOM_CANFD_Matrix_CH_V600_202502_4133b6dd_Rx
      Rte_Spinlock_SG_APTC_TCU_SigGroup_oAPTC_TCU_oATOM_CAN_Matrix_PT_V600_20250211_467c0275_Rx
      Rte_Spinlock_SG_BCM_05_SigGroup_oBCM_05_oATOM_CAN_Matrix_PT_V600_20250211_46c76b05_Rx
      Rte_Spinlock_SG_BCM_06_SigGroup_oBCM_06_oATOM_CAN_Matrix_PT_V600_20250211_7741510b_Rx
      Rte_Spinlock_SG_BMS_BatInfor_01_SigGroup_oBMS_BatInfor_01_oATOM_CAN_Matrix_PT_V600_20250211_4fef2501_Rx
      Rte_Spinlock_SG_BMS_BatInfor_02_SigGroup_oBMS_BatInfor_02_oATOM_CAN_Matrix_PT_V600_20250211_426bcc59_Rx
      Rte_Spinlock_SG_BMS_BatInfor_03_SigGroup_oBMS_BatInfor_03_oATOM_CAN_Matrix_PT_V600_20250211_f03896ae_Rx
      Rte_Spinlock_SG_BMS_CellTemp_SigGroup_oBMS_CellTemp_oATOM_CAN_Matrix_PT_V600_20250211_591a267a_Rx
      Rte_Spinlock_SG_BMS_CellVoltage_SigGroup_oBMS_CellVoltage_oATOM_CAN_Matrix_PT_V600_20250211_e26ec140_Rx
      Rte_Spinlock_SG_BMS_Charge_01_SigGroup_oBMS_Charge_01_oATOM_CAN_Matrix_PT_V600_20250211_216177cb_Rx
      Rte_Spinlock_SG_BMS_Charge_02_SigGroup_oBMS_Charge_02_oATOM_CAN_Matrix_PT_V600_20250211_116647c1_Rx
      Rte_Spinlock_SG_BMS_Charge_03_SigGroup_oBMS_Charge_03_oATOM_CAN_Matrix_PT_V600_20250211_b7b455f8_Rx
      Rte_Spinlock_SG_BMS_DIRelayState_SigGroup_oBMS_DIRelayState_oATOM_CAN_Matrix_PT_V600_20250211_ca554d8c_Rx
      Rte_Spinlock_SG_BMS_ErrorInfo_SigGroup_oBMS_ErrorInfo_oATOM_CAN_Matrix_PT_V600_20250211_0728f72e_Rx
      Rte_Spinlock_SG_BMS_PRO_SigGroup_oBMS_PRO_oATOM_CAN_Matrix_PT_V600_20250211_21a267c0_Rx
      Rte_Spinlock_SG_BMS_TCU_SigGroup_oBMS_TCU_oATOM_CAN_Matrix_PT_V600_20250211_541a46a3_Rx
      Rte_Spinlock_SG_BMS_VersionInfor_SigGroup_oBMS_VersionInfor_oATOM_CAN_Matrix_PT_V600_20250211_3c7841d8_Rx
      Rte_Spinlock_SG_BMS_status_01_SigGroup_oBMS_status_01_oATOM_CAN_Matrix_PT_V600_20250211_2f7ddbcd_Rx
      Rte_Spinlock_SG_BMS_status_02_SigGroup_oBMS_status_02_oATOM_CAN_Matrix_PT_V600_20250211_1f7aebc7_Rx
      Rte_Spinlock_SG_BMS_status_03_SigGroup_oBMS_status_03_oATOM_CAN_Matrix_PT_V600_20250211_b9a8f9fe_Rx
      Rte_Spinlock_SG_BMS_status_04_SigGroup_oBMS_status_04_oATOM_CAN_Matrix_PT_V600_20250211_7f748bd3_Rx
      Rte_Spinlock_SG_CGW_01_SigGroup_oCGW_01_oATOM_CAN_Matrix_PT_V600_20250211_9280de14_Rx
      Rte_Spinlock_SG_CGW_02_SigGroup_oCGW_02_oATOM_CAN_Matrix_PT_V600_20250211_a306e41a_Rx
      Rte_Spinlock_SG_CGW_VIN1_SigGroup_oCGW_VIN1_oATOM_CAN_Matrix_PT_V600_20250211_49910b51_Rx
      Rte_Spinlock_SG_CGW_VIN2_SigGroup_oCGW_VIN2_oATOM_CAN_Matrix_PT_V600_20250211_c0accf92_Rx
      Rte_Spinlock_SG_CGW_VIN3VER_SigGroup_oCGW_VIN3VER_oATOM_CAN_Matrix_PT_V600_20250211_7600cd71_Rx
      Rte_Spinlock_SG_DCM_FL_02_SigGroup_oDCM_FL_02_oATOM_CAN_Matrix_PT_V600_20250211_46147686_Rx
      Rte_Spinlock_SG_DCM_FR_02_SigGroup_oDCM_FR_02_oATOM_CAN_Matrix_PT_V600_20250211_f609c275_Rx
      Rte_Spinlock_SG_DCM_FR_SigGroup_oDCM_FR_oATOM_CAN_Matrix_PT_V600_20250211_eb540c93_Rx
      Rte_Spinlock_SG_DCM_RL_SigGroup_oDCM_RL_oATOM_CAN_Matrix_PT_V600_20250211_a6554e24_Rx
      Rte_Spinlock_SG_DCM_RR_SigGroup_oDCM_RR_oATOM_CAN_Matrix_PT_V600_20250211_9219ec09_Rx
      Rte_Spinlock_SG_EPS_CONV_SigGroup_oEPS_CONV_oATOM_CANFD_Matrix_CH_V600_202502_42428757_Rx
      Rte_Spinlock_SG_EVCOM_State_01_SigGroup_oEVCOM_State_01_oATOM_CAN_Matrix_PT_V600_20250211_16f3767b_Rx
      Rte_Spinlock_SG_IBS_ACC_SigGroup_oIBS_ACC_oATOM_CANFD_Matrix_CH_V600_202502_c31bc8ab_Rx
      Rte_Spinlock_SG_IBS_APS_SigGroup_oIBS_APS_oATOM_CANFD_Matrix_CH_V600_202502_91bbe9ec_Rx
      Rte_Spinlock_SG_IBS_Status_01_SigGroup_oIBS_Status_01_oATOM_CANFD_Matrix_CH_V600_202502_bdf732ba_Rx
      Rte_Spinlock_SG_IBS_Status_02_SigGroup_oIBS_Status_02_oATOM_CANFD_Matrix_CH_V600_202502_8df002b0_Rx
      Rte_Spinlock_SG_IBS_Status_03_SigGroup_oIBS_Status_03_oATOM_CANFD_Matrix_CH_V600_202502_2b221089_Rx
      Rte_Spinlock_SG_IBS_Status_04_SigGroup_oIBS_Status_04_oATOM_CANFD_Matrix_CH_V600_202502_edfe62a4_Rx
      Rte_Spinlock_SG_IBS_Status_05_SigGroup_oIBS_Status_05_oATOM_CAN_Matrix_PT_V600_20250211_7471090c_Rx
      Rte_Spinlock_SG_IBS_Status_06_SigGroup_oIBS_Status_06_oATOM_CANFD_Matrix_CH_V600_202502_7b2b4097_Rx
      Rte_Spinlock_SG_IBS_Torque_SigGroup_oIBS_Torque_oATOM_CANFD_Matrix_CH_V600_202502_5a2dd5ad_Rx
      Rte_Spinlock_SG_IBS_VCU_MotorControl_SigGroup_oIBS_VCU_MotorControl_oATOM_CANFD_Matrix_CH_V600_202502_9a811a5b_Rx
      Rte_Spinlock_SG_IBS_WheelSpeed_01_SigGroup_oIBS_WheelSpeed_01_oATOM_CANFD_Matrix_CH_V600_202502_5773aa13_Rx
      Rte_Spinlock_SG_IBS_WheelSpeed_02_SigGroup_oIBS_WheelSpeed_02_oATOM_CANFD_Matrix_CH_V600_202502_2d752b6e_Rx
      Rte_Spinlock_SG_IVI_01_SigGroup_oIVI_01_oATOM_CAN_Matrix_PT_V600_20250211_284cc0c2_Rx
      Rte_Spinlock_SG_IVI_03_SigGroup_oIVI_03_oATOM_CAN_Matrix_PT_V600_20250211_bf981109_Rx
      Rte_Spinlock_SG_IVI_OdometerInfor_SigGroup_oIVI_OdometerInfor_oATOM_CAN_Matrix_PT_V600_20250211_3516238b_Rx
      Rte_Spinlock_SG_MCU_01_SigGroup_oMCU_01_oATOM_CAN_Matrix_PT_V600_20250211_3844bc9f_Rx
      Rte_Spinlock_SG_MCU_02_SigGroup_oMCU_02_oATOM_CAN_Matrix_PT_V600_20250211_09c28691_Rx
      Rte_Spinlock_SG_MCU_DeratingStatus_SigGroup_oMCU_DeratingStatus_oATOM_CAN_Matrix_PT_V600_20250211_c60bf9ce_Rx
      Rte_Spinlock_SG_MCU_FailureCode_SigGroup_oMCU_FailureCode_oATOM_CAN_Matrix_PT_V600_20250211_bf11f7cf_Rx
      Rte_Spinlock_SG_MCU_Temperature_01_SigGroup_oMCU_Temperature_01_oATOM_CAN_Matrix_PT_V600_20250211_9ee5905c_Rx
      Rte_Spinlock_SG_MCU_Temperature_02_SigGroup_oMCU_Temperature_02_oATOM_CAN_Matrix_PT_V600_20250211_5f18debb_Rx
      Rte_Spinlock_SG_POD_DCDC_01_SigGroup_oPOD_DCDC_01_oATOM_CAN_Matrix_PT_V600_20250211_c0cfae4d_Rx
      Rte_Spinlock_SG_POD_DCDC_02_SigGroup_oPOD_DCDC_02_oATOM_CAN_Matrix_PT_V600_20250211_62e3e6f8_Rx
      Rte_Spinlock_SG_POD_OBC_CHRGSTATION_SigGroup_oPOD_OBC_CHRGSTATION_oATOM_CAN_Matrix_PT_V600_20250211_4d87b474_Rx
      Rte_Spinlock_SG_POD_OBC_STATUS_02_SigGroup_oPOD_OBC_STATUS_02_oATOM_CAN_Matrix_PT_V600_20250211_49c67a09_Rx
      Rte_Spinlock_SG_POD_OBC_STATUS_03_SigGroup_oPOD_OBC_STATUS_03_oATOM_CAN_Matrix_PT_V600_20250211_d6eb071d_Rx
      Rte_Spinlock_SG_POD_OBC_STATUS_04_SigGroup_oPOD_OBC_STATUS_04_oATOM_CAN_Matrix_PT_V600_20250211_bdcb78f3_Rx
      Rte_Spinlock_SG_POD_Status_01_SigGroup_oPOD_Status_01_oATOM_CAN_Matrix_PT_V600_20250211_880c9d5a_Rx
      Rte_Spinlock_SG_POD_Status_02_SigGroup_oPOD_Status_02_oATOM_CAN_Matrix_PT_V600_20250211_b80bad50_Rx
      Rte_Spinlock_SG_PRND_SigGroup_oPRND_oATOM_CAN_Matrix_PT_V600_20250211_ddf34a23_Rx
      Rte_Spinlock_SG_SGW_01_SigGroup_oSGW_01_oATOM_CAN_Matrix_PT_V600_20250211_37bbfdeb_Rx
      Rte_Spinlock_SG_SGW_04_SigGroup_oSGW_04_oATOM_CAN_Matrix_PT_V600_20250211_6531b3f9_Rx
      Rte_Spinlock_SG_SGW_16_SigGroup_oSGW_16_oATOM_CAN_Matrix_PT_V600_20250211_194d06e6_Rx
      Rte_Spinlock_SG_SGW_17_SigGroup_oSGW_17_oATOM_CANFD_Matrix_CH_V600_202502_804294b2_Rx
      Rte_Spinlock_SG_SGW_FVSynchronization_01_SigGrou_oSGW_FVSynchronization_01_oATOM_CAN_Matrix_PT_V600_20250211_0d3cf875_Rx
      Rte_Spinlock_SG_SGW_IBS_01_SigGroup_oSGW_IBS_01_oATOM_CAN_Matrix_PT_V600_20250211_0dec95d0_Rx
      Rte_Spinlock_SG_SGW_PT_01_SigGroup_oSGW_PT_01_oATOM_CAN_Matrix_PT_V600_20250211_d1f7f071_Rx
      Rte_Spinlock_SG_SGW_Time_SigGroup_oSGW_Time_oATOM_CAN_Matrix_PT_V600_20250211_0ca37593_Rx
      Rte_Spinlock_SG_SGW_VCU_01_SigGroup_oSGW_VCU_01_oATOM_CAN_Matrix_PT_V600_20250211_899d317b_Rx
      Rte_Spinlock_SG_TCU_01_SigGroup_oTCU_01_oATOM_CAN_Matrix_PT_V600_20250211_95b4cd9c_Rx
      Rte_Spinlock_SG_TCU_02_SigGroup_oTCU_02_oATOM_CAN_Matrix_PT_V600_20250211_a432f792_Rx
      Rte_Spinlock_SG_VCU_02_SigGroup_oVCU_02_oATOM_CANFD_Matrix_CH_V600_202502_2fc20804_Tx
      Rte_Spinlock_SG_VCU_03_SigGroup_oVCU_03_oATOM_CANFD_Matrix_CH_V600_202502_8990e3c1_Tx
      Rte_Spinlock_SG_VCU_04_SigGroup_oVCU_04_oATOM_CANFD_Matrix_CH_V600_202502_4cce7c18_Tx
      Rte_Spinlock_SG_VCU_05_SigGroup_oVCU_05_oATOM_CAN_Matrix_PT_V600_20250211_d5c1ee4c_Tx
      Rte_Spinlock_SG_VCU_06_SigGroup_oVCU_06_oATOM_CAN_Matrix_PT_V600_20250211_e447d442_Tx
      Rte_Spinlock_SG_VCU_AccPedal_SigGroup_oVCU_AccPedal_oATOM_CANFD_Matrix_CH_V600_202502_aa50ac8d_Tx
      Rte_Spinlock_SG_VCU_BMS_SigGroup_oVCU_BMS_oATOM_CANFD_Matrix_CH_V600_202502_d27feb30_Tx
      Rte_Spinlock_SG_VCU_Chassis_01_SigGroup_oVCU_Chassis_01_oATOM_CANFD_Matrix_CH_V600_202502_52963860_Tx
      Rte_Spinlock_SG_VCU_DCDC_SigGroup_oVCU_DCDC_oATOM_CAN_Matrix_PT_V600_20250211_d0a22af6_Tx
      Rte_Spinlock_SG_VCU_HMIsignals_01_SigGroup_oVCU_HMIsignals_01_oATOM_CANFD_Matrix_CH_V600_202502_c30c8d8f_Tx
      Rte_Spinlock_SG_VCU_HMIsignals_02_SigGroup_oVCU_HMIsignals_02_oATOM_CANFD_Matrix_CH_V600_202502_b90a0cf2_Tx
      Rte_Spinlock_SG_VCU_HMIsignals_03_SigGroup_oVCU_HMIsignals_03_oATOM_CAN_Matrix_PT_V600_20250211_197a0877_Tx
      Rte_Spinlock_SG_VCU_IBS_01_SigGroup_oVCU_IBS_01_oATOM_CANFD_Matrix_CH_V600_202502_f0f49d09_Tx
      Rte_Spinlock_SG_VCU_MCU_02_SigGroup_oVCU_MCU_02_oATOM_CAN_Matrix_PT_V600_20250211_2d530015_Tx
      Rte_Spinlock_SG_VCU_MCU_03_SigGroup_oVCU_MCU_03_oATOM_CANFD_Matrix_CH_V600_202502_c0057d9b_Tx
      Rte_Spinlock_SG_VCU_MCU_05_SigGroup_oVCU_MCU_05_oATOM_CAN_Matrix_PT_V600_20250211_7ef1168b_Tx
      Rte_Spinlock_SG_VCU_POD_SigGroup_oVCU_POD_oATOM_CAN_Matrix_PT_V600_20250211_c17d64e5_Tx
      Rte_Spinlock_SG_VCU_PlugInChrgInfo_SigGroup_oVCU_PlugInChrgInfo_oATOM_CANFD_Matrix_CH_V600_202502_c285d340_Tx
      Rte_Spinlock_SG_VCU_SynReq_01_SigGroup_oVCU_SynReq_01_oATOM_CAN_Matrix_PT_V600_20250211_2ec232a9_Tx
      Rte_Spinlock_SG_VCU_TCU_SigGroup_oVCU_TCU_oATOM_CAN_Matrix_PT_V600_20250211_1a98021d_Tx
      Rte_Spinlock_SOCWU_Ena_oVCU_BS_01_oATOM_HWLIN1_c1ae10c8_Tx
      Rte_Spinlock_SOCWU_Treshold_oVCU_BS_01_oATOM_HWLIN1_cb8c1a90_Tx
      Rte_Spinlock_VCU_ACU_DriverWarningLampSts_oVCU_01_oATOM_HWLIN1_42c2b0b9_Tx
      Rte_Spinlock_VCU_ACU_PassengerAirbagSts_oVCU_01_oATOM_HWLIN1_a0d9a7b9_Tx
      Rte_Spinlock_VCU_ACU_PassengerWarningLampSts_oVCU_01_oATOM_HWLIN1_76395bc4_Tx
      Rte_Spinlock_VCU_ACU_WarningLampSts_oVCU_01_oATOM_HWLIN1_7751b62b_Tx
      Rte_Spinlock_VCU_BCM_FLSeatBeltRemindReq_oVCU_01_oATOM_HWLIN1_980b8460_Tx
      Rte_Spinlock_VCU_BCM_FRSeatBeltRemindReq_oVCU_01_oATOM_HWLIN1_ce21434a_Tx
      Rte_Spinlock_VCU_BCM_RLSeatBeltRemindReq_oVCU_01_oATOM_HWLIN1_bc6dc441_Tx
      Rte_Spinlock_VCU_BCM_RRSeatBeltRemindReq_oVCU_01_oATOM_HWLIN1_ea47036b_Tx
      Rte_Spinlock_VCU_CGW_VehicleState_oVCU_01_oATOM_HWLIN1_77400d2e_Tx
      Rte_Spinlock_VCU_DCDCFail_LIN_oVCU_01_oATOM_HWLIN1_0c50ae50_Tx
      Rte_Spinlock_VCU_DCM_FL_DoorFLSts_oVCU_01_oATOM_HWLIN1_c9cb9c36_Tx
      Rte_Spinlock_VCU_DCM_FR_DoorFRSts_oVCU_01_oATOM_HWLIN1_610e09cb_Tx
      Rte_Spinlock_VCU_DCM_RL_DoorRLSts_oVCU_01_oATOM_HWLIN1_4b0c11ee_Tx
      Rte_Spinlock_VCU_DCM_RR_DoorRRSts_oVCU_01_oATOM_HWLIN1_e3c98413_Tx
      Rte_Spinlock_VCU_DriveMotOvrTemp_LIN_oVCU_01_oATOM_HWLIN1_65d20ded_Tx
      Rte_Spinlock_VCU_HVBatCriFail_LIN_oVCU_01_oATOM_HWLIN1_2bf2157d_Tx
      Rte_Spinlock_VCU_HVBatOvrTemp_LIN_oVCU_01_oATOM_HWLIN1_7c76df3a_Tx
      Rte_Spinlock_VCU_IBS_BrakeFluidWarning_oVCU_01_oATOM_HWLIN1_5bfbc2fa_Tx
      Rte_Spinlock_VCU_IBS_EBDFault_oVCU_01_oATOM_HWLIN1_7e339715_Tx
      Rte_Spinlock_VCU_IBS_RollerbenchMode_oVCU_01_oATOM_HWLIN1_91a58216_Tx
      Rte_Spinlock_VCU_IBS_SystemStatus_oVCU_01_oATOM_HWLIN1_7138be07_Tx
      Rte_Spinlock_VCU_IVI_BulbCheckSts_oVCU_01_oATOM_HWLIN1_d842011f_Tx
      Rte_Spinlock_VCU_IVI_VrState_oVCU_01_oATOM_HWLIN1_eab73730_Tx
  module config EcuC
  ecuc value collection DaVinci_Project: ecuc-values=[Com, Rte, Os, EcuC, NvM]
