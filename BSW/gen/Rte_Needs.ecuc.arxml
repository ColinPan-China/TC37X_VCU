AUTOSAR XML (schema 4-0-3)
package /DaVinci_Project
  module config Rte
    6 x RteBswModuleInstance:
      BswM
        BswM_MainFunctionTimingEvent0 (RteBswEventToTaskMapping): RteBswUsedOsAlarmRef=Os/Rte_Al_TE2_Bsw_Task_0_10ms
      Dio
      EcuM
        EcuM_MainFunctionTimingEvent0 (RteBswEventToTaskMapping): RteBswUsedOsAlarmRef=Os/Rte_Al_TE2_Bsw_Task_0_10ms
      McalLib
      Mcu
      Port
    4 x RteSwComponentInstance:
      BswM_EcuSwComposition
        Timer_BswM_MainFunction (RteEventToTaskMapping): RteUsedOsAlarmRef=Os/Rte_Al_TE2_Bsw_Task_0_10ms
      EcuM_EcuSwComposition
        Timer_EcuM_MainFunction (RteEventToTaskMapping): RteUsedOsAlarmRef=Os/Rte_Al_TE2_Bsw_Task_0_10ms
      Os_OsCore0_swc_EcuSwComposition
      SWC1_EcuSwComposition
        TMT_SWC1_Runnable10ms (RteEventToTaskMapping): RteUsedOsAlarmRef=Os/Rte_Al_TE_SWC1_SWC1_Runnable10ms
    RteOsInteraction
      Rte_Al_TE_SWC1_SWC1_Runnable10ms (RteUsedOsActivation): RteExpectedActivationOffset=0, RteActivationOsAlarmRef=Os/Rte_Al_TE_SWC1_SWC1_Runnable10ms, RteActivationOsTaskRef=AswTask
      Rte_Al_TE2_Bsw_Task_0_10ms (RteUsedOsActivation): RteExpectedActivationOffset=0, RteActivationOsAlarmRef=Os/Rte_Al_TE2_Bsw_Task_0_10ms, RteActivationOsTaskRef=Bsw_Task
  module config NvM
  module config Os
    AswTask (OsTask): OsTaskActivation=1, OsTaskPriority=64, OsTaskSchedule=FULL
    Rte_Al_TE_SWC1_SWC1_Runnable10ms (OsAlarm): OsAlarmCounterRef=SystemTimer
      OsAlarmAction
        OsAlarmActivateTask: OsAlarmActivateTaskRef=AswTask
    Asw_Init (OsTask): OsTaskActivation=1, OsTaskPriority=63, OsTaskSchedule=FULL
    Bsw_Task (OsTask): OsTaskActivation=1, OsTaskPriority=65, OsTaskSchedule=FULL
    Rte_Al_TE2_Bsw_Task_0_10ms (OsAlarm): OsAlarmCounterRef=SystemTimer
      OsAlarmAction
        OsAlarmActivateTask: OsAlarmActivateTaskRef=Bsw_Task
  module config EcuC
  ecuc value collection DaVinci_Project: ecuc-values=[Com, Rte, Os, EcuC, NvM]
