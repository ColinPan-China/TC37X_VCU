AUTOSAR XML (schema 4-0-3)
package /DaVinci_Project
  module config Com
    ComConfig
      123 x ComSignal:
        AN0_oVcuAdcTxG0Msg0_oTC37X_VCU_CAN01_66f10a00_Tx: ComSignalType=SINT16
        AN10_oVcuAdcTxG1Msg0_oTC37X_VCU_CAN01_f71f00b1_Tx: ComSignalType=SINT16
        AN11_oVcuAdcTxG1Msg0_oTC37X_VCU_CAN01_d39d5187_Tx: ComSignalType=SINT16
        AN12_oVcuAdcTxG1Msg1_oTC37X_VCU_CAN01_5149143c_Tx: ComSignalType=SINT16
        AN13_oVcuAdcTxG1Msg1_oTC37X_VCU_CAN01_75cb450a_Tx: ComSignalType=SINT16
        AN14_oVcuAdcTxG1Msg1_oTC37X_VCU_CAN01_8a44f288_Tx: ComSignalType=SINT16
        AN15_oVcuAdcTxG1Msg1_oTC37X_VCU_CAN01_aec6a3be_Tx: ComSignalType=SINT16
        AN16_oVcuAdcTxG2Msg0_oTC37X_VCU_CAN01_156a4b45_Tx: ComSignalType=SINT16
        AN17_oVcuAdcTxG2Msg0_oTC37X_VCU_CAN01_31e81a73_Tx: ComSignalType=SINT16
        AN18_oVcuAdcTxG2Msg0_oTC37X_VCU_CAN01_31042200_Tx: ComSignalType=SINT16
        AN19_oVcuAdcTxG2Msg0_oTC37X_VCU_CAN01_15867336_Tx: ComSignalType=SINT16
        AN1_oVcuAdcTxG0Msg0_oTC37X_VCU_CAN01_42735b36_Tx: ComSignalType=SINT16
        AN20_oVcuAdcTxG2Msg1_oTC37X_VCU_CAN01_aae62509_Tx: ComSignalType=SINT16
        AN21_oVcuAdcTxG2Msg1_oTC37X_VCU_CAN01_8e64743f_Tx: ComSignalType=SINT16
        AN22_oVcuAdcTxG2Msg1_oTC37X_VCU_CAN01_e3e28765_Tx: ComSignalType=SINT16
        AN23_oVcuAdcTxG2Msg1_oTC37X_VCU_CAN01_c760d653_Tx: ComSignalType=SINT16
        AN24_oVcuAdcTxG3Msg0_oTC37X_VCU_CAN01_c095b3f0_Tx: ComSignalType=SINT16
        AN25_oVcuAdcTxG3Msg0_oTC37X_VCU_CAN01_e417e2c6_Tx: ComSignalType=SINT16
        AN26_oVcuAdcTxG3Msg0_oTC37X_VCU_CAN01_8991119c_Tx: ComSignalType=SINT16
        AN27_oVcuAdcTxG3Msg0_oTC37X_VCU_CAN01_ad1340aa_Tx: ComSignalType=SINT16
        AN28_oVcuAdcTxG3Msg1_oTC37X_VCU_CAN01_42adce38_Tx: ComSignalType=SINT16
        AN29_oVcuAdcTxG3Msg1_oTC37X_VCU_CAN01_662f9f0e_Tx: ComSignalType=SINT16
        AN2_oVcuAdcTxG0Msg0_oTC37X_VCU_CAN01_2ff5a86c_Tx: ComSignalType=SINT16
        AN30_oVcuAdcTxG3Msg1_oTC37X_VCU_CAN01_72505601_Tx: ComSignalType=SINT16
        AN31_oVcuAdcTxG3Msg1_oTC37X_VCU_CAN01_56d20737_Tx: ComSignalType=SINT16
        AN32_oVcuAdcTxG8Msg0_oTC37X_VCU_CAN01_543dc9cc_Tx: ComSignalType=SINT16
        AN33_oVcuAdcTxG8Msg0_oTC37X_VCU_CAN01_70bf98fa_Tx: ComSignalType=SINT16
        AN34_oVcuAdcTxG8Msg0_oTC37X_VCU_CAN01_8f302f78_Tx: ComSignalType=SINT16
        AN35_oVcuAdcTxG8Msg0_oTC37X_VCU_CAN01_abb27e4e_Tx: ComSignalType=SINT16
        AN36_oVcuAdcTxG8Msg1_oTC37X_VCU_CAN01_29663bf5_Tx: ComSignalType=SINT16
        AN37_oVcuAdcTxG8Msg1_oTC37X_VCU_CAN01_0de46ac3_Tx: ComSignalType=SINT16
        AN38_oVcuAdcTxG8Msg1_oTC37X_VCU_CAN01_0d0852b0_Tx: ComSignalType=SINT16
        AN39_oVcuAdcTxG8Msg1_oTC37X_VCU_CAN01_298a0386_Tx: ComSignalType=SINT16
        AN3_oVcuAdcTxG0Msg0_oTC37X_VCU_CAN01_0b77f95a_Tx: ComSignalType=SINT16
        AN40_oVcuAdcTxG8Msg2_oTC37X_VCU_CAN01_1ba46d98_Tx: ComSignalType=SINT16
        AN41_oVcuAdcTxG8Msg2_oTC37X_VCU_CAN01_3f263cae_Tx: ComSignalType=SINT16
        AN42_oVcuAdcTxG8Msg2_oTC37X_VCU_CAN01_52a0cff4_Tx: ComSignalType=SINT16
        AN43_oVcuAdcTxG8Msg2_oTC37X_VCU_CAN01_76229ec2_Tx: ComSignalType=SINT16
        AN44_oVcuAdcTxG8Msg3_oTC37X_VCU_CAN01_66ff9fa1_Tx: ComSignalType=SINT16
        AN45_oVcuAdcTxG8Msg3_oTC37X_VCU_CAN01_427dce97_Tx: ComSignalType=SINT16
        AN46_oVcuAdcTxG8Msg3_oTC37X_VCU_CAN01_2ffb3dcd_Tx: ComSignalType=SINT16
        AN47_oVcuAdcTxG8Msg3_oTC37X_VCU_CAN01_0b796cfb_Tx: ComSignalType=SINT16
        AN4_oVcuAdcTxG0Msg1_oTC37X_VCU_CAN01_1baaf839_Tx: ComSignalType=SINT16
        AN5_oVcuAdcTxG0Msg1_oTC37X_VCU_CAN01_3f28a90f_Tx: ComSignalType=SINT16
        AN6_oVcuAdcTxG0Msg1_oTC37X_VCU_CAN01_52ae5a55_Tx: ComSignalType=SINT16
        AN7_oVcuAdcTxG0Msg1_oTC37X_VCU_CAN01_762c0b63_Tx: ComSignalType=SINT16
        AN8_oVcuAdcTxG1Msg0_oTC37X_VCU_CAN01_8ebae131_Tx: ComSignalType=SINT16
        AN9_oVcuAdcTxG1Msg0_oTC37X_VCU_CAN01_aa38b007_Tx: ComSignalType=SINT16
        Bts7xx_HS1_En_oVcuRxCtrlMsg1_oTC37X_VCU_CAN01_d0692a3c_Rx: ComNotification=Rte_COMCbk_Bts7xx_HS1_En_oVcuRxCtrlMsg1_oTC37X_VCU_CAN01_d0692a3c_Rx, ComSignalType=SINT8
        Bts7xx_HS2_En_oVcuRxCtrlMsg1_oTC37X_VCU_CAN01_b48951c2_Rx: ComSignalType=SINT8
        Bts7xx_HS3_En_oVcuRxCtrlMsg1_oTC37X_VCU_CAN01_21f98557_Rx: ComSignalType=SINT8
        Bts7xx_HS4_En_oVcuRxCtrlMsg1_oTC37X_VCU_CAN01_7d49a63e_Rx: ComSignalType=SINT8
        ECC_PMP2_SpdSet_oPMP_Cmd_oLIN00_8cabc4b7_Tx: ComSignalType=UINT8
        ECC_PMP3_SpdSet_oPMP_Cmd_oLIN00_0d8ea190_Tx: ComSignalType=UINT8
        EXT10_Valid_oVcuTxIoMsg5_oTC37X_VCU_CAN00_ba532916_Tx: ComSignalType=UINT16
        EXT11_Valid_oVcuTxIoMsg6_oTC37X_VCU_CAN00_d025e36b_Tx: ComSignalType=UINT16
        EXT12_Valid_oVcuTxIoMsg6_oTC37X_VCU_CAN00_8a44dc0b_Tx: ComSignalType=UINT16
        EXT13_Valid_oVcuTxIoMsg7_oTC37X_VCU_CAN00_e5e67df5_Tx: ComSignalType=UINT16
        EXT14_Valid_oVcuTxIoMsg7_oTC37X_VCU_CAN00_d1d4142a_Tx: ComSignalType=UINT16
        EXT15_Valid_oVcuTxIoMsg8_oTC37X_VCU_CAN00_a75ba75d_Tx: ComSignalType=UINT16
        EXT16_Valid_oVcuTxIoMsg8_oTC37X_VCU_CAN00_fd3a983d_Tx: ComSignalType=UINT16
        EXT1_Valid_oVcuTxIoMsg1_oTC37X_VCU_CAN00_caf787ea_Tx: ComSignalType=UINT16
        EXT2_Valid_oVcuTxIoMsg1_oTC37X_VCU_CAN00_9096b88a_Tx: ComSignalType=UINT16
        EXT3_Valid_oVcuTxIoMsg2_oTC37X_VCU_CAN00_fae072f7_Tx: ComSignalType=UINT16
        EXT4_Valid_oVcuTxIoMsg2_oTC37X_VCU_CAN00_ced21b28_Tx: ComSignalType=UINT16
        EXT5_Valid_oVcuTxIoMsg3_oTC37X_VCU_CAN00_a170bad6_Tx: ComSignalType=UINT16
        EXT6_Valid_oVcuTxIoMsg3_oTC37X_VCU_CAN00_fb1185b6_Tx: ComSignalType=UINT16
        EXT7_Valid_oVcuTxIoMsg4_oTC37X_VCU_CAN00_9acf98cd_Tx: ComSignalType=UINT16
        EXT8_Valid_oVcuTxIoMsg4_oTC37X_VCU_CAN00_725b5c6c_Tx: ComSignalType=UINT16
        EXT9_Valid_oVcuTxIoMsg5_oTC37X_VCU_CAN00_1df9fd92_Tx: ComSignalType=UINT16
        EXT_A_IN10_oVcuTxIoMsg5_oTC37X_VCU_CAN00_83e5b725_Tx: ComSignalType=SINT16
        EXT_A_IN11_oVcuTxIoMsg6_oTC37X_VCU_CAN00_67848296_Tx: ComSignalType=SINT16
        EXT_A_IN12_oVcuTxIoMsg6_oTC37X_VCU_CAN00_74acbbe5_Tx: ComSignalType=SINT16
        EXT_A_IN13_oVcuTxIoMsg7_oTC37X_VCU_CAN00_9519e5d5_Tx: ComSignalType=SINT16
        EXT_A_IN14_oVcuTxIoMsg7_oTC37X_VCU_CAN00_bdae7fe2_Tx: ComSignalType=SINT16
        EXT_A_IN15_oVcuTxIoMsg8_oTC37X_VCU_CAN00_4536335b_Tx: ComSignalType=SINT16
        EXT_A_IN16_oVcuTxIoMsg8_oTC37X_VCU_CAN00_561e0a28_Tx: ComSignalType=SINT16
        EXT_A_IN1_oVcuTxIoMsg1_oTC37X_VCU_CAN00_37348eff_Tx: ComSignalType=SINT16
        EXT_A_IN2_oVcuTxIoMsg1_oTC37X_VCU_CAN00_241cb78c_Tx: ComSignalType=SINT16
        EXT_A_IN3_oVcuTxIoMsg2_oTC37X_VCU_CAN00_c07d823f_Tx: ComSignalType=SINT16
        EXT_A_IN4_oVcuTxIoMsg2_oTC37X_VCU_CAN00_e8ca1808_Tx: ComSignalType=SINT16
        EXT_A_IN5_oVcuTxIoMsg3_oTC37X_VCU_CAN00_097f4638_Tx: ComSignalType=SINT16
        EXT_A_IN6_oVcuTxIoMsg3_oTC37X_VCU_CAN00_1a577f4b_Tx: ComSignalType=SINT16
        EXT_A_IN7_oVcuTxIoMsg4_oTC37X_VCU_CAN00_f59e9dfe_Tx: ComSignalType=SINT16
        EXT_A_IN8_oVcuTxIoMsg4_oTC37X_VCU_CAN00_aa164141_Tx: ComSignalType=SINT16
        EXT_A_IN9_oVcuTxIoMsg5_oTC37X_VCU_CAN00_4ba31f71_Tx: ComSignalType=SINT16
        EXT_PWM_IN1_Duty_oVcuMeasurementMsg0_oTC37X_VCU_CAN01_92760a96_Tx: ComSignalType=SINT8
        EXT_PWM_IN1_Period_oVcuMeasurementMsg0_oTC37X_VCU_CAN01_c46a50e4_Tx: ComSignalType=SINT16
        EXT_PWM_IN2_Duty_oVcuMeasurementMsg0_oTC37X_VCU_CAN01_5b42119b_Tx: ComSignalType=SINT8
        EXT_PWM_IN2_Period_oVcuMeasurementMsg0_oTC37X_VCU_CAN01_fba12e71_Tx: ComSignalType=SINT16
        Ext_IN2_oVcuMeasurementMsg0_oTC37X_VCU_CAN01_a925e19e_Tx: ComSignalType=SINT8
        Tle4252d_en_oVcuRxCtrlMsg1_oTC37X_VCU_CAN01_24c739a8_Rx: ComSignalType=SINT8
        Tle888qk_Lout14_En_oVcuRxCtrlMsg2_oTC37X_VCU_CAN01_a11e1e88_Rx: ComSignalType=SINT8
        Tle888qk_Lout16_En_oVcuRxCtrlMsg2_oTC37X_VCU_CAN01_508eb1e3_Rx: ComSignalType=SINT8
        Tle888qk_Lout1_En_oVcuRxCtrlMsg2_oTC37X_VCU_CAN01_0e3571fa_Rx: ComNotification=Rte_COMCbk_Tle888qk_Lout1_En_oVcuRxCtrlMsg2_oTC37X_VCU_CAN01_0e3571fa_Rx, ComSignalType=SINT8
        Tle888qk_Lout8_En_oVcuRxCtrlMsg2_oTC37X_VCU_CAN01_ebe51441_Rx: ComSignalType=SINT8
        Tle888qk_Out21BriCfg_oVcuRxCtrlMsg0_oTC37X_VCU_CAN01_f4735e02_Rx: ComSignalType=SINT8
        Tle888qk_Out21_En_oVcuRxCtrlMsg0_oTC37X_VCU_CAN01_fce8b2a9_Rx: ComNotification=Rte_COMCbk_Tle888qk_Out21_En_oVcuRxCtrlMsg0_oTC37X_VCU_CAN01_fce8b2a9_Rx, ComSignalType=SINT8
        Tle888qk_Out22BriCfg_oVcuRxCtrlMsg0_oTC37X_VCU_CAN01_27e842f9_Rx: ComSignalType=SINT8
        Tle888qk_Out22_En_oVcuRxCtrlMsg0_oTC37X_VCU_CAN01_9808c957_Rx: ComSignalType=SINT8
        Tle888qk_Out23BriCfg_oVcuRxCtrlMsg0_oTC37X_VCU_CAN01_69614950_Rx: ComSignalType=SINT8
        Tle888qk_Out23_En_oVcuRxCtrlMsg0_oTC37X_VCU_CAN01_0d781dc2_Rx: ComSignalType=SINT8
        Tle888qk_Out24BriCfg_oVcuRxCtrlMsg0_oTC37X_VCU_CAN01_5baf7d4e_Rx: ComSignalType=SINT8
        Tle888qk_Out24_En_oVcuRxCtrlMsg0_oTC37X_VCU_CAN01_51c83eab_Rx: ComSignalType=SINT8
        Tle9201_Dir_oVcuRxCtrlMsg1_oTC37X_VCU_CAN01_4c38edaa_Rx: ComSignalType=SINT8
        Tle9201_Dis_oVcuRxCtrlMsg1_oTC37X_VCU_CAN01_7aca7d59_Rx: ComSignalType=SINT8
        Tle9201_Pwm_oVcuRxCtrlMsg1_oTC37X_VCU_CAN01_bf73fa17_Rx: ComSignalType=SINT8
        VcuRxMsg1_Sig0_oVcuRxMsg1_oTC37X_VCU_CAN00_13cef464_Rx: ComNotification=Rte_COMCbk_VcuRxMsg1_Sig0_oVcuRxMsg1_oTC37X_VCU_CAN00_13cef464_Rx, ComTimeoutNotification=Rte_COMCbkRxTOut_VcuRxMsg1_Sig0_oVcuRxMsg1_oTC37X_VCU_CAN00_13cef464_Rx, ComTimeout=2, ComSignalType=SINT16
        VcuRxMsg1_Sig1_oVcuRxMsg1_oTC37X_VCU_CAN00_70c92d40_Rx: ComNotification=Rte_COMCbk_VcuRxMsg1_Sig1_oVcuRxMsg1_oTC37X_VCU_CAN00_70c92d40_Rx, ComTimeoutNotification=Rte_COMCbkRxTOut_VcuRxMsg1_Sig1_oVcuRxMsg1_oTC37X_VCU_CAN00_70c92d40_Rx, ComTimeout=2, ComSignalType=SINT16
        VcuRxMsg1_Sig2_oVcuRxMsg1_oTC37X_VCU_CAN00_d5c1462c_Rx: ComNotification=Rte_COMCbk_VcuRxMsg1_Sig2_oVcuRxMsg1_oTC37X_VCU_CAN00_d5c1462c_Rx, ComTimeoutNotification=Rte_COMCbkRxTOut_VcuRxMsg1_Sig2_oVcuRxMsg1_oTC37X_VCU_CAN00_d5c1462c_Rx, ComTimeout=2, ComSignalType=SINT16
        VcuRxMsg1_Sig3_oVcuRxMsg1_oTC37X_VCU_CAN00_b6c69f08_Rx: ComNotification=Rte_COMCbk_VcuRxMsg1_Sig3_oVcuRxMsg1_oTC37X_VCU_CAN00_b6c69f08_Rx, ComTimeoutNotification=Rte_COMCbkRxTOut_VcuRxMsg1_Sig3_oVcuRxMsg1_oTC37X_VCU_CAN00_b6c69f08_Rx, ComTimeout=2, ComSignalType=SINT16
        VcuRxMsg2_Sig0_oVcuRxMsg2_oTC37X_VCU_CAN00_94ceda5c_Rx: ComNotification=Rte_COMCbk_VcuRxMsg2_Sig0_oVcuRxMsg2_oTC37X_VCU_CAN00_94ceda5c_Rx, ComTimeoutNotification=Rte_COMCbkRxTOut_VcuRxMsg2_Sig0_oVcuRxMsg2_oTC37X_VCU_CAN00_94ceda5c_Rx, ComTimeout=2, ComSignalType=SINT16
        VcuRxMsg2_Sig1_oVcuRxMsg2_oTC37X_VCU_CAN00_f7c90378_Rx: ComNotification=Rte_COMCbk_VcuRxMsg2_Sig1_oVcuRxMsg2_oTC37X_VCU_CAN00_f7c90378_Rx, ComTimeoutNotification=Rte_COMCbkRxTOut_VcuRxMsg2_Sig1_oVcuRxMsg2_oTC37X_VCU_CAN00_f7c90378_Rx, ComTimeout=2, ComSignalType=SINT16
        VcuRxMsg2_Sig2_oVcuRxMsg2_oTC37X_VCU_CAN00_52c16814_Rx: ComNotification=Rte_COMCbk_VcuRxMsg2_Sig2_oVcuRxMsg2_oTC37X_VCU_CAN00_52c16814_Rx, ComTimeoutNotification=Rte_COMCbkRxTOut_VcuRxMsg2_Sig2_oVcuRxMsg2_oTC37X_VCU_CAN00_52c16814_Rx, ComTimeout=2, ComSignalType=SINT16
        VcuRxMsg2_Sig3_oVcuRxMsg2_oTC37X_VCU_CAN00_31c6b130_Rx: ComNotification=Rte_COMCbk_VcuRxMsg2_Sig3_oVcuRxMsg2_oTC37X_VCU_CAN00_31c6b130_Rx, ComTimeoutNotification=Rte_COMCbkRxTOut_VcuRxMsg2_Sig3_oVcuRxMsg2_oTC37X_VCU_CAN00_31c6b130_Rx, ComTimeout=2, ComSignalType=SINT16
        VcuTxMsg1_Sig0_oVcuTxMsg1_oTC37X_VCU_CAN00_8243b9a9_Tx: ComSignalType=SINT16
        VcuTxMsg1_Sig1_oVcuTxMsg1_oTC37X_VCU_CAN00_e144608d_Tx: ComSignalType=SINT16
        VcuTxMsg1_Sig2_oVcuTxMsg1_oTC37X_VCU_CAN00_444c0be1_Tx: ComSignalType=SINT16
        VcuTxMsg1_Sig3_oVcuTxMsg1_oTC37X_VCU_CAN00_274bd2c5_Tx: ComSignalType=SINT16
        VcuTxMsg2_Sig0_oVcuTxMsg2_oTC37X_VCU_CAN00_05439791_Tx: ComSignalType=SINT16
        VcuTxMsg2_Sig1_oVcuTxMsg2_oTC37X_VCU_CAN00_66444eb5_Tx: ComSignalType=SINT16
        VcuTxMsg2_Sig2_oVcuTxMsg2_oTC37X_VCU_CAN00_c34c25d9_Tx: ComSignalType=SINT16
        VcuTxMsg2_Sig3_oVcuTxMsg2_oTC37X_VCU_CAN00_a04bfcfd_Tx: ComSignalType=SINT16
  module config Rte
    32 x RteBswModuleInstance:
      Adc
      BswM
        BswM_MainFunctionTimingEvent0 (RteBswEventToTaskMapping): RteBswUsedOsEventRef=Rte_Ev_Cyclic2_Bsw_Task_0_10ms, RteBswUsedOsAlarmRef=Os/Rte_Al_TE2_Bsw_Task_0_10ms
      Can
        3 x RteBswEventToTaskMapping, all with RteBswUsedOsEventRef=Rte_Ev_Cyclic2_Bsw_Task_0_10ms, RteBswUsedOsAlarmRef=Os/Rte_Al_TE2_Bsw_Task_0_10ms:
          Can_MainFunction_BusOffTimingEvent0
          Can_MainFunction_ModeTimingEvent0
          Can_MainFunction_WakeupTimingEvent0
      CanIf
      CanNm
        CanNm_MainFunctionTimingEvent0 (RteBswEventToTaskMapping): RteBswUsedOsEventRef=Rte_Ev_Cyclic2_Bsw_Task_0_10ms, RteBswUsedOsAlarmRef=Os/Rte_Al_TE2_Bsw_Task_0_10ms
      CanSM
        CanSM_MainFunctionTimingEvent0 (RteBswEventToTaskMapping): RteBswUsedOsEventRef=Rte_Ev_Cyclic2_Bsw_Task_0_10ms, RteBswUsedOsAlarmRef=Os/Rte_Al_TE2_Bsw_Task_0_10ms
      CanTp
        CanTp_MainFunctionTimingEvent0 (RteBswEventToTaskMapping): RteBswUsedOsEventRef=Rte_Ev_Cyclic2_Bsw_Task_0_5ms, RteBswUsedOsAlarmRef=Os/Rte_Al_TE2_Bsw_Task_0_5ms
      Com
        Com_MainFunctionRx_ComMainFunctionRxTimingEvent0 (RteBswEventToTaskMapping): RteBswUsedOsEventRef=Rte_Ev_Cyclic2_Bsw_Task_0_10ms, RteBswUsedOsAlarmRef=Os/Rte_Al_TE2_Bsw_Task_0_10ms
        Com_MainFunctionTx_ComMainFunctionTxTimingEvent0 (RteBswEventToTaskMapping): RteBswUsedOsEventRef=Rte_Ev_Cyclic2_Bsw_Task_0_10ms, RteBswUsedOsAlarmRef=Os/Rte_Al_TE2_Bsw_Task_0_10ms
      ComM
        8 x RteBswEventToTaskMapping, all with RteBswUsedOsEventRef=Rte_Ev_Cyclic2_Bsw_Task_0_20ms, RteBswUsedOsAlarmRef=Os/Rte_Al_TE2_Bsw_Task_0_20ms:
          ComM_MainFunction_{0..7}TimingEvent0
      Dcm
        Dcm_MainFunctionTimingEvent0 (RteBswEventToTaskMapping): RteBswUsedOsEventRef=Rte_Ev_Cyclic2_Bsw_Task_0_10ms, RteBswUsedOsAlarmRef=Os/Rte_Al_TE2_Bsw_Task_0_10ms
      Dem
        Dem_MasterMainFunctionTimingEvent0 (RteBswEventToTaskMapping): RteBswUsedOsEventRef=Rte_Ev_Cyclic2_Bsw_Task_0_10ms, RteBswUsedOsAlarmRef=Os/Rte_Al_TE2_Bsw_Task_0_10ms
        Dem_SatelliteMainFunctionTimingEvent0 (RteBswEventToTaskMapping): RteBswUsedOsEventRef=Rte_Ev_Cyclic2_Bsw_Task_0_10ms, RteBswUsedOsAlarmRef=Os/Rte_Al_TE2_Bsw_Task_0_10ms
      Det
      Dio
      Dma
      EcuM
        EcuM_MainFunctionTimingEvent0 (RteBswEventToTaskMapping): RteBswUsedOsEventRef=Rte_Ev_Cyclic2_Bsw_Task_0_10ms, RteBswUsedOsAlarmRef=Os/Rte_Al_TE2_Bsw_Task_0_10ms
      Fee
        Fee_MainFunctionTimingEvent0 (RteBswEventToTaskMapping): RteBswUsedOsEventRef=Rte_Ev_Cyclic2_Bsw_Task_0_10ms, RteBswUsedOsAlarmRef=Os/Rte_Al_TE2_Bsw_Task_0_10ms
      Fls
        Fls_17_Dmu_MainFunctionTimingEvent0 (RteBswEventToTaskMapping): RteBswUsedOsEventRef=Rte_Ev_Cyclic2_Bsw_Task_0_10ms, RteBswUsedOsAlarmRef=Os/Rte_Al_TE2_Bsw_Task_0_10ms
      Icu
      IoHwAb
      Irq
      LinIf
        LinIf_MainFunctionTimingEvent0 (RteBswEventToTaskMapping): RteBswUsedOsEventRef=Rte_Ev_Cyclic2_Bsw_Task_0_5ms, RteBswUsedOsAlarmRef=Os/Rte_Al_TE2_Bsw_Task_0_5ms
      LinSM
        LinSM_MainFunctionTimingEvent0 (RteBswEventToTaskMapping): RteBswUsedOsEventRef=Rte_Ev_Cyclic2_Bsw_Task_0_10ms, RteBswUsedOsAlarmRef=Os/Rte_Al_TE2_Bsw_Task_0_10ms
      LinTrcv
      McalLib
      Mcu
      Nm
      NvM
        NvM_MainFunctionTimingEvent0 (RteBswEventToTaskMapping): RteBswUsedOsEventRef=Rte_Ev_Cyclic2_Bsw_Task_0_10ms, RteBswUsedOsAlarmRef=Os/Rte_Al_TE2_Bsw_Task_0_10ms
      PduR
      Port
      Pwm
      Spi
        Spi_MainFunction_HandlingTimingEvent0 (RteBswEventToTaskMapping): RteBswUsedOsEventRef=Rte_Ev_Cyclic2_Bsw_Task_0_5ms, RteBswUsedOsAlarmRef=Os/Rte_Al_TE2_Bsw_Task_0_5ms
      Xcp
        CanXcp_MainFunctionTimingEvent0 (RteBswEventToTaskMapping): RteBswUsedOsEventRef=Rte_Ev_Cyclic2_Bsw_Task_0_5ms, RteBswUsedOsAlarmRef=Os/Rte_Al_TE2_Bsw_Task_0_5ms
        Xcp_MainFunctionTimingEvent0 (RteBswEventToTaskMapping): RteBswUsedOsEventRef=Rte_Ev_Cyclic2_Bsw_Task_0_5ms, RteBswUsedOsAlarmRef=Os/Rte_Al_TE2_Bsw_Task_0_5ms
    16 x RteSwComponentInstance:
      BswM_EcuSwComposition
        Timer_BswM_MainFunction (RteEventToTaskMapping): RteUsedOsEventRef=Rte_Ev_Cyclic2_Bsw_Task_0_10ms, RteUsedOsAlarmRef=Os/Rte_Al_TE2_Bsw_Task_0_10ms
      ComM_EcuSwComposition
        8 x RteEventToTaskMapping, all with RteUsedOsEventRef=Rte_Ev_Cyclic2_Bsw_Task_0_20ms, RteUsedOsAlarmRef=Os/Rte_Al_TE2_Bsw_Task_0_20ms:
          Timer_ComM_MainFunction_{0..7}
      Com_SWC_EcuSwComposition
        7 x RteEventToTaskMapping:
          TMT_Com_Runnable_2ms: RteUsedOsEventRef=Rte_Ev_Run_Com_SWC_Com_Runnable_2ms, RteUsedOsAlarmRef=Os/Rte_Al_TE_Com_SWC_Com_Runnable_2ms
          TMT_Com_Runnable_20ms: RteUsedOsEventRef=Rte_Ev_Run_Com_SWC_Com_Runnable_500ms, RteUsedOsAlarmRef=Os/Rte_Al_TE_Com_SWC_Com_Runnable_500ms
          DRT_Rte_Msg10Eh_Rx_Notification_Tle888qk_Out21_En_Tle888qk_Out21_En: RteUsedOsEventRef=Rte_Ev_Run_Com_SWC_Rte_Msg10Eh_Rx_Notification
          DRT_Rte_Msg10Fh_Rx_Notification_Bts7xx_HS1_En_Bts7xx_HS1_En: RteUsedOsEventRef=Rte_Ev_Run_Com_SWC_Rte_Msg10Fh_Rx_Notification
          DRT_Rte_Msg110h_Rx_Notification_Tle888qk_Lout1_En_Tle888qk_Lout1_En: RteUsedOsEventRef=Rte_Ev_Run_Com_SWC_Rte_Msg110h_Rx_Notification
          DRT_Rte_Msg200h_Rx_Notification_VcuRxMsg1_Sig0_VcuRxMsg1_Sig0: RteUsedOsEventRef=Rte_Ev_Run_Com_SWC_Rte_Msg200h_Rx_Notification
          DRT_Rte_Msg201h_Rx_Notification_VcuRxMsg2_Sig0_VcuRxMsg2_Sig0: RteUsedOsEventRef=Rte_Ev_Run_Com_SWC_Rte_Msg201h_Rx_Notification
      DIAG_SWC_EcuSwComposition
        TMT_DTCMonitorRunnable_10ms (RteEventToTaskMapping): RteUsedOsEventRef=Rte_Ev_Cyclic_AswTask_0_10ms, RteUsedOsAlarmRef=Os/Rte_Al_TE_AswTask_0_10ms
        NvmBlock_DIAG_SWC_NvBlockNeed_AttemptCounter (RteNvRamAllocation):
          RteNvmRamBlockLocationSymbol = Rte_DIAG_SWC_NvBlockNeed_AttemptCounter_MirrorBlock
          RteNvmRomBlockLocationSymbol = Rte_DIAG_SWC_NvBlockNeed_AttemptCounter_DefaultValue
          RteNvmBlockRef = DIAG_SWC_NvBlockNeed_AttemptCounter
        NvmBlock_DIAG_SWC_NvBlockNeed_DiagDID_00 (RteNvRamAllocation):
          RteNvmRamBlockLocationSymbol = Rte_DIAG_SWC_NvBlockNeed_DiagDID_00_MirrorBlock
          RteNvmRomBlockLocationSymbol = Rte_DIAG_SWC_NvBlockNeed_DiagDID_00_DefaultValue
          RteNvmBlockRef = DIAG_SWC_NvBlockNeed_DiagDID_00
      Dcm_EcuSwComposition
        Timer_Dcm_MainFunction (RteEventToTaskMapping): RteUsedOsEventRef=Rte_Ev_Cyclic2_Bsw_Task_0_10ms, RteUsedOsAlarmRef=Os/Rte_Al_TE2_Bsw_Task_0_10ms
      DemMaster_0_EcuSwComposition
        Timer_Dem_MasterMainFunction (RteEventToTaskMapping): RteUsedOsEventRef=Rte_Ev_Cyclic2_Bsw_Task_0_10ms, RteUsedOsAlarmRef=Os/Rte_Al_TE2_Bsw_Task_0_10ms
      DemSatellite_0_EcuSwComposition
        Timer_Dem_SatelliteMainFunction (RteEventToTaskMapping): RteUsedOsEventRef=Rte_Ev_Cyclic2_Bsw_Task_0_10ms, RteUsedOsAlarmRef=Os/Rte_Al_TE2_Bsw_Task_0_10ms
      Det_EcuSwComposition
      EcuM_EcuSwComposition
        Timer_EcuM_MainFunction (RteEventToTaskMapping): RteUsedOsEventRef=Rte_Ev_Cyclic2_Bsw_Task_0_10ms, RteUsedOsAlarmRef=Os/Rte_Al_TE2_Bsw_Task_0_10ms
      IoHwAb_EcuSwComposition
      IoHwAb_SWC_EcuSwComposition
        TMT_IoHwAb_SWC_Runnable (RteEventToTaskMapping): RteUsedOsEventRef=Rte_Ev_Cyclic_AswTask_0_10ms, RteUsedOsAlarmRef=Os/Rte_Al_TE_AswTask_0_10ms
      NvM_EcuSwComposition
        Timer_NvM_MainFunction (RteEventToTaskMapping): RteUsedOsEventRef=Rte_Ev_Cyclic2_Bsw_Task_0_10ms, RteUsedOsAlarmRef=Os/Rte_Al_TE2_Bsw_Task_0_10ms
      Os_OsCore0_swc_EcuSwComposition
      PowerMng_SWC_EcuSwComposition
        TMT_Led_Runnable1000ms (RteEventToTaskMapping): RteUsedOsEventRef=Rte_Ev_Run_PowerMng_SWC_Led_Runnable1000ms, RteUsedOsAlarmRef=Os/Rte_Al_TE_PowerMng_SWC_Led_Runnable1000ms
      SWC1_EcuSwComposition
        TMT_SWC1_Runnable10ms (RteEventToTaskMapping): RteUsedOsEventRef=Rte_Ev_Cyclic_AswTask_0_10ms, RteUsedOsAlarmRef=Os/Rte_Al_TE_AswTask_0_10ms
        NvmBlock_SWC1_NvBlockNeed_UserData3 (RteNvRamAllocation):
          RteNvmRamBlockLocationSymbol = Rte_SWC1_NvBlockNeed_UserData3_MirrorBlock
          RteNvmRomBlockLocationSymbol = Rte_SWC1_NvBlockNeed_UserData3_DefaultValue
          RteNvmBlockRef = SWC1NvBlockNeed_UserData3
      NvM_SWC_EcuSwComposition
        NvmBlock_NvM_SWC_NVNeed_NVBlockDescriptor_UserData1 (RteNvRamAllocation):
          RteNvmRomBlockLocationSymbol = Rte_NvM_SWC_NVBlockDescriptor_UserData1_ROM_NVBlockDescriptor_UserData1
          RteNvmBlockRef = NvM_SWC_NVBlockDescriptor_UserData1
        NvmBlock_NvM_SWC_NVNeed_NVBlockDescriptor_UserData2 (RteNvRamAllocation):
          RteNvmRomBlockLocationSymbol = Rte_NvM_SWC_NVBlockDescriptor_UserData2_ROM_NVBlockDescriptor_UserData2
          RteNvmBlockRef = NvM_SWC_NVBlockDescriptor_UserData2
    RteOsInteraction
      7 x RteUsedOsActivation, all with RteExpectedActivationOffset=0:
        Rte_Al_TE_AswTask_0_10ms: RteActivationOsAlarmRef=Os/Rte_Al_TE_AswTask_0_10ms, RteActivationOsTaskRef=AswTask
        Rte_Al_TE_Com_SWC_Com_Runnable_2ms: RteActivationOsAlarmRef=Os/Rte_Al_TE_Com_SWC_Com_Runnable_2ms, RteActivationOsTaskRef=AswTask
        Rte_Al_TE_Com_SWC_Com_Runnable_500ms: RteActivationOsAlarmRef=Os/Rte_Al_TE_Com_SWC_Com_Runnable_500ms, RteActivationOsTaskRef=AswTask
        Rte_Al_TE_PowerMng_SWC_Led_Runnable1000ms: RteActivationOsAlarmRef=Os/Rte_Al_TE_PowerMng_SWC_Led_Runnable1000ms, RteActivationOsTaskRef=AswTask
        Rte_Al_TE2_Bsw_Task_0_10ms: RteActivationOsAlarmRef=Os/Rte_Al_TE2_Bsw_Task_0_10ms, RteActivationOsTaskRef=Bsw_Task
        Rte_Al_TE2_Bsw_Task_0_20ms: RteActivationOsAlarmRef=Os/Rte_Al_TE2_Bsw_Task_0_20ms, RteActivationOsTaskRef=Bsw_Task
        Rte_Al_TE2_Bsw_Task_0_5ms: RteActivationOsAlarmRef=Os/Rte_Al_TE2_Bsw_Task_0_5ms, RteActivationOsTaskRef=Bsw_Task
  module config NvM
    NvMCommonVendorParams: NvMCfgCbkIncludeList=Rte_Cbk.h
    5 x NvMBlockDescriptor:
      NvM_SWC_NVBlockDescriptor_UserData1: NvMNvBlockLength=10, NvMRomBlockDataAddress=Rte_NvM_SWC_NVBlockDescriptor_UserData1_ROM_NVBlockDescriptor_UserData1, NvMBlockUseSyncMechanism=true, NvMWriteRamBlockToNvCallback=Rte_GetMirror_NvM_SWC_NVBlockDescriptor_UserData1, NvMReadRamBlockFromNvCallback=Rte_SetMirror_NvM_SWC_NVBlockDescriptor_UserData1, NvMUseJobendCallback=true, NvMSingleBlockCallback=Rte_NvMNotifyJobFinished_NvM_SWC_NVBlockDescriptor_UserData1, NvMInitBlockCallback=NULL_PTR, NvMUseServicePorts=false
      NvM_SWC_NVBlockDescriptor_UserData2: NvMNvBlockLength=32, NvMRomBlockDataAddress=Rte_NvM_SWC_NVBlockDescriptor_UserData2_ROM_NVBlockDescriptor_UserData2, NvMBlockUseSyncMechanism=true, NvMWriteRamBlockToNvCallback=Rte_GetMirror_NvM_SWC_NVBlockDescriptor_UserData2, NvMReadRamBlockFromNvCallback=Rte_SetMirror_NvM_SWC_NVBlockDescriptor_UserData2, NvMUseJobendCallback=true, NvMSingleBlockCallback=Rte_NvMNotifyJobFinished_NvM_SWC_NVBlockDescriptor_UserData2, NvMInitBlockCallback=NULL_PTR, NvMUseServicePorts=false
      DIAG_SWC_NvBlockNeed_AttemptCounter: NvMNvBlockLength=1, NvMRamBlockDataAddress=Rte_DIAG_SWC_NvBlockNeed_AttemptCounter_MirrorBlock, NvMRomBlockDataAddress=Rte_DIAG_SWC_NvBlockNeed_AttemptCounter_DefaultValue
      DIAG_SWC_NvBlockNeed_DiagDID_00: NvMNvBlockLength=4, NvMRamBlockDataAddress=Rte_DIAG_SWC_NvBlockNeed_DiagDID_00_MirrorBlock, NvMRomBlockDataAddress=Rte_DIAG_SWC_NvBlockNeed_DiagDID_00_DefaultValue
      SWC1NvBlockNeed_UserData3: NvMNvBlockLength=10, NvMRamBlockDataAddress=Rte_SWC1_NvBlockNeed_UserData3_MirrorBlock, NvMRomBlockDataAddress=Rte_SWC1_NvBlockNeed_UserData3_DefaultValue
  module config Os
    AswTask (OsTask):
      OsTaskActivation = 1
      OsTaskPriority = 64
      OsTaskSchedule = FULL
      OsTaskEventRef = Rte_Ev_Cyclic_AswTask_0_10ms
      OsTaskEventRef = Rte_Ev_Run_Com_SWC_Com_Runnable_2ms
      OsTaskEventRef = Rte_Ev_Run_Com_SWC_Com_Runnable_500ms
      OsTaskEventRef = Rte_Ev_Run_Com_SWC_Rte_Msg10Eh_Rx_Notification
      OsTaskEventRef = Rte_Ev_Run_Com_SWC_Rte_Msg10Fh_Rx_Notification
      OsTaskEventRef = Rte_Ev_Run_Com_SWC_Rte_Msg110h_Rx_Notification
      OsTaskEventRef = Rte_Ev_Run_Com_SWC_Rte_Msg200h_Rx_Notification
      OsTaskEventRef = Rte_Ev_Run_Com_SWC_Rte_Msg201h_Rx_Notification
      OsTaskEventRef = Rte_Ev_Run_NvM_SWC_NvM_SWC_UserData1_Runnable
      OsTaskEventRef = Rte_Ev_Run_NvM_SWC_NvM_SWC_UserData2_Runnable
      OsTaskEventRef = Rte_Ev_Run_PowerMng_SWC_Led_Runnable1000ms
    4 x OsAlarm, all with OsAlarmCounterRef=SystemTimer:
      Rte_Al_TE_AswTask_0_10ms
        OsAlarmAction
          OsAlarmSetEvent: OsAlarmSetEventRef=Rte_Ev_Cyclic_AswTask_0_10ms, OsAlarmSetEventTaskRef=AswTask
      Rte_Al_TE_Com_SWC_Com_Runnable_2ms
        OsAlarmAction
          OsAlarmSetEvent: OsAlarmSetEventRef=Rte_Ev_Run_Com_SWC_Com_Runnable_2ms, OsAlarmSetEventTaskRef=AswTask
      Rte_Al_TE_Com_SWC_Com_Runnable_500ms
        OsAlarmAction
          OsAlarmSetEvent: OsAlarmSetEventRef=Rte_Ev_Run_Com_SWC_Com_Runnable_500ms, OsAlarmSetEventTaskRef=AswTask
      Rte_Al_TE_PowerMng_SWC_Led_Runnable1000ms
        OsAlarmAction
          OsAlarmSetEvent: OsAlarmSetEventRef=Rte_Ev_Run_PowerMng_SWC_Led_Runnable1000ms, OsAlarmSetEventTaskRef=AswTask
    Asw_Init (OsTask): OsTaskActivation=1, OsTaskPriority=63, OsTaskSchedule=FULL
    Bsw_Task (OsTask):
      OsTaskActivation = 1
      OsTaskPriority = 65
      OsTaskSchedule = FULL
      OsTaskEventRef = Rte_Ev_Cyclic2_Bsw_Task_0_10ms
      OsTaskEventRef = Rte_Ev_Cyclic2_Bsw_Task_0_20ms
      OsTaskEventRef = Rte_Ev_Cyclic2_Bsw_Task_0_5ms
    3 x OsAlarm, all with OsAlarmCounterRef=SystemTimer:
      Rte_Al_TE2_Bsw_Task_0_10ms
        OsAlarmAction
          OsAlarmSetEvent: OsAlarmSetEventRef=Rte_Ev_Cyclic2_Bsw_Task_0_10ms, OsAlarmSetEventTaskRef=Bsw_Task
      Rte_Al_TE2_Bsw_Task_0_20ms
        OsAlarmAction
          OsAlarmSetEvent: OsAlarmSetEventRef=Rte_Ev_Cyclic2_Bsw_Task_0_20ms, OsAlarmSetEventTaskRef=Bsw_Task
      Rte_Al_TE2_Bsw_Task_0_5ms
        OsAlarmAction
          OsAlarmSetEvent: OsAlarmSetEventRef=Rte_Ev_Cyclic2_Bsw_Task_0_5ms, OsAlarmSetEventTaskRef=Bsw_Task
    14 x OsEvent:
      Rte_Ev_Cyclic2_Bsw_Task_0_10ms
      Rte_Ev_Cyclic2_Bsw_Task_0_20ms
      Rte_Ev_Cyclic2_Bsw_Task_0_5ms
      Rte_Ev_Cyclic_AswTask_0_10ms
      Rte_Ev_Run_Com_SWC_Com_Runnable_2ms
      Rte_Ev_Run_Com_SWC_Com_Runnable_500ms
      Rte_Ev_Run_Com_SWC_Rte_Msg10Eh_Rx_Notification
      Rte_Ev_Run_Com_SWC_Rte_Msg10Fh_Rx_Notification
      Rte_Ev_Run_Com_SWC_Rte_Msg110h_Rx_Notification
      Rte_Ev_Run_Com_SWC_Rte_Msg200h_Rx_Notification
      Rte_Ev_Run_Com_SWC_Rte_Msg201h_Rx_Notification
      Rte_Ev_Run_NvM_SWC_NvM_SWC_UserData1_Runnable
      Rte_Ev_Run_NvM_SWC_NvM_SWC_UserData2_Runnable
      Rte_Ev_Run_PowerMng_SWC_Led_Runnable1000ms
  module config EcuC
  ecuc value collection DaVinci_Project: ecuc-values=[Com, Rte, Os, EcuC, NvM]
